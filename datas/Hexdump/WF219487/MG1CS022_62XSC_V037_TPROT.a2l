ASAP2_VERSION 1 60
/begin PROJECT MG1CS022 "MG1CS022"
/begin HEADER "" VERSION "MG1CS022_62XSC_V037_TPROT" PROJECT_NO MG1CS022 /end HEADER
/begin MODULE DIM ""
/begin MOD_COMMON "" BYTE_ORDER MSB_LAST ALIGNMENT_BYTE 1 ALIGNMENT_WORD 2 ALIGNMENT_LONG 4 ALIGNMENT_INT64 4 ALIGNMENT_FLOAT32_IEEE 4 ALIGNMENT_FLOAT64_IEEE 4 DATA_SIZE 32 /end MOD_COMMON
/begin CHARACTERISTIC MoCMem_ctDebErrChkRAM_C "Error tolerance threshold for double storage and cyclic RAM-Test" VALUE 0x805914D0 Val_Wu8 255.0 dez 0.00 255.0 FORMAT "%5.1" /end CHARACTERISTIC
/begin CHARACTERISTIC MoCMem_ctDebErrChkROM_C "Error tolerance threshold for cyclic ROM-Test" VALUE 0x805914D1 Val_Wu8 255.0 dez 0.00 255.0 FORMAT "%5.1" /end CHARACTERISTIC
/begin CHARACTERISTIC MoCMem_ctDebHealChkRAMCpl_C "Complement of the tolerance threshold of the healing counter for the double storage and the cyclical RAM-tests" VALUE 0x80595C88 Val_Wu8 255.0 dez 0.00 255.0 FORMAT "%5.1" /end CHARACTERISTIC
/begin CHARACTERISTIC MoCMem_ctDebHealChkRAM_C "Tolerance threshold of the healing counter for the double storage and the cyclical RAM-tests" VALUE 0x805914D2 Val_Wu8 255.0 dez 0.00 255.0 FORMAT "%5.1" /end CHARACTERISTIC
/begin CHARACTERISTIC MoCMem_ctDebHealChkROMCpl_C "Complement of the tolerance threshold of the healing counter for the cyclical ROM-tests" VALUE 0x80595C89 Val_Wu8 255.0 dez 0.00 255.0 FORMAT "%5.1" /end CHARACTERISTIC
/begin CHARACTERISTIC MoCMem_ctDebHealChkROM_C "Tolerance threshold of the healing counter for the cyclical ROM-tests" VALUE 0x805914D3 Val_Wu8 255.0 dez 0.00 255.0 FORMAT "%5.1" /end CHARACTERISTIC
/begin CHARACTERISTIC MoCMem_noMEMChkRstCpl_CW "Double storage for MoCMem_noMEMChkRst_CW" VALUE 0x80595C8A Val_Wu8 255.0 dez 0.00 255.0 FORMAT "%5.1" /end CHARACTERISTIC
/begin CHARACTERISTIC MoCMem_noMEMChkRst_CW "Disables the error reaction found during the cyclical memory check (Depends on MOCMEM_CONF_SERIES_TOOLCHAIN and MO_ROM_SY)" VALUE 0x805914D4 Val_Wu8 255.0 dez 0.00 255.0 FORMAT "%5.1" /end CHARACTERISTIC
/begin CHARACTERISTIC MoCMem_numRamChk_C "Number of 32-bit memory cells to be tested in cyclical RAM-check" VALUE 0x80591ADC Val_Wu16 65535.00 dez 0.00 65535.00 FORMAT "%8.2" /end CHARACTERISTIC
/begin CHARACTERISTIC MoCMem_numRomChk_CA "Number of 32-bit memory cells to be tested in cyclical ROM-check." VAL_BLK 0x80591ADE ValA_Wu16 65535.00 dez 0.00 65535.00 FORMAT "%8.2" NUMBER 4 /end CHARACTERISTIC
/begin CHARACTERISTIC MoCMem_RamTst_CW "Code word for simulating error in cyclic RAM, Stack and CSA test" VALUE 0x80595C8B Val_Wu8 255.0 dez 0.00 255.0 FORMAT "%5.1" /end CHARACTERISTIC
/begin CHARACTERISTIC MoCMem_RomTst_CW "code word for requiring the reaction test of the cyclic ROM test" VALUE 0x80595C8C Val_Wu8 255.0 dez 0.00 255.0 FORMAT "%5.1" /end CHARACTERISTIC
/begin CHARACTERISTIC MoCMem_stSwtAutRamChkConf_C "Switch to select automatic configuration of block size for the cyclic RAM check" VALUE 0x805914D5 Val_Wu8 255.0 dez 0.00 255.0 FORMAT "%5.1" /end CHARACTERISTIC
/begin CHARACTERISTIC MoCMem_stSwtAutRomChkConf_C "Switch to select automatic configuration of block size for the cyclic ROM check" VALUE 0x805914D6 Val_Wu8 255.0 dez 0.00 255.0 FORMAT "%5.1" /end CHARACTERISTIC
/begin CHARACTERISTIC MoCPFC_stPtlRespTestActv_CW "codeword to simulate wrong PFC response error" VALUE 0x80595C8E Val_Wu8 255.0 dez 0.00 255.0 FORMAT "%5.1" /end CHARACTERISTIC
/begin CHARACTERISTIC MoCSCC_cntrDebMax_C "Debounce counter for configuration check error" VALUE 0x805914D8 Val_Wu8 255.0 dez 0.00 255.0 FORMAT "%5.1" /end CHARACTERISTIC
/begin CHARACTERISTIC MoCSCC_stSCCTstActv_CW "status bits to simulate the safety feature configuration check fault" VALUE 0x80595CB0 Val_Wu16 65535.00 dez 0.00 65535.00 FORMAT "%8.2" /end CHARACTERISTIC
/begin CHARACTERISTIC MoCSCC_swtDisblEmmChk_CA "Disable activation check of EMM events, each bit corresponds to a specific EMM event" VAL_BLK 0x80591AA0 ValA_Wu32 4294967295.00 OneToOne 0.00 4294967295.00 FORMAT "%13.2" NUMBER 12 /end CHARACTERISTIC
/begin CHARACTERISTIC MoCSCC_swtLfastWrkarndActv_CW "Deactivation of crossbar MPU check for activation of LFAST interface" VALUE 0x805914D9 Val_Wu8 255.0 dez 0.00 255.0 FORMAT "%5.1" /end CHARACTERISTIC
/begin CHARACTERISTIC MoCSOP_cntrDebCtrlLinesActvThd_C "Debounce level to determine a robust calibration of debounce counter for control lines active during positive test" VALUE 0x80595C90 Val_Wu8 255.0 dez 0.00 255.0 FORMAT "%5.1" /end CHARACTERISTIC
/begin CHARACTERISTIC MoCSOP_cntrFrMacroTicEnd_C "Synchronisation of FlexRay Shutoff Path Test with specified MacroTick (Slot-End)" VALUE 0x80591AE6 Val_Wu16 65535.00 dez 0.00 65535.00 FORMAT "%8.2" /end CHARACTERISTIC
/begin CHARACTERISTIC MoCSOP_cntrFrMacroTicStrt_C "Synchronisation of FlexRay Shutoff Path Test with specified MacroTick (Slot-Start)" VALUE 0x80591AE8 Val_Wu16 65535.00 dez 0.00 65535.00 FORMAT "%8.2" /end CHARACTERISTIC
/begin CHARACTERISTIC MoCSOP_ctDebCANFrTest_C "Debounce counter for the maximum timeout deviation in the CAN and FlexRay test" VALUE 0x805914DA Val_Wu8 255.0 dez 0.00 255.0 FORMAT "%5.1" /end CHARACTERISTIC
/begin CHARACTERISTIC MoCSOP_ctDebSOPTst_C "Maximum duration of the power stages shut-off path test" VALUE 0x80591AEA Val_Wu16 65535.00 dez 0.00 65535.00 FORMAT "%8.2" /end CHARACTERISTIC
/begin CHARACTERISTIC MoCSOP_ctDebSycDrv_C "Maximum number of debounce count to confirm the Syc_stSub state to support secure engine off feature" VALUE 0x805914DB Val_Wu8 255.0 dez 0.00 255.0 FORMAT "%5.1" /end CHARACTERISTIC
/begin CHARACTERISTIC MoCSOP_ctRstCANFrTest_C "Limit of resets executed in CANFR shut off path test" VALUE 0x805914DC Val_Wu8 255.0 dez 0.00 255.0 FORMAT "%5.1" /end CHARACTERISTIC
/begin CHARACTERISTIC MoCSOP_ctRst_C "limit of resets executed in shut off path test" VALUE 0x805914DD Val_Wu8 255.0 dez 0.00 255.0 FORMAT "%5.1" /end CHARACTERISTIC
/begin CHARACTERISTIC MoCSOP_nEngMaxOVLthDisbl_C "Maximum engine speed for activating the overvoltage latch in the VDD5 monitoring hardware" VALUE 0x80591AEC Val_Ws16 32767.50 EngN -16384.00 16383.50 FORMAT "%8.2" /end CHARACTERISTIC
/begin CHARACTERISTIC MoCSOP_stCANErrReac_CW "codeword for activating the error reaction CAN-driver-disabling" VALUE 0x805914DE Val_Wu8 255.0 dez 0.00 255.0 FORMAT "%5.1" /end CHARACTERISTIC
/begin CHARACTERISTIC MoCSOP_stCANTestActv_CW "Test label for ECU-MST purpose for CANFR test" VALUE 0x80595C91 Val_Wu8 1.000 dez 0.00 1.000 FORMAT "%5.3" EXTENDED_LIMITS 0.00 255.0 /end CHARACTERISTIC
/begin CHARACTERISTIC MoCSOP_stErrReactnERPN_CA "Includes the error reaction type based on the error combinations of ERPN-Errorpin path" VAL_BLK 0x805914DF ValA_Wu8 2.00000000000 MoCSOP_stErrReactnERPN_CA_Compu 0.00 2.00000000000 FORMAT "%13.11" NUMBER 4 /end CHARACTERISTIC
/begin CHARACTERISTIC MoCSOP_stErrReactn_CA "Includes the error reaction type based on the error combinations of InjVlv and PVMT shut off paths" VAL_BLK 0x805914E3 ValA_Wu8 2.00000000000 MoCSOP_stErrReactn_CA_Compu 0.00 2.00000000000 FORMAT "%13.11" NUMBER 16 /end CHARACTERISTIC
/begin CHARACTERISTIC MoCSOP_stMMErrReac_CW "code word for activating the fault reaction MM reset" VALUE 0x805914F3 Val_Wu8 255.0 dez 0.00 255.0 FORMAT "%5.1" /end CHARACTERISTIC
/begin CHARACTERISTIC MoCSOP_stOVErrReactn_C "Error reaction for an error in overvoltage test" VALUE 0x805914F4 Val_Wu8 1.00000000000 MoCSOP_stOVErrReactn_C_Compu 1.00000000000 2.00000000000 FORMAT "%13.11" /end CHARACTERISTIC
/begin CHARACTERISTIC MoCSOP_stReqCANFrTest_C "Calibration to decide for the execution of CANFR test" VALUE 0x805914F5 Val_Wu8 255.0 dez 0.00 255.0 FORMAT "%5.1" /end CHARACTERISTIC
/begin CHARACTERISTIC MoCSOP_stSWResetDem_CW "Status-Bit for Software-Reset demand in case of shut-off path test error" VALUE 0x805914F6 Val_Wu8 255.0 dez 0.00 255.0 FORMAT "%5.1" /end CHARACTERISTIC
/begin CHARACTERISTIC MoCSOP_stTestActv_CW "Codeword to activate MFT and check the error reaction from shut off path test" VALUE 0x80595C92 Val_Wu8 1.000 dez 0.00 1.000 FORMAT "%5.3" EXTENDED_LIMITS 0.00 255.0 /end CHARACTERISTIC
/begin CHARACTERISTIC MoCSOP_swtAlwysPsTest_C "Switch to select repetition of power stage SOP test in case of broken after run" VALUE 0x805914F7 Val_Wu8 1.000 dez 0.00 1.000 FORMAT "%5.3" EXTENDED_LIMITS 0.00 255.0 /end CHARACTERISTIC
/begin CHARACTERISTIC MoCSOP_swtRepFaildPESTest_C "Switch to repeat the complete MoCSOP test in case of an aborted after-run if there was an error in previous CAN-FR, Injection Control lines test" VALUE 0x805914F8 Val_Wu8 1.000 dez 0.00 1.000 FORMAT "%5.3" EXTENDED_LIMITS 0.00 255.0 /end CHARACTERISTIC
/begin CHARACTERISTIC MoFACC_swtCANEna_C "Calibration to enabledisable CAN extraction" VALUE 0x805914FA Val_Wu8 1.00000000000 B_TRUE 0.00 1.00000000000 FORMAT "%13.11" /end CHARACTERISTIC
/begin AXIS_PTS MoFAirFlEta_agIntkClsdHiRes_Ax "Actual position intake valve closed (0.5 mm cylinder individuel) distribution - High resolution" 0x80591B14 MoFAirFl_agIntkClsd Axis_Xs16 1023.984 kw_q0p0156 35 -512.0000 511.9844 FORMAT "%8.4" DEPOSIT ABSOLUTE /end AXIS_PTS
/begin AXIS_PTS MoFAirFlEta_agIntkClsd_Ax "Actual position intake valve closed (0.5 mm cylinder individuel) distribution" 0x80591B5C MoFAirFl_agIntkClsd Axis_Xs16 1023.984 kw_q0p0156 7 -512.0000 511.9844 FORMAT "%8.4" DEPOSIT ABSOLUTE /end AXIS_PTS
/begin AXIS_PTS MoFAirFlEta_nEngHiRes_Ax "Data point distribution for high resolution engine speed" 0x80591520 MoFESpd_nEng Axis_Xu8 10200. nmot_q40 60 0.00 10200. FORMAT "%5.0" DEPOSIT ABSOLUTE /end AXIS_PTS
/begin AXIS_PTS MoFAirFlEta_nEng_Ax "Data point distribution for engine speed" 0x8059155D MoFESpd_nEng Axis_Xu8 10200. nmot_q40 12 0.00 10200. FORMAT "%5.0" DEPOSIT ABSOLUTE /end AXIS_PTS
/begin AXIS_PTS MoFAirFlEta_ratFillgHiRes_Ax "High resolution data point distribution for air charge" 0x80591B6C MoFAirFl_ratFillg Axis_Xu16 1535.977 rel_uw_q0p0234 60 0.00 1535.977 FORMAT "%8.3" DEPOSIT ABSOLUTE /end AXIS_PTS
/begin AXIS_PTS MoFAirFlEta_ratFillg_Ax "Axis grid distribution for air charge" 0x80591BE6 MoFAirFl_ratFillg Axis_Xu16 1535.977 rel_uw_q0p0234 12 0.00 1535.977 FORMAT "%8.3" DEPOSIT ABSOLUTE /end AXIS_PTS
/begin CHARACTERISTIC MoFAirFl_cntrAfimActvMax_C "Max. allowed AFIM active time in function monitoring" VALUE 0x80591B10 Val_Wu16 65535.00 OneToOne 0.00 65535.00 FORMAT "%8.2" /end CHARACTERISTIC
/begin CHARACTERISTIC MoFAirFl_cntrComNEngDynMin_C "Correction expected value minimum count of syncs dependent on speed dynamics in function monitoring" VALUE 0x80591570 Val_Wu8 255.0 OneToOne 0.00 255.0 FORMAT "%5.1" /end CHARACTERISTIC
/begin CHARACTERISTIC MoFAirFl_cntrErrDebMaxCtOffGdi_C "Max. allowed error debounce time in function MoFAirFl_CtOffGdi" VALUE 0x80591512 Val_Wu8 255.0 OneToOne 0.00 255.0 FORMAT "%5.1" /end CHARACTERISTIC
/begin CHARACTERISTIC MoFAirFl_cntrErrDebMaxCylGdi_C "Max. allowed error debounce time in function MoFAirFl_CylGdi" VALUE 0x80591516 Val_Wu8 255.0 OneToOne 0.00 255.0 FORMAT "%5.1" /end CHARACTERISTIC
/begin CHARACTERISTIC MoFAirFl_cntrErrDebMaxFF_C "Max. allowed error debounce time in function MoFAirFl_FF" VALUE 0x8059156C Val_Wu8 255.0 OneToOne 0.00 255.0 FORMAT "%5.1" /end CHARACTERISTIC
/begin CHARACTERISTIC MoFAirFl_cntrErrDebMaxInCom_C "Max. allowed error debounce time in function MoFAirFl_In" VALUE 0x80591571 Val_Wu8 255.0 OneToOne 0.00 255.0 FORMAT "%5.1" /end CHARACTERISTIC
/begin CHARACTERISTIC MoFAirFl_cntrErrDebMaxMixCtlGdiChkAirFl_C "Max. allowed error debounce time in function MoFAirFl_MixCtlGdi (AirFl)" VALUE 0x8059157C Val_Wu8 255.0 OneToOne 0.00 255.0 FORMAT "%5.1" /end CHARACTERISTIC
/begin CHARACTERISTIC MoFAirFl_cntrErrDebMaxMixCtlGdiChkCtrl_C "Max. allowed error debounce time in function MoFAirFl_MixCtlGdi (Ctrl)" VALUE 0x8059157D Val_Wu8 255.0 OneToOne 0.00 255.0 FORMAT "%5.1" /end CHARACTERISTIC
/begin CHARACTERISTIC MoFAirFl_cntrFuAdpnActvMax_C "Max. tolerable time counter for flexfuel adaption check in function monitoring" VALUE 0x80594C42 Val_Wu16 65535.00 OneToOne 0.00 65535.00 FORMAT "%8.2" /end CHARACTERISTIC
/begin CHARACTERISTIC MoFAirFl_cntrRstMaxCtOffGdi_C "Maximum number of Pre-ICO-Resets in function MoFAirFl_CtOffGdi" VALUE 0x80591513 Val_Wu8 255.0 OneToOne 0.00 255.0 FORMAT "%5.1" /end CHARACTERISTIC
/begin CHARACTERISTIC MoFAirFl_cntrRstMaxCylGdi_C "Maximum number of Pre-ICO-Resets in function MoFAirFl_CylGdi" VALUE 0x80591517 Val_Wu8 255.0 OneToOne 0.00 255.0 FORMAT "%5.1" /end CHARACTERISTIC
/begin CHARACTERISTIC MoFAirFl_cntrRstMaxFF_C "Maximum number of Pre-ICO-Resets in function MoFAirFl_FF" VALUE 0x8059156D Val_Wu8 255.0 OneToOne 0.00 255.0 FORMAT "%5.1" /end CHARACTERISTIC
/begin CHARACTERISTIC MoFAirFl_cntrRstMaxInCom_C "Maximum number of Pre-ICO-Resets in function MoFAirFl_In" VALUE 0x80591572 Val_Wu8 255.0 OneToOne 0.00 255.0 FORMAT "%5.1" /end CHARACTERISTIC
/begin CHARACTERISTIC MoFAirFl_cntrRstMaxMixCtlGdiChkAirFl_C "Maximum number of Pre-ICO-Resets in function MoFAirFl_MixCtlGdi (AirFl)" VALUE 0x8059157E Val_Wu8 255.0 OneToOne 0.00 255.0 FORMAT "%5.1" /end CHARACTERISTIC
/begin CHARACTERISTIC MoFAirFl_cntrRstMaxMixCtlGdiChkCtrl_C "Maximum number of Pre-ICO-Resets in function MoFAirFl_MixCtlGdi (Ctrl)" VALUE 0x8059157F Val_Wu8 255.0 OneToOne 0.00 255.0 FORMAT "%5.1" /end CHARACTERISTIC
/begin CHARACTERISTIC MoFAirFl_diaChrgMtnHiRes_M "High resolution correction of the optimized model reference ignition angle depending on charge motion due to intake opening" MAP 0x80591C00 MapG_Ws16 6553.500 zw_q0p1 -3276.800 3276.700 FORMAT "%8.3"
 /begin AXIS_DESCR COM_AXIS MoFESpd_nEng nmot_q40 60 0.00 10200. FORMAT "%5.0" AXIS_PTS_REF MoFAirFlEta_nEngHiRes_Ax /end AXIS_DESCR
 /begin AXIS_DESCR COM_AXIS MoFAirFl_agIntkClsd kw_q0p0156 35 -512.0000 511.9844 FORMAT "%8.4" AXIS_PTS_REF MoFAirFlEta_agIntkClsdHiRes_Ax /end AXIS_DESCR
/end CHARACTERISTIC
/begin CHARACTERISTIC MoFAirFl_etaDeltaIgnAgAirChrgWHiRes_M "High resolution air charge dependent ignition angle efficiency unsing extended range for air charge" MAP 0x80592C68 Map_Xs16Ys16Ws16 1.999939 fak_uw_b4 0.00 1.999939 FORMAT "%8.6" EXTENDED_LIMITS -2.000000 1.999939
 /begin AXIS_DESCR STD_AXIS NO_INPUT_QUANTITY zw_q0p1 40 0.00 3276.700 FORMAT "%8.3" EXTENDED_LIMITS -3276.800 3276.700 DEPOSIT ABSOLUTE /end AXIS_DESCR
 /begin AXIS_DESCR STD_AXIS NO_INPUT_QUANTITY rel_uw_q0p0234 8 0.00 767.9766 FORMAT "%8.4" EXTENDED_LIMITS -768.0000 767.9766 DEPOSIT ABSOLUTE /end AXIS_DESCR
/end CHARACTERISTIC
/begin CHARACTERISTIC MoFAirFl_etaFuMSpltMin_C "Min threshold value for injection split efficiency in function monitoring" VALUE 0x80592F4C Val_Wu16 1.999969 fak_uw_b2 0.00 1.999969 FORMAT "%8.6" /end CHARACTERISTIC
/begin CHARACTERISTIC MoFAirFl_etaLam_T "Lambda efficiency in function monitoring" CURVE 0x80592F4E ValA_Wu16 1.999969 fak_uw_b2 0.00 1.999969 FORMAT "%8.6"
 /begin AXIS_DESCR COM_AXIS MoFAirFl_ratLamSp fak_uw_b16 8 0.00 15.99976 FORMAT "%8.5" AXIS_PTS_REF MoFAirFl_ratLamSp_Ax /end AXIS_DESCR
/end CHARACTERISTIC
/begin CHARACTERISTIC MoFAirFl_facAftStrtCorrnGdiMax_T "Maximum after-start adaption value in function monitoring (GDI)" CURVE 0x80594C4E ValA_Wu16 63.99902 fak_uw_b64 0.00 63.99902 FORMAT "%8.5"
 /begin AXIS_DESCR COM_AXIS MoF_tEng temp_ub_q0p75_o48 8 -48.0 143.3 FORMAT "%5.1" AXIS_PTS_REF MoF_tEng_DST /end AXIS_DESCR
/end CHARACTERISTIC
/begin CHARACTERISTIC MoFAirFl_facCorFuAvrgMax_C "Maximum permitted average value for cylinder individual fuel correction in function monitoring" VALUE 0x80591B12 Val_Wu16 1.999969 fak_uw_b2 0.00 1.999969 FORMAT "%8.6" /end CHARACTERISTIC
/begin CHARACTERISTIC MoFAirFl_facCorrnFuMCylIndAfimMax_C "Max. allowed value cylinder individual fuel corrections (AFIM) in function monitoring" VALUE 0x80591518 Val_Wu8 1.992188 fak_ub_b2 0.00 1.992188 FORMAT "%8.6" /end CHARACTERISTIC
/begin CHARACTERISTIC MoFAirFl_facCorrnFuMCylIndMax_C "Max. allowed value cylinder individual fuel corrections in function monitoring" VALUE 0x80591519 Val_Wu8 1.992188 fak_ub_b2 0.00 1.992188 FORMAT "%8.6" /end CHARACTERISTIC
/begin CHARACTERISTIC MoFAirFl_facFFAvrg_C "Substitute value of the ethanol content in case of sensor failure after diagnosis confirmation" VALUE 0x80594C44 Val_Wu16 1.999969 fak_uw_b2 0.00 1.999969 FORMAT "%8.6" /end CHARACTERISTIC
/begin CHARACTERISTIC MoFAirFl_facFuAdpnMax_C "Max. tolerable flexfuel adaption factor in function monitoring" VALUE 0x80594C46 Val_Wu16 1.999969 fak_uw_b2 0.00 1.999969 FORMAT "%8.6" /end CHARACTERISTIC
/begin CHARACTERISTIC MoFAirFl_facFuAdpnMin_C "Min. tolerable flexfuel adaption factor in function monitoring" VALUE 0x80594C48 Val_Wu16 1.999969 fak_uw_b2 0.00 1.999969 FORMAT "%8.6" /end CHARACTERISTIC
/begin CHARACTERISTIC MoFAirFl_facFuAdpnTolcOfs_C "Offset for check of flexfuel adaption factor in function monitoring" VALUE 0x80594C4A Val_Wu16 1.999969 fak_uw_b2 0.00 1.999969 FORMAT "%8.6" /end CHARACTERISTIC
/begin CHARACTERISTIC MoFAirFl_facLamAdpnMax_T "maximal permissible air-fuel-ratio adaption in monitoring function" CURVE 0x80594C5E Mo_DataCurveSstU16WU16 1.999969 fak_uw_b2 0.00 1.999969 FORMAT "%8.6"
 /begin AXIS_DESCR STD_AXIS NO_INPUT_QUANTITY nmot_q40 4 0.00 2621400. FORMAT "%8.0" DEPOSIT ABSOLUTE /end AXIS_DESCR
/end CHARACTERISTIC
/begin CHARACTERISTIC MoFAirFl_facLamCtrlMax_C "Max. allowed value lambda control in function monitoring" VALUE 0x80594C70 Val_Wu16 1.999969 fak_uw_b2 0.00 1.999969 FORMAT "%8.6" /end CHARACTERISTIC
/begin CHARACTERISTIC MoFAirFl_facMixCorrnLivcMax_C "Max. allowed value mixture correction (LIVC) in function monitoring" VALUE 0x80594C72 Val_Wu16 1.999969 fak_uw_b2 0.00 1.999969 FORMAT "%8.6" /end CHARACTERISTIC
/begin CHARACTERISTIC MoFAirFl_facTolrChkCpv_C "Factor tolerance in check of canister purge in function monitoring" VALUE 0x80594C74 Val_Ws16 1.999969 fak_sw_b1 -1.000000 0.999969 FORMAT "%8.6" EXTENDED_LIMITS -1.000000 0.9999695 /end CHARACTERISTIC
/begin CHARACTERISTIC MoFAirFl_facTolrChkRatFuMCylIndMax_C "Factor maximum tolerance in check of cylinder-individual fuel in function monitoring" VALUE 0x8059151A Val_Wu8 1.992188 fak_ub_b2 0.00 1.992188 FORMAT "%8.6" /end CHARACTERISTIC
/begin CHARACTERISTIC MoFAirFl_facTolrChkRatFuMCylIndMin_C "Factor minimum tolerance in check of cylinder-individual fuel in function monitoring" VALUE 0x8059151B Val_Wu8 1.992188 fak_ub_b2 0.00 1.992188 FORMAT "%8.6" /end CHARACTERISTIC
/begin CHARACTERISTIC MoFAirFl_facTolrRatFuMGdiChkMax_C "Factor maximum tolerance in check of bank selective fuel in function monitoring (GDI)" VALUE 0x80591580 Val_Wu8 1.992188 fak_ub_b2 0.00 1.992188 FORMAT "%8.6" /end CHARACTERISTIC
/begin CHARACTERISTIC MoFAirFl_facTolrRatFuMGdiChkMin_C "Factor minimum tolerance in check of bank selective fuel in function monitoring (GDI)" VALUE 0x80591581 Val_Wu8 1.992188 fak_ub_b2 0.00 1.992188 FORMAT "%8.6" /end CHARACTERISTIC
/begin CHARACTERISTIC MoFAirFl_flgChrgMtn_C "Activation correction of the optimized model reference ignition angle depending on charge motion due to intake opening" VALUE 0x8059156A Val_Wu8 1.00000000000 B_TRUE 0.00 1.00000000000 FORMAT "%13.11" /end CHARACTERISTIC
/begin CHARACTERISTIC MoFAirFl_iaDeltaOptLamHiRes_T "High resolution delta optimal ignition angle lambda dependent in function monitoring" CURVE 0x80592F5E Mo_DataCurveSstU16WU16 6553.500 zw_q0p1 0.00 6553.500 FORMAT "%8.3"
 /begin AXIS_DESCR STD_AXIS MoFAirFl_ratLamSp fak_uw_b16 40 0.00 15.99976 FORMAT "%8.5" DEPOSIT ABSOLUTE /end AXIS_DESCR
/end CHARACTERISTIC
/begin CHARACTERISTIC MoFAirFl_iaDeltaOptTHiRes_T "High resolution delta optimal ignition angle temperature dependent in function monitoring" CURVE 0x80593000 ValA_Wu16 6553.500 zw_q0p1 0.00 6553.500 FORMAT "%8.3"
 /begin AXIS_DESCR COM_AXIS MoF_tEng temp_ub_q0p75_o48 8 -48.0 143.3 FORMAT "%5.1" AXIS_PTS_REF MoF_tEng_DST /end AXIS_DESCR
/end CHARACTERISTIC
/begin CHARACTERISTIC MoFAirFl_iaOptmHiRes_M "High resolution optimal ignition angle in function monitoring" MAP 0x80593010 MapG_Ws16 6553.500 zw_q0p1 -3276.800 3276.700 FORMAT "%8.3"
 /begin AXIS_DESCR COM_AXIS MoFAirFl_ratFillg rel_uw_q0p0234 60 0.00 1535.977 FORMAT "%8.3" AXIS_PTS_REF MoFAirFlEta_ratFillgHiRes_Ax /end AXIS_DESCR
 /begin AXIS_DESCR COM_AXIS MoFESpd_nEng nmot_q40 60 0.00 10200. FORMAT "%5.0" AXIS_PTS_REF MoFAirFlEta_nEngHiRes_Ax /end AXIS_DESCR
/end CHARACTERISTIC
/begin CHARACTERISTIC MoFAirFl_nEngStallg_C "Engine speed threshold for stall detection in function monitoring" VALUE 0x80591514 Val_Wu8 10200. nmot_q40 0.00 10200. FORMAT "%5.0" /end CHARACTERISTIC
/begin CHARACTERISTIC MoFAirFl_nEngThdFuEvapChk_C "Speed threshold for the check of evaporating fuel in function monitoring" VALUE 0x80591582 Val_Wu8 10200. nmot_q40 0.00 10200. FORMAT "%5.0" /end CHARACTERISTIC
/begin CHARACTERISTIC MoFAirFl_nErrHndlgActvnCtOffGdi_C "Engine speed threshold for activation of error handling in function MoFAirFl_CtOffGdi" VALUE 0x80591515 Val_Wu8 10200. nmot_q40 0.00 10200. FORMAT "%5.0" /end CHARACTERISTIC
/begin CHARACTERISTIC MoFAirFl_nErrHndlgActvnCylGdi_C "Engine speed threshold for activation of error handling in function MoFAirFl_CylGdi" VALUE 0x8059151C Val_Wu8 10200. nmot_q40 0.00 10200. FORMAT "%5.0" /end CHARACTERISTIC
/begin CHARACTERISTIC MoFAirFl_nErrHndlgActvnFF_C "Engine speed threshold for activation of error handling in function MoFAirFl_FF" VALUE 0x8059156E Val_Wu8 10200. nmot_q40 0.00 10200. FORMAT "%5.0" /end CHARACTERISTIC
/begin CHARACTERISTIC MoFAirFl_nErrHndlgActvnInCom_C "Engine speed threshold for activation of error handling in function MoFAirFl_In" VALUE 0x80591573 Val_Wu8 10200. nmot_q40 0.00 10200. FORMAT "%5.0" /end CHARACTERISTIC
/begin CHARACTERISTIC MoFAirFl_nErrHndlgActvnMixCtlGdi_C "Engine speed threshold for activation of error handling in function MoFAirFl_MixCtlGdi" VALUE 0x80591583 Val_Wu8 10200. nmot_q40 0.00 10200. FORMAT "%5.0" /end CHARACTERISTIC
/begin CHARACTERISTIC MoFAirFl_nrCylAdv_C "Count of advanced cylinders in function monitoring" VALUE 0x80591574 Val_Wu8 5.000 OneToOne 0.00 5.000 FORMAT "%5.3" EXTENDED_LIMITS 0.00 255.0 /end CHARACTERISTIC
/begin CHARACTERISTIC MoFAirFl_nrCylTot_C "Total count of cylinders in function monitoring" VALUE 0x80591575 Val_Wu8 8.000 OneToOne 0.00 8.000 FORMAT "%5.3" EXTENDED_LIMITS 0.00 255.0 /end CHARACTERISTIC
/begin CHARACTERISTIC MoFAirFl_ofsTolrChkCpv_C "Offset tolerance in check of canister purge in function monitoring" VALUE 0x80594C76 Val_Wu16 1535.953 rel_uw_b3072 0.00 1535.953 FORMAT "%8.3" EXTENDED_LIMITS 0.00 3071.953 /end CHARACTERISTIC
/begin CHARACTERISTIC MoFAirFl_ofsTolrChkRatFuMCylInd_C "Offset tolerance in check of cylinder-individual fuel in function monitoring" VALUE 0x8059151D Val_Wu8 11.95 rel_uw_b3072 0.00 11.95 FORMAT "%5.2" /end CHARACTERISTIC
/begin CHARACTERISTIC MoFAirFl_ofsTolrRatFuMGdiChk_C "Offset tolerance in check of fuel in function monitoring (GDI)" VALUE 0x80591584 Val_Wu8 191.3 rel_ub_q0p75 0.00 191.3 FORMAT "%5.1" /end CHARACTERISTIC
/begin CHARACTERISTIC MoFAirFl_ratFuEvapMinHiEngSpd_C "Minimum permitted value of evaporating fuel at high engine speeds in function monitoring" VALUE 0x80594C78 Val_Ws16 3071.953 rel_sw_b1536 -1536.000 1535.953 FORMAT "%8.3" /end CHARACTERISTIC
/begin CHARACTERISTIC MoFAirFl_ratFuEvapMinLoEngSpd_C "Minimum permitted value of evaporating fuel at low engine speeds in function monitoring" VALUE 0x80594C7A Val_Ws16 3071.953 rel_sw_b1536 -1536.000 1535.953 FORMAT "%8.3" /end CHARACTERISTIC
/begin CHARACTERISTIC MoFAirFl_ratFuMLamAdpnGdiMax_C "Max. allowed value lambda adaption additive on GDI path in function monitoring" VALUE 0x80594C7C Val_Ws16 3071.953 rel_sw_b1536 -1536.000 1535.953 FORMAT "%8.3" /end CHARACTERISTIC
/begin AXIS_PTS MoFAirFl_ratLamSp_Ax "Axis grid distribution for lambda in function monitoring" 0x80594C30 MoFAirFl_ratLamSp Axis_Xu16 15.99976 fak_uw_b16 8 0.00 15.99976 FORMAT "%8.5" DEPOSIT ABSOLUTE /end AXIS_PTS
/begin CHARACTERISTIC MoFAirFl_rLamCtlMaxPri_C "Maximum value limit for relative lambda control value for primary control continuous in function monitoring" VALUE 0x80594C7E Val_Ws16 1.999969 fak_sw_b1 -1.000000 0.999969 FORMAT "%8.6" EXTENDED_LIMITS -1.000000 0.9999695 /end CHARACTERISTIC
/begin CHARACTERISTIC MoFAirFl_rLamCtlMinPri_C "Minimum value limit for relative lambda control value for primary control continuous in function monitoring" VALUE 0x80594C80 Val_Ws16 1.999969 fak_sw_b1 -1.000000 0.999969 FORMAT "%8.6" EXTENDED_LIMITS -1.000000 0.9999695 /end CHARACTERISTIC
/begin CHARACTERISTIC MoFAirFl_stCfgAirFlMixCtl_C "Code word for relative lambda control primary control configuration in MoFAirFl_MixCtlGdi and MoFAirFl_MixCtlPfi" VALUE 0x80591585 Val_Wu8 255.0 OneToOne 0.00 255.0 FORMAT "%5.1" /end CHARACTERISTIC
/begin CHARACTERISTIC MoFAirFl_stCfgCylBnk_C "Codeword for configuration of cylinder-bank-assignment" VALUE 0x80591576 Val_Wu8 255.0 OneToOne 0.00 255.0 FORMAT "%5.1" /end CHARACTERISTIC
/begin CHARACTERISTIC MoFAirFl_stCfgCyl_C "Codeword for configuration of function MoFAirFl_Cyl (Gdi, Pfi)" VALUE 0x8059151E Val_Wu8 255.0 OneToOne 0.00 255.0 FORMAT "%5.1" /end CHARACTERISTIC
/begin CHARACTERISTIC MoFAirFl_stCfglIn_C "Codeword for configuration of function MoFAirFl_In" VALUE 0x80591577 Val_Wu8 255.0 OneToOne 0.00 255.0 FORMAT "%5.1" /end CHARACTERISTIC
/begin CHARACTERISTIC MoFAirFl_stCfgMoFAirFl_C "Central codeword for configuration of actual torque monitoring" VALUE 0x80594C4C Val_Wu16 65535.00 OneToOne 0.00 65535.00 FORMAT "%8.2" /end CHARACTERISTIC
/begin CHARACTERISTIC MoFAirFl_stOperModHks_C "Operation mode HKS in function monitoring" VALUE 0x80591578 Val_Wu8 255.0 OneToOne 0.00 255.0 FORMAT "%5.1" /end CHARACTERISTIC
/begin CHARACTERISTIC MoFAirFl_stOperModHom_C "Operation mode HOM in function monitoring" VALUE 0x80591579 Val_Wu8 255.0 OneToOne 0.00 255.0 FORMAT "%5.1" /end CHARACTERISTIC
/begin CHARACTERISTIC MoFAirFl_stOperModHsp_C "Operation mode HSP in function monitoring" VALUE 0x8059157A Val_Wu8 255.0 OneToOne 0.00 255.0 FORMAT "%5.1" /end CHARACTERISTIC
/begin AXIS_PTS MoF_tEng_DST "interpolation node distribution for engine temperature in the function monitoring" 0x80591845 MoF_tEng Axis_Xu8 191.3 temp_ub_q0p75_o48 8 -48.0 143.3 FORMAT "%5.1" DEPOSIT ABSOLUTE /end AXIS_PTS
/begin MEASUREMENT etaaus_um "Fuel cut off efficiency for monitoring" UBYTE fak_ub_b2 1 100 0.00 1.992188 FORMAT "%8.6" ECU_ADDRESS 0x6001824C /end MEASUREMENT
/begin MEASUREMENT etaaus_ur "RAM data redundancy for ETAAUS_UM" UBYTE OneToOne 1 100 0.00 255.0 FORMAT "%5.1" ECU_ADDRESS 0x60017AE0 /end MEASUREMENT
/begin MEASUREMENT MoCMem_adChkSumBlk "Addresses of checksum blocks configured for cyclic memory check" ULONG dez 1 100 0.00 4294967295.00 FORMAT "%13.2" ARRAY_SIZE 2 ECU_ADDRESS 0x60017630 /end MEASUREMENT
/begin MEASUREMENT MoCMem_adChkSumBlkCpl "Double storage for MoCMem_adChkSumBlk" ULONG dez 1 100 0.00 4294967295.00 FORMAT "%13.2" ARRAY_SIZE 2 ECU_ADDRESS 0x60017B88 /end MEASUREMENT
/begin MEASUREMENT MoCMem_ctDebErrChkROM "error debounce counter for cyclical ROM-test" UBYTE OneToOne 1 100 0.00 255.0 FORMAT "%5.1" ECU_ADDRESS 0x60018289 /end MEASUREMENT
/begin MEASUREMENT MoCMem_ctDebErrChkROMCpl "complement of the error debounce counter for cyclical ROM-test" UBYTE OneToOne 1 100 0.00 255.0 FORMAT "%5.1" ECU_ADDRESS 0x60017B94 /end MEASUREMENT
/begin MEASUREMENT MoCMem_ctDebHealChkROM "error healing counter for cyclical ROM-test" UWORD OneToOne 1 100 0.00 65535.00 FORMAT "%8.2" ECU_ADDRESS 0x60018268 /end MEASUREMENT
/begin MEASUREMENT MoCMem_ctDebHealChkROMCpl "complement of the error healing counter for cyclical ROM-test" UWORD OneToOne 1 100 0.00 65535.00 FORMAT "%8.2" ECU_ADDRESS 0x60017B72 /end MEASUREMENT
/begin MEASUREMENT MoCMem_ctLrnROM "Counter for the learn process of the ROM check" UBYTE OneToOne 1 100 0.00 255.0 FORMAT "%5.1" ECU_ADDRESS 0x60018288 /end MEASUREMENT
/begin MEASUREMENT MoCMem_ctLrnROMCpl "Complement of the counter for the learn process of the ROM check" UBYTE OneToOne 1 100 0.00 255.0 FORMAT "%5.1" ECU_ADDRESS 0x60017B93 /end MEASUREMENT
/begin MEASUREMENT MoCMem_idxCSAry "Array index to point to the desired checksum block" UBYTE OneToOne 1 100 0.00 255.0 FORMAT "%5.1" ECU_ADDRESS 0x60018287 /end MEASUREMENT
/begin MEASUREMENT MoCMem_idxCSAryCpl "Double storage for MoCMem_idxCSAry" UBYTE OneToOne 1 100 0.00 255.0 FORMAT "%5.1" ECU_ADDRESS 0x60017B92 /end MEASUREMENT
/begin MEASUREMENT MoCMem_nrRomChk "Number of 32-bit memory cells to be tested in cyclical ROM check" UWORD OneToOne 1 100 0.00 65535.00 FORMAT "%8.2" ARRAY_SIZE 4 ECU_ADDRESS 0x60018260 /end MEASUREMENT
/begin MEASUREMENT MoCMem_nrRomChkCpl "Double storage of the number of 32-bit memory cells to be tested in cyclical ROM check" UWORD OneToOne 1 100 0.00 65535.00 FORMAT "%8.2" ARRAY_SIZE 4 ECU_ADDRESS 0x60017B6A /end MEASUREMENT
/begin MEASUREMENT MoCMem_nrRomChkSize "Memory size in Byte that is tested in the cyclic ROM check" ULONG OneToOne 1 100 0.00 4294967295.00 FORMAT "%13.2" ECU_ADDRESS 0x60018280 /end MEASUREMENT
/begin MEASUREMENT MoCMem_numChkSumCurrent "current checksum for cyclical ROM-check" ULONG OneToOne 1 100 0.00 4294967295.00 FORMAT "%13.2" ECU_ADDRESS 0x6001827C /end MEASUREMENT
/begin MEASUREMENT MoCMem_numChkSumCurrentCpl "RAM data redundancy for MoCMem_numChkSumCurrent" ULONG OneToOne 1 100 0.00 4294967295.00 FORMAT "%13.2" ECU_ADDRESS 0x60017B84 /end MEASUREMENT
/begin MEASUREMENT MoCMem_RomCurrentPtr "pointer with the address for the cyclic checked ROM area which should be checkt at the next cyclic call of the cyclic ROM check" ULONG default 1 100 0.00 4294967295.00 FORMAT "%13.2" ECU_ADDRESS 0x60018278 /end MEASUREMENT
/begin MEASUREMENT MoCMem_RomCurrentPtrCpl "duplicate storage of MoCMem_RomCurrentPtrCpl" ULONG OneToOne 1 100 0.00 4294967295.00 FORMAT "%13.2" ECU_ADDRESS 0x60017B80 /end MEASUREMENT
/begin MEASUREMENT MoCMem_stDataCycChkBlk "DME support available for data set block" UBYTE OneToOne 1 100 0.00 255.0 FORMAT "%5.1" ARRAY_SIZE 2 ECU_ADDRESS 0x60018285 /end MEASUREMENT
/begin MEASUREMENT MoCMem_stDataCycChkBlkCpl "Double storage of DME support available for data set block" UBYTE OneToOne 1 100 0.00 255.0 FORMAT "%5.1" ARRAY_SIZE 2 ECU_ADDRESS 0x60017B90 /end MEASUREMENT
/begin MEASUREMENT MoCMem_stDisChk "State of the deactivation of the ROM cyclic test" UBYTE OneToOne 1 100 0.00 255.0 FORMAT "%5.1" ECU_ADDRESS 0x60018284 /end MEASUREMENT
/begin MEASUREMENT MoCMem_tiROMAccus "Sum of the intervals between function calls during the learn process" ULONG OneToOne 1 100 0.00 4294967295.00 FORMAT "%13.2" ECU_ADDRESS 0x60018274 /end MEASUREMENT
/begin MEASUREMENT MoCMem_tiROMAccusCpl "Complement of the sum of the intervals between function calls during the learn process" ULONG OneToOne 1 100 0.00 4294967295.00 FORMAT "%13.2" ECU_ADDRESS 0x60017B7C /end MEASUREMENT
/begin MEASUREMENT MoCMem_tiROMus "Timestamp of the current call" ULONG OneToOne 1 100 0.00 4294967295.00 FORMAT "%13.2" ECU_ADDRESS 0x60018270 /end MEASUREMENT
/begin MEASUREMENT MoCMem_tiROMusCpl "Complement of the timestamp of the current call" ULONG OneToOne 1 100 0.00 4294967295.00 FORMAT "%13.2" ECU_ADDRESS 0x60017B78 /end MEASUREMENT
/begin MEASUREMENT MoCMem_tiROMusOld "Timestamp of the previous call" ULONG OneToOne 1 100 0.00 4294967295.00 FORMAT "%13.2" ECU_ADDRESS 0x6001826C /end MEASUREMENT
/begin MEASUREMENT MoCMem_tiROMusOldCpl "Complement of the timestamp of the previous call" ULONG OneToOne 1 100 0.00 4294967295.00 FORMAT "%13.2" ECU_ADDRESS 0x60017B74 /end MEASUREMENT
/begin MEASUREMENT MoCPFC_Checksum "Inter result of checksum calculation in the program flow check" ULONG OneToOne 1 100 0.00 4294967295.00 FORMAT "%13.2" ECU_ADDRESS 0x60017B60 /end MEASUREMENT
/begin MEASUREMENT MoCPFC_Checkword "Modul specific signature for building the checksum of the PFC in function monitoring" ULONG OneToOne 1 100 0.00 4294967295.00 FORMAT "%13.2" ECU_ADDRESS 0x60017B64 /end MEASUREMENT
/begin MEASUREMENT MoCPFC_Counter "Module call counter for program flow check in monitoring" UBYTE OneToOne 1 100 0.00 255.0 FORMAT "%5.1" ECU_ADDRESS 0x60017B68 /end MEASUREMENT
/begin MEASUREMENT MoCPFC_PtlResp "Partial response from program flow check to monitoring module" ULONG OneToOne 1 100 0.00 4294967295.00 FORMAT "%13.2" ECU_ADDRESS 0x60017B5C /end MEASUREMENT
/begin MEASUREMENT MoCSCC_stLfastWrkarndActv_MP "State of deactivation of crossbar MPU check for activation of LFAST interface" UBYTE OneToOne 1 100 0.00 255.0 FORMAT "%5.1" ECU_ADDRESS 0x70009F88 /end MEASUREMENT
/begin MEASUREMENT MoCSCC_stMstInstFnd "State of found Master instance" ULONG dez 1 100 0.00 4294967295.00 FORMAT "%13.2" ECU_ADDRESS 0x50001B30 /end MEASUREMENT
/begin MEASUREMENT MoCSOP_cntrDebErrPinActv "debounce counter for active error pin during positive and overvoltage test" UBYTE OneToOne 1 100 0.00 255.0 FORMAT "%5.1" ECU_ADDRESS 0x60017B58 /end MEASUREMENT
/begin MEASUREMENT MoCSOP_cntrDebErrPinActvCpl "Complement of debounce counter for active error pin during positive and overvoltage test" UBYTE OneToOne 1 100 0.00 255.0 FORMAT "%5.1" ECU_ADDRESS 0x60017B57 /end MEASUREMENT
/begin MEASUREMENT MoCSOP_cntrDebExtErrPinEveActv "Debounce counter for error in disabling of external error pin event" UBYTE OneToOne 1 100 0.00 255.0 FORMAT "%5.1" ECU_ADDRESS 0x60017B56 /end MEASUREMENT
/begin MEASUREMENT MoCSOP_cntrDebExtErrPinEveActvCpl "Complement of debounce counter for error in disabling of external error pin event" UBYTE OneToOne 1 100 0.00 255.0 FORMAT "%5.1" ECU_ADDRESS 0x60017B55 /end MEASUREMENT
/begin MEASUREMENT MoCSOP_cntrDebExtErrPinEveActv_MP "Measurement Array for debounce counter for error in disabling of external error pin event" UBYTE OneToOne 1 100 0.00 255.0 FORMAT "%5.1" ARRAY_SIZE 25 ECU_ADDRESS 0x70009F6F /end MEASUREMENT
/begin MEASUREMENT MoCSOP_cntrDebSycDrv "Debounce counter for the delay required in reading the injection power stages" UBYTE OneToOne 1 100 0.00 255.0 FORMAT "%5.1" ECU_ADDRESS 0x60017B54 /end MEASUREMENT
/begin MEASUREMENT MoCSOP_cntrDebSycDrvCpl "Double storage of MoCSOP_cntrDebSycDrv" UBYTE OneToOne 1 100 0.00 255.0 FORMAT "%5.1" ECU_ADDRESS 0x60017B53 /end MEASUREMENT
/begin MEASUREMENT MoCSOP_cntrSignalSwtDelay "Counter to debounce the delay required in reading the feedback line status" UBYTE OneToOne 1 100 0.00 255.0 FORMAT "%5.1" ECU_ADDRESS 0x60017B52 /end MEASUREMENT
/begin MEASUREMENT MoCSOP_cntrSignalSwtDelayCpl "Double storage of MoCSOP_cntrSignalSwtDelay" UBYTE OneToOne 1 100 0.00 255.0 FORMAT "%5.1" ECU_ADDRESS 0x60017B51 /end MEASUREMENT
/begin MEASUREMENT MoCSOP_ctBusErr "error counter for communication bus error between FC and other ASICS like power stage ASIC, Monitoring module etc" UBYTE OneToOne 1 100 0.00 255.0 FORMAT "%5.1" ECU_ADDRESS 0x60017B50 /end MEASUREMENT
/begin MEASUREMENT MoCSOP_ctBusErr_MP "Measurement point of error counter for communication bus error between FC and other ASICS like power stage ASIC, Monitoring module etc" UBYTE OneToOne 1 100 0.00 255.0 FORMAT "%5.1" ARRAY_SIZE 25 ECU_ADDRESS 0x70009F56 /end MEASUREMENT
/begin MEASUREMENT MoCSOP_ctCANFrIdx "Index for MoCSOPs measurement point arrays for CANFR test" UBYTE OneToOne 1 100 0.00 255.0 FORMAT "%5.1" ECU_ADDRESS 0x60017B4F /end MEASUREMENT
/begin MEASUREMENT MoCSOP_ctDebCANFrTest "timeout error counter in CAN and FlexRay test" UBYTE OneToOne 1 100 0.00 255.0 FORMAT "%5.1" ECU_ADDRESS 0x60017B4E /end MEASUREMENT
/begin MEASUREMENT MoCSOP_ctDebCANFrTestCpl "complement of the timeout error counter in CAN and FlexRay test" UBYTE OneToOne 1 100 0.00 255.0 FORMAT "%5.1" ECU_ADDRESS 0x60017B4D /end MEASUREMENT
/begin MEASUREMENT MoCSOP_ctDebSOPTst "Number of repetitions of shut-off path test (implementation of a time monitoring)" UWORD OneToOne 1 100 0.00 65535.00 FORMAT "%8.2" ECU_ADDRESS 0x60017B1E /end MEASUREMENT
/begin MEASUREMENT MoCSOP_ctDebSOPTstCpl "Complement copy of MoCSOP_ctDebSOPTst" UWORD OneToOne 1 100 0.00 65535.00 FORMAT "%8.2" ECU_ADDRESS 0x60017B1C /end MEASUREMENT
/begin MEASUREMENT MoCSOP_ctErrMM "Copy of the error counter from the monitoring module in function controller" UBYTE OneToOne 1 100 0.00 255.0 FORMAT "%5.1" ECU_ADDRESS 0x60017B2E /end MEASUREMENT
/begin MEASUREMENT MoCSOP_ctErrMM_mp "Array copy of MoCSOP_ctErrMM in 2,2ms- Raster" UBYTE OneToOne 1 100 0.00 255.0 FORMAT "%5.1" ARRAY_SIZE 25 ECU_ADDRESS 0x70009F3D /end MEASUREMENT
/begin MEASUREMENT MoCSOP_ctErrOSTimeout "error counter handling Alarm Task period" UBYTE OneToOne 1 100 0.00 255.0 FORMAT "%5.1" ECU_ADDRESS 0x60017B4C /end MEASUREMENT
/begin MEASUREMENT MoCSOP_ctIdx "Index for MoCSOPs measurement point arrays (for full measurements without data loss with an INCA 10ms raster, though a 2.2 ms alarm task raster =gt; 5 or 4 entries10ms ). Shows the last written index position." UBYTE OneToOne 1 100 0.00 255.0 FORMAT "%5.1" ECU_ADDRESS 0x60017B4B /end MEASUREMENT
/begin MEASUREMENT MoCSOP_ctRespOffsetTst "Counter used for test purpose in time of response" UWORD OneToOne 1 100 0.00 65535.00 FORMAT "%8.2" ECU_ADDRESS 0x60017B1A /end MEASUREMENT
/begin MEASUREMENT MoCSOP_ctRst "number of resets executed in shut off path test" UBYTE OneToOne 1 100 0.00 255.0 FORMAT "%5.1" ECU_ADDRESS 0x600365EB /end MEASUREMENT
/begin MEASUREMENT MoCSOP_ctRstCANFrTest "No of Resets executed for CANFR test" UBYTE OneToOne 1 100 0.00 255.0 FORMAT "%5.1" ECU_ADDRESS 0x600365EA /end MEASUREMENT
/begin MEASUREMENT MoCSOP_ctRstCANFrTestCpl "complement number of resets executed in CANFR shut off path test" UBYTE OneToOne 1 100 0.00 255.0 FORMAT "%5.1" ECU_ADDRESS 0x600365E9 /end MEASUREMENT
/begin MEASUREMENT MoCSOP_ctRstCpl "complement number of resets executed in shut off path test" UBYTE OneToOne 1 100 0.00 255.0 FORMAT "%5.1" ECU_ADDRESS 0x600365E8 /end MEASUREMENT
/begin MEASUREMENT MoCSOP_flgErrPinActvd "Flag to indicate if error pin is activated during Error Pin negative test" UBYTE OneToOne 1 100 0.00 255.0 FORMAT "%5.1" ECU_ADDRESS 0x60017B4A /end MEASUREMENT
/begin MEASUREMENT MoCSOP_flgErrPinActvdCpl "Double storage for MoCSOP_flgErrPinActvd" UBYTE OneToOne 1 100 0.00 255.0 FORMAT "%5.1" ECU_ADDRESS 0x60017B49 /end MEASUREMENT
/begin MEASUREMENT MoCSOP_flgReqSOPTest "Flag to indicate that a request to execute shuit off path test is present" UBYTE OneToOne 1 100 0.00 255.0 FORMAT "%5.1" ECU_ADDRESS 0x6001825F /end MEASUREMENT
/begin MEASUREMENT MoCSOP_flgReqSOPTestCpl "Complement of request to execute SOP test variable" UBYTE OneToOne 1 100 0.00 255.0 FORMAT "%5.1" ECU_ADDRESS 0x60017B48 /end MEASUREMENT
/begin MEASUREMENT MoCSOP_flgT15RisngEdge "Flag to detect the T15_st rising edge" UBYTE OneToOne 1 100 0.00 255.0 FORMAT "%5.1" ECU_ADDRESS 0x6001825E /end MEASUREMENT
/begin MEASUREMENT MoCSOP_flgT15RisngEdgeCpl "Complement of T15 rising edge variable" UBYTE OneToOne 1 100 0.00 255.0 FORMAT "%5.1" ECU_ADDRESS 0x60017B47 /end MEASUREMENT
/begin MEASUREMENT MoCSOP_st "status of the shut-down path test" UWORD OneToOne 1 100 0.00 65535.00 FORMAT "%8.2" ECU_ADDRESS 0x600365E0 /end MEASUREMENT
/begin MEASUREMENT MoCSOP_stActMsg "copy of the status variable for synchronizing shut off path test and query-/response communication" UBYTE dez 1 100 0.00 255.0 FORMAT "%5.1" ECU_ADDRESS 0x60000987 /end MEASUREMENT
/begin MEASUREMENT MoCSOP_stActvMsg "Information for level 1, 2: Shut-off path test is on or WDA-line is active (injections disabled)" UBYTE dez 1 100 0.00 255.0 FORMAT "%5.1" ECU_ADDRESS 0x60000988 /end MEASUREMENT
/begin MEASUREMENT MoCSOP_stBusErr "status variable for communication bus error between FC and other ASICS like power stage ASIC, Monitoring module etc" UWORD OneToOne 1 100 0.00 65535.00 FORMAT "%8.2" ECU_ADDRESS 0x60017B18 /end MEASUREMENT
/begin MEASUREMENT MoCSOP_stBusErr_MP "Measurement point for status variable for communication bus error between FC and other ASICS like power stage ASIC, Monitoring module etc" UWORD OneToOne 1 100 0.00 65535.00 FORMAT "%8.2" ARRAY_SIZE 25 ECU_ADDRESS 0x70009C44 /end MEASUREMENT
/begin MEASUREMENT MoCSOP_stCANFrTest "CANFR test status" UBYTE OneToOne 1 100 0.00 255.0 FORMAT "%5.1" ECU_ADDRESS 0x60017B2D /end MEASUREMENT
/begin MEASUREMENT MoCSOP_stCANFrTestCpl "Complement of status of CANFR test status" UBYTE OneToOne 1 100 0.00 255.0 FORMAT "%5.1" ECU_ADDRESS 0x60017B46 /end MEASUREMENT
/begin MEASUREMENT MoCSOP_stCANFrTestErr "Error status of CANFR test" UBYTE OneToOne 1 100 0.00 255.0 FORMAT "%5.1" ECU_ADDRESS 0x60017B45 /end MEASUREMENT
/begin MEASUREMENT MoCSOP_stCANFrTestErrReas "Reason for CAN-FR shut off path test failure" UBYTE OneToOne 1 100 0.00 255.0 FORMAT "%5.1" ECU_ADDRESS 0x600365E7 /end MEASUREMENT
/begin MEASUREMENT MoCSOP_stCANFrTestErrReasCpl "Complement of reason for CAN-FR shut off path test failure" UBYTE OneToOne 1 100 0.00 255.0 FORMAT "%5.1" ECU_ADDRESS 0x600365E6 /end MEASUREMENT
/begin MEASUREMENT MoCSOP_stCANFrTestState "status of state machine check CANFR test" UBYTE OneToOne 1 100 0.00 255.0 FORMAT "%5.1" ECU_ADDRESS 0x60017B44 /end MEASUREMENT
/begin MEASUREMENT MoCSOP_stCANFrTestStateCpl "Complement of MoCSOP_stCANFrTestState" UBYTE OneToOne 1 100 0.00 255.0 FORMAT "%5.1" ECU_ADDRESS 0x60017B43 /end MEASUREMENT
/begin MEASUREMENT MoCSOP_stCanTdi "Status bit for activation or deactivation of the CAN_TDI shut off path during an active WDA line" UBYTE B_TRUE 1 100 0.00 1.00000000000 BIT_MASK 0x1 FORMAT "%13.11" ECU_ADDRESS 0x60017B42 /end MEASUREMENT
/begin MEASUREMENT MoCSOP_stCANTestState_mp "measurement-array for displaying the actual state of the state machine during the CAN test" UBYTE MoCSOP_stCANFrTestState_mp_Compu 1 100 0.00 12.0000000000 FORMAT "%13.10" ARRAY_SIZE 12 ECU_ADDRESS 0x70009F31 /end MEASUREMENT
/begin MEASUREMENT MoCSOP_stCheckState "status state machine check power stages" UBYTE MoCSOP_stCheckStateCY329_mp_Compu 1 100 0.00 18.0000000000 FORMAT "%13.10" ECU_ADDRESS 0x60017B41 /end MEASUREMENT
/begin MEASUREMENT MoCSOP_stCheckStateCpl "Complement of MoCSOP_stCheckState" UBYTE OneToOne 1 100 0.00 255.0 FORMAT "%5.1" ECU_ADDRESS 0x60017B40 /end MEASUREMENT
/begin MEASUREMENT MoCSOP_stCheckState_mp "State variable indicates which MoCSOP step is executed" UBYTE MoCSOP_stCheckStateCY329_mp_Compu 1 100 0.00 18.0000000000 FORMAT "%13.10" ARRAY_SIZE 25 ECU_ADDRESS 0x70009F18 /end MEASUREMENT
/begin MEASUREMENT MoCSOP_stComActv "status for communication from MoCCOM active" UBYTE OneToOne 1 100 0.00 255.0 FORMAT "%5.1" ECU_ADDRESS 0x60017B2C /end MEASUREMENT
/begin MEASUREMENT MoCSOP_stComActvCpl "RAM data redundancy for MoCSOP_stComActv" UBYTE OneToOne 1 100 0.00 255.0 FORMAT "%5.1" ECU_ADDRESS 0x60017B2B /end MEASUREMENT
/begin MEASUREMENT MoCSOP_stComTrcvOld "Array to hold the STB pin status of the transceivers before the Com shut off path test" ULONG OneToOne 1 100 0.00 4294967295.00 FORMAT "%13.2" ARRAY_SIZE 2 ECU_ADDRESS 0x60017B20 /end MEASUREMENT
/begin MEASUREMENT MoCSOP_stCpl "RAM data redundancy for MoCSOP_st" UWORD OneToOne 1 100 0.00 65535.00 FORMAT "%8.2" ECU_ADDRESS 0x600365E2 /end MEASUREMENT
/begin MEASUREMENT MoCSOP_stDia "diagnose status of the shut-down path test" UBYTE OneToOne 1 100 0.00 255.0 FORMAT "%5.1" ECU_ADDRESS 0x60017B3F /end MEASUREMENT
/begin MEASUREMENT MoCSOP_stDiaCpl "RAM data redundancy for MoCSOP_stDia" UBYTE OneToOne 1 100 0.00 255.0 FORMAT "%5.1" ECU_ADDRESS 0x60017B3E /end MEASUREMENT
/begin MEASUREMENT MoCSOP_stDiaERPN "diagnose status of the CY329 specific shut off path tests" UBYTE OneToOne 1 100 0.00 255.0 FORMAT "%5.1" ECU_ADDRESS 0x60017B3D /end MEASUREMENT
/begin MEASUREMENT MoCSOP_stDiaERPNCpl "Complement for diagnose status of the CY329 specific shut off path tests" UBYTE OneToOne 1 100 0.00 255.0 FORMAT "%5.1" ECU_ADDRESS 0x60017B3C /end MEASUREMENT
/begin MEASUREMENT MoCSOP_stEmmState_MP "Measurement Array for EMM state" UBYTE MoCSOP_stEmmStateIFX_MP_Compu 1 100 0.00 32.0000000000 FORMAT "%13.10" ARRAY_SIZE 25 ECU_ADDRESS 0x70009EFF /end MEASUREMENT
/begin MEASUREMENT MoCSOP_stErr "contains the state of the communication via SPI-subsystem to the monitoring module" UBYTE OneToOne 1 100 0.00 255.0 FORMAT "%5.1" ECU_ADDRESS 0x60017B3B /end MEASUREMENT
/begin MEASUREMENT MoCSOP_stErrPinActvnReq "Status for the activation of the error pin in the FlexRay or CAN test, if the WDA line was not active during the test." UBYTE OneToOne 1 100 0.00 255.0 FORMAT "%5.1" ECU_ADDRESS 0x60017B3A /end MEASUREMENT
/begin MEASUREMENT MoCSOP_stErrPin_MP "Measurement point with the actual error pin status" UBYTE MoCSOP_stErrPin_MP_Compu 1 100 0.00 1.00000000000 FORMAT "%13.11" ARRAY_SIZE 25 ECU_ADDRESS 0x70009EE6 /end MEASUREMENT
/begin MEASUREMENT MoCSOP_stErrReactn "Status which error reaction type will be executed" UBYTE OneToOne 1 100 0.00 255.0 FORMAT "%5.1" ECU_ADDRESS 0x60017B39 /end MEASUREMENT
/begin MEASUREMENT MoCSOP_stErrReactnERPN "Status to indicate which error reaction type will be triggered for CY329 specific shut off path tests" UBYTE OneToOne 1 100 0.00 255.0 FORMAT "%5.1" ECU_ADDRESS 0x60017B38 /end MEASUREMENT
/begin MEASUREMENT MoCSOP_stInhbStrtCdn "Status to start shut-off path test interupted due to inhibit line active condition" UBYTE OneToOne 1 100 0.00 255.0 FORMAT "%5.1" ECU_ADDRESS 0x6001825D /end MEASUREMENT
/begin MEASUREMENT MoCSOP_stOvl "Status variable for CJ945 overvoltage detection latch" UBYTE dez 1 100 0.00 255.0 FORMAT "%5.1" ECU_ADDRESS 0x6000098A /end MEASUREMENT
/begin MEASUREMENT MoCSOP_stOvlCpl "Double storage of the status variable for CJ945 overvoltage detection latch" UBYTE dez 1 100 0.00 255.0 FORMAT "%5.1" ECU_ADDRESS 0x6000098B /end MEASUREMENT
/begin MEASUREMENT MoCSOP_stOVTstStatusEval "Overvoltage test evaluation status" UBYTE OneToOne 1 100 0.00 255.0 FORMAT "%5.1" ECU_ADDRESS 0x60017B37 /end MEASUREMENT
/begin MEASUREMENT MoCSOP_stOVTstStatusEvalCpl "Complement variable for overvoltage test evaluation status" UBYTE OneToOne 1 100 0.00 255.0 FORMAT "%5.1" ECU_ADDRESS 0x60017B36 /end MEASUREMENT
/begin MEASUREMENT MoCSOP_stPVMTUnderTest "PVMT signal which is under test during overvoltage test" UBYTE OneToOne 1 100 0.00 255.0 FORMAT "%5.1" ECU_ADDRESS 0x60017B35 /end MEASUREMENT
/begin MEASUREMENT MoCSOP_stRdy "Status variable for synchronisation from shut-off path test and query/response communication (test is done completely)" UBYTE OneToOne 1 100 0.00 255.0 FORMAT "%5.1" ECU_ADDRESS 0x600365E5 /end MEASUREMENT
/begin MEASUREMENT MoCSOP_stRdyCan "indicates that the CAN test was executed" UBYTE OneToOne 1 100 0.00 255.0 FORMAT "%5.1" ECU_ADDRESS 0x60017B2A /end MEASUREMENT
/begin MEASUREMENT MoCSOP_stRdyCanCpl "Complement of MoCSOP_stRdyCan" UBYTE OneToOne 1 100 0.00 255.0 FORMAT "%5.1" ECU_ADDRESS 0x60017B34 /end MEASUREMENT
/begin MEASUREMENT MoCSOP_stRdyCpl "Double storage for status variable for synchronisation from shut-off path test and query/response communication" UBYTE OneToOne 1 100 0.00 255.0 FORMAT "%5.1" ECU_ADDRESS 0x600365E4 /end MEASUREMENT
/begin MEASUREMENT MoCSOP_stRdyFr "Indicates whether the FlexRay test was executed" UBYTE OneToOne 1 100 0.00 255.0 FORMAT "%5.1" ECU_ADDRESS 0x60017B29 /end MEASUREMENT
/begin MEASUREMENT MoCSOP_stRdyFrCpl "Complement of MoCSOP_stRdyFr" UBYTE OneToOne 1 100 0.00 255.0 FORMAT "%5.1" ECU_ADDRESS 0x60017B33 /end MEASUREMENT
/begin MEASUREMENT MoCSOP_stRdyInj "Indicates that the Injection control lines test was executed" UBYTE OneToOne 1 100 0.00 255.0 FORMAT "%5.1" ECU_ADDRESS 0x60017B28 /end MEASUREMENT
/begin MEASUREMENT MoCSOP_stRdyInjCpl "Complement of MoCSOP_stRdyInj" UBYTE OneToOne 1 100 0.00 255.0 FORMAT "%5.1" ECU_ADDRESS 0x60017B32 /end MEASUREMENT
/begin MEASUREMENT MoCSOP_stRdyMsg "information for level 1,2 about status of synchronizing shut off path test and query-/resonse-communication" UBYTE OneToOne 1 100 0.00 255.0 FORMAT "%5.1" ECU_ADDRESS 0x6000F7E0 /end MEASUREMENT
/begin MEASUREMENT MoCSOP_stReqPSStatus "Status of request power stage function" UBYTE OneToOne 1 100 0.00 255.0 FORMAT "%5.1" ECU_ADDRESS 0x60017B31 /end MEASUREMENT
/begin MEASUREMENT MoCSOP_stReqPSStatusBusErr "Status of bus error in request powerstage status function" UBYTE OneToOne 1 100 0.00 255.0 FORMAT "%5.1" ECU_ADDRESS 0x60017B30 /end MEASUREMENT
/begin MEASUREMENT MoCSOP_stT15Old "Variable to update the T15_st status" UBYTE OneToOne 1 100 0.00 255.0 FORMAT "%5.1" ECU_ADDRESS 0x6001825C /end MEASUREMENT
/begin MEASUREMENT MoCSOP_stT15OldCpl "Complement of MoCSOP_stT15Old" UBYTE OneToOne 1 100 0.00 255.0 FORMAT "%5.1" ECU_ADDRESS 0x60017B2F /end MEASUREMENT
/begin MEASUREMENT MoCSOP_tiCanTest_MP "Actual time which was needed for the execution of the CAN test itself" ULONG MoCSOP_Time_us 1 100 0.00 4294967295.00 FORMAT "%13.2" ECU_ADDRESS 0x70009A0C /end MEASUREMENT
/begin MEASUREMENT MoExe_ctCyc "10 ms counter to generate scheduling for monitoring" UBYTE OneToOne 1 100 0.00 255.0 FORMAT "%5.1" ECU_ADDRESS 0x6001825B /end MEASUREMENT
/begin MEASUREMENT MoExe_ctCycCpl "Complement variable for MoExe_ctCyc" UBYTE OneToOne 1 100 0.00 255.0 FORMAT "%5.1" ECU_ADDRESS 0x60017AED /end MEASUREMENT
/begin MEASUREMENT MoFACCCo_bbOutCpl "duplicate storage for MoFACCCo_bbOut" UBYTE OneToOne 1 100 0.00 255.0 FORMAT "%5.1" ECU_ADDRESS 0x60017AEC /end MEASUREMENT
/begin MEASUREMENT MoFACC_flgPtd "condition ACC permitted in the function monitoring" UBYTE B_TRUE 1 100 0.00 1.00000000000 BIT_MASK 0x1 FORMAT "%13.11" ECU_ADDRESS 0x6001825A /end MEASUREMENT
/begin MEASUREMENT MoFAirFlCtOffGdi_bbLoc1Cpl "Complement of MoFAirFlCtOffGdi_bbLoc1" UBYTE OneToOne 1 100 0.00 255.0 FORMAT "%5.1" ECU_ADDRESS 0x60017AEB /end MEASUREMENT
/begin MEASUREMENT MoFAirFlCtOffGdi_flgClr "Condition clear FCM in function MoFAirFl_CtOffGdi" UBYTE B_TRUE 1 100 0.00 1.00000000000 BIT_MASK 0x1 FORMAT "%13.11" ECU_ADDRESS 0x7000015A /end MEASUREMENT
/begin MEASUREMENT MoFAirFlCylGdi_flgClr "Condition clear FCM in function MoFAirFl_CylGdi" UBYTE B_TRUE 1 100 0.00 1.00000000000 BIT_MASK 0x1 FORMAT "%13.11" ECU_ADDRESS 0x70000159 /end MEASUREMENT
/begin MEASUREMENT MoFAirFlEta_agIntkClsdHiRes_Ax_result "Actual position intake valve closed (0.5 mm cylinder individuel) value distribution - High resolution" SLONG dez 1 100 -2147483648.00 2147483647.00 FORMAT "%13.2" ECU_ADDRESS 0x60018248 /end MEASUREMENT
/begin MEASUREMENT MoFAirFlEta_agIntkClsd_Ax_result "Actual position intake valve closed (0.5 mm cylinder individuel) value distribution" SLONG dez 1 100 -2147483648.00 2147483647.00 FORMAT "%13.2" ECU_ADDRESS 0x60018244 /end MEASUREMENT
/begin MEASUREMENT MoFAirFlEta_nEngHiRes_Ax_result "Supporting coordinate for high resolution engine speed during function monitoring" SLONG dez 1 100 -2147483648.00 2147483647.00 FORMAT "%13.2" ECU_ADDRESS 0x60018240 /end MEASUREMENT
/begin MEASUREMENT MoFAirFlEta_nEng_Ax_result "Supporting coordinate for engine speed during function monitoring" SLONG dez 1 100 -2147483648.00 2147483647.00 FORMAT "%13.2" ECU_ADDRESS 0x6001823C /end MEASUREMENT
/begin MEASUREMENT MoFAirFlEta_ratFillgHiRes_Ax_result "High resolution data point value distribution for air charge" SLONG dez 1 100 -2147483648.00 2147483647.00 FORMAT "%13.2" ECU_ADDRESS 0x60018238 /end MEASUREMENT
/begin MEASUREMENT MoFAirFlEta_ratFillg_Ax_result "Result of grid search for air charge in function monitoring" SLONG dez 1 100 -2147483648.00 2147483647.00 FORMAT "%13.2" ECU_ADDRESS 0x60018234 /end MEASUREMENT
/begin MEASUREMENT MoFAirFlFF_bbLocCpl "complement variable for MoFAirFlFF_bbLoc" UBYTE OneToOne 1 100 0.00 255.0 FORMAT "%5.1" ECU_ADDRESS 0x60017ACE /end MEASUREMENT
/begin MEASUREMENT MoFAirFlFF_flgClr "Condition clear FCM in function MoFAirFl_FF" UBYTE B_TRUE 1 100 0.00 1.00000000000 BIT_MASK 0x1 FORMAT "%13.11" ECU_ADDRESS 0x6000AEC7 /end MEASUREMENT
/begin MEASUREMENT MoFAirFlIn_bbOut1Cpl "Ram data redundancy for MoFAirFlIn_bbOut1" UBYTE OneToOne 1 100 0.00 255.0 FORMAT "%5.1" ECU_ADDRESS 0x60017AC7 /end MEASUREMENT
/begin MEASUREMENT MoFAirFlIn_flgClr "Condition clear FCM in function MoFAirFl_In" UBYTE B_TRUE 1 100 0.00 1.00000000000 BIT_MASK 0x1 FORMAT "%13.11" ECU_ADDRESS 0x70000158 /end MEASUREMENT
/begin MEASUREMENT MoFAirFlMixCtlGdiChkAirFl_flgClr "Condition clear FCM in function MoFAirFl_MixCtlGdi (AirFl)" UBYTE B_TRUE 1 100 0.00 1.00000000000 BIT_MASK 0x1 FORMAT "%13.11" ECU_ADDRESS 0x70000157 /end MEASUREMENT
/begin MEASUREMENT MoFAirFlMixCtlGdiChkCtrl_flgClr "Condition clear FCM in function MoFAirFl_MixCtlGdi (Ctrl)" UBYTE B_TRUE 1 100 0.00 1.00000000000 BIT_MASK 0x1 FORMAT "%13.11" ECU_ADDRESS 0x70000156 /end MEASUREMENT
/begin MEASUREMENT MoFAirFlMixCtlGdi_nEng "engine speed in function MoFAirFl_MixCtlGdi" UBYTE nmot_q40 1 100 0.00 10200. FORMAT "%5.0" ECU_ADDRESS 0x6001809F /end MEASUREMENT
/begin MEASUREMENT MoFAirFlMixCtlGdi_nEngCpl "Ram data redundancy for MoFAirFlMixCtlGdi_nEng" UBYTE OneToOne 1 100 0.00 255.0 FORMAT "%5.1" ECU_ADDRESS 0x6001795F /end MEASUREMENT
/begin MEASUREMENT MoFAirFl_agIntkClsd "Actual position intake valve closed (0.5 mm cylinder individuel) in functional monitoring" SWORD kw_q0p0156 1 100 -512.0000 511.9844 FORMAT "%8.4" ECU_ADDRESS 0x6001822E /end MEASUREMENT
/begin MEASUREMENT MoFAirFl_agIntkClsdCpl "Actual position intake valve closed (0.5 mm cylinder individuel) complement value in functional monitoring" UWORD OneToOne 1 100 0.00 65535.00 FORMAT "%8.2" ECU_ADDRESS 0x60017ADE /end MEASUREMENT
/begin MEASUREMENT MoFAirFl_CdaCplIfClass_V4_I.bHemInjSyncCpl "Instance of data class for ram data redundancy of MoFAirFl_CdaIfClass_V2_0_0_I / Member Variable" UBYTE OneToOne 1 100 0.00 255.0 FORMAT "%5.1" ECU_ADDRESS 0x60017AB0 /end MEASUREMENT
/begin MEASUREMENT MoFAirFl_CdaCplIfClass_V4_I.bHmbvCpl "Instance of data class for ram data redundancy of MoFAirFl_CdaIfClass_V2_0_0_I / Member Variable" UBYTE OneToOne 1 100 0.00 255.0 FORMAT "%5.1" ECU_ADDRESS 0x60017AB1 /end MEASUREMENT
/begin MEASUREMENT MoFAirFl_CdaCplIfClass_V4_I.bHmbzylsyCpl "Instance of data class for ram data redundancy of MoFAirFl_CdaIfClass_V2_0_0_I / Member Variable" UBYTE OneToOne 1 100 0.00 255.0 FORMAT "%5.1" ECU_ADDRESS 0x60017AB2 /end MEASUREMENT
/begin MEASUREMENT MoFAirFl_CdaCplIfClass_V4_I.hmbcplCpl "Instance of data class for ram data redundancy of MoFAirFl_CdaIfClass_V2_0_0_I / Member Variable" UBYTE dez 1 100 0.00 255.0 FORMAT "%5.1" ECU_ADDRESS 0x60017AB3 /end MEASUREMENT
/begin MEASUREMENT MoFAirFl_CdaIfClass_V4_I.bHemInjSync "Instance of data class for quantities in connection to Cda in function monitoring / Member Variable" UBYTE OneToOne 1 100 0.00 255.0 FORMAT "%5.1" ECU_ADDRESS 0x600181F0 /end MEASUREMENT
/begin MEASUREMENT MoFAirFl_CdaIfClass_V4_I.bHmbv "Instance of data class for quantities in connection to Cda in function monitoring / Member Variable" UBYTE OneToOne 1 100 0.00 255.0 FORMAT "%5.1" ECU_ADDRESS 0x600181F1 /end MEASUREMENT
/begin MEASUREMENT MoFAirFl_CdaIfClass_V4_I.bHmbzylsy "Instance of data class for quantities in connection to Cda in function monitoring / Member Variable" UBYTE OneToOne 1 100 0.00 255.0 FORMAT "%5.1" ECU_ADDRESS 0x600181F2 /end MEASUREMENT
/begin MEASUREMENT MoFAirFl_CdaIfClass_V4_I.hmbcpl "Instance of data class for quantities in connection to Cda in function monitoring / Member Variable" UBYTE dez 1 100 0.00 255.0 FORMAT "%5.1" ECU_ADDRESS 0x600181F3 /end MEASUREMENT
/begin MEASUREMENT MoFAirFl_cntrAfimActvGdi "Counter for AFIM activation time in function monitoring (GDI)" UWORD OneToOne 1 100 0.00 65535.00 FORMAT "%8.2" ECU_ADDRESS 0x60018252 /end MEASUREMENT
/begin MEASUREMENT MoFAirFl_cntrAfimActvGdiCpl "Ram data redundancy for MoFAirFl_cntrAfimActvGdi" UWORD OneToOne 1 100 0.00 65535.00 FORMAT "%8.2" ECU_ADDRESS 0x60017AE4 /end MEASUREMENT
/begin MEASUREMENT MoFAirFl_cntrComCntrS0Stat "Counter for extension of measure frame of communication S0 in function monitoring" UBYTE OneToOne 1 100 0.00 255.0 FORMAT "%5.1" ECU_ADDRESS 0x60018207 /end MEASUREMENT
/begin MEASUREMENT MoFAirFl_cntrComCntrS0StatCpl "Ram data redundancy for MoFAirFl_cntrComCntrS0Stat" UBYTE OneToOne 1 100 0.00 255.0 FORMAT "%5.1" ECU_ADDRESS 0x60017AC6 /end MEASUREMENT
/begin MEASUREMENT MoFAirFl_cntrComCntrS1Stat "Counter for extension of measure frame of communication S1 in function monitoring" UBYTE OneToOne 1 100 0.00 255.0 FORMAT "%5.1" ECU_ADDRESS 0x60018206 /end MEASUREMENT
/begin MEASUREMENT MoFAirFl_cntrComCntrS1StatCpl "Ram data redundancy for MoFAirFl_cntrComCntrS1Stat" UBYTE OneToOne 1 100 0.00 255.0 FORMAT "%5.1" ECU_ADDRESS 0x60017AC5 /end MEASUREMENT
/begin MEASUREMENT MoFAirFl_cntrComS0 "Counter syncs S0 in function monitoring" UWORD OneToOne 1 100 0.00 65535.00 FORMAT "%8.2" ECU_ADDRESS 0x60018200 /end MEASUREMENT
/begin MEASUREMENT MoFAirFl_cntrComS0Cpl "Ram data redundancy for MoFAirFl_cntrComS0" UWORD OneToOne 1 100 0.00 65535.00 FORMAT "%8.2" ECU_ADDRESS 0x60017AC0 /end MEASUREMENT
/begin MEASUREMENT MoFAirFl_cntrComS0Old "Counter (old value) syncs S0 in function monitoring" UWORD OneToOne 1 100 0.00 65535.00 FORMAT "%8.2" ECU_ADDRESS 0x600181FE /end MEASUREMENT
/begin MEASUREMENT MoFAirFl_cntrComS0OldCpl "Ram data redundancy for MoFAirFl_cntrComS0Old" UWORD OneToOne 1 100 0.00 65535.00 FORMAT "%8.2" ECU_ADDRESS 0x60017ABE /end MEASUREMENT
/begin MEASUREMENT MoFAirFl_cntrComS0Rdnt "Redundancy of Counter syncs S0 in function monitoring" UWORD OneToOne 1 100 0.00 65535.00 FORMAT "%8.2" ECU_ADDRESS 0x600181FC /end MEASUREMENT
/begin MEASUREMENT MoFAirFl_cntrComS0RdntCpl "Ram data redundancy of MoFAirFl_cntrComS0Rdnt" UWORD OneToOne 1 100 0.00 65535.00 FORMAT "%8.2" ECU_ADDRESS 0x60017ABC /end MEASUREMENT
/begin MEASUREMENT MoFAirFl_cntrComS1 "Counter syncs S1 in function monitoring" UWORD OneToOne 1 100 0.00 65535.00 FORMAT "%8.2" ECU_ADDRESS 0x600181FA /end MEASUREMENT
/begin MEASUREMENT MoFAirFl_cntrComS1Cpl "Ram data redundancy for MoFAirFl_cntrComS1" UWORD OneToOne 1 100 0.00 65535.00 FORMAT "%8.2" ECU_ADDRESS 0x60017ABA /end MEASUREMENT
/begin MEASUREMENT MoFAirFl_cntrComS1Old "Counter (old value) syncs S1 in function monitoring" UWORD OneToOne 1 100 0.00 65535.00 FORMAT "%8.2" ECU_ADDRESS 0x600181F8 /end MEASUREMENT
/begin MEASUREMENT MoFAirFl_cntrComS1OldCpl "Ram data redundancy for MoFAirFl_cntrComS1Old" UWORD OneToOne 1 100 0.00 65535.00 FORMAT "%8.2" ECU_ADDRESS 0x60017AB8 /end MEASUREMENT
/begin MEASUREMENT MoFAirFl_cntrComS1Rdnt "Redundancy of Counter syncs S1 in function monitoring" UWORD OneToOne 1 100 0.00 65535.00 FORMAT "%8.2" ECU_ADDRESS 0x600181F6 /end MEASUREMENT
/begin MEASUREMENT MoFAirFl_cntrComS1RdntCpl "Ram data redundancy of MoFAirFl_cntrComS1Rdnt" UWORD OneToOne 1 100 0.00 65535.00 FORMAT "%8.2" ECU_ADDRESS 0x60017AB6 /end MEASUREMENT
/begin MEASUREMENT MoFAirFl_cntrDiagDebCtOffGdi "Diagnosis counter in function MoFAirFl_CtOffGdi" UBYTE OneToOne 1 100 0.00 255.0 FORMAT "%5.1" ECU_ADDRESS 0x6000AEC9 /end MEASUREMENT
/begin MEASUREMENT MoFAirFl_cntrDiagDebCylGdi "Diagnosis counter in function MoFAirFl_CylGdi" UBYTE OneToOne 1 100 0.00 255.0 FORMAT "%5.1" ECU_ADDRESS 0x6000AEC8 /end MEASUREMENT
/begin MEASUREMENT MoFAirFl_cntrDiagDebFF "Diagnosis counter in function MoFAirFl_FF" UBYTE OneToOne 1 100 0.00 255.0 FORMAT "%5.1" ECU_ADDRESS 0x6000AEC6 /end MEASUREMENT
/begin MEASUREMENT MoFAirFl_cntrDiagDebIn "Diagnosis counter in function MoFAirFl_In" UBYTE OneToOne 1 100 0.00 255.0 FORMAT "%5.1" ECU_ADDRESS 0x6000AEC5 /end MEASUREMENT
/begin MEASUREMENT MoFAirFl_cntrDiagDebMixCtlGdiChkAirFl "Diagnosis counter in function MoFAirFl_MixCtlGdi (AirFl)" UBYTE OneToOne 1 100 0.00 255.0 FORMAT "%5.1" ECU_ADDRESS 0x6000AEC4 /end MEASUREMENT
/begin MEASUREMENT MoFAirFl_cntrDiagDebMixCtlGdiChkCtrl "Diagnosis counter in function MoFAirFl_MixCtlGdi (Ctrl)" UBYTE OneToOne 1 100 0.00 255.0 FORMAT "%5.1" ECU_ADDRESS 0x6000AEC3 /end MEASUREMENT
/begin MEASUREMENT MoFAirFl_cntrErrDebCtOffGdi "Error debounce counter in function MoFAirFl_CtOffGdi" UBYTE OneToOne 1 100 0.00 255.0 FORMAT "%5.1" ECU_ADDRESS 0x60018258 /end MEASUREMENT
/begin MEASUREMENT MoFAirFl_cntrErrDebCtOffGdiCpl "Ram data redundancy for MoFAirFl_cntrErrDebCtOffGdi" UBYTE OneToOne 1 100 0.00 255.0 FORMAT "%5.1" ECU_ADDRESS 0x60017AEA /end MEASUREMENT
/begin MEASUREMENT MoFAirFl_cntrErrDebCylGdi "Error debounce counter in function MoFAirFl_CylGdi" UBYTE OneToOne 1 100 0.00 255.0 FORMAT "%5.1" ECU_ADDRESS 0x60018255 /end MEASUREMENT
/begin MEASUREMENT MoFAirFl_cntrErrDebCylGdiCpl "Ram data redundancy for MoFAirFl_cntrErrDebCylGdi" UBYTE OneToOne 1 100 0.00 255.0 FORMAT "%5.1" ECU_ADDRESS 0x60017AE7 /end MEASUREMENT
/begin MEASUREMENT MoFAirFl_cntrErrDebFF "Error debounce counter in function MoFAirFl_FF" UBYTE OneToOne 1 100 0.00 255.0 FORMAT "%5.1" ECU_ADDRESS 0x6001820D /end MEASUREMENT
/begin MEASUREMENT MoFAirFl_cntrErrDebFFCpl "Ram data redundancy for MoFAirFl_cntrErrDebFF" UBYTE OneToOne 1 100 0.00 255.0 FORMAT "%5.1" ECU_ADDRESS 0x60017ACD /end MEASUREMENT
/begin MEASUREMENT MoFAirFl_cntrErrDebInCom "Error debounce counter in function MoFAirFl_In" UBYTE OneToOne 1 100 0.00 255.0 FORMAT "%5.1" ECU_ADDRESS 0x60018205 /end MEASUREMENT
/begin MEASUREMENT MoFAirFl_cntrErrDebInComCpl "Ram data redundancy MoFAirFl_cntrErrDebInCom" UBYTE OneToOne 1 100 0.00 255.0 FORMAT "%5.1" ECU_ADDRESS 0x60017AC4 /end MEASUREMENT
/begin MEASUREMENT MoFAirFl_cntrErrDebMixCtlGdiChkAirFl "Error debounce counter in function MoFAirFl_MixCtlGdi (AirFl)" UBYTE OneToOne 1 100 0.00 255.0 FORMAT "%5.1" ECU_ADDRESS 0x6001809E /end MEASUREMENT
/begin MEASUREMENT MoFAirFl_cntrErrDebMixCtlGdiChkAirFlCpl "Ram data redundancy for MoFAirFl_cntrErrDebMixCtlGdiChkAirFl" UBYTE OneToOne 1 100 0.00 255.0 FORMAT "%5.1" ECU_ADDRESS 0x6001795E /end MEASUREMENT
/begin MEASUREMENT MoFAirFl_cntrErrDebMixCtlGdiChkCtrl "Error debounce counter in function MoFAirFl_MixCtlGdi (Ctrl)" UBYTE OneToOne 1 100 0.00 255.0 FORMAT "%5.1" ECU_ADDRESS 0x6001809D /end MEASUREMENT
/begin MEASUREMENT MoFAirFl_cntrErrDebMixCtlGdiChkCtrlCpl "Ram data redundancy for MoFAirFl_cntrErrDebMixCtlGdiChkCtrl" UBYTE OneToOne 1 100 0.00 255.0 FORMAT "%5.1" ECU_ADDRESS 0x6001795D /end MEASUREMENT
/begin MEASUREMENT MoFAirFl_cntrFuAdpnActv "Time counter flexfuel adaption active in function monitoring" UWORD OneToOne 1 100 0.00 65535.00 FORMAT "%8.2" ECU_ADDRESS 0x6001820A /end MEASUREMENT
/begin MEASUREMENT MoFAirFl_cntrFuAdpnActvCpl "RAM data redundancy for MoFAirFl_cntrFuAdpnActv" UWORD OneToOne 1 100 0.00 65535.00 FORMAT "%8.2" ECU_ADDRESS 0x60017ACA /end MEASUREMENT
/begin MEASUREMENT MoFAirFl_CtOffCplIfClass_V4_I.evz_auscplCpl "Instance of data class for ram data redundancy of MoFAirFl_CtOffIfClass / Member Variable" UBYTE OneToOne 1 100 0.00 255.0 FORMAT "%5.1" ECU_ADDRESS 0x60017A78 /end MEASUREMENT
/begin MEASUREMENT MoFAirFl_CtOffCplIfClass_V4_I.evz_auscpl_memCpl "Instance of data class for ram data redundancy of MoFAirFl_CtOffIfClass / Member Variable" UBYTE OneToOne 1 100 0.00 255.0 FORMAT "%5.1" ARRAY_SIZE 4 ECU_ADDRESS 0x60017A79 /end MEASUREMENT
/begin MEASUREMENT MoFAirFl_CtOffCplIfClass_V4_I.evz_austotCpl "Instance of data class for ram data redundancy of MoFAirFl_CtOffIfClass / Member Variable" UBYTE OneToOne 1 100 0.00 255.0 FORMAT "%5.1" ECU_ADDRESS 0x60017A7D /end MEASUREMENT
/begin MEASUREMENT MoFAirFl_CtOffCplIfClass_V4_I.evz_austot_memCpl "Instance of data class for ram data redundancy of MoFAirFl_CtOffIfClass / Member Variable" UBYTE OneToOne 1 100 0.00 255.0 FORMAT "%5.1" ARRAY_SIZE 4 ECU_ADDRESS 0x60017A7E /end MEASUREMENT
/begin MEASUREMENT MoFAirFl_CtOffCplIfClass_V4_I.flgInjEnadCpl "Instance of data class for ram data redundancy of MoFAirFl_CtOffIfClass / Member Variable" UBYTE OneToOne 1 100 0.00 255.0 FORMAT "%5.1" ECU_ADDRESS 0x60017A82 /end MEASUREMENT
/begin MEASUREMENT MoFAirFl_CtOffCplIfClass_V4_I.injTrigCylMskCpl "Instance of data class for ram data redundancy of MoFAirFl_CtOffIfClass / Member Variable" UWORD OneToOne 1 100 0.00 65535.00 FORMAT "%8.2" ECU_ADDRESS 0x60017A84 /end MEASUREMENT
/begin MEASUREMENT MoFAirFl_CtOffCplIfClass_V4_I.injTrigCylMskRdntCpl "Instance of data class for ram data redundancy of MoFAirFl_CtOffIfClass / Member Variable" UWORD OneToOne 1 100 0.00 65535.00 FORMAT "%8.2" ECU_ADDRESS 0x60017A86 /end MEASUREMENT
/begin MEASUREMENT MoFAirFl_CtOffCplIfClass_V4_I.injmode_zzylhCpl "Instance of data class for ram data redundancy of MoFAirFl_CtOffIfClass / Member Variable" ULONG OneToOne 1 100 0.00 4294967295.00 FORMAT "%13.2" ECU_ADDRESS 0x60017A88 /end MEASUREMENT
/begin MEASUREMENT MoFAirFl_CtOffCplIfClass_V4_I.injmode_zzylh_rdntCpl "Instance of data class for ram data redundancy of MoFAirFl_CtOffIfClass / Member Variable" ULONG OneToOne 1 100 0.00 4294967295.00 FORMAT "%13.2" ECU_ADDRESS 0x60017A8C /end MEASUREMENT
/begin MEASUREMENT MoFAirFl_CtOffCplIfClass_V4_I.injmode_zzylnCpl "Instance of data class for ram data redundancy of MoFAirFl_CtOffIfClass / Member Variable" ULONG OneToOne 1 100 0.00 4294967295.00 FORMAT "%13.2" ECU_ADDRESS 0x60017A90 /end MEASUREMENT
/begin MEASUREMENT MoFAirFl_CtOffCplIfClass_V4_I.injmode_zzyln_rdntCpl "Instance of data class for ram data redundancy of MoFAirFl_CtOffIfClass / Member Variable" ULONG OneToOne 1 100 0.00 4294967295.00 FORMAT "%13.2" ECU_ADDRESS 0x60017A94 /end MEASUREMENT
/begin MEASUREMENT MoFAirFl_CtOffCplIfClass_V4_I.injmode_zzylsCpl "Instance of data class for ram data redundancy of MoFAirFl_CtOffIfClass / Member Variable" ULONG OneToOne 1 100 0.00 4294967295.00 FORMAT "%13.2" ECU_ADDRESS 0x60017A98 /end MEASUREMENT
/begin MEASUREMENT MoFAirFl_CtOffCplIfClass_V4_I.injmode_zzyls_rdntCpl "Instance of data class for ram data redundancy of MoFAirFl_CtOffIfClass / Member Variable" ULONG OneToOne 1 100 0.00 4294967295.00 FORMAT "%13.2" ECU_ADDRESS 0x60017A9C /end MEASUREMENT
/begin MEASUREMENT MoFAirFl_CtOffCplIfClass_V4_I.stInjPfiDeactvAryCpl "Instance of data class for ram data redundancy of MoFAirFl_CtOffIfClass / Member Variable" UBYTE OneToOne 1 100 0.00 255.0 FORMAT "%5.1" ARRAY_SIZE 4 ECU_ADDRESS 0x60017AA0 /end MEASUREMENT
/begin MEASUREMENT MoFAirFl_CtOffCplIfClass_V4_I.stInjPfiDeactvAryRdntCpl "Instance of data class for ram data redundancy of MoFAirFl_CtOffIfClass / Member Variable" UBYTE OneToOne 1 100 0.00 255.0 FORMAT "%5.1" ARRAY_SIZE 4 ECU_ADDRESS 0x60017AA4 /end MEASUREMENT
/begin MEASUREMENT MoFAirFl_CtOffCplIfClass_V4_I.stInjPfiDeactvBkupAryCpl "Instance of data class for ram data redundancy of MoFAirFl_CtOffIfClass / Member Variable" UBYTE OneToOne 1 100 0.00 255.0 FORMAT "%5.1" ARRAY_SIZE 4 ECU_ADDRESS 0x60017AA8 /end MEASUREMENT
/begin MEASUREMENT MoFAirFl_CtOffCplIfClass_V4_I.stInjTiPfiCpl "Instance of data class for ram data redundancy of MoFAirFl_CtOffIfClass / Member Variable" UBYTE OneToOne 1 100 0.00 255.0 FORMAT "%5.1" ECU_ADDRESS 0x60017AAC /end MEASUREMENT
/begin MEASUREMENT MoFAirFl_CtOffCplIfClass_V4_I.stInjTiPfiRdntCpl "Instance of data class for ram data redundancy of MoFAirFl_CtOffIfClass / Member Variable" UBYTE OneToOne 1 100 0.00 255.0 FORMAT "%5.1" ECU_ADDRESS 0x60017AAD /end MEASUREMENT
/begin MEASUREMENT MoFAirFl_CtOffIfClass_V4_I.evz_auscpl "Instance of data class for quantities in connection with injection cut-off in function monitoring / Member Variable" UBYTE OneToOne 1 100 0.00 255.0 FORMAT "%5.1" ECU_ADDRESS 0x600181B8 /end MEASUREMENT
/begin MEASUREMENT MoFAirFl_CtOffIfClass_V4_I.evz_auscpl_mem "Instance of data class for quantities in connection with injection cut-off in function monitoring / Member Variable" UBYTE OneToOne 1 100 0.00 255.0 FORMAT "%5.1" ARRAY_SIZE 4 ECU_ADDRESS 0x600181B9 /end MEASUREMENT
/begin MEASUREMENT MoFAirFl_CtOffIfClass_V4_I.evz_austot "Instance of data class for quantities in connection with injection cut-off in function monitoring / Member Variable" UBYTE OneToOne 1 100 0.00 255.0 FORMAT "%5.1" ECU_ADDRESS 0x600181BD /end MEASUREMENT
/begin MEASUREMENT MoFAirFl_CtOffIfClass_V4_I.evz_austot_mem "Instance of data class for quantities in connection with injection cut-off in function monitoring / Member Variable" UBYTE OneToOne 1 100 0.00 255.0 FORMAT "%5.1" ARRAY_SIZE 4 ECU_ADDRESS 0x600181BE /end MEASUREMENT
/begin MEASUREMENT MoFAirFl_CtOffIfClass_V4_I.flgInjEnad "Instance of data class for quantities in connection with injection cut-off in function monitoring / Member Variable" UBYTE OneToOne 1 100 0.00 255.0 FORMAT "%5.1" ECU_ADDRESS 0x600181C2 /end MEASUREMENT
/begin MEASUREMENT MoFAirFl_CtOffIfClass_V4_I.injTrigCylMsk "Instance of data class for quantities in connection with injection cut-off in function monitoring / Member Variable" UWORD OneToOne 1 100 0.00 65535.00 FORMAT "%8.2" ECU_ADDRESS 0x600181C4 /end MEASUREMENT
/begin MEASUREMENT MoFAirFl_CtOffIfClass_V4_I.injTrigCylMskRdnt "Instance of data class for quantities in connection with injection cut-off in function monitoring / Member Variable" UWORD OneToOne 1 100 0.00 65535.00 FORMAT "%8.2" ECU_ADDRESS 0x600181C6 /end MEASUREMENT
/begin MEASUREMENT MoFAirFl_CtOffIfClass_V4_I.injmode_zzylh "Instance of data class for quantities in connection with injection cut-off in function monitoring / Member Variable" ULONG OneToOne 1 100 0.00 4294967295.00 FORMAT "%13.2" ECU_ADDRESS 0x600181C8 /end MEASUREMENT
/begin MEASUREMENT MoFAirFl_CtOffIfClass_V4_I.injmode_zzylh_rdnt "Instance of data class for quantities in connection with injection cut-off in function monitoring / Member Variable" ULONG OneToOne 1 100 0.00 4294967295.00 FORMAT "%13.2" ECU_ADDRESS 0x600181CC /end MEASUREMENT
/begin MEASUREMENT MoFAirFl_CtOffIfClass_V4_I.injmode_zzyln "Instance of data class for quantities in connection with injection cut-off in function monitoring / Member Variable" ULONG OneToOne 1 100 0.00 4294967295.00 FORMAT "%13.2" ECU_ADDRESS 0x600181D0 /end MEASUREMENT
/begin MEASUREMENT MoFAirFl_CtOffIfClass_V4_I.injmode_zzyln_rdnt "Instance of data class for quantities in connection with injection cut-off in function monitoring / Member Variable" ULONG OneToOne 1 100 0.00 4294967295.00 FORMAT "%13.2" ECU_ADDRESS 0x600181D4 /end MEASUREMENT
/begin MEASUREMENT MoFAirFl_CtOffIfClass_V4_I.injmode_zzyls "Instance of data class for quantities in connection with injection cut-off in function monitoring / Member Variable" ULONG OneToOne 1 100 0.00 4294967295.00 FORMAT "%13.2" ECU_ADDRESS 0x600181D8 /end MEASUREMENT
/begin MEASUREMENT MoFAirFl_CtOffIfClass_V4_I.injmode_zzyls_rdnt "Instance of data class for quantities in connection with injection cut-off in function monitoring / Member Variable" ULONG OneToOne 1 100 0.00 4294967295.00 FORMAT "%13.2" ECU_ADDRESS 0x600181DC /end MEASUREMENT
/begin MEASUREMENT MoFAirFl_CtOffIfClass_V4_I.stInjPfiDeactvAry "Instance of data class for quantities in connection with injection cut-off in function monitoring / Member Variable" UBYTE OneToOne 1 100 0.00 255.0 FORMAT "%5.1" ARRAY_SIZE 4 ECU_ADDRESS 0x600181E0 /end MEASUREMENT
/begin MEASUREMENT MoFAirFl_CtOffIfClass_V4_I.stInjPfiDeactvAryRdnt "Instance of data class for quantities in connection with injection cut-off in function monitoring / Member Variable" UBYTE OneToOne 1 100 0.00 255.0 FORMAT "%5.1" ARRAY_SIZE 4 ECU_ADDRESS 0x600181E4 /end MEASUREMENT
/begin MEASUREMENT MoFAirFl_CtOffIfClass_V4_I.stInjPfiDeactvBkupAry "Instance of data class for quantities in connection with injection cut-off in function monitoring / Member Variable" UBYTE OneToOne 1 100 0.00 255.0 FORMAT "%5.1" ARRAY_SIZE 4 ECU_ADDRESS 0x600181E8 /end MEASUREMENT
/begin MEASUREMENT MoFAirFl_CtOffIfClass_V4_I.stInjTiPfi "Instance of data class for quantities in connection with injection cut-off in function monitoring / Member Variable" UBYTE OneToOne 1 100 0.00 255.0 FORMAT "%5.1" ECU_ADDRESS 0x600181EC /end MEASUREMENT
/begin MEASUREMENT MoFAirFl_CtOffIfClass_V4_I.stInjTiPfiRdnt "Instance of data class for quantities in connection with injection cut-off in function monitoring / Member Variable" UBYTE OneToOne 1 100 0.00 255.0 FORMAT "%5.1" ECU_ADDRESS 0x600181ED /end MEASUREMENT
/begin MEASUREMENT MoFAirFl_etaIA "Ignition angle efficiency in function monitoring" UWORD fak_uw_b2 1 100 0.00 1.999969 FORMAT "%8.6" ECU_ADDRESS 0x60018218 /end MEASUREMENT
/begin MEASUREMENT MoFAirFl_etaIAAvrg "average ignition angle efficiency in function monitoring" UWORD fak_uw_b2 1 100 0.00 1.999969 FORMAT "%8.6" ECU_ADDRESS 0x60018216 /end MEASUREMENT
/begin MEASUREMENT MoFAirFl_etaIAAvrgCpl "Ram data redundancy for MoFAirFl_etaIAAvrg" UWORD OneToOne 1 100 0.00 65535.00 FORMAT "%8.2" ECU_ADDRESS 0x60017ADC /end MEASUREMENT
/begin MEASUREMENT MoFAirFl_etaIACpl "Ram data redundancy for MoFAirFl_etaIA" UWORD OneToOne 1 100 0.00 65535.00 FORMAT "%8.2" ECU_ADDRESS 0x60017ADA /end MEASUREMENT
/begin MEASUREMENT MoFAirFl_etaInjCtOff "Injection cut-off efficiency in function monitoring" UWORD fak_uw_b2 1 100 0.00 1.999969 FORMAT "%8.6" ECU_ADDRESS 0x60018214 /end MEASUREMENT
/begin MEASUREMENT MoFAirFl_etaInjCtOffCpl "Ram data redundancy for MoFAirFl_etaInjCtOff" UWORD OneToOne 1 100 0.00 65535.00 FORMAT "%8.2" ECU_ADDRESS 0x60017AD8 /end MEASUREMENT
/begin MEASUREMENT MoFAirFl_etaInjSplt "Injection split efficiency in function monitoring" UWORD fak_uw_b2 1 100 0.00 1.999969 FORMAT "%8.6" ECU_ADDRESS 0x60018212 /end MEASUREMENT
/begin MEASUREMENT MoFAirFl_etaInjSpltCpl "Ram data redundancy for MoFAirFl_etaInjSplt" UWORD OneToOne 1 100 0.00 65535.00 FORMAT "%8.2" ECU_ADDRESS 0x60017AD6 /end MEASUREMENT
/begin MEASUREMENT MoFAirFl_etaLam "Lambda efficiency in function monitoring" UWORD fak_uw_b2 1 100 0.00 1.999969 FORMAT "%8.6" ECU_ADDRESS 0x60018210 /end MEASUREMENT
/begin MEASUREMENT MoFAirFl_etaLamCpl "Ram data redundancy for MoFAirFl_etaLam" UWORD OneToOne 1 100 0.00 65535.00 FORMAT "%8.2" ECU_ADDRESS 0x60017AD4 /end MEASUREMENT
/begin MEASUREMENT MoFAirFl_facAftStrtCorrn "Factor post start in fuel monitoring" UWORD fak_uw_b64 1 100 0.00 63.99902 FORMAT "%8.5" ECU_ADDRESS 0x60018096 /end MEASUREMENT
/begin MEASUREMENT MoFAirFl_facAftStrtCorrnCpl "Factor post start in fuel monitoring cpl" UWORD OneToOne 1 100 0.00 65535.00 FORMAT "%8.2" ECU_ADDRESS 0x60017954 /end MEASUREMENT
/begin MEASUREMENT MoFAirFl_facFuAdpnLst "Last valid flexfuel adaption factor in function monitoring" UWORD fak_uw_b2 1 100 0.00 1.999969 FORMAT "%8.6" ECU_ADDRESS 0x60018208 /end MEASUREMENT
/begin MEASUREMENT MoFAirFl_facFuAdpnLstCpl "RAM data redundancy for MoFAirFl_facFuAdpnLst" UWORD OneToOne 1 100 0.00 65535.00 FORMAT "%8.2" ECU_ADDRESS 0x60017AC8 /end MEASUREMENT
/begin MEASUREMENT MoFAirFl_facLamFuM "Lambda correction in fuel monitoring" UWORD fak_uw_b2 1 100 0.00 1.999969 FORMAT "%8.6" ECU_ADDRESS 0x60018094 /end MEASUREMENT
/begin MEASUREMENT MoFAirFl_facLamFuMCpl "Lambda correction in fuel monitoring cpl" UWORD OneToOne 1 100 0.00 65535.00 FORMAT "%8.2" ECU_ADDRESS 0x60017952 /end MEASUREMENT
/begin MEASUREMENT MoFAirFl_facPCFuM "Factor pre control in fuel monitoring" UWORD fak_uw_b64 1 100 0.00 63.99902 FORMAT "%8.5" ECU_ADDRESS 0x60018092 /end MEASUREMENT
/begin MEASUREMENT MoFAirFl_facPCFuMCpl "Factor pre control in fuel monitoring cpl" UWORD OneToOne 1 100 0.00 65535.00 FORMAT "%8.2" ECU_ADDRESS 0x60017950 /end MEASUREMENT
/begin MEASUREMENT MoFAirFl_FfCplIfClass_V4_I.B_ethggCpl "Instance of data class for ram data redundancy of MoFAirFl_FfIfClass_V4 / Instance of data class for ram data redundancy of MoFAirFl_FfIfClass_V4_I Member Variable" UBYTE OneToOne 1 100 0.00 255.0 FORMAT "%5.1" ECU_ADDRESS 0x60017A6E /end MEASUREMENT
/begin MEASUREMENT MoFAirFl_FfCplIfClass_V4_I.ethggRdntCpl "Instance of data class for ram data redundancy of MoFAirFl_FfIfClass_V4 / Instance of data class for ram data redundancy of MoFAirFl_FfIfClass_V4_I Member Variable" UBYTE OneToOne 1 100 0.00 255.0 FORMAT "%5.1" ECU_ADDRESS 0x60017A6F /end MEASUREMENT
/begin MEASUREMENT MoFAirFl_FfCplIfClass_V4_I.facFuAdpnCpl "Instance of data class for ram data redundancy of MoFAirFl_FfIfClass_V4 / Instance of data class for ram data redundancy of MoFAirFl_FfIfClass_V4_I Member Variable" UWORD OneToOne 1 100 0.00 65535.00 FORMAT "%8.2" ECU_ADDRESS 0x60017A70 /end MEASUREMENT
/begin MEASUREMENT MoFAirFl_FfCplIfClass_V4_I.flgEthVldCpl "Instance of data class for ram data redundancy of MoFAirFl_FfIfClass_V4 / Instance of data class for ram data redundancy of MoFAirFl_FfIfClass_V4_I Member Variable" UBYTE OneToOne 1 100 0.00 255.0 FORMAT "%5.1" ECU_ADDRESS 0x60017A72 /end MEASUREMENT
/begin MEASUREMENT MoFAirFl_FfCplIfClass_V4_I.stEthVldRdntCpl "Instance of data class for ram data redundancy of MoFAirFl_FfIfClass_V4 / Instance of data class for ram data redundancy of MoFAirFl_FfIfClass_V4_I Member Variable" UBYTE OneToOne 1 100 0.00 255.0 FORMAT "%5.1" ECU_ADDRESS 0x60017A73 /end MEASUREMENT
/begin MEASUREMENT MoFAirFl_FfCplIfClass_V4_I.stFuAdpnRdntCpl "Instance of data class for ram data redundancy of MoFAirFl_FfIfClass_V4 / Instance of data class for ram data redundancy of MoFAirFl_FfIfClass_V4_I Member Variable" UWORD OneToOne 1 100 0.00 65535.00 FORMAT "%8.2" ECU_ADDRESS 0x60017A74 /end MEASUREMENT
/begin MEASUREMENT MoFAirFl_FfIfClass_V4_I.B_ethgg "Instance of data class for quantities in connection with FlexFuel in function monitoring / Instance of data class for quantities in connection with FlexFuel in function monitoring Member Variable" UBYTE OneToOne 1 100 0.00 255.0 FORMAT "%5.1" ECU_ADDRESS 0x600181AE /end MEASUREMENT
/begin MEASUREMENT MoFAirFl_FfIfClass_V4_I.ethggRdnt "Instance of data class for quantities in connection with FlexFuel in function monitoring / Instance of data class for quantities in connection with FlexFuel in function monitoring Member Variable" UBYTE OneToOne 1 100 0.00 255.0 FORMAT "%5.1" ECU_ADDRESS 0x600181AF /end MEASUREMENT
/begin MEASUREMENT MoFAirFl_FfIfClass_V4_I.facFuAdpn "Instance of data class for quantities in connection with FlexFuel in function monitoring / Instance of data class for quantities in connection with FlexFuel in function monitoring Member Variable" UWORD fak_uw_b2 1 100 0.00 1.999969 FORMAT "%8.6" ECU_ADDRESS 0x600181B0 /end MEASUREMENT
/begin MEASUREMENT MoFAirFl_FfIfClass_V4_I.flgEthVld "Instance of data class for quantities in connection with FlexFuel in function monitoring / Instance of data class for quantities in connection with FlexFuel in function monitoring Member Variable" UBYTE OneToOne 1 100 0.00 255.0 FORMAT "%5.1" ECU_ADDRESS 0x600181B2 /end MEASUREMENT
/begin MEASUREMENT MoFAirFl_FfIfClass_V4_I.stEthVldRdnt "Instance of data class for quantities in connection with FlexFuel in function monitoring / Instance of data class for quantities in connection with FlexFuel in function monitoring Member Variable" UBYTE OneToOne 1 100 0.00 255.0 FORMAT "%5.1" ECU_ADDRESS 0x600181B3 /end MEASUREMENT
/begin MEASUREMENT MoFAirFl_FfIfClass_V4_I.stFuAdpnRdnt "Instance of data class for quantities in connection with FlexFuel in function monitoring / Instance of data class for quantities in connection with FlexFuel in function monitoring Member Variable" UWORD dez 1 100 0.00 65535.00 FORMAT "%8.2" ECU_ADDRESS 0x600181B4 /end MEASUREMENT
/begin MEASUREMENT MoFAirFl_flgCtOffExpdCylHom "Status flag injection cut off expected for zzlh" UBYTE B_TRUE 1 100 0.00 1.00000000000 BIT_MASK 0x1 FORMAT "%13.11" ECU_ADDRESS 0x60018259 /end MEASUREMENT
/begin MEASUREMENT MoFAirFl_flgCtOffExpdCylNsp "Status flag injection cut off expected for zzlnsp" UBYTE B_TRUE 1 100 0.00 1.00000000000 BIT_MASK 0x2 FORMAT "%13.11" ECU_ADDRESS 0x60018259 /end MEASUREMENT
/begin MEASUREMENT MoFAirFl_flgCtOffExpdCylStrat "Status flag injection cut off expected for zzls" UBYTE B_TRUE 1 100 0.00 1.00000000000 BIT_MASK 0x4 FORMAT "%13.11" ECU_ADDRESS 0x60018259 /end MEASUREMENT
/begin MEASUREMENT MoFAirFl_flgErrCom "Information error in communication with level1" UBYTE B_TRUE 1 100 0.00 1.00000000000 BIT_MASK 0x1 FORMAT "%13.11" ECU_ADDRESS 0x60018203 /end MEASUREMENT
/begin MEASUREMENT MoFAirFl_flgInjEnadCylHom "status flag injection active for zzylh" UBYTE B_TRUE 1 100 0.00 1.00000000000 BIT_MASK 0x8 FORMAT "%13.11" ECU_ADDRESS 0x60018259 /end MEASUREMENT
/begin MEASUREMENT MoFAirFl_flgInjEnadCylNsp "status flag injection active for zzylnsp" UBYTE B_TRUE 1 100 0.00 1.00000000000 BIT_MASK 0x10 FORMAT "%13.11" ECU_ADDRESS 0x60018259 /end MEASUREMENT
/begin MEASUREMENT MoFAirFl_flgInjEnadCylStrat "status flag injection active for zzyls" UBYTE B_TRUE 1 100 0.00 1.00000000000 BIT_MASK 0x20 FORMAT "%13.11" ECU_ADDRESS 0x60018259 /end MEASUREMENT
/begin MEASUREMENT MoFAirFl_flgIrrvErrCtOffGdiMsg "Irreversible error bit in function MoFAirFl_CtOffGdi" UBYTE B_TRUE 1 100 0.00 1.00000000000 BIT_MASK 0x1 FORMAT "%13.11" ECU_ADDRESS 0x700007F7 /end MEASUREMENT
/begin MEASUREMENT MoFAirFl_flgIrrvErrCylGdiMsg "Irreversible error bit in function MoFAirFl_CylGdi" UBYTE B_TRUE 1 100 0.00 1.00000000000 BIT_MASK 0x1 FORMAT "%13.11" ECU_ADDRESS 0x700007F6 /end MEASUREMENT
/begin MEASUREMENT MoFAirFl_flgIrrvErrFFMsg "Irreversible error bit in function MoFAirFl_FF" UBYTE B_TRUE 1 100 0.00 1.00000000000 BIT_MASK 0x1 FORMAT "%13.11" ECU_ADDRESS 0x700007F5 /end MEASUREMENT
/begin MEASUREMENT MoFAirFl_flgIrrvErrInMsg "Irreversible error bit in function MoFAirFl_In" UBYTE B_TRUE 1 100 0.00 1.00000000000 BIT_MASK 0x1 FORMAT "%13.11" ECU_ADDRESS 0x700007F3 /end MEASUREMENT
/begin MEASUREMENT MoFAirFl_flgIrrvErrMixCtlGdiChkAirFlMsg "Irreversible error bit in function MoFAirFl_MixCtlGdi (AirFl)" UBYTE B_TRUE 1 100 0.00 1.00000000000 BIT_MASK 0x1 FORMAT "%13.11" ECU_ADDRESS 0x700007F2 /end MEASUREMENT
/begin MEASUREMENT MoFAirFl_flgIrrvErrMixCtlGdiChkCtrlMsg "Irreversible error bit in function MoFAirFl_MixCtlGdi (Ctrl)" UBYTE B_TRUE 1 100 0.00 1.00000000000 BIT_MASK 0x1 FORMAT "%13.11" ECU_ADDRESS 0x700007F1 /end MEASUREMENT
/begin MEASUREMENT MoFAirFl_flgOldSubSt "state of old substtituton mode from MoFAirFl_FF in function monitoring" UBYTE B_TRUE 1 100 0.00 1.00000000000 BIT_MASK 0x1 FORMAT "%13.11" ECU_ADDRESS 0x6001820E /end MEASUREMENT
/begin MEASUREMENT MoFAirFl_flgTestCtOffGdiMsg "Bit test conditions for diagnosis in function MoFAirFl_CtOffGdi" UBYTE B_TRUE 1 100 0.00 1.00000000000 BIT_MASK 0x1 FORMAT "%13.11" ECU_ADDRESS 0x700007EF /end MEASUREMENT
/begin MEASUREMENT MoFAirFl_flgTestCylGdiMsg "Bit test conditions for diagnosis in function MoFAirFl_CylGdi" UBYTE B_TRUE 1 100 0.00 1.00000000000 BIT_MASK 0x1 FORMAT "%13.11" ECU_ADDRESS 0x700007EE /end MEASUREMENT
/begin MEASUREMENT MoFAirFl_flgTestFFMsg "Bit test conditions for diagnosis in function MoFAirFl_FF" UBYTE B_TRUE 1 100 0.00 1.00000000000 BIT_MASK 0x1 FORMAT "%13.11" ECU_ADDRESS 0x700007ED /end MEASUREMENT
/begin MEASUREMENT MoFAirFl_flgTestInMsg "Bit test conditions for diagnosis in function MoFAirFl_In" UBYTE B_TRUE 1 100 0.00 1.00000000000 BIT_MASK 0x1 FORMAT "%13.11" ECU_ADDRESS 0x700007EB /end MEASUREMENT
/begin MEASUREMENT MoFAirFl_flgTestMixCtlGdiChkAirFlMsg "Bit test conditions for diagnosis in function MoFAirFl_MixCtlGdi (AirFl)" UBYTE B_TRUE 1 100 0.00 1.00000000000 BIT_MASK 0x1 FORMAT "%13.11" ECU_ADDRESS 0x700007EA /end MEASUREMENT
/begin MEASUREMENT MoFAirFl_flgTestMixCtlGdiChkCtrlMsg "Bit test conditions for diagnosis in function MoFAirFl_MixCtlGdi (Ctrl)" UBYTE B_TRUE 1 100 0.00 1.00000000000 BIT_MASK 0x1 FORMAT "%13.11" ECU_ADDRESS 0x700007E9 /end MEASUREMENT
/begin MEASUREMENT MoFAirFl_iaDelta "Delta ignition angle in function monitoring" SWORD zw_q0p05 1 100 -1638.400 1638.350 FORMAT "%8.3" ECU_ADDRESS 0x6001822C /end MEASUREMENT
/begin MEASUREMENT MoFAirFl_iaDeltaCpl "RAM data redundancy for MoFAirFl_iaDelta" UWORD OneToOne 1 100 0.00 65535.00 FORMAT "%8.2" ECU_ADDRESS 0x60017AD2 /end MEASUREMENT
/begin MEASUREMENT MoFAirFl_iaDeltaOpt "Optimum ignition angle delta replacing MeasPnt" SWORD zw_q0p05 1 100 -1638.400 1638.350 FORMAT "%8.3" ECU_ADDRESS 0x6001822A /end MEASUREMENT
/begin MEASUREMENT MoFAirFl_iaDeltaOptChrgMtn "Optimum ignition angle delta charge motion replacing MeasPnt" SWORD zw_q0p05 1 100 -1638.400 1638.350 FORMAT "%8.3" ECU_ADDRESS 0x60018228 /end MEASUREMENT
/begin MEASUREMENT MoFAirFl_iaDeltaOptChrgMtnCpl "Optimum charge ignition angle delta complement" UWORD OneToOne 1 100 0.00 65535.00 FORMAT "%8.2" ECU_ADDRESS 0x60018226 /end MEASUREMENT
/begin MEASUREMENT MoFAirFl_iaDeltaOptCpl "Optimum ignition angle delta complement" UWORD OneToOne 1 100 0.00 65535.00 FORMAT "%8.2" ECU_ADDRESS 0x60018224 /end MEASUREMENT
/begin MEASUREMENT MoFAirFl_iaOpt "Optimum ignition angle variable replacing MeasPnt" SWORD zw_q0p05 1 100 -1638.400 1638.350 FORMAT "%8.3" ECU_ADDRESS 0x60018222 /end MEASUREMENT
/begin MEASUREMENT MoFAirFl_iaOptCpl "Optimum ignition angle complement" UWORD OneToOne 1 100 0.00 65535.00 FORMAT "%8.2" ECU_ADDRESS 0x60018220 /end MEASUREMENT
/begin MEASUREMENT MoFAirFl_iaOptTot "Total opt ign angle variable replacing MeasPnt" SWORD zw_q0p05 1 100 -1638.400 1638.350 FORMAT "%8.3" ECU_ADDRESS 0x6001821E /end MEASUREMENT
/begin MEASUREMENT MoFAirFl_iaOptTotCpl "Total optimum ignition angle complement" UWORD OneToOne 1 100 0.00 65535.00 FORMAT "%8.2" ECU_ADDRESS 0x6001821C /end MEASUREMENT
/begin MEASUREMENT MoFAirFl_InjTmngCplIfClass_V4_I.bdemodCpl "Instance of data class for ram data redundancy of MoFAirFl_InjTmngIfClass / Member Variable" UBYTE OneToOne 1 100 0.00 255.0 FORMAT "%5.1" ECU_ADDRESS 0x60017A62 /end MEASUREMENT
/begin MEASUREMENT MoFAirFl_InjTmngCplIfClass_V4_I.bdemodRdntCpl "Instance of data class for ram data redundancy of MoFAirFl_InjTmngIfClass / Member Variable" UBYTE OneToOne 1 100 0.00 255.0 FORMAT "%5.1" ECU_ADDRESS 0x60017A63 /end MEASUREMENT
/begin MEASUREMENT MoFAirFl_InjTmngCplIfClass_V4_I.cntrCylAdvCpl "Instance of data class for ram data redundancy of MoFAirFl_InjTmngIfClass / Complement value of SW-cylinder counter doubled range" UBYTE OneToOne 1 100 0.00 255.0 FORMAT "%5.1" ECU_ADDRESS 0x60017A64 /end MEASUREMENT
/begin MEASUREMENT MoFAirFl_InjTmngCplIfClass_V4_I.cntrCylAdvRdntCpl "Instance of data class for ram data redundancy of MoFAirFl_InjTmngIfClass / Complement value of SW-cylinder counter doubled range redundant" UBYTE OneToOne 1 100 0.00 255.0 FORMAT "%5.1" ECU_ADDRESS 0x60017A65 /end MEASUREMENT
/begin MEASUREMENT MoFAirFl_InjTmngCplIfClass_V4_I.stInjTmngCpl "Instance of data class for ram data redundancy of MoFAirFl_InjTmngIfClass / Member Variable" UBYTE OneToOne 1 100 0.00 255.0 FORMAT "%5.1" ECU_ADDRESS 0x60017A66 /end MEASUREMENT
/begin MEASUREMENT MoFAirFl_InjTmngCplIfClass_V4_I.stInjTmngRdntCpl "Instance of data class for ram data redundancy of MoFAirFl_InjTmngIfClass / Member Variable" UBYTE OneToOne 1 100 0.00 255.0 FORMAT "%5.1" ECU_ADDRESS 0x60017A67 /end MEASUREMENT
/begin MEASUREMENT MoFAirFl_InjTmngCplIfClass_V4_I.zzylhCpl "Instance of data class for ram data redundancy of MoFAirFl_InjTmngIfClass / Member Variable" UBYTE OneToOne 1 100 0.00 255.0 FORMAT "%5.1" ECU_ADDRESS 0x60017A68 /end MEASUREMENT
/begin MEASUREMENT MoFAirFl_InjTmngCplIfClass_V4_I.zzylhRdntCpl "Instance of data class for ram data redundancy of MoFAirFl_InjTmngIfClass / Member Variable" UBYTE OneToOne 1 100 0.00 255.0 FORMAT "%5.1" ECU_ADDRESS 0x60017A69 /end MEASUREMENT
/begin MEASUREMENT MoFAirFl_InjTmngCplIfClass_V4_I.zzylnspCpl "Instance of data class for ram data redundancy of MoFAirFl_InjTmngIfClass / Member Variable" UBYTE OneToOne 1 100 0.00 255.0 FORMAT "%5.1" ECU_ADDRESS 0x60017A6A /end MEASUREMENT
/begin MEASUREMENT MoFAirFl_InjTmngCplIfClass_V4_I.zzylnspRdntCpl "Instance of data class for ram data redundancy of MoFAirFl_InjTmngIfClass / Member Variable" UBYTE OneToOne 1 100 0.00 255.0 FORMAT "%5.1" ECU_ADDRESS 0x60017A6B /end MEASUREMENT
/begin MEASUREMENT MoFAirFl_InjTmngCplIfClass_V4_I.zzylsCpl "Instance of data class for ram data redundancy of MoFAirFl_InjTmngIfClass / Member Variable" UBYTE OneToOne 1 100 0.00 255.0 FORMAT "%5.1" ECU_ADDRESS 0x60017A6C /end MEASUREMENT
/begin MEASUREMENT MoFAirFl_InjTmngCplIfClass_V4_I.zzylsRdntCpl "Instance of data class for ram data redundancy of MoFAirFl_InjTmngIfClass / Member Variable" UBYTE OneToOne 1 100 0.00 255.0 FORMAT "%5.1" ECU_ADDRESS 0x60017A6D /end MEASUREMENT
/begin MEASUREMENT MoFAirFl_InjTmngIfClass_V4_I.bdemod "Instance of data class for quantities in connection with injection time in function monitoring / Member Variable" UBYTE OneToOne 1 100 0.00 255.0 FORMAT "%5.1" ECU_ADDRESS 0x600181A2 /end MEASUREMENT
/begin MEASUREMENT MoFAirFl_InjTmngIfClass_V4_I.bdemodRdnt "Instance of data class for quantities in connection with injection time in function monitoring / Member Variable" UBYTE OneToOne 1 100 0.00 255.0 FORMAT "%5.1" ECU_ADDRESS 0x600181A3 /end MEASUREMENT
/begin MEASUREMENT MoFAirFl_InjTmngIfClass_V4_I.cntrCylAdv "Instance of data class for quantities in connection with injection time in function monitoring / SW-cylinder counter doubled range" UBYTE dez 1 100 0.00 255.0 FORMAT "%5.1" ECU_ADDRESS 0x600181A4 /end MEASUREMENT
/begin MEASUREMENT MoFAirFl_InjTmngIfClass_V4_I.cntrCylAdvRdnt "Instance of data class for quantities in connection with injection time in function monitoring / SW-cylinder counter doubled range redundant" UBYTE dez 1 100 0.00 255.0 FORMAT "%5.1" ECU_ADDRESS 0x600181A5 /end MEASUREMENT
/begin MEASUREMENT MoFAirFl_InjTmngIfClass_V4_I.stInjTmng "Instance of data class for quantities in connection with injection time in function monitoring / Member Variable" UBYTE OneToOne 1 100 0.00 255.0 FORMAT "%5.1" ECU_ADDRESS 0x600181A6 /end MEASUREMENT
/begin MEASUREMENT MoFAirFl_InjTmngIfClass_V4_I.stInjTmngRdnt "Instance of data class for quantities in connection with injection time in function monitoring / Member Variable" UBYTE OneToOne 1 100 0.00 255.0 FORMAT "%5.1" ECU_ADDRESS 0x600181A7 /end MEASUREMENT
/begin MEASUREMENT MoFAirFl_InjTmngIfClass_V4_I.zzylh "Instance of data class for quantities in connection with injection time in function monitoring / Member Variable" UBYTE OneToOne 1 100 0.00 7.000 FORMAT "%5.3" ECU_ADDRESS 0x600181A8 /end MEASUREMENT
/begin MEASUREMENT MoFAirFl_InjTmngIfClass_V4_I.zzylhRdnt "Instance of data class for quantities in connection with injection time in function monitoring / Member Variable" UBYTE OneToOne 1 100 0.00 255.0 FORMAT "%5.1" ECU_ADDRESS 0x600181A9 /end MEASUREMENT
/begin MEASUREMENT MoFAirFl_InjTmngIfClass_V4_I.zzylnsp "Instance of data class for quantities in connection with injection time in function monitoring / Member Variable" UBYTE OneToOne 1 100 0.00 7.000 FORMAT "%5.3" ECU_ADDRESS 0x600181AA /end MEASUREMENT
/begin MEASUREMENT MoFAirFl_InjTmngIfClass_V4_I.zzylnspRdnt "Instance of data class for quantities in connection with injection time in function monitoring / Member Variable" UBYTE OneToOne 1 100 0.00 255.0 FORMAT "%5.1" ECU_ADDRESS 0x600181AB /end MEASUREMENT
/begin MEASUREMENT MoFAirFl_InjTmngIfClass_V4_I.zzyls "Instance of data class for quantities in connection with injection time in function monitoring / Member Variable" UBYTE OneToOne 1 100 0.00 7.000 FORMAT "%5.3" ECU_ADDRESS 0x600181AC /end MEASUREMENT
/begin MEASUREMENT MoFAirFl_InjTmngIfClass_V4_I.zzylsRdnt "Instance of data class for quantities in connection with injection time in function monitoring / Member Variable" UBYTE OneToOne 1 100 0.00 255.0 FORMAT "%5.1" ECU_ADDRESS 0x600181AD /end MEASUREMENT
/begin MEASUREMENT MoFAirFl_MixCtlGdi_lamsbg_rCtlPri "Lambda with feedforward control" UWORD fak_uw_b16 1 100 0.00 15.99976 FORMAT "%8.5" ECU_ADDRESS 0x60018090 /end MEASUREMENT
/begin MEASUREMENT MoFAirFl_MixCtlGdi_lamsbg_rCtlPriCpl "Lambda with feedforward control cpl" UWORD OneToOne 1 100 0.00 65535.00 FORMAT "%8.2" ECU_ADDRESS 0x6001794E /end MEASUREMENT
/begin MEASUREMENT MoFAirFl_MixMngtCplIfClass_V4_I.B_afimreqCpl "Instance of data class for ram data redundancy of MoFAirFl_MixMngIfClass / Member Variable" UBYTE OneToOne 1 100 0.00 255.0 FORMAT "%5.1" ECU_ADDRESS 0x60017998 /end MEASUREMENT
/begin MEASUREMENT MoFAirFl_MixMngtCplIfClass_V4_I.facLamCtlPfiAryCpl "Instance of data class for ram data redundancy of MoFAirFl_MixMngIfClass / Member Variable" UWORD OneToOne 1 100 0.00 65535.00 FORMAT "%8.2" ARRAY_SIZE 4 ECU_ADDRESS 0x6001799A /end MEASUREMENT
/begin MEASUREMENT MoFAirFl_MixMngtCplIfClass_V4_I.facLamCtlPfiAryRdntCpl "Instance of data class for ram data redundancy of MoFAirFl_MixMngIfClass / Member Variable" UWORD OneToOne 1 100 0.00 65535.00 FORMAT "%8.2" ARRAY_SIZE 4 ECU_ADDRESS 0x600179A2 /end MEASUREMENT
/begin MEASUREMENT MoFAirFl_MixMngtCplIfClass_V4_I.facLamCtlPfiBkupAryCpl "Instance of data class for ram data redundancy of MoFAirFl_MixMngIfClass / Member Variable" UWORD OneToOne 1 100 0.00 65535.00 FORMAT "%8.2" ARRAY_SIZE 4 ECU_ADDRESS 0x600179AA /end MEASUREMENT
/begin MEASUREMENT MoFAirFl_MixMngtCplIfClass_V4_I.facMixCorrnLivcCpl "Instance of data class for ram data redundancy of MoFAirFl_MixMngIfClass / Complement value of Adaption factor Atkinson gasoline backflow" UWORD OneToOne 1 100 0.00 65535.00 FORMAT "%8.2" ECU_ADDRESS 0x600179B2 /end MEASUREMENT
/begin MEASUREMENT MoFAirFl_MixMngtCplIfClass_V4_I.facPcPfiRestCpl "Instance of data class for ram data redundancy of MoFAirFl_MixMngIfClass / Member Variable" UWORD OneToOne 1 100 0.00 65535.00 FORMAT "%8.2" ECU_ADDRESS 0x600179B4 /end MEASUREMENT
/begin MEASUREMENT MoFAirFl_MixMngtCplIfClass_V4_I.facPcRestCpl "Instance of data class for ram data redundancy of MoFAirFl_MixMngIfClass / Member Variable" UWORD OneToOne 1 100 0.00 65535.00 FORMAT "%8.2" ECU_ADDRESS 0x600179B6 /end MEASUREMENT
/begin MEASUREMENT MoFAirFl_MixMngtCplIfClass_V4_I.facPrtnPfiAryCpl "Instance of data class for ram data redundancy of MoFAirFl_MixMngIfClass / Member Variable" UBYTE OneToOne 1 100 0.00 255.0 FORMAT "%5.1" ARRAY_SIZE 4 ECU_ADDRESS 0x600179B8 /end MEASUREMENT
/begin MEASUREMENT MoFAirFl_MixMngtCplIfClass_V4_I.facPrtnPfiAryRdntCpl "Instance of data class for ram data redundancy of MoFAirFl_MixMngIfClass / Member Variable" UBYTE OneToOne 1 100 0.00 255.0 FORMAT "%5.1" ARRAY_SIZE 4 ECU_ADDRESS 0x600179BC /end MEASUREMENT
/begin MEASUREMENT MoFAirFl_MixMngtCplIfClass_V4_I.facPrtnPfiBkupAryCpl "Instance of data class for ram data redundancy of MoFAirFl_MixMngIfClass / Member Variable" UBYTE OneToOne 1 100 0.00 255.0 FORMAT "%5.1" ARRAY_SIZE 4 ECU_ADDRESS 0x600179C0 /end MEASUREMENT
/begin MEASUREMENT MoFAirFl_MixMngtCplIfClass_V4_I.facPrtnPfiCpl "Instance of data class for ram data redundancy of MoFAirFl_MixMngIfClass / Member Variable" UBYTE OneToOne 1 100 0.00 255.0 FORMAT "%5.1" ECU_ADDRESS 0x600179C4 /end MEASUREMENT
/begin MEASUREMENT MoFAirFl_MixMngtCplIfClass_V4_I.ffuevaliCpl "Instance of data class for ram data redundancy of MoFAirFl_MixMngIfClass / Member Variable" UWORD OneToOne 1 100 0.00 65535.00 FORMAT "%8.2" ECU_ADDRESS 0x600179C6 /end MEASUREMENT
/begin MEASUREMENT MoFAirFl_MixMngtCplIfClass_V4_I.ffuevalipfiCpl "Instance of data class for ram data redundancy of MoFAirFl_MixMngIfClass / Member Variable" UWORD OneToOne 1 100 0.00 65535.00 FORMAT "%8.2" ECU_ADDRESS 0x600179C8 /end MEASUREMENT
/begin MEASUREMENT MoFAirFl_MixMngtCplIfClass_V4_I.fkrkAryCpl "Instance of data class for ram data redundancy of MoFAirFl_MixMngIfClass / Member Variable" UWORD OneToOne 1 100 0.00 65535.00 FORMAT "%8.2" ARRAY_SIZE 4 ECU_ADDRESS 0x600179CA /end MEASUREMENT
/begin MEASUREMENT MoFAirFl_MixMngtCplIfClass_V4_I.fkrkPfiAryCpl "Instance of data class for ram data redundancy of MoFAirFl_MixMngIfClass / Member Variable" UWORD OneToOne 1 100 0.00 65535.00 FORMAT "%8.2" ARRAY_SIZE 4 ECU_ADDRESS 0x600179D2 /end MEASUREMENT
/begin MEASUREMENT MoFAirFl_MixMngtCplIfClass_V4_I.fkrkPfiAryRdntCpl "Instance of data class for ram data redundancy of MoFAirFl_MixMngIfClass / Member Variable" UWORD OneToOne 1 100 0.00 65535.00 FORMAT "%8.2" ARRAY_SIZE 4 ECU_ADDRESS 0x600179DA /end MEASUREMENT
/begin MEASUREMENT MoFAirFl_MixMngtCplIfClass_V4_I.fnsadCpl "Instance of data class for ram data redundancy of MoFAirFl_MixMngIfClass / Member Variable" UWORD OneToOne 1 100 0.00 65535.00 FORMAT "%8.2" ECU_ADDRESS 0x600179E2 /end MEASUREMENT
/begin MEASUREMENT MoFAirFl_MixMngtCplIfClass_V4_I.fr2Cpl "Instance of data class for ram data redundancy of MoFAirFl_MixMngIfClass / Member Variable" UWORD OneToOne 1 100 0.00 65535.00 FORMAT "%8.2" ECU_ADDRESS 0x600179E4 /end MEASUREMENT
/begin MEASUREMENT MoFAirFl_MixMngtCplIfClass_V4_I.frCpl "Instance of data class for ram data redundancy of MoFAirFl_MixMngIfClass / Member Variable" UWORD OneToOne 1 100 0.00 65535.00 FORMAT "%8.2" ECU_ADDRESS 0x600179E6 /end MEASUREMENT
/begin MEASUREMENT MoFAirFl_MixMngtCplIfClass_V4_I.fragdi2Cpl "Instance of data class for ram data redundancy of MoFAirFl_MixMngIfClass / Member Variable" UWORD OneToOne 1 100 0.00 65535.00 FORMAT "%8.2" ECU_ADDRESS 0x600179E8 /end MEASUREMENT
/begin MEASUREMENT MoFAirFl_MixMngtCplIfClass_V4_I.fragdiCpl "Instance of data class for ram data redundancy of MoFAirFl_MixMngIfClass / Member Variable" UWORD OneToOne 1 100 0.00 65535.00 FORMAT "%8.2" ECU_ADDRESS 0x600179EA /end MEASUREMENT
/begin MEASUREMENT MoFAirFl_MixMngtCplIfClass_V4_I.frapfi2Cpl "Instance of data class for ram data redundancy of MoFAirFl_MixMngIfClass / Member Variable" UWORD OneToOne 1 100 0.00 65535.00 FORMAT "%8.2" ECU_ADDRESS 0x600179EC /end MEASUREMENT
/begin MEASUREMENT MoFAirFl_MixMngtCplIfClass_V4_I.frapfiCpl "Instance of data class for ram data redundancy of MoFAirFl_MixMngIfClass / Member Variable" UWORD OneToOne 1 100 0.00 65535.00 FORMAT "%8.2" ECU_ADDRESS 0x600179EE /end MEASUREMENT
/begin MEASUREMENT MoFAirFl_MixMngtCplIfClass_V4_I.lamsbg2Cpl "Instance of data class for ram data redundancy of MoFAirFl_MixMngIfClass / Member Variable" UWORD OneToOne 1 100 0.00 65535.00 FORMAT "%8.2" ECU_ADDRESS 0x600179F0 /end MEASUREMENT
/begin MEASUREMENT MoFAirFl_MixMngtCplIfClass_V4_I.lamsbgCpl "Instance of data class for ram data redundancy of MoFAirFl_MixMngIfClass / Member Variable" UWORD OneToOne 1 100 0.00 65535.00 FORMAT "%8.2" ECU_ADDRESS 0x600179F2 /end MEASUREMENT
/begin MEASUREMENT MoFAirFl_MixMngtCplIfClass_V4_I.rCtlPriB1Cpl "Instance of data class for ram data redundancy of MoFAirFl_MixMngIfClass / Member Variable" UWORD OneToOne 1 100 0.00 65535.00 FORMAT "%8.2" ECU_ADDRESS 0x600179F4 /end MEASUREMENT
/begin MEASUREMENT MoFAirFl_MixMngtCplIfClass_V4_I.rCtlPriB2Cpl "Instance of data class for ram data redundancy of MoFAirFl_MixMngIfClass / Member Variable" UWORD OneToOne 1 100 0.00 65535.00 FORMAT "%8.2" ECU_ADDRESS 0x600179F6 /end MEASUREMENT
/begin MEASUREMENT MoFAirFl_MixMngtCplIfClass_V4_I.ratFuMCylIndCpl "Instance of data class for ram data redundancy of MoFAirFl_MixMngIfClass / Member Variable" UWORD OneToOne 1 100 0.00 65535.00 FORMAT "%8.2" ECU_ADDRESS 0x600179F8 /end MEASUREMENT
/begin MEASUREMENT MoFAirFl_MixMngtCplIfClass_V4_I.ratFuMGdiBnk2Cpl "Instance of data class for ram data redundancy of MoFAirFl_MixMngIfClass / Member Variable" UWORD OneToOne 1 100 0.00 65535.00 FORMAT "%8.2" ECU_ADDRESS 0x600179FA /end MEASUREMENT
/begin MEASUREMENT MoFAirFl_MixMngtCplIfClass_V4_I.ratFuMGdiCpl "Instance of data class for ram data redundancy of MoFAirFl_MixMngIfClass / Member Variable" UWORD OneToOne 1 100 0.00 65535.00 FORMAT "%8.2" ECU_ADDRESS 0x600179FC /end MEASUREMENT
/begin MEASUREMENT MoFAirFl_MixMngtCplIfClass_V4_I.ratFuMLivcCpl "Instance of data class for ram data redundancy of MoFAirFl_MixMngIfClass / Complement value for Cylinder individual Atkinson fuel amount" UWORD OneToOne 1 100 0.00 65535.00 FORMAT "%8.2" ECU_ADDRESS 0x600179FE /end MEASUREMENT
/begin MEASUREMENT MoFAirFl_MixMngtCplIfClass_V4_I.ratFuMLivcRdntCpl "Instance of data class for ram data redundancy of MoFAirFl_MixMngIfClass / Complement value for Cylinder individual Atkinson fuel amount (ones complement)" UWORD OneToOne 1 100 0.00 65535.00 FORMAT "%8.2" ECU_ADDRESS 0x60017A00 /end MEASUREMENT
/begin MEASUREMENT MoFAirFl_MixMngtCplIfClass_V4_I.ratFuMPfiBnk2Cpl "Instance of data class for ram data redundancy of MoFAirFl_MixMngIfClass / Member Variable" UWORD OneToOne 1 100 0.00 65535.00 FORMAT "%8.2" ECU_ADDRESS 0x60017A02 /end MEASUREMENT
/begin MEASUREMENT MoFAirFl_MixMngtCplIfClass_V4_I.ratFuMPfiCpl "Instance of data class for ram data redundancy of MoFAirFl_MixMngIfClass / Member Variable" UWORD OneToOne 1 100 0.00 65535.00 FORMAT "%8.2" ECU_ADDRESS 0x60017A04 /end MEASUREMENT
/begin MEASUREMENT MoFAirFl_MixMngtCplIfClass_V4_I.ratFuPrtnPfiInjAryCpl "Instance of data class for ram data redundancy of MoFAirFl_MixMngIfClass / Member Variable" UWORD OneToOne 1 100 0.00 65535.00 FORMAT "%8.2" ARRAY_SIZE 4 ECU_ADDRESS 0x60017A06 /end MEASUREMENT
/begin MEASUREMENT MoFAirFl_MixMngtCplIfClass_V4_I.ratFuPrtnPfiInjAryRdntCpl "Instance of data class for ram data redundancy of MoFAirFl_MixMngIfClass / Member Variable" UWORD OneToOne 1 100 0.00 65535.00 FORMAT "%8.2" ARRAY_SIZE 4 ECU_ADDRESS 0x60017A0E /end MEASUREMENT
/begin MEASUREMENT MoFAirFl_MixMngtCplIfClass_V4_I.ratFuPrtnPfiInjBkupAryCpl "Instance of data class for ram data redundancy of MoFAirFl_MixMngIfClass / Member Variable" UWORD OneToOne 1 100 0.00 65535.00 FORMAT "%8.2" ARRAY_SIZE 4 ECU_ADDRESS 0x60017A16 /end MEASUREMENT
/begin MEASUREMENT MoFAirFl_MixMngtCplIfClass_V4_I.ratPrdcAirPrtnPfiAryCpl "Instance of data class for ram data redundancy of MoFAirFl_MixMngIfClass / Member Variable" UWORD OneToOne 1 100 0.00 65535.00 FORMAT "%8.2" ARRAY_SIZE 4 ECU_ADDRESS 0x60017A1E /end MEASUREMENT
/begin MEASUREMENT MoFAirFl_MixMngtCplIfClass_V4_I.ratPrdcAirPrtnPfiAryRdntCpl "Instance of data class for ram data redundancy of MoFAirFl_MixMngIfClass / Member Variable" UWORD OneToOne 1 100 0.00 65535.00 FORMAT "%8.2" ARRAY_SIZE 4 ECU_ADDRESS 0x60017A26 /end MEASUREMENT
/begin MEASUREMENT MoFAirFl_MixMngtCplIfClass_V4_I.ratPrdcAirPrtnPfiBkupAryCpl "Instance of data class for ram data redundancy of MoFAirFl_MixMngIfClass / Member Variable" UWORD OneToOne 1 100 0.00 65535.00 FORMAT "%8.2" ARRAY_SIZE 4 ECU_ADDRESS 0x60017A2E /end MEASUREMENT
/begin MEASUREMENT MoFAirFl_MixMngtCplIfClass_V4_I.rkagdi2Cpl "Instance of data class for ram data redundancy of MoFAirFl_MixMngIfClass / Member Variable" UWORD OneToOne 1 100 0.00 65535.00 FORMAT "%8.2" ECU_ADDRESS 0x60017A36 /end MEASUREMENT
/begin MEASUREMENT MoFAirFl_MixMngtCplIfClass_V4_I.rkagdiCpl "Instance of data class for ram data redundancy of MoFAirFl_MixMngIfClass / Member Variable" UWORD OneToOne 1 100 0.00 65535.00 FORMAT "%8.2" ECU_ADDRESS 0x60017A38 /end MEASUREMENT
/begin MEASUREMENT MoFAirFl_MixMngtCplIfClass_V4_I.rkapfi2Cpl "Instance of data class for ram data redundancy of MoFAirFl_MixMngIfClass / Member Variable" UWORD OneToOne 1 100 0.00 65535.00 FORMAT "%8.2" ECU_ADDRESS 0x60017A3A /end MEASUREMENT
/begin MEASUREMENT MoFAirFl_MixMngtCplIfClass_V4_I.rkapfiCpl "Instance of data class for ram data redundancy of MoFAirFl_MixMngIfClass / Member Variable" UWORD OneToOne 1 100 0.00 65535.00 FORMAT "%8.2" ECU_ADDRESS 0x60017A3C /end MEASUREMENT
/begin MEASUREMENT MoFAirFl_MixMngtCplIfClass_V4_I.rkausgCpl "Instance of data class for ram data redundancy of MoFAirFl_MixMngIfClass / Member Variable" UWORD OneToOne 1 100 0.00 65535.00 FORMAT "%8.2" ECU_ADDRESS 0x60017A3E /end MEASUREMENT
/begin MEASUREMENT MoFAirFl_MixMngtCplIfClass_V4_I.rkteBnk1Cpl "Instance of data class for ram data redundancy of MoFAirFl_MixMngIfClass / Member Variable" UWORD OneToOne 1 100 0.00 65535.00 FORMAT "%8.2" ECU_ADDRESS 0x60017A40 /end MEASUREMENT
/begin MEASUREMENT MoFAirFl_MixMngtCplIfClass_V4_I.rkteBnk2Cpl "Instance of data class for ram data redundancy of MoFAirFl_MixMngIfClass / Member Variable" UWORD OneToOne 1 100 0.00 65535.00 FORMAT "%8.2" ECU_ADDRESS 0x60017A42 /end MEASUREMENT
/begin MEASUREMENT MoFAirFl_MixMngtCplIfClass_V4_I.rkteCpl "Instance of data class for ram data redundancy of MoFAirFl_MixMngIfClass / Member Variable" UWORD OneToOne 1 100 0.00 65535.00 FORMAT "%8.2" ECU_ADDRESS 0x60017A44 /end MEASUREMENT
/begin MEASUREMENT MoFAirFl_MixMngtCplIfClass_V4_I.rkukgCpl "Instance of data class for ram data redundancy of MoFAirFl_MixMngIfClass / Member Variable" UWORD OneToOne 1 100 0.00 65535.00 FORMAT "%8.2" ECU_ADDRESS 0x60017A46 /end MEASUREMENT
/begin MEASUREMENT MoFAirFl_MixMngtCplIfClass_V4_I.rkukgpfiCpl "Instance of data class for ram data redundancy of MoFAirFl_MixMngIfClass / Member Variable" UWORD OneToOne 1 100 0.00 65535.00 FORMAT "%8.2" ECU_ADDRESS 0x60017A48 /end MEASUREMENT
/begin MEASUREMENT MoFAirFl_MixMngtCplIfClass_V4_I.rlfgBnk1Cpl "Instance of data class for ram data redundancy of MoFAirFl_MixMngIfClass / Member Variable" UWORD OneToOne 1 100 0.00 65535.00 FORMAT "%8.2" ECU_ADDRESS 0x60017A4A /end MEASUREMENT
/begin MEASUREMENT MoFAirFl_MixMngtCplIfClass_V4_I.rlfgBnk2Cpl "Instance of data class for ram data redundancy of MoFAirFl_MixMngIfClass / Member Variable" UWORD OneToOne 1 100 0.00 65535.00 FORMAT "%8.2" ECU_ADDRESS 0x60017A4C /end MEASUREMENT
/begin MEASUREMENT MoFAirFl_MixMngtCplIfClass_V4_I.rlfgCpl "Instance of data class for ram data redundancy of MoFAirFl_MixMngIfClass / Member Variable" UWORD OneToOne 1 100 0.00 65535.00 FORMAT "%8.2" ECU_ADDRESS 0x60017A4E /end MEASUREMENT
/begin MEASUREMENT MoFAirFl_MixMngtCplIfClass_V4_I.rlpBnk1Cpl "Instance of data class for ram data redundancy of MoFAirFl_MixMngIfClass / Member Variable" UWORD OneToOne 1 100 0.00 65535.00 FORMAT "%8.2" ECU_ADDRESS 0x60017A50 /end MEASUREMENT
/begin MEASUREMENT MoFAirFl_MixMngtCplIfClass_V4_I.rlpBnk2Cpl "Instance of data class for ram data redundancy of MoFAirFl_MixMngIfClass / Member Variable" UWORD OneToOne 1 100 0.00 65535.00 FORMAT "%8.2" ECU_ADDRESS 0x60017A52 /end MEASUREMENT
/begin MEASUREMENT MoFAirFl_MixMngtCplIfClass_V4_I.rlpCpl "Instance of data class for ram data redundancy of MoFAirFl_MixMngIfClass / Member Variable" UWORD OneToOne 1 100 0.00 65535.00 FORMAT "%8.2" ECU_ADDRESS 0x60017A54 /end MEASUREMENT
/begin MEASUREMENT MoFAirFl_MixMngtCplIfClass_V4_I.rlrextBnk1Cpl "Instance of data class for ram data redundancy of MoFAirFl_MixMngIfClass / Member Variable" UWORD OneToOne 1 100 0.00 65535.00 FORMAT "%8.2" ECU_ADDRESS 0x60017A56 /end MEASUREMENT
/begin MEASUREMENT MoFAirFl_MixMngtCplIfClass_V4_I.rlrextBnk2Cpl "Instance of data class for ram data redundancy of MoFAirFl_MixMngIfClass / Member Variable" UWORD OneToOne 1 100 0.00 65535.00 FORMAT "%8.2" ECU_ADDRESS 0x60017A58 /end MEASUREMENT
/begin MEASUREMENT MoFAirFl_MixMngtCplIfClass_V4_I.rlrextCpl "Instance of data class for ram data redundancy of MoFAirFl_MixMngIfClass / Member Variable" UWORD OneToOne 1 100 0.00 65535.00 FORMAT "%8.2" ECU_ADDRESS 0x60017A5A /end MEASUREMENT
/begin MEASUREMENT MoFAirFl_MixMngtCplIfClass_V4_I.rlrintBnk1Cpl "Instance of data class for ram data redundancy of MoFAirFl_MixMngIfClass / Member Variable" UWORD OneToOne 1 100 0.00 65535.00 FORMAT "%8.2" ECU_ADDRESS 0x60017A5C /end MEASUREMENT
/begin MEASUREMENT MoFAirFl_MixMngtCplIfClass_V4_I.rlrintBnk2Cpl "Instance of data class for ram data redundancy of MoFAirFl_MixMngIfClass / Member Variable" UWORD OneToOne 1 100 0.00 65535.00 FORMAT "%8.2" ECU_ADDRESS 0x60017A5E /end MEASUREMENT
/begin MEASUREMENT MoFAirFl_MixMngtCplIfClass_V4_I.rlrintCpl "Instance of data class for ram data redundancy of MoFAirFl_MixMngIfClass / Member Variable" UWORD OneToOne 1 100 0.00 65535.00 FORMAT "%8.2" ECU_ADDRESS 0x60017A60 /end MEASUREMENT
/begin MEASUREMENT MoFAirFl_MixMngtIfClass_V4_I.B_afimreq "Instance of data class for quantities in connection with mixture management in function monitoring / Member Variable" UBYTE OneToOne 1 100 0.00 255.0 FORMAT "%5.1" ECU_ADDRESS 0x600180D8 /end MEASUREMENT
/begin MEASUREMENT MoFAirFl_MixMngtIfClass_V4_I.facLamCtlPfiAry "Instance of data class for quantities in connection with mixture management in function monitoring / Member Variable" UWORD fak_uw_b2 1 100 0.00 1.999969 FORMAT "%8.6" ARRAY_SIZE 4 ECU_ADDRESS 0x600180DA /end MEASUREMENT
/begin MEASUREMENT MoFAirFl_MixMngtIfClass_V4_I.facLamCtlPfiAryRdnt "Instance of data class for quantities in connection with mixture management in function monitoring / Member Variable" UWORD OneToOne 1 100 0.00 65535.00 FORMAT "%8.2" ARRAY_SIZE 4 ECU_ADDRESS 0x600180E2 /end MEASUREMENT
/begin MEASUREMENT MoFAirFl_MixMngtIfClass_V4_I.facLamCtlPfiBkupAry "Instance of data class for quantities in connection with mixture management in function monitoring / Member Variable" UWORD fak_uw_b2 1 100 0.00 1.999969 FORMAT "%8.6" ARRAY_SIZE 4 ECU_ADDRESS 0x600180EA /end MEASUREMENT
/begin MEASUREMENT MoFAirFl_MixMngtIfClass_V4_I.facMixCorrnLivc "Instance of data class for quantities in connection with mixture management in function monitoring / Adaption factor Atkinson gasoline backflow" UWORD fak_uw_b2 1 100 0.00 1.999969 FORMAT "%8.6" ECU_ADDRESS 0x600180F2 /end MEASUREMENT
/begin MEASUREMENT MoFAirFl_MixMngtIfClass_V4_I.facPcPfiRest "Instance of data class for quantities in connection with mixture management in function monitoring / Member Variable" UWORD fak_uw_b64 1 100 0.00 63.99902 FORMAT "%8.5" ECU_ADDRESS 0x600180F4 /end MEASUREMENT
/begin MEASUREMENT MoFAirFl_MixMngtIfClass_V4_I.facPcRest "Instance of data class for quantities in connection with mixture management in function monitoring / Member Variable" UWORD fak_uw_b64 1 100 0.00 63.99902 FORMAT "%8.5" ECU_ADDRESS 0x600180F6 /end MEASUREMENT
/begin MEASUREMENT MoFAirFl_MixMngtIfClass_V4_I.facPrtnPfi "Instance of data class for quantities in connection with mixture management in function monitoring / Member Variable" UBYTE fak_ub_b1 1 100 0.00 0.9961 ECU_ADDRESS 0x600180F8 /end MEASUREMENT
/begin MEASUREMENT MoFAirFl_MixMngtIfClass_V4_I.facPrtnPfiAry "Instance of data class for quantities in connection with mixture management in function monitoring / Member Variable" UBYTE fak_ub_b1 1 100 0.00 0.9961 ARRAY_SIZE 4 ECU_ADDRESS 0x600180F9 /end MEASUREMENT
/begin MEASUREMENT MoFAirFl_MixMngtIfClass_V4_I.facPrtnPfiAryRdnt "Instance of data class for quantities in connection with mixture management in function monitoring / Member Variable" UBYTE OneToOne 1 100 0.00 255.0 FORMAT "%5.1" ARRAY_SIZE 4 ECU_ADDRESS 0x600180FD /end MEASUREMENT
/begin MEASUREMENT MoFAirFl_MixMngtIfClass_V4_I.facPrtnPfiBkupAry "Instance of data class for quantities in connection with mixture management in function monitoring / Member Variable" UBYTE fak_ub_b1 1 100 0.00 0.9961 ARRAY_SIZE 4 ECU_ADDRESS 0x60018101 /end MEASUREMENT
/begin MEASUREMENT MoFAirFl_MixMngtIfClass_V4_I.ffuevali "Instance of data class for quantities in connection with mixture management in function monitoring / Member Variable" UWORD fak_uw_b64 1 100 0.00 63.99902 FORMAT "%8.5" ECU_ADDRESS 0x60018106 /end MEASUREMENT
/begin MEASUREMENT MoFAirFl_MixMngtIfClass_V4_I.ffuevalipfi "Instance of data class for quantities in connection with mixture management in function monitoring / Member Variable" UWORD fak_uw_b64 1 100 0.00 63.99902 FORMAT "%8.5" ECU_ADDRESS 0x60018108 /end MEASUREMENT
/begin MEASUREMENT MoFAirFl_MixMngtIfClass_V4_I.fkrkAry "Instance of data class for quantities in connection with mixture management in function monitoring / Member Variable" UWORD fak_uw_b2 1 100 0.00 1.999969 FORMAT "%8.6" ARRAY_SIZE 4 ECU_ADDRESS 0x6001810A /end MEASUREMENT
/begin MEASUREMENT MoFAirFl_MixMngtIfClass_V4_I.fkrkPfiAry "Instance of data class for quantities in connection with mixture management in function monitoring / Member Variable" UWORD fak_uw_b2 1 100 0.00 1.999969 FORMAT "%8.6" ARRAY_SIZE 4 ECU_ADDRESS 0x60018112 /end MEASUREMENT
/begin MEASUREMENT MoFAirFl_MixMngtIfClass_V4_I.fkrkPfiAryRdnt "Instance of data class for quantities in connection with mixture management in function monitoring / Member Variable" UWORD OneToOne 1 100 0.00 65535.00 FORMAT "%8.2" ARRAY_SIZE 4 ECU_ADDRESS 0x6001811A /end MEASUREMENT
/begin MEASUREMENT MoFAirFl_MixMngtIfClass_V4_I.fnsad "Instance of data class for quantities in connection with mixture management in function monitoring / Member Variable" UWORD fak_uw_b2 1 100 0.00 1.999969 FORMAT "%8.6" ECU_ADDRESS 0x60018122 /end MEASUREMENT
/begin MEASUREMENT MoFAirFl_MixMngtIfClass_V4_I.fr "Instance of data class for quantities in connection with mixture management in function monitoring / Member Variable" UWORD fak_uw_b2 1 100 0.00 1.999969 FORMAT "%8.6" ECU_ADDRESS 0x60018124 /end MEASUREMENT
/begin MEASUREMENT MoFAirFl_MixMngtIfClass_V4_I.fr2 "Instance of data class for quantities in connection with mixture management in function monitoring / Member Variable" UWORD fak_uw_b2 1 100 0.00 1.999969 FORMAT "%8.6" ECU_ADDRESS 0x60018126 /end MEASUREMENT
/begin MEASUREMENT MoFAirFl_MixMngtIfClass_V4_I.fragdi "Instance of data class for quantities in connection with mixture management in function monitoring / Member Variable" UWORD fak_uw_b2 1 100 0.00 1.999969 FORMAT "%8.6" ECU_ADDRESS 0x60018128 /end MEASUREMENT
/begin MEASUREMENT MoFAirFl_MixMngtIfClass_V4_I.fragdi2 "Instance of data class for quantities in connection with mixture management in function monitoring / Member Variable" UWORD fak_uw_b2 1 100 0.00 1.999969 FORMAT "%8.6" ECU_ADDRESS 0x6001812A /end MEASUREMENT
/begin MEASUREMENT MoFAirFl_MixMngtIfClass_V4_I.frapfi "Instance of data class for quantities in connection with mixture management in function monitoring / Member Variable" UWORD fak_uw_b2 1 100 0.00 1.999969 FORMAT "%8.6" ECU_ADDRESS 0x6001812C /end MEASUREMENT
/begin MEASUREMENT MoFAirFl_MixMngtIfClass_V4_I.frapfi2 "Instance of data class for quantities in connection with mixture management in function monitoring / Member Variable" UWORD fak_uw_b2 1 100 0.00 1.999969 FORMAT "%8.6" ECU_ADDRESS 0x6001812E /end MEASUREMENT
/begin MEASUREMENT MoFAirFl_MixMngtIfClass_V4_I.lamsbg "Instance of data class for quantities in connection with mixture management in function monitoring / Member Variable" UWORD fak_uw_b16 1 100 0.00 15.99976 FORMAT "%8.5" ECU_ADDRESS 0x60018130 /end MEASUREMENT
/begin MEASUREMENT MoFAirFl_MixMngtIfClass_V4_I.lamsbg2 "Instance of data class for quantities in connection with mixture management in function monitoring / Member Variable" UWORD fak_uw_b16 1 100 0.00 15.99976 FORMAT "%8.5" ECU_ADDRESS 0x60018132 /end MEASUREMENT
/begin MEASUREMENT MoFAirFl_MixMngtIfClass_V4_I.rCtlPriB1 "Instance of data class for quantities in connection with mixture management in function monitoring / Member Variable" SWORD fak_sw_b1 1 100 -1.000000 0.999969 FORMAT "%8.6" ECU_ADDRESS 0x60018134 /end MEASUREMENT
/begin MEASUREMENT MoFAirFl_MixMngtIfClass_V4_I.rCtlPriB2 "Instance of data class for quantities in connection with mixture management in function monitoring / Member Variable" SWORD fak_sw_b1 1 100 -1.000000 0.999969 FORMAT "%8.6" ECU_ADDRESS 0x60018136 /end MEASUREMENT
/begin MEASUREMENT MoFAirFl_MixMngtIfClass_V4_I.ratFuMCylInd "Instance of data class for quantities in connection with mixture management in function monitoring / Member Variable" UWORD rel_uw_b3072 1 100 0.00 3071.953 FORMAT "%8.3" ECU_ADDRESS 0x60018138 /end MEASUREMENT
/begin MEASUREMENT MoFAirFl_MixMngtIfClass_V4_I.ratFuMGdi "Instance of data class for quantities in connection with mixture management in function monitoring / Member Variable" UWORD rel_uw_b3072 1 100 0.00 3071.953 FORMAT "%8.3" ECU_ADDRESS 0x6001813A /end MEASUREMENT
/begin MEASUREMENT MoFAirFl_MixMngtIfClass_V4_I.ratFuMGdiBnk2 "Instance of data class for quantities in connection with mixture management in function monitoring / Member Variable" UWORD rel_uw_b3072 1 100 0.00 3071.953 FORMAT "%8.3" ECU_ADDRESS 0x6001813C /end MEASUREMENT
/begin MEASUREMENT MoFAirFl_MixMngtIfClass_V4_I.ratFuMLivc "Instance of data class for quantities in connection with mixture management in function monitoring / Cylinder individual Atkinson fuel amount" UWORD rel_uw_b3072 1 100 0.00 3071.953 FORMAT "%8.3" ECU_ADDRESS 0x6001813E /end MEASUREMENT
/begin MEASUREMENT MoFAirFl_MixMngtIfClass_V4_I.ratFuMLivcRdnt "Instance of data class for quantities in connection with mixture management in function monitoring / Cylinder individual Atkinson fuel amount (ones complement)" UWORD dez 1 100 0.00 65535.00 FORMAT "%8.2" ECU_ADDRESS 0x60018140 /end MEASUREMENT
/begin MEASUREMENT MoFAirFl_MixMngtIfClass_V4_I.ratFuMPfi "Instance of data class for quantities in connection with mixture management in function monitoring / Member Variable" UWORD rel_uw_b3072 1 100 0.00 3071.953 FORMAT "%8.3" ECU_ADDRESS 0x60018142 /end MEASUREMENT
/begin MEASUREMENT MoFAirFl_MixMngtIfClass_V4_I.ratFuMPfiBnk2 "Instance of data class for quantities in connection with mixture management in function monitoring / Member Variable" UWORD rel_uw_b3072 1 100 0.00 3071.953 FORMAT "%8.3" ECU_ADDRESS 0x60018144 /end MEASUREMENT
/begin MEASUREMENT MoFAirFl_MixMngtIfClass_V4_I.ratFuPrtnPfiInjAry "Instance of data class for quantities in connection with mixture management in function monitoring / Member Variable" UWORD rel_uw_b3072 1 100 0.00 3071.953 FORMAT "%8.3" ARRAY_SIZE 4 ECU_ADDRESS 0x60018146 /end MEASUREMENT
/begin MEASUREMENT MoFAirFl_MixMngtIfClass_V4_I.ratFuPrtnPfiInjAryRdnt "Instance of data class for quantities in connection with mixture management in function monitoring / Member Variable" UWORD OneToOne 1 100 0.00 65535.00 FORMAT "%8.2" ARRAY_SIZE 4 ECU_ADDRESS 0x6001814E /end MEASUREMENT
/begin MEASUREMENT MoFAirFl_MixMngtIfClass_V4_I.ratFuPrtnPfiInjBkupAry "Instance of data class for quantities in connection with mixture management in function monitoring / Member Variable" UWORD rel_uw_b3072 1 100 0.00 3071.953 FORMAT "%8.3" ARRAY_SIZE 4 ECU_ADDRESS 0x60018156 /end MEASUREMENT
/begin MEASUREMENT MoFAirFl_MixMngtIfClass_V4_I.ratPrdcAirPrtnPfiAry "Instance of data class for quantities in connection with mixture management in function monitoring / Member Variable" UWORD rel_uw_q0p0234 1 100 0.00 1535.977 FORMAT "%8.3" ARRAY_SIZE 4 ECU_ADDRESS 0x6001815E /end MEASUREMENT
/begin MEASUREMENT MoFAirFl_MixMngtIfClass_V4_I.ratPrdcAirPrtnPfiAryRdnt "Instance of data class for quantities in connection with mixture management in function monitoring / Member Variable" UWORD OneToOne 1 100 0.00 65535.00 FORMAT "%8.2" ARRAY_SIZE 4 ECU_ADDRESS 0x60018166 /end MEASUREMENT
/begin MEASUREMENT MoFAirFl_MixMngtIfClass_V4_I.ratPrdcAirPrtnPfiBkupAry "Instance of data class for quantities in connection with mixture management in function monitoring / Member Variable" UWORD rel_uw_q0p0234 1 100 0.00 1535.977 FORMAT "%8.3" ARRAY_SIZE 4 ECU_ADDRESS 0x6001816E /end MEASUREMENT
/begin MEASUREMENT MoFAirFl_MixMngtIfClass_V4_I.rkagdi "Instance of data class for quantities in connection with mixture management in function monitoring / Member Variable" SWORD rel_sw_b1536 1 100 -1536.000 1535.953 FORMAT "%8.3" ECU_ADDRESS 0x60018176 /end MEASUREMENT
/begin MEASUREMENT MoFAirFl_MixMngtIfClass_V4_I.rkagdi2 "Instance of data class for quantities in connection with mixture management in function monitoring / Member Variable" SWORD rel_sw_b1536 1 100 -1536.000 1535.953 FORMAT "%8.3" ECU_ADDRESS 0x60018178 /end MEASUREMENT
/begin MEASUREMENT MoFAirFl_MixMngtIfClass_V4_I.rkapfi "Instance of data class for quantities in connection with mixture management in function monitoring / Member Variable" SWORD rel_sw_b1536 1 100 -1536.000 1535.953 FORMAT "%8.3" ECU_ADDRESS 0x6001817A /end MEASUREMENT
/begin MEASUREMENT MoFAirFl_MixMngtIfClass_V4_I.rkapfi2 "Instance of data class for quantities in connection with mixture management in function monitoring / Member Variable" SWORD rel_sw_b1536 1 100 -1536.000 1535.953 FORMAT "%8.3" ECU_ADDRESS 0x6001817C /end MEASUREMENT
/begin MEASUREMENT MoFAirFl_MixMngtIfClass_V4_I.rkausg "Instance of data class for quantities in connection with mixture management in function monitoring / Member Variable" SWORD rel_sw_b1536 1 100 -1536.000 1535.953 FORMAT "%8.3" ECU_ADDRESS 0x6001817E /end MEASUREMENT
/begin MEASUREMENT MoFAirFl_MixMngtIfClass_V4_I.rkte "Instance of data class for quantities in connection with mixture management in function monitoring / Member Variable" SWORD rel_sw_b1536 1 100 -1536.000 1535.953 FORMAT "%8.3" ECU_ADDRESS 0x60018180 /end MEASUREMENT
/begin MEASUREMENT MoFAirFl_MixMngtIfClass_V4_I.rkteBnk1 "Instance of data class for quantities in connection with mixture management in function monitoring / Member Variable" SWORD rel_sw_b1536 1 100 -1536.000 1535.953 FORMAT "%8.3" ECU_ADDRESS 0x60018182 /end MEASUREMENT
/begin MEASUREMENT MoFAirFl_MixMngtIfClass_V4_I.rkteBnk2 "Instance of data class for quantities in connection with mixture management in function monitoring / Member Variable" SWORD rel_sw_b1536 1 100 -1536.000 1535.953 FORMAT "%8.3" ECU_ADDRESS 0x60018184 /end MEASUREMENT
/begin MEASUREMENT MoFAirFl_MixMngtIfClass_V4_I.rkukg "Instance of data class for quantities in connection with mixture management in function monitoring / Member Variable" SWORD rel_sw_b1536 1 100 -1536.000 1535.953 FORMAT "%8.3" ECU_ADDRESS 0x60018186 /end MEASUREMENT
/begin MEASUREMENT MoFAirFl_MixMngtIfClass_V4_I.rkukgpfi "Instance of data class for quantities in connection with mixture management in function monitoring / Member Variable" SWORD rel_sw_b1536 1 100 -1536.000 1535.953 FORMAT "%8.3" ECU_ADDRESS 0x60018188 /end MEASUREMENT
/begin MEASUREMENT MoFAirFl_MixMngtIfClass_V4_I.rlfg "Instance of data class for quantities in connection with mixture management in function monitoring / Member Variable" UWORD rel_uw_q0p0234 1 100 0.00 1535.977 FORMAT "%8.3" ECU_ADDRESS 0x6001818A /end MEASUREMENT
/begin MEASUREMENT MoFAirFl_MixMngtIfClass_V4_I.rlfgBnk1 "Instance of data class for quantities in connection with mixture management in function monitoring / Member Variable" UWORD rel_uw_q0p0234 1 100 0.00 1535.977 FORMAT "%8.3" ECU_ADDRESS 0x6001818C /end MEASUREMENT
/begin MEASUREMENT MoFAirFl_MixMngtIfClass_V4_I.rlfgBnk2 "Instance of data class for quantities in connection with mixture management in function monitoring / Member Variable" UWORD rel_uw_q0p0234 1 100 0.00 1535.977 FORMAT "%8.3" ECU_ADDRESS 0x6001818E /end MEASUREMENT
/begin MEASUREMENT MoFAirFl_MixMngtIfClass_V4_I.rlp "Instance of data class for quantities in connection with mixture management in function monitoring / Member Variable" UWORD rel_uw_q0p0234 1 100 0.00 1535.977 FORMAT "%8.3" ECU_ADDRESS 0x60018190 /end MEASUREMENT
/begin MEASUREMENT MoFAirFl_MixMngtIfClass_V4_I.rlpBnk1 "Instance of data class for quantities in connection with mixture management in function monitoring / Member Variable" UWORD rel_uw_q0p0234 1 100 0.00 1535.977 FORMAT "%8.3" ECU_ADDRESS 0x60018192 /end MEASUREMENT
/begin MEASUREMENT MoFAirFl_MixMngtIfClass_V4_I.rlpBnk2 "Instance of data class for quantities in connection with mixture management in function monitoring / Member Variable" UWORD rel_uw_q0p0234 1 100 0.00 1535.977 FORMAT "%8.3" ECU_ADDRESS 0x60018194 /end MEASUREMENT
/begin MEASUREMENT MoFAirFl_MixMngtIfClass_V4_I.rlrext "Instance of data class for quantities in connection with mixture management in function monitoring / Member Variable" UWORD rel_uw_q0p0234 1 100 0.00 1535.977 FORMAT "%8.3" ECU_ADDRESS 0x60018196 /end MEASUREMENT
/begin MEASUREMENT MoFAirFl_MixMngtIfClass_V4_I.rlrextBnk1 "Instance of data class for quantities in connection with mixture management in function monitoring / Member Variable" UWORD rel_uw_q0p0234 1 100 0.00 1535.977 FORMAT "%8.3" ECU_ADDRESS 0x60018198 /end MEASUREMENT
/begin MEASUREMENT MoFAirFl_MixMngtIfClass_V4_I.rlrextBnk2 "Instance of data class for quantities in connection with mixture management in function monitoring / Member Variable" UWORD rel_uw_q0p0234 1 100 0.00 1535.977 FORMAT "%8.3" ECU_ADDRESS 0x6001819A /end MEASUREMENT
/begin MEASUREMENT MoFAirFl_MixMngtIfClass_V4_I.rlrint "Instance of data class for quantities in connection with mixture management in function monitoring / Member Variable" UWORD rel_uw_q0p0234 1 100 0.00 1535.977 FORMAT "%8.3" ECU_ADDRESS 0x6001819C /end MEASUREMENT
/begin MEASUREMENT MoFAirFl_MixMngtIfClass_V4_I.rlrintBnk1 "Instance of data class for quantities in connection with mixture management in function monitoring / Member Variable" UWORD rel_uw_q0p0234 1 100 0.00 1535.977 FORMAT "%8.3" ECU_ADDRESS 0x6001819E /end MEASUREMENT
/begin MEASUREMENT MoFAirFl_MixMngtIfClass_V4_I.rlrintBnk2 "Instance of data class for quantities in connection with mixture management in function monitoring / Member Variable" UWORD rel_uw_q0p0234 1 100 0.00 1535.977 FORMAT "%8.3" ECU_ADDRESS 0x600181A0 /end MEASUREMENT
/begin MEASUREMENT MoFAirFl_nEngOld "Engine speed (pld value) in function MoFAirFl_In" UBYTE nmot_q40 1 100 0.00 10200. FORMAT "%5.0" ECU_ADDRESS 0x60018204 /end MEASUREMENT
/begin MEASUREMENT MoFAirFl_nEngOldCpl "Ram data redundancy for MoFAirFl_nEngOld" UBYTE OneToOne 1 100 0.00 255.0 FORMAT "%5.1" ECU_ADDRESS 0x60017AC3 /end MEASUREMENT
/begin MEASUREMENT MoFAirFl_ratAirPrdcGdi "Predicted air charge for GDI-path in fuel monitoring" UWORD rel_uw_q0p0234 1 100 0.00 1535.977 FORMAT "%8.3" ECU_ADDRESS 0x6001808E /end MEASUREMENT
/begin MEASUREMENT MoFAirFl_ratAirPrdcGdiCpl "Predicted air charge for GDI-path in fuel monitoring cpl" UWORD OneToOne 1 100 0.00 65535.00 FORMAT "%8.2" ECU_ADDRESS 0x6001794C /end MEASUREMENT
/begin MEASUREMENT MoFAirFl_ratFuMCpv "Relative fuel mass from canister purge in fuel monitoring" SWORD rel_sw_b1536 1 100 -1536.000 1535.953 FORMAT "%8.3" ECU_ADDRESS 0x6001808C /end MEASUREMENT
/begin MEASUREMENT MoFAirFl_ratFuMCpvCpl "Relative fuel mass from canister purge in fuel monitoring cpl" UWORD OneToOne 1 100 0.00 65535.00 FORMAT "%8.2" ECU_ADDRESS 0x6001794A /end MEASUREMENT
/begin MEASUREMENT MoFAirFl_ratFuMCpvMin "Min. permitted relative fuel mass from canister purge in fuel monitoring" SWORD rel_sw_b1536 1 100 -1536.000 1535.953 FORMAT "%8.3" ECU_ADDRESS 0x6001808A /end MEASUREMENT
/begin MEASUREMENT MoFAirFl_ratFuMCpvMinCpl "Min. permitted relative fuel mass from canister purge in fuel monitoring cpl" UWORD OneToOne 1 100 0.00 65535.00 FORMAT "%8.2" ECU_ADDRESS 0x60017948 /end MEASUREMENT
/begin MEASUREMENT MoFAirFl_ratFuMCylIndExpt "Expected value for cylinder-individual fuel" UWORD rel_uw_b3072 1 100 0.00 3071.953 FORMAT "%8.3" ECU_ADDRESS 0x60018250 /end MEASUREMENT
/begin MEASUREMENT MoFAirFl_ratFuMCylIndExptCpl "Complement of MoFAirFl_ratFuMCylIndExpt" UWORD OneToOne 1 100 0.00 65535.00 FORMAT "%8.2" ECU_ADDRESS 0x60017AE2 /end MEASUREMENT
/begin MEASUREMENT MoFAirFl_ratFuMGdiAddl "Additive fuel in function monitoring (GDI)" SWORD rel_sw_b1536 1 100 -1536.000 1535.953 FORMAT "%8.3" ECU_ADDRESS 0x6001807E /end MEASUREMENT
/begin MEASUREMENT MoFAirFl_ratFuMGdiAddlCpl "RAM data redundancy for MoFAirFl_ratFuMGdiAddl" UWORD OneToOne 1 100 0.00 65535.00 FORMAT "%8.2" ECU_ADDRESS 0x60017946 /end MEASUREMENT
/begin MEASUREMENT MoFAirFl_ratFuMGdiExpt "Expected value for relative fuel mass in function monitoring (GDI)" UWORD rel_uw_b3072 1 100 0.00 3071.953 FORMAT "%8.3" ECU_ADDRESS 0x60018088 /end MEASUREMENT
/begin MEASUREMENT MoFAirFl_ratFuMGdiExptBnk2 "Expected value for relative fuel mass bank 2 in function monitoring (GDI)" UWORD rel_uw_b3072 1 100 0.00 3071.953 FORMAT "%8.3" ECU_ADDRESS 0x60018086 /end MEASUREMENT
/begin MEASUREMENT MoFAirFl_ratFuMGdiExptBnk2Cpl "RAM data redundancy for MoFAirFl_ratFuMGdiExptBnk2" UWORD OneToOne 1 100 0.00 65535.00 FORMAT "%8.2" ECU_ADDRESS 0x60017944 /end MEASUREMENT
/begin MEASUREMENT MoFAirFl_ratFuMGdiExptCpl "RAM data redundancy for MoFAirFl_ratFuMGdiExpt" UWORD OneToOne 1 100 0.00 65535.00 FORMAT "%8.2" ECU_ADDRESS 0x60017942 /end MEASUREMENT
/begin MEASUREMENT MoFAirFl_ratFuMMaxGdi "Max. permitted relative fuel mass in fuel monitoring" UWORD rel_uw_b3072 1 100 0.00 3071.953 FORMAT "%8.3" ECU_ADDRESS 0x60018084 /end MEASUREMENT
/begin MEASUREMENT MoFAirFl_ratFuMMaxGdiCpl "Max. permitted relative fuel mass in fuel monitoring cpl" UWORD OneToOne 1 100 0.00 65535.00 FORMAT "%8.2" ECU_ADDRESS 0x60017940 /end MEASUREMENT
/begin MEASUREMENT MoFAirFl_ratFuMMinGdi "Min. permitted relative fuel mass in fuel monitoring" UWORD rel_uw_b3072 1 100 0.00 3071.953 FORMAT "%8.3" ECU_ADDRESS 0x60018082 /end MEASUREMENT
/begin MEASUREMENT MoFAirFl_ratFuMMinGdiCpl "Min. permitted relative fuel mass in fuel monitoring cpl" UWORD OneToOne 1 100 0.00 65535.00 FORMAT "%8.2" ECU_ADDRESS 0x6001793E /end MEASUREMENT
/begin MEASUREMENT MoFAirFl_ratFuMTotExptGdi "Expected relative fuel mass in fuel monitoring" ULONG rel_uw_b3072 1 100 0.00 201326591.953 FORMAT "%13.3" ECU_ADDRESS 0x60018098 /end MEASUREMENT
/begin MEASUREMENT MoFAirFl_ratFuMTotExptGdiCpl "Expected relative fuel mass in fuel monitoring cpl" ULONG OneToOne 1 100 0.00 4294967295.00 FORMAT "%13.2" ECU_ADDRESS 0x60017958 /end MEASUREMENT
/begin MEASUREMENT MoFAirFl_ratFuMTotGdiExpt "Expected value for relative fuel mass total in function monitoring (GDI)" UWORD rel_uw_b3072 1 100 0.00 3071.953 FORMAT "%8.3" ECU_ADDRESS 0x6001807C /end MEASUREMENT
/begin MEASUREMENT MoFAirFl_ratFuMTotGdiExptBnk2 "Expected value for relative fuel mass total bank 2 in function monitoring (GDI)" UWORD rel_uw_b3072 1 100 0.00 3071.953 FORMAT "%8.3" ECU_ADDRESS 0x6001807A /end MEASUREMENT
/begin MEASUREMENT MoFAirFl_ratFuMTotGdiExptBnk2Cpl "RAM data redundancy for MoFAirFl_ratFuMTotGdiExptBnk2" UWORD OneToOne 1 100 0.00 65535.00 FORMAT "%8.2" ECU_ADDRESS 0x6001793C /end MEASUREMENT
/begin MEASUREMENT MoFAirFl_ratFuMTotGdiExptCpl "RAM data redundancy for MoFAirFl_ratFuMTotGdiExpt" UWORD OneToOne 1 100 0.00 65535.00 FORMAT "%8.2" ECU_ADDRESS 0x6001793A /end MEASUREMENT
/begin MEASUREMENT MoFAirFl_ratLamSp "Desired lambda in function monitoring" UWORD fak_uw_b16 1 100 0.00 15.99976 FORMAT "%8.5" ECU_ADDRESS 0x6001821A /end MEASUREMENT
/begin MEASUREMENT MoFAirFl_ratLamSpCpl "RAM data redundancy for MoFAirFl_ratLamSp" UWORD OneToOne 1 100 0.00 65535.00 FORMAT "%8.2" ECU_ADDRESS 0x60017AD0 /end MEASUREMENT
/begin MEASUREMENT MoFAirFl_ratLamSp_Ax_result "Result of grid search for lambda in function monitoring" SLONG dez 1 100 -2147483648.00 2147483647.00 FORMAT "%13.2" ECU_ADDRESS 0x60018230 /end MEASUREMENT
/begin MEASUREMENT MoFAirFl_stCtOffMask "Injection cut-off mask in function monitoring" UBYTE OneToOne 1 100 0.00 255.0 FORMAT "%5.1" ECU_ADDRESS 0x60018256 /end MEASUREMENT
/begin MEASUREMENT MoFAirFl_stCtOffMaskCpl "RAM data redundancy for MoFAirFl_stCtOffMask" UBYTE OneToOne 1 100 0.00 255.0 FORMAT "%5.1" ECU_ADDRESS 0x60017AE9 /end MEASUREMENT
/begin MEASUREMENT MoFAirFl_stErrAirFlFFMsg "Status error message for MoFAirFL_FF" UBYTE OneToOne 1 100 0.00 255.0 FORMAT "%5.1" ECU_ADDRESS 0x6000F392 /end MEASUREMENT
/begin MEASUREMENT MoFAirFl_stErrAirFlTot "State error information for air fuel" UBYTE OneToOne 1 100 0.00 255.0 FORMAT "%5.1" ECU_ADDRESS 0x6001809C /end MEASUREMENT
/begin MEASUREMENT MoFAirFl_stErrAirFlTotCpl "State error information from MoFAirFl_MixCtlGdi (AirFl) cpl" UBYTE OneToOne 1 100 0.00 255.0 FORMAT "%5.1" ECU_ADDRESS 0x6001795C /end MEASUREMENT
/begin MEASUREMENT MoFAirFl_stErrCplIn "Status error information" UWORD OneToOne 1 100 0.00 65535.00 FORMAT "%8.2" ECU_ADDRESS 0x600181F4 /end MEASUREMENT
/begin MEASUREMENT MoFAirFl_stErrCplInCpl "Complement for MoFAirFl_stErrCplIn" UWORD OneToOne 1 100 0.00 65535.00 FORMAT "%8.2" ECU_ADDRESS 0x60017AB4 /end MEASUREMENT
/begin MEASUREMENT MoFAirFl_stErrCtOffGdi "State error information from MoFAirFl_CtOffGdi" UBYTE OneToOne 1 100 0.00 255.0 FORMAT "%5.1" ECU_ADDRESS 0x60018257 /end MEASUREMENT
/begin MEASUREMENT MoFAirFl_stErrCtOffGdiCpl "Complement of sMoFAirFl_stErrCtOffGdi" UBYTE OneToOne 1 100 0.00 255.0 FORMAT "%5.1" ECU_ADDRESS 0x60017AE8 /end MEASUREMENT
/begin MEASUREMENT MoFAirFl_stErrCtOffGdiMsg "State error information from MoFAirFl_CtOffGdi (exported)" UBYTE OneToOne 1 100 0.00 255.0 FORMAT "%5.1" ECU_ADDRESS 0x6000F391 /end MEASUREMENT
/begin MEASUREMENT MoFAirFl_stErrCylGdi "State error information from MoFAirFl_CylGdi" UBYTE OneToOne 1 100 0.00 255.0 FORMAT "%5.1" ECU_ADDRESS 0x60018254 /end MEASUREMENT
/begin MEASUREMENT MoFAirFl_stErrCylGdiCpl "Complement of MoFAirFl_stErrCylGdi" UBYTE OneToOne 1 100 0.00 255.0 FORMAT "%5.1" ECU_ADDRESS 0x60017AE6 /end MEASUREMENT
/begin MEASUREMENT MoFAirFl_stErrCylGdiMsg "State error information from MoFAirFl_CylGdi (exported)" UBYTE OneToOne 1 100 0.00 255.0 FORMAT "%5.1" ECU_ADDRESS 0x6000F390 /end MEASUREMENT
/begin MEASUREMENT MoFAirFl_stErrEta "Eta error state variable replacing MeasPnt" UBYTE OneToOne 1 100 0.00 255.0 FORMAT "%5.1" ECU_ADDRESS 0x6001824E /end MEASUREMENT
/begin MEASUREMENT MoFAirFl_stErrEtaCpl "Efficiency error information complement" UBYTE OneToOne 1 100 0.00 255.0 FORMAT "%5.1" ECU_ADDRESS 0x6001824D /end MEASUREMENT
/begin MEASUREMENT MoFAirFl_stErrMixCtlGdiChkAirFlMsg "State error information from MoFAirFl_MixCtlGdi (AirFl, exported)" UBYTE OneToOne 1 100 0.00 255.0 FORMAT "%5.1" ECU_ADDRESS 0x6000F38F /end MEASUREMENT
/begin MEASUREMENT MoFAirFl_stErrMixCtlGdiChkCtrl "State error information from MoFAirFl_MixCtlGdi (Ctrl)" UWORD OneToOne 1 100 0.00 65535.00 FORMAT "%8.2" ECU_ADDRESS 0x60018080 /end MEASUREMENT
/begin MEASUREMENT MoFAirFl_stErrMixCtlGdiChkCtrlCpl "State error information from MoFAirFl_MixCtlGdi (Ctrl) cpl" UWORD OneToOne 1 100 0.00 65535.00 FORMAT "%8.2" ECU_ADDRESS 0x60017938 /end MEASUREMENT
/begin MEASUREMENT MoFAirFl_stErrMixCtlGdiChkCtrlMsg "State error information from MoFAirFl_MixCtlGdi (Ctrl, exported)" UWORD OneToOne 1 100 0.00 65535.00 FORMAT "%8.2" ECU_ADDRESS 0x60008BAE /end MEASUREMENT
/begin MEASUREMENT MoFAirFl_stInjTmng "Status injection timing in function monitoring" UBYTE OneToOne 1 100 0.00 255.0 FORMAT "%5.1" ECU_ADDRESS 0x60018202 /end MEASUREMENT
/begin MEASUREMENT MoFAirFl_stInjTmngCpl "RAM data redundancy for MoFAirFl_stInjTmng" UBYTE OneToOne 1 100 0.00 255.0 FORMAT "%5.1" ECU_ADDRESS 0x60017AC2 /end MEASUREMENT
/begin MEASUREMENT MoFAirFl_TrqActCplIfClass_V4_I.agIntkClsdCpl "Instance of data class for ram data redundancy of MoFAirFl_TrqActIfClass / Instance of data class for ram data redundancy of MoFAirFl_TrqActIfClass Member Variable" UWORD OneToOne 1 100 0.00 65535.00 FORMAT "%8.2" ARRAY_SIZE 5 ECU_ADDRESS 0x60017960 /end MEASUREMENT
/begin MEASUREMENT MoFAirFl_TrqActCplIfClass_V4_I.agIntkClsdRdtCpl "Instance of data class for ram data redundancy of MoFAirFl_TrqActIfClass / Instance of data class for ram data redundancy of MoFAirFl_TrqActIfClass Member Variable" UWORD OneToOne 1 100 0.00 65535.00 FORMAT "%8.2" ARRAY_SIZE 5 ECU_ADDRESS 0x6001796A /end MEASUREMENT
/begin MEASUREMENT MoFAirFl_TrqActCplIfClass_V4_I.etaaufteCpl "Instance of data class for ram data redundancy of MoFAirFl_TrqActIfClass / Member Variable" UWORD OneToOne 1 100 0.00 65535.00 FORMAT "%8.2" ECU_ADDRESS 0x60017974 /end MEASUREMENT
/begin MEASUREMENT MoFAirFl_TrqActCplIfClass_V4_I.etazwistCpl "Instance of data class for ram data redundancy of MoFAirFl_TrqActIfClass / Member Variable" UWORD OneToOne 1 100 0.00 65535.00 FORMAT "%8.2" ECU_ADDRESS 0x60017976 /end MEASUREMENT
/begin MEASUREMENT MoFAirFl_TrqActCplIfClass_V4_I.etazwistmCpl "Instance of data class for ram data redundancy of MoFAirFl_TrqActIfClass / Member Variable" UWORD OneToOne 1 100 0.00 65535.00 FORMAT "%8.2" ECU_ADDRESS 0x60017978 /end MEASUREMENT
/begin MEASUREMENT MoFAirFl_TrqActCplIfClass_V4_I.miistCpl "Instance of data class for ram data redundancy of MoFAirFl_TrqActIfClass / RAM data redundancy for MoFAirFl_TrqActIfClass_V4.miist" UWORD OneToOne 1 100 0.00 65535.00 FORMAT "%8.2" ECU_ADDRESS 0x6001797A /end MEASUREMENT
/begin MEASUREMENT MoFAirFl_TrqActCplIfClass_V4_I.zwcalcarCpl "Instance of data class for ram data redundancy of MoFAirFl_TrqActIfClass / Member Variable" UWORD OneToOne 1 100 0.00 65535.00 FORMAT "%8.2" ARRAY_SIZE 4 ECU_ADDRESS 0x6001797C /end MEASUREMENT
/begin MEASUREMENT MoFAirFl_TrqActCplIfClass_V4_I.zwcalcar_zzylzueCpl "Instance of data class for ram data redundancy of MoFAirFl_TrqActIfClass / Member Variable" UBYTE OneToOne 1 100 0.00 255.0 FORMAT "%5.1" ECU_ADDRESS 0x60017984 /end MEASUREMENT
/begin MEASUREMENT MoFAirFl_TrqActCplIfClass_V4_I.zwcalcarcpCpl "Instance of data class for ram data redundancy of MoFAirFl_TrqActIfClass / Member Variable" UWORD OneToOne 1 100 0.00 65535.00 FORMAT "%8.2" ARRAY_SIZE 4 ECU_ADDRESS 0x60017986 /end MEASUREMENT
/begin MEASUREMENT MoFAirFl_TrqActCplIfClass_V4_I.zwoptCpl "Instance of data class for ram data redundancy of MoFAirFl_TrqActIfClass / Member Variable" UWORD OneToOne 1 100 0.00 65535.00 FORMAT "%8.2" ECU_ADDRESS 0x6001798E /end MEASUREMENT
/begin MEASUREMENT MoFAirFl_TrqActCplIfClass_V4_I.zwoutCpl "Instance of data class for ram data redundancy of MoFAirFl_TrqActIfClass / Member Variable" UBYTE OneToOne 1 100 0.00 255.0 FORMAT "%5.1" ECU_ADDRESS 0x60017990 /end MEASUREMENT
/begin MEASUREMENT MoFAirFl_TrqActCplIfClass_V4_I.zwoutcplCpl "Instance of data class for ram data redundancy of MoFAirFl_TrqActIfClass / Member Variable" UBYTE OneToOne 1 100 0.00 255.0 FORMAT "%5.1" ECU_ADDRESS 0x60017991 /end MEASUREMENT
/begin MEASUREMENT MoFAirFl_TrqActCplIfClass_V4_I.zwouthireslAry_zzylzueCpl "Instance of data class for ram data redundancy of MoFAirFl_TrqActIfClass / Actual Torque interface class" UWORD OneToOne 1 100 0.00 65535.00 FORMAT "%8.2" ECU_ADDRESS 0x60017992 /end MEASUREMENT
/begin MEASUREMENT MoFAirFl_TrqActCplIfClass_V4_I.zwouthireslCpl "Instance of data class for ram data redundancy of MoFAirFl_TrqActIfClass / Actual Torque interface class" UWORD OneToOne 1 100 0.00 65535.00 FORMAT "%8.2" ECU_ADDRESS 0x60017994 /end MEASUREMENT
/begin MEASUREMENT MoFAirFl_TrqActCplIfClass_V4_I.zwouthireslRdntCpl "Instance of data class for ram data redundancy of MoFAirFl_TrqActIfClass / Actual Torque interface class" UWORD OneToOne 1 100 0.00 65535.00 FORMAT "%8.2" ECU_ADDRESS 0x60017996 /end MEASUREMENT
/begin MEASUREMENT MoFAirFl_TrqActIfClass_V4_I.agIntkClsd "Instance of data class for quantities in connection with actual torque in function monitoring / Instance of data class for quantities in connection with actual torque in function monitoring Member Variable" SWORD kw_q0p0156 1 100 -512.0000 511.9844 FORMAT "%8.4" ARRAY_SIZE 5 ECU_ADDRESS 0x600180A0 /end MEASUREMENT
/begin MEASUREMENT MoFAirFl_TrqActIfClass_V4_I.agIntkClsdRdt "Instance of data class for quantities in connection with actual torque in function monitoring / Instance of data class for quantities in connection with actual torque in function monitoring Member Variable" UWORD OneToOne 1 100 0.00 65535.00 FORMAT "%8.2" ARRAY_SIZE 5 ECU_ADDRESS 0x600180AA /end MEASUREMENT
/begin MEASUREMENT MoFAirFl_TrqActIfClass_V4_I.etaaufte "Instance of data class for quantities in connection with actual torque in function monitoring / Member Variable" UWORD fak_uw_b2 1 100 0.00 1.999969 FORMAT "%8.6" ECU_ADDRESS 0x600180B4 /end MEASUREMENT
/begin MEASUREMENT MoFAirFl_TrqActIfClass_V4_I.etazwist "Instance of data class for quantities in connection with actual torque in function monitoring / Member Variable" UWORD fak_uw_b2 1 100 0.00 1.999969 FORMAT "%8.6" ECU_ADDRESS 0x600180B6 /end MEASUREMENT
/begin MEASUREMENT MoFAirFl_TrqActIfClass_V4_I.etazwistm "Instance of data class for quantities in connection with actual torque in function monitoring / Member Variable" UWORD fak_uw_b2 1 100 0.00 1.999969 FORMAT "%8.6" ECU_ADDRESS 0x600180B8 /end MEASUREMENT
/begin MEASUREMENT MoFAirFl_TrqActIfClass_V4_I.miist "Instance of data class for quantities in connection with actual torque in function monitoring / Real engine torque in monitoring." UWORD rel_uw_b100 1 100 0.00 99.99847 FORMAT "%8.5" ECU_ADDRESS 0x600180BA /end MEASUREMENT
/begin MEASUREMENT MoFAirFl_TrqActIfClass_V4_I.zwcalcar "Instance of data class for quantities in connection with actual torque in function monitoring / Member Variable" SWORD zw_q0p05 1 100 -1638.400 1638.350 FORMAT "%8.3" ARRAY_SIZE 4 ECU_ADDRESS 0x600180BC /end MEASUREMENT
/begin MEASUREMENT MoFAirFl_TrqActIfClass_V4_I.zwcalcar_zzylzue "Instance of data class for quantities in connection with actual torque in function monitoring / Member Variable" SBYTE zw_sb_q0p75 1 100 -96.00 95.25 FORMAT "%5.2" ECU_ADDRESS 0x600180C4 /end MEASUREMENT
/begin MEASUREMENT MoFAirFl_TrqActIfClass_V4_I.zwcalcarcp "Instance of data class for quantities in connection with actual torque in function monitoring / Member Variable" UWORD OneToOne 1 100 0.00 65535.00 FORMAT "%8.2" ARRAY_SIZE 4 ECU_ADDRESS 0x600180C6 /end MEASUREMENT
/begin MEASUREMENT MoFAirFl_TrqActIfClass_V4_I.zwopt "Instance of data class for quantities in connection with actual torque in function monitoring / Member Variable" SWORD zw_q0p05 1 100 -1638.400 1638.350 FORMAT "%8.3" ECU_ADDRESS 0x600180CE /end MEASUREMENT
/begin MEASUREMENT MoFAirFl_TrqActIfClass_V4_I.zwout "Instance of data class for quantities in connection with actual torque in function monitoring / Member Variable" SBYTE zw_sb_q0p75 1 100 -96.00 95.25 FORMAT "%5.2" ECU_ADDRESS 0x600180D0 /end MEASUREMENT
/begin MEASUREMENT MoFAirFl_TrqActIfClass_V4_I.zwoutcpl "Instance of data class for quantities in connection with actual torque in function monitoring / Member Variable" UBYTE OneToOne 1 100 0.00 255.0 FORMAT "%5.1" ECU_ADDRESS 0x600180D1 /end MEASUREMENT
/begin MEASUREMENT MoFAirFl_TrqActIfClass_V4_I.zwouthiresl "Instance of data class for quantities in connection with actual torque in function monitoring / Instance of data class for quantities in connection to actual torque of function MoXAirFl_Adp Member Variable" SWORD zw_q0p1 1 100 -3276.800 3276.700 FORMAT "%8.3" ECU_ADDRESS 0x600180D2 /end MEASUREMENT
/begin MEASUREMENT MoFAirFl_TrqActIfClass_V4_I.zwouthireslAry_zzylzue "Instance of data class for quantities in connection with actual torque in function monitoring / Instance of data class for quantities in connection to actual torque of function MoXAirFl_Adp Member Variable" SWORD zw_q0p1 1 100 -3276.800 3276.700 FORMAT "%8.3" ECU_ADDRESS 0x600180D4 /end MEASUREMENT
/begin MEASUREMENT MoFAirFl_TrqActIfClass_V4_I.zwouthireslRdnt "Instance of data class for quantities in connection with actual torque in function monitoring / Instance of data class for quantities in connection to actual torque of function MoXAirFl_Adp Member Variable" UWORD OneToOne 1 100 0.00 65535.00 FORMAT "%8.2" ECU_ADDRESS 0x600180D6 /end MEASUREMENT
/begin MEASUREMENT MoF_stErrTotFF "Error information for MoFAirFl_FF" UBYTE OneToOne 1 100 0.00 255.0 FORMAT "%5.1" ECU_ADDRESS 0x6001820C /end MEASUREMENT
/begin MEASUREMENT MoF_stErrTotFFCpl "Complement for MoF_stErrTotFF" UBYTE OneToOne 1 100 0.00 255.0 FORMAT "%5.1" ECU_ADDRESS 0x60017ACC /end MEASUREMENT
/begin MEASUREMENT Mo_flgIrrvErrSOPMsg "Irreversible error bit of shut-off path test" UBYTE B_TRUE 1 100 0.00 1.00000000000 BIT_MASK 0x1 FORMAT "%13.11" ECU_ADDRESS 0x6000F8B5 /end MEASUREMENT
/begin FUNCTION MoCMem_Co "80.24.1   Microcontroller Monitoring: Cyclic memory test"
 /begin DEF_CHARACTERISTIC MoCMem_ctDebErrChkRAM_C MoCMem_ctDebErrChkROM_C MoCMem_ctDebHealChkRAMCpl_C MoCMem_ctDebHealChkRAM_C MoCMem_ctDebHealChkROMCpl_C MoCMem_ctDebHealChkROM_C MoCMem_noMEMChkRstCpl_CW MoCMem_noMEMChkRst_CW MoCMem_numRamChk_C MoCMem_numRomChk_CA MoCMem_RamTst_CW MoCMem_RomTst_CW MoCMem_stSwtAutRamChkConf_C MoCMem_stSwtAutRomChkConf_C /end DEF_CHARACTERISTIC
 /begin IN_MEASUREMENT MoExe_ctCyc /end IN_MEASUREMENT
 /begin LOC_MEASUREMENT MoCMem_adChkSumBlk MoCMem_adChkSumBlkCpl MoCMem_ctDebErrChkROM MoCMem_ctDebErrChkROMCpl MoCMem_ctDebHealChkROM MoCMem_ctDebHealChkROMCpl MoCMem_ctLrnROM MoCMem_ctLrnROMCpl MoCMem_idxCSAry MoCMem_idxCSAryCpl MoCMem_nrRomChk MoCMem_nrRomChkCpl MoCMem_nrRomChkSize MoCMem_numChkSumCurrent MoCMem_numChkSumCurrentCpl MoCMem_RomCurrentPtr MoCMem_RomCurrentPtrCpl MoCMem_stDataCycChkBlk MoCMem_stDataCycChkBlkCpl MoCMem_stDisChk MoCMem_tiROMAccus MoCMem_tiROMAccusCpl MoCMem_tiROMus MoCMem_tiROMusCpl MoCMem_tiROMusOld MoCMem_tiROMusOldCpl /end LOC_MEASUREMENT
 FUNCTION_VERSION "80.24.1" /end FUNCTION
/begin FUNCTION MoCPFC_Co "14.4.0    Microcontroller Monitoring: Program flow check" /begin DEF_CHARACTERISTIC MoCPFC_stPtlRespTestActv_CW /end DEF_CHARACTERISTIC /begin IN_MEASUREMENT MoCCom_bPFCNew MoCCom_Query /end IN_MEASUREMENT /begin OUT_MEASUREMENT MoCPFC_Checksum MoCPFC_PtlResp /end OUT_MEASUREMENT /begin LOC_MEASUREMENT MoCPFC_Checkword MoCPFC_Counter /end LOC_MEASUREMENT FUNCTION_VERSION "14.4.0" /end FUNCTION
/begin FUNCTION MoCSCC_Co "1.27.0    Microcontroller Monitoring: Safety feature Configuration Check(SCC)"
 /begin DEF_CHARACTERISTIC MoCSCC_cntrDebMax_C MoCSCC_stSCCTstActv_CW MoCSCC_swtDisblEmmChk_CA MoCSCC_swtLfastWrkarndActv_CW /end DEF_CHARACTERISTIC
 /begin REF_CHARACTERISTIC MoCSOP_stReqCANFrTest_C /end REF_CHARACTERISTIC
 /begin IN_MEASUREMENT MoCSOP_stComActv /end IN_MEASUREMENT
 /begin LOC_MEASUREMENT MoCSCC_stLfastWrkarndActv_MP MoCSCC_stMstInstFnd /end LOC_MEASUREMENT
 FUNCTION_VERSION "1.27.0" /end FUNCTION
/begin FUNCTION MoCSOP_Co "81.28.0   Microcontroller Monitoring: Shut-off path test"
 /begin DEF_CHARACTERISTIC MoCSOP_cntrDebCtrlLinesActvThd_C MoCSOP_cntrFrMacroTicEnd_C MoCSOP_cntrFrMacroTicStrt_C MoCSOP_ctDebCANFrTest_C MoCSOP_ctDebSOPTst_C MoCSOP_ctDebSycDrv_C MoCSOP_ctRstCANFrTest_C MoCSOP_ctRst_C MoCSOP_nEngMaxOVLthDisbl_C MoCSOP_stCANErrReac_CW MoCSOP_stCANTestActv_CW MoCSOP_stErrReactnERPN_CA MoCSOP_stErrReactn_CA MoCSOP_stMMErrReac_CW MoCSOP_stOVErrReactn_C MoCSOP_stReqCANFrTest_C MoCSOP_stSWResetDem_CW MoCSOP_stTestActv_CW MoCSOP_swtAlwysPsTest_C MoCSOP_swtRepFaildPESTest_C /end DEF_CHARACTERISTIC
 /begin IN_MEASUREMENT Epm_nEng MoGlbl_vblStructCpl.Mo_stCplChk MoGlbl_vblStructCpl.Mo_stMoCCpl Mo_stMoF Mo_stMoFCpl T15_st /end IN_MEASUREMENT
 /begin OUT_MEASUREMENT MoCSOP_ctErrMM MoCSOP_st MoCSOP_stActMsg MoCSOP_stActvMsg MoCSOP_stCANFrTest MoCSOP_stComActv MoCSOP_stComActvCpl MoCSOP_stOvl MoCSOP_stRdy MoCSOP_stRdyCan MoCSOP_stRdyCpl MoCSOP_stRdyFr MoCSOP_stRdyInj MoCSOP_stRdyMsg /end OUT_MEASUREMENT
 /begin LOC_MEASUREMENT MoCSOP_cntrDebErrPinActv MoCSOP_cntrDebErrPinActvCpl MoCSOP_cntrDebExtErrPinEveActv MoCSOP_cntrDebExtErrPinEveActvCpl MoCSOP_cntrDebExtErrPinEveActv_MP MoCSOP_cntrDebSycDrv MoCSOP_cntrDebSycDrvCpl MoCSOP_cntrSignalSwtDelay MoCSOP_cntrSignalSwtDelayCpl MoCSOP_ctBusErr MoCSOP_ctBusErr_MP MoCSOP_ctCANFrIdx MoCSOP_ctDebCANFrTest MoCSOP_ctDebCANFrTestCpl MoCSOP_ctDebSOPTst MoCSOP_ctDebSOPTstCpl MoCSOP_ctErrMM_mp MoCSOP_ctErrOSTimeout MoCSOP_ctIdx MoCSOP_ctRespOffsetTst MoCSOP_ctRst MoCSOP_ctRstCANFrTest MoCSOP_ctRstCANFrTestCpl MoCSOP_ctRstCpl MoCSOP_flgErrPinActvd MoCSOP_flgErrPinActvdCpl MoCSOP_flgReqSOPTest MoCSOP_flgReqSOPTestCpl MoCSOP_flgT15RisngEdge MoCSOP_flgT15RisngEdgeCpl MoCSOP_stBusErr MoCSOP_stBusErr_MP MoCSOP_stCANFrTestCpl MoCSOP_stCANFrTestErr MoCSOP_stCANFrTestErrReas MoCSOP_stCANFrTestErrReasCpl MoCSOP_stCANFrTestState MoCSOP_stCANFrTestStateCpl MoCSOP_stCanTdi MoCSOP_stCANTestState_mp MoCSOP_stCheckState MoCSOP_stCheckStateCpl MoCSOP_stCheckState_mp MoCSOP_stComTrcvOld MoCSOP_stCpl MoCSOP_stDia MoCSOP_stDiaCpl MoCSOP_stDiaERPN MoCSOP_stDiaERPNCpl MoCSOP_stEmmState_MP MoCSOP_stErr MoCSOP_stErrPinActvnReq MoCSOP_stErrPin_MP MoCSOP_stErrReactn MoCSOP_stErrReactnERPN MoCSOP_stInhbStrtCdn MoCSOP_stOvlCpl MoCSOP_stOVTstStatusEval MoCSOP_stOVTstStatusEvalCpl MoCSOP_stPVMTUnderTest MoCSOP_stRdyCanCpl MoCSOP_stRdyFrCpl MoCSOP_stRdyInjCpl MoCSOP_stReqPSStatus MoCSOP_stReqPSStatusBusErr MoCSOP_stT15Old MoCSOP_stT15OldCpl MoCSOP_tiCanTest_MP Mo_flgIrrvErrSOPMsg /end LOC_MEASUREMENT
 FUNCTION_VERSION "81.28.0" /end FUNCTION
/begin FUNCTION MoExe_Co "818.2.0   Monitoring: Execution control" /begin OUT_MEASUREMENT MoExe_ctCyc MoExe_ctCycCpl /end OUT_MEASUREMENT FUNCTION_VERSION "818.2.0" /end FUNCTION
/begin FUNCTION MoFACC_Co "112.0.0   Function Monitoring: Adaptive cruise control" /begin DEF_CHARACTERISTIC MoFACC_swtCANEna_C /end DEF_CHARACTERISTIC
 /begin IN_MEASUREMENT MoFFrm_Rx_flgACCActv MoFFrm_Rx_stPdu_GWIMG3 Mo_stCplChk Mo_stMoC Mo_stMoCCpl /end IN_MEASUREMENT
 /begin OUT_MEASUREMENT MoFACC_flgPtd /end OUT_MEASUREMENT
 /begin LOC_MEASUREMENT MoFACCCo_bbOutCpl /end LOC_MEASUREMENT
 FUNCTION_VERSION "112.0.0" /end FUNCTION
/begin FUNCTION MoFAirFl_CtOffGdi "14.0.0    Function Monitoring: Fuel cut off GDI"
 /begin DEF_CHARACTERISTIC MoFAirFl_cntrErrDebMaxCtOffGdi_C MoFAirFl_cntrRstMaxCtOffGdi_C MoFAirFl_nEngStallg_C MoFAirFl_nErrHndlgActvnCtOffGdi_C /end DEF_CHARACTERISTIC
 /begin REF_CHARACTERISTIC MoFAirFl_nrCylTot_C /end REF_CHARACTERISTIC
 /begin IN_MEASUREMENT MoFAirFl_CtOffIfClass_V4_I.evz_auscpl MoFAirFl_CtOffIfClass_V4_I.evz_auscpl_mem MoFAirFl_CtOffIfClass_V4_I.evz_austot MoFAirFl_CtOffIfClass_V4_I.evz_austot_mem MoFAirFl_CtOffIfClass_V4_I.flgInjEnad MoFAirFl_CtOffIfClass_V4_I.injTrigCylMsk MoFAirFl_CtOffIfClass_V4_I.injTrigCylMskRdnt MoFAirFl_CtOffIfClass_V4_I.injmode_zzylh MoFAirFl_CtOffIfClass_V4_I.injmode_zzylh_rdnt MoFAirFl_CtOffIfClass_V4_I.injmode_zzyln MoFAirFl_CtOffIfClass_V4_I.injmode_zzyln_rdnt MoFAirFl_CtOffIfClass_V4_I.injmode_zzyls MoFAirFl_CtOffIfClass_V4_I.injmode_zzyls_rdnt MoFAirFl_CtOffIfClass_V4_I.stInjPfiDeactvAry MoFAirFl_CtOffIfClass_V4_I.stInjPfiDeactvAryRdnt MoFAirFl_CtOffIfClass_V4_I.stInjPfiDeactvBkupAry MoFAirFl_CtOffIfClass_V4_I.stInjTiPfi MoFAirFl_CtOffIfClass_V4_I.stInjTiPfiRdnt MoFAirFl_flgErrCom MoFAirFl_InjTmngIfClass_V4_I.bdemod MoFAirFl_InjTmngIfClass_V4_I.bdemodRdnt MoFAirFl_InjTmngIfClass_V4_I.cntrCylAdv MoFAirFl_InjTmngIfClass_V4_I.cntrCylAdvRdnt MoFAirFl_InjTmngIfClass_V4_I.stInjTmng MoFAirFl_InjTmngIfClass_V4_I.stInjTmngRdnt MoFAirFl_InjTmngIfClass_V4_I.zzylh MoFAirFl_InjTmngIfClass_V4_I.zzylhRdnt MoFAirFl_InjTmngIfClass_V4_I.zzylnsp MoFAirFl_InjTmngIfClass_V4_I.zzylnspRdnt MoFAirFl_InjTmngIfClass_V4_I.zzyls MoFAirFl_InjTmngIfClass_V4_I.zzylsRdnt MoFESpd_nEng MoF_bAirFlChkDisbl Mo_bPostDrv Mo_bPreDrv Mo_ctRst Mo_ctRstCpl Mo_stCplChk Mo_stMoC Mo_stMoCCpl Mo_stMoF Mo_stMoFCpl /end IN_MEASUREMENT
 /begin OUT_MEASUREMENT MoFAirFl_flgIrrvErrCtOffGdiMsg MoFAirFl_flgTestCtOffGdiMsg MoFAirFl_stCtOffMask MoFAirFl_stErrCtOffGdiMsg /end OUT_MEASUREMENT
 /begin LOC_MEASUREMENT MoFAirFlCtOffGdi_bbLoc1Cpl MoFAirFlCtOffGdi_flgClr MoFAirFl_cntrDiagDebCtOffGdi MoFAirFl_cntrErrDebCtOffGdi MoFAirFl_cntrErrDebCtOffGdiCpl MoFAirFl_flgCtOffExpdCylHom MoFAirFl_flgCtOffExpdCylNsp MoFAirFl_flgCtOffExpdCylStrat MoFAirFl_flgInjEnadCylHom MoFAirFl_flgInjEnadCylNsp MoFAirFl_flgInjEnadCylStrat MoFAirFl_stCtOffMaskCpl MoFAirFl_stErrCtOffGdi MoFAirFl_stErrCtOffGdiCpl /end LOC_MEASUREMENT
 FUNCTION_VERSION "14.0.0" /end FUNCTION
/begin FUNCTION MoFAirFl_CylGdi "13.0.0    Function Monitoring: Fuel cut off GDI"
 /begin DEF_CHARACTERISTIC MoFAirFl_cntrAfimActvMax_C MoFAirFl_cntrErrDebMaxCylGdi_C MoFAirFl_cntrRstMaxCylGdi_C MoFAirFl_facCorFuAvrgMax_C MoFAirFl_facCorrnFuMCylIndAfimMax_C MoFAirFl_facCorrnFuMCylIndMax_C MoFAirFl_facTolrChkRatFuMCylIndMax_C MoFAirFl_facTolrChkRatFuMCylIndMin_C MoFAirFl_nErrHndlgActvnCylGdi_C MoFAirFl_ofsTolrChkRatFuMCylInd_C MoFAirFl_stCfgCyl_C /end DEF_CHARACTERISTIC
 /begin REF_CHARACTERISTIC MoFAirFl_nrCylTot_C MoFAirFl_stCfgCylBnk_C /end REF_CHARACTERISTIC
 /begin IN_MEASUREMENT MoFAirFl_InjTmngIfClass_V4_I.bdemod MoFAirFl_InjTmngIfClass_V4_I.bdemodRdnt MoFAirFl_InjTmngIfClass_V4_I.cntrCylAdv MoFAirFl_InjTmngIfClass_V4_I.cntrCylAdvRdnt MoFAirFl_InjTmngIfClass_V4_I.stInjTmng MoFAirFl_InjTmngIfClass_V4_I.stInjTmngRdnt MoFAirFl_InjTmngIfClass_V4_I.zzylh MoFAirFl_InjTmngIfClass_V4_I.zzylhRdnt MoFAirFl_InjTmngIfClass_V4_I.zzylnsp MoFAirFl_InjTmngIfClass_V4_I.zzylnspRdnt MoFAirFl_InjTmngIfClass_V4_I.zzyls MoFAirFl_InjTmngIfClass_V4_I.zzylsRdnt MoFAirFl_MixMngtIfClass_V4_I.B_afimreq MoFAirFl_MixMngtIfClass_V4_I.facLamCtlPfiAry MoFAirFl_MixMngtIfClass_V4_I.facLamCtlPfiAryRdnt MoFAirFl_MixMngtIfClass_V4_I.facLamCtlPfiBkupAry MoFAirFl_MixMngtIfClass_V4_I.facMixCorrnLivc MoFAirFl_MixMngtIfClass_V4_I.facPcPfiRest MoFAirFl_MixMngtIfClass_V4_I.facPcRest MoFAirFl_MixMngtIfClass_V4_I.facPrtnPfi MoFAirFl_MixMngtIfClass_V4_I.facPrtnPfiAry MoFAirFl_MixMngtIfClass_V4_I.facPrtnPfiAryRdnt MoFAirFl_MixMngtIfClass_V4_I.facPrtnPfiBkupAry MoFAirFl_MixMngtIfClass_V4_I.ffuevali MoFAirFl_MixMngtIfClass_V4_I.ffuevalipfi MoFAirFl_MixMngtIfClass_V4_I.fkrkAry MoFAirFl_MixMngtIfClass_V4_I.fkrkPfiAry MoFAirFl_MixMngtIfClass_V4_I.fkrkPfiAryRdnt MoFAirFl_MixMngtIfClass_V4_I.fnsad MoFAirFl_MixMngtIfClass_V4_I.fr MoFAirFl_MixMngtIfClass_V4_I.fr2 MoFAirFl_MixMngtIfClass_V4_I.fragdi MoFAirFl_MixMngtIfClass_V4_I.fragdi2 MoFAirFl_MixMngtIfClass_V4_I.frapfi MoFAirFl_MixMngtIfClass_V4_I.frapfi2 MoFAirFl_MixMngtIfClass_V4_I.lamsbg MoFAirFl_MixMngtIfClass_V4_I.lamsbg2 MoFAirFl_MixMngtIfClass_V4_I.rCtlPriB1 MoFAirFl_MixMngtIfClass_V4_I.rCtlPriB2 MoFAirFl_MixMngtIfClass_V4_I.ratFuMCylInd MoFAirFl_MixMngtIfClass_V4_I.ratFuMGdi MoFAirFl_MixMngtIfClass_V4_I.ratFuMGdiBnk2 MoFAirFl_MixMngtIfClass_V4_I.ratFuMLivc MoFAirFl_MixMngtIfClass_V4_I.ratFuMLivcRdnt MoFAirFl_MixMngtIfClass_V4_I.ratFuMPfi MoFAirFl_MixMngtIfClass_V4_I.ratFuMPfiBnk2 MoFAirFl_MixMngtIfClass_V4_I.ratFuPrtnPfiInjAry MoFAirFl_MixMngtIfClass_V4_I.ratFuPrtnPfiInjAryRdnt MoFAirFl_MixMngtIfClass_V4_I.ratFuPrtnPfiInjBkupAry MoFAirFl_MixMngtIfClass_V4_I.ratPrdcAirPrtnPfiAry MoFAirFl_MixMngtIfClass_V4_I.ratPrdcAirPrtnPfiAryRdnt MoFAirFl_MixMngtIfClass_V4_I.ratPrdcAirPrtnPfiBkupAry MoFAirFl_MixMngtIfClass_V4_I.rkagdi MoFAirFl_MixMngtIfClass_V4_I.rkagdi2 MoFAirFl_MixMngtIfClass_V4_I.rkapfi MoFAirFl_MixMngtIfClass_V4_I.rkapfi2 MoFAirFl_MixMngtIfClass_V4_I.rkausg MoFAirFl_MixMngtIfClass_V4_I.rkte MoFAirFl_MixMngtIfClass_V4_I.rkteBnk1 MoFAirFl_MixMngtIfClass_V4_I.rkteBnk2 MoFAirFl_MixMngtIfClass_V4_I.rkukg MoFAirFl_MixMngtIfClass_V4_I.rkukgpfi MoFAirFl_MixMngtIfClass_V4_I.rlfg MoFAirFl_MixMngtIfClass_V4_I.rlfgBnk1 MoFAirFl_MixMngtIfClass_V4_I.rlfgBnk2 MoFAirFl_MixMngtIfClass_V4_I.rlp MoFAirFl_MixMngtIfClass_V4_I.rlpBnk1 MoFAirFl_MixMngtIfClass_V4_I.rlpBnk2 MoFAirFl_MixMngtIfClass_V4_I.rlrext MoFAirFl_MixMngtIfClass_V4_I.rlrextBnk1 MoFAirFl_MixMngtIfClass_V4_I.rlrextBnk2 MoFAirFl_MixMngtIfClass_V4_I.rlrint MoFAirFl_MixMngtIfClass_V4_I.rlrintBnk1 MoFAirFl_MixMngtIfClass_V4_I.rlrintBnk2 MoFAirFl_ratFuMGdiAddl MoFAirFl_ratFuMTotGdiExpt MoFAirFl_ratFuMTotGdiExptBnk2 MoFESpd_nEng MoF_bAirFlChkDisbl Mo_bPostDrv Mo_bPreDrv Mo_ctRst Mo_ctRstCpl Mo_stCplChk Mo_stMoC Mo_stMoCCpl Mo_stMoF Mo_stMoFCpl /end IN_MEASUREMENT
 /begin OUT_MEASUREMENT MoFAirFl_flgIrrvErrCylGdiMsg MoFAirFl_flgTestCylGdiMsg MoFAirFl_stErrCylGdiMsg /end OUT_MEASUREMENT
 /begin LOC_MEASUREMENT MoFAirFlCylGdi_flgClr MoFAirFl_cntrAfimActvGdi MoFAirFl_cntrAfimActvGdiCpl MoFAirFl_cntrDiagDebCylGdi MoFAirFl_cntrErrDebCylGdi MoFAirFl_cntrErrDebCylGdiCpl MoFAirFl_ratFuMCylIndExpt MoFAirFl_ratFuMCylIndExptCpl MoFAirFl_stErrCylGdi MoFAirFl_stErrCylGdiCpl /end LOC_MEASUREMENT
 FUNCTION_VERSION "13.0.0" /end FUNCTION
/begin FUNCTION MoFAirFl_Eta "39.1.0    Function Monitoring: Efficiencies for air and fuel"
 /begin DEF_CHARACTERISTIC MoFAirFlEta_agIntkClsdHiRes_Ax MoFAirFlEta_agIntkClsd_Ax MoFAirFlEta_nEngHiRes_Ax MoFAirFlEta_nEng_Ax MoFAirFlEta_ratFillgHiRes_Ax MoFAirFlEta_ratFillg_Ax MoFAirFl_diaChrgMtnHiRes_M MoFAirFl_etaDeltaIgnAgAirChrgWHiRes_M MoFAirFl_etaFuMSpltMin_C MoFAirFl_etaLam_T MoFAirFl_flgChrgMtn_C MoFAirFl_iaDeltaOptLamHiRes_T MoFAirFl_iaDeltaOptTHiRes_T MoFAirFl_iaOptmHiRes_M MoFAirFl_ratLamSp_Ax /end DEF_CHARACTERISTIC
 /begin REF_CHARACTERISTIC MoFAirFl_nrCylTot_C MoFAirFl_stCfgMoFAirFl_C MoFAirFl_stOperModHsp_C MoF_tEng_DST /end REF_CHARACTERISTIC
 /begin IN_MEASUREMENT MoFAirFl_InjTmngIfClass_V4_I.bdemod MoFAirFl_InjTmngIfClass_V4_I.bdemodRdnt MoFAirFl_InjTmngIfClass_V4_I.cntrCylAdv MoFAirFl_InjTmngIfClass_V4_I.cntrCylAdvRdnt MoFAirFl_InjTmngIfClass_V4_I.stInjTmng MoFAirFl_InjTmngIfClass_V4_I.stInjTmngRdnt MoFAirFl_InjTmngIfClass_V4_I.zzylh MoFAirFl_InjTmngIfClass_V4_I.zzylhRdnt MoFAirFl_InjTmngIfClass_V4_I.zzylnsp MoFAirFl_InjTmngIfClass_V4_I.zzylnspRdnt MoFAirFl_InjTmngIfClass_V4_I.zzyls MoFAirFl_InjTmngIfClass_V4_I.zzylsRdnt MoFAirFl_MixMngtIfClass_V4_I.B_afimreq MoFAirFl_MixMngtIfClass_V4_I.facLamCtlPfiAry MoFAirFl_MixMngtIfClass_V4_I.facLamCtlPfiAryRdnt MoFAirFl_MixMngtIfClass_V4_I.facLamCtlPfiBkupAry MoFAirFl_MixMngtIfClass_V4_I.facMixCorrnLivc MoFAirFl_MixMngtIfClass_V4_I.facPcPfiRest MoFAirFl_MixMngtIfClass_V4_I.facPcRest MoFAirFl_MixMngtIfClass_V4_I.facPrtnPfi MoFAirFl_MixMngtIfClass_V4_I.facPrtnPfiAry MoFAirFl_MixMngtIfClass_V4_I.facPrtnPfiAryRdnt MoFAirFl_MixMngtIfClass_V4_I.facPrtnPfiBkupAry MoFAirFl_MixMngtIfClass_V4_I.ffuevali MoFAirFl_MixMngtIfClass_V4_I.ffuevalipfi MoFAirFl_MixMngtIfClass_V4_I.fkrkAry MoFAirFl_MixMngtIfClass_V4_I.fkrkPfiAry MoFAirFl_MixMngtIfClass_V4_I.fkrkPfiAryRdnt MoFAirFl_MixMngtIfClass_V4_I.fnsad MoFAirFl_MixMngtIfClass_V4_I.fr MoFAirFl_MixMngtIfClass_V4_I.fr2 MoFAirFl_MixMngtIfClass_V4_I.fragdi MoFAirFl_MixMngtIfClass_V4_I.fragdi2 MoFAirFl_MixMngtIfClass_V4_I.frapfi MoFAirFl_MixMngtIfClass_V4_I.frapfi2 MoFAirFl_MixMngtIfClass_V4_I.lamsbg MoFAirFl_MixMngtIfClass_V4_I.lamsbg2 MoFAirFl_MixMngtIfClass_V4_I.rCtlPriB1 MoFAirFl_MixMngtIfClass_V4_I.rCtlPriB2 MoFAirFl_MixMngtIfClass_V4_I.ratFuMCylInd MoFAirFl_MixMngtIfClass_V4_I.ratFuMGdi MoFAirFl_MixMngtIfClass_V4_I.ratFuMGdiBnk2 MoFAirFl_MixMngtIfClass_V4_I.ratFuMLivc MoFAirFl_MixMngtIfClass_V4_I.ratFuMLivcRdnt MoFAirFl_MixMngtIfClass_V4_I.ratFuMPfi MoFAirFl_MixMngtIfClass_V4_I.ratFuMPfiBnk2 MoFAirFl_MixMngtIfClass_V4_I.ratFuPrtnPfiInjAry MoFAirFl_MixMngtIfClass_V4_I.ratFuPrtnPfiInjAryRdnt MoFAirFl_MixMngtIfClass_V4_I.ratFuPrtnPfiInjBkupAry MoFAirFl_MixMngtIfClass_V4_I.ratPrdcAirPrtnPfiAry MoFAirFl_MixMngtIfClass_V4_I.ratPrdcAirPrtnPfiAryRdnt MoFAirFl_MixMngtIfClass_V4_I.ratPrdcAirPrtnPfiBkupAry MoFAirFl_MixMngtIfClass_V4_I.rkagdi MoFAirFl_MixMngtIfClass_V4_I.rkagdi2 MoFAirFl_MixMngtIfClass_V4_I.rkapfi MoFAirFl_MixMngtIfClass_V4_I.rkapfi2 MoFAirFl_MixMngtIfClass_V4_I.rkausg MoFAirFl_MixMngtIfClass_V4_I.rkte MoFAirFl_MixMngtIfClass_V4_I.rkteBnk1 MoFAirFl_MixMngtIfClass_V4_I.rkteBnk2 MoFAirFl_MixMngtIfClass_V4_I.rkukg MoFAirFl_MixMngtIfClass_V4_I.rkukgpfi MoFAirFl_MixMngtIfClass_V4_I.rlfg MoFAirFl_MixMngtIfClass_V4_I.rlfgBnk1 MoFAirFl_MixMngtIfClass_V4_I.rlfgBnk2 MoFAirFl_MixMngtIfClass_V4_I.rlp MoFAirFl_MixMngtIfClass_V4_I.rlpBnk1 MoFAirFl_MixMngtIfClass_V4_I.rlpBnk2 MoFAirFl_MixMngtIfClass_V4_I.rlrext MoFAirFl_MixMngtIfClass_V4_I.rlrextBnk1 MoFAirFl_MixMngtIfClass_V4_I.rlrextBnk2 MoFAirFl_MixMngtIfClass_V4_I.rlrint MoFAirFl_MixMngtIfClass_V4_I.rlrintBnk1 MoFAirFl_MixMngtIfClass_V4_I.rlrintBnk2 MoFAirFl_ratFillg MoFAirFl_stCtOffMask MoFAirFl_TrqActIfClass_V4_I.agIntkClsd MoFAirFl_TrqActIfClass_V4_I.agIntkClsdRdt MoFAirFl_TrqActIfClass_V4_I.etaaufte MoFAirFl_TrqActIfClass_V4_I.etazwist MoFAirFl_TrqActIfClass_V4_I.etazwistm MoFAirFl_TrqActIfClass_V4_I.miist MoFAirFl_TrqActIfClass_V4_I.zwcalcar MoFAirFl_TrqActIfClass_V4_I.zwcalcar_zzylzue MoFAirFl_TrqActIfClass_V4_I.zwcalcarcp MoFAirFl_TrqActIfClass_V4_I.zwopt MoFAirFl_TrqActIfClass_V4_I.zwout MoFAirFl_TrqActIfClass_V4_I.zwoutcpl MoFAirFl_TrqActIfClass_V4_I.zwouthiresl MoFAirFl_TrqActIfClass_V4_I.zwouthireslAry_zzylzue MoFAirFl_TrqActIfClass_V4_I.zwouthireslRdnt MoFESpd_nEng MoFIA_iaOutpHiResl MoF_tEng MoF_tEng_DST_result Mo_stCplChk Mo_stMoC Mo_stMoCCpl /end IN_MEASUREMENT
 /begin OUT_MEASUREMENT etaaus_um MoFAirFl_etaIA MoFAirFl_etaIAAvrg MoFAirFl_etaInjCtOff MoFAirFl_etaInjSplt MoFAirFl_etaLam /end OUT_MEASUREMENT
 /begin LOC_MEASUREMENT etaaus_ur MoFAirFlEta_agIntkClsdHiRes_Ax_result MoFAirFlEta_agIntkClsd_Ax_result MoFAirFlEta_nEngHiRes_Ax_result MoFAirFlEta_nEng_Ax_result MoFAirFlEta_ratFillgHiRes_Ax_result MoFAirFlEta_ratFillg_Ax_result MoFAirFl_agIntkClsd MoFAirFl_agIntkClsdCpl MoFAirFl_etaIAAvrgCpl MoFAirFl_etaIACpl MoFAirFl_etaInjCtOffCpl MoFAirFl_etaInjSpltCpl MoFAirFl_etaLamCpl MoFAirFl_iaDelta MoFAirFl_iaDeltaCpl MoFAirFl_iaDeltaOpt MoFAirFl_iaDeltaOptChrgMtn MoFAirFl_iaDeltaOptChrgMtnCpl MoFAirFl_iaDeltaOptCpl MoFAirFl_iaOpt MoFAirFl_iaOptCpl MoFAirFl_iaOptTot MoFAirFl_iaOptTotCpl MoFAirFl_ratLamSp MoFAirFl_ratLamSpCpl MoFAirFl_ratLamSp_Ax_result MoFAirFl_stErrEta MoFAirFl_stErrEtaCpl /end LOC_MEASUREMENT
 FUNCTION_VERSION "39.1.0" /end FUNCTION
/begin FUNCTION MoFAirFl_FF "18.1.0    Function Monitoring: Flex-Fuel"
 /begin DEF_CHARACTERISTIC MoFAirFl_cntrErrDebMaxFF_C MoFAirFl_cntrFuAdpnActvMax_C MoFAirFl_cntrRstMaxFF_C MoFAirFl_facFFAvrg_C MoFAirFl_facFuAdpnMax_C MoFAirFl_facFuAdpnMin_C MoFAirFl_facFuAdpnTolcOfs_C MoFAirFl_nErrHndlgActvnFF_C /end DEF_CHARACTERISTIC
 /begin IN_MEASUREMENT MoFAirFl_FfIfClass_V4_I.B_ethgg MoFAirFl_FfIfClass_V4_I.ethggRdnt MoFAirFl_FfIfClass_V4_I.facFuAdpn MoFAirFl_FfIfClass_V4_I.flgEthVld MoFAirFl_FfIfClass_V4_I.stEthVldRdnt MoFAirFl_FfIfClass_V4_I.stFuAdpnRdnt MoFESpd_nEng MoF_bAirFlChkDisbl Mo_bPostDrv Mo_bPreDrv Mo_ctRst Mo_ctRstCpl Mo_stCplChk Mo_stMoC Mo_stMoCCpl Mo_stMoF Mo_stMoFCpl /end IN_MEASUREMENT
 /begin OUT_MEASUREMENT MoFAirFl_facFuAdpnLst MoFAirFl_flgIrrvErrFFMsg MoFAirFl_flgTestFFMsg MoFAirFl_stErrAirFlFFMsg /end OUT_MEASUREMENT
 /begin LOC_MEASUREMENT MoFAirFlFF_bbLocCpl MoFAirFlFF_flgClr MoFAirFl_cntrDiagDebFF MoFAirFl_cntrErrDebFF MoFAirFl_cntrErrDebFFCpl MoFAirFl_cntrFuAdpnActv MoFAirFl_cntrFuAdpnActvCpl MoFAirFl_facFuAdpnLstCpl MoFAirFl_flgOldSubSt MoF_stErrTotFF MoF_stErrTotFFCpl /end LOC_MEASUREMENT
 FUNCTION_VERSION "18.1.0" /end FUNCTION
/begin FUNCTION MoFAirFl_In "59.1.0    Function Monitoring: Input signals for air and fuel"
 /begin DEF_CHARACTERISTIC MoFAirFl_cntrComNEngDynMin_C MoFAirFl_cntrErrDebMaxInCom_C MoFAirFl_cntrRstMaxInCom_C MoFAirFl_nErrHndlgActvnInCom_C MoFAirFl_nrCylAdv_C MoFAirFl_nrCylTot_C MoFAirFl_stCfgCylBnk_C MoFAirFl_stCfglIn_C MoFAirFl_stCfgMoFAirFl_C MoFAirFl_stOperModHks_C MoFAirFl_stOperModHom_C MoFAirFl_stOperModHsp_C /end DEF_CHARACTERISTIC
 /begin IN_MEASUREMENT MoFESpd_nEng MoF_bAirFlChkDisbl MoXAirFl_CdaIfClass_V4_I.bHemInjSync MoXAirFl_CdaIfClass_V4_I.bHmbv MoXAirFl_CdaIfClass_V4_I.bHmbzylsy MoXAirFl_CdaIfClass_V4_I.hmbcpl MoXAirFl_cntrComS0 MoXAirFl_cntrComS0Rdnt MoXAirFl_cntrComS1 MoXAirFl_cntrComS1Rdnt MoXAirFl_CtOffIfClass_V4_I.evz_auscpl MoXAirFl_CtOffIfClass_V4_I.evz_auscpl_mem MoXAirFl_CtOffIfClass_V4_I.evz_austot MoXAirFl_CtOffIfClass_V4_I.evz_austot_mem MoXAirFl_CtOffIfClass_V4_I.flgInjEnad MoXAirFl_CtOffIfClass_V4_I.injTrigCylMsk MoXAirFl_CtOffIfClass_V4_I.injTrigCylMskRdnt MoXAirFl_CtOffIfClass_V4_I.injmode_zzylh MoXAirFl_CtOffIfClass_V4_I.injmode_zzylh_rdnt MoXAirFl_CtOffIfClass_V4_I.injmode_zzyln MoXAirFl_CtOffIfClass_V4_I.injmode_zzyln_rdnt MoXAirFl_CtOffIfClass_V4_I.injmode_zzyls MoXAirFl_CtOffIfClass_V4_I.injmode_zzyls_rdnt MoXAirFl_CtOffIfClass_V4_I.stInjPfiDeactvAry MoXAirFl_CtOffIfClass_V4_I.stInjPfiDeactvAryRdnt MoXAirFl_CtOffIfClass_V4_I.stInjPfiDeactvBkupAry MoXAirFl_CtOffIfClass_V4_I.stInjTiPfi MoXAirFl_CtOffIfClass_V4_I.stInjTiPfiRdnt MoXAirFl_FfIfClass_V4_I.B_ethgg MoXAirFl_FfIfClass_V4_I.ethggRdnt MoXAirFl_FfIfClass_V4_I.facFuAdpn MoXAirFl_FfIfClass_V4_I.flgEthVld MoXAirFl_FfIfClass_V4_I.stEthVldRdnt MoXAirFl_FfIfClass_V4_I.stFuAdpnRdnt MoXAirFl_InjTmngIfClass_V4_I.bdemod MoXAirFl_InjTmngIfClass_V4_I.bdemodRdnt MoXAirFl_InjTmngIfClass_V4_I.cntrCylAdv MoXAirFl_InjTmngIfClass_V4_I.cntrCylAdvRdnt MoXAirFl_InjTmngIfClass_V4_I.stInjTmng MoXAirFl_InjTmngIfClass_V4_I.stInjTmngRdnt MoXAirFl_InjTmngIfClass_V4_I.zzylh MoXAirFl_InjTmngIfClass_V4_I.zzylhRdnt MoXAirFl_InjTmngIfClass_V4_I.zzylnsp MoXAirFl_InjTmngIfClass_V4_I.zzylnspRdnt MoXAirFl_InjTmngIfClass_V4_I.zzyls MoXAirFl_InjTmngIfClass_V4_I.zzylsRdnt MoXAirFl_MixMngtIfClass_V4_I.B_afimreq MoXAirFl_MixMngtIfClass_V4_I.facLamCtlPfiAry MoXAirFl_MixMngtIfClass_V4_I.facLamCtlPfiAryRdnt MoXAirFl_MixMngtIfClass_V4_I.facLamCtlPfiBkupAry MoXAirFl_MixMngtIfClass_V4_I.facMixCorrnLivc MoXAirFl_MixMngtIfClass_V4_I.facPcPfiRest MoXAirFl_MixMngtIfClass_V4_I.facPcRest MoXAirFl_MixMngtIfClass_V4_I.facPrtnPfi MoXAirFl_MixMngtIfClass_V4_I.facPrtnPfiAry MoXAirFl_MixMngtIfClass_V4_I.facPrtnPfiAryRdnt MoXAirFl_MixMngtIfClass_V4_I.facPrtnPfiBkupAry MoXAirFl_MixMngtIfClass_V4_I.ffuevali MoXAirFl_MixMngtIfClass_V4_I.ffuevalipfi MoXAirFl_MixMngtIfClass_V4_I.fkrkAry MoXAirFl_MixMngtIfClass_V4_I.fkrkPfiAry MoXAirFl_MixMngtIfClass_V4_I.fkrkPfiAryRdnt MoXAirFl_MixMngtIfClass_V4_I.fnsad MoXAirFl_MixMngtIfClass_V4_I.fr MoXAirFl_MixMngtIfClass_V4_I.fr2 MoXAirFl_MixMngtIfClass_V4_I.fragdi MoXAirFl_MixMngtIfClass_V4_I.fragdi2 MoXAirFl_MixMngtIfClass_V4_I.frapfi MoXAirFl_MixMngtIfClass_V4_I.frapfi2 MoXAirFl_MixMngtIfClass_V4_I.lamsbg MoXAirFl_MixMngtIfClass_V4_I.lamsbg2 MoXAirFl_MixMngtIfClass_V4_I.rCtlPriB1 MoXAirFl_MixMngtIfClass_V4_I.rCtlPriB2 MoXAirFl_MixMngtIfClass_V4_I.ratFuMCylInd MoXAirFl_MixMngtIfClass_V4_I.ratFuMGdi MoXAirFl_MixMngtIfClass_V4_I.ratFuMGdiBnk2 MoXAirFl_MixMngtIfClass_V4_I.ratFuMLivc MoXAirFl_MixMngtIfClass_V4_I.ratFuMLivcRdnt MoXAirFl_MixMngtIfClass_V4_I.ratFuMPfi MoXAirFl_MixMngtIfClass_V4_I.ratFuMPfiBnk2 MoXAirFl_MixMngtIfClass_V4_I.ratFuPrtnPfiInjAry MoXAirFl_MixMngtIfClass_V4_I.ratFuPrtnPfiInjAryRdnt MoXAirFl_MixMngtIfClass_V4_I.ratFuPrtnPfiInjBkupAry MoXAirFl_MixMngtIfClass_V4_I.ratPrdcAirPrtnPfiAry MoXAirFl_MixMngtIfClass_V4_I.ratPrdcAirPrtnPfiAryRdnt MoXAirFl_MixMngtIfClass_V4_I.ratPrdcAirPrtnPfiBkupAry MoXAirFl_MixMngtIfClass_V4_I.rkagdi MoXAirFl_MixMngtIfClass_V4_I.rkagdi2 MoXAirFl_MixMngtIfClass_V4_I.rkapfi MoXAirFl_MixMngtIfClass_V4_I.rkapfi2 MoXAirFl_MixMngtIfClass_V4_I.rkausg MoXAirFl_MixMngtIfClass_V4_I.rkte MoXAirFl_MixMngtIfClass_V4_I.rkteBnk1 MoXAirFl_MixMngtIfClass_V4_I.rkteBnk2 MoXAirFl_MixMngtIfClass_V4_I.rkukg MoXAirFl_MixMngtIfClass_V4_I.rkukgpfi MoXAirFl_MixMngtIfClass_V4_I.rlfg MoXAirFl_MixMngtIfClass_V4_I.rlfgBnk1 MoXAirFl_MixMngtIfClass_V4_I.rlfgBnk2 MoXAirFl_MixMngtIfClass_V4_I.rlp MoXAirFl_MixMngtIfClass_V4_I.rlpBnk1 MoXAirFl_MixMngtIfClass_V4_I.rlpBnk2 MoXAirFl_MixMngtIfClass_V4_I.rlrext MoXAirFl_MixMngtIfClass_V4_I.rlrextBnk1 MoXAirFl_MixMngtIfClass_V4_I.rlrextBnk2 MoXAirFl_MixMngtIfClass_V4_I.rlrint MoXAirFl_MixMngtIfClass_V4_I.rlrintBnk1 MoXAirFl_MixMngtIfClass_V4_I.rlrintBnk2 MoXAirFl_TrqActIfClass_V4_I.agIntkClsd MoXAirFl_TrqActIfClass_V4_I.agIntkClsdCpl MoXAirFl_TrqActIfClass_V4_I.etaaufte MoXAirFl_TrqActIfClass_V4_I.etazwist MoXAirFl_TrqActIfClass_V4_I.etazwistm MoXAirFl_TrqActIfClass_V4_I.miist MoXAirFl_TrqActIfClass_V4_I.zwcalcar MoXAirFl_TrqActIfClass_V4_I.zwcalcar_zzylzue MoXAirFl_TrqActIfClass_V4_I.zwcalcarcp MoXAirFl_TrqActIfClass_V4_I.zwopt MoXAirFl_TrqActIfClass_V4_I.zwout MoXAirFl_TrqActIfClass_V4_I.zwoutcpl MoXAirFl_TrqActIfClass_V4_I.zwouthiresl MoXAirFl_TrqActIfClass_V4_I.zwouthireslAry_zzylzue MoXAirFl_TrqActIfClass_V4_I.zwouthireslRdnt Mo_bPostDrv Mo_bPreDrv Mo_ctRst Mo_ctRstCpl Mo_stCplChk Mo_stMoC Mo_stMoCCpl Mo_stMoF Mo_stMoFCpl /end IN_MEASUREMENT
 /begin OUT_MEASUREMENT MoFAirFl_CdaIfClass_V4_I.bHemInjSync MoFAirFl_CdaIfClass_V4_I.bHmbv MoFAirFl_CdaIfClass_V4_I.bHmbzylsy MoFAirFl_CdaIfClass_V4_I.hmbcpl MoFAirFl_CtOffIfClass_V4_I.evz_auscpl MoFAirFl_CtOffIfClass_V4_I.evz_auscpl_mem MoFAirFl_CtOffIfClass_V4_I.evz_austot MoFAirFl_CtOffIfClass_V4_I.evz_austot_mem MoFAirFl_CtOffIfClass_V4_I.flgInjEnad MoFAirFl_CtOffIfClass_V4_I.injTrigCylMsk MoFAirFl_CtOffIfClass_V4_I.injTrigCylMskRdnt MoFAirFl_CtOffIfClass_V4_I.injmode_zzylh MoFAirFl_CtOffIfClass_V4_I.injmode_zzylh_rdnt MoFAirFl_CtOffIfClass_V4_I.injmode_zzyln MoFAirFl_CtOffIfClass_V4_I.injmode_zzyln_rdnt MoFAirFl_CtOffIfClass_V4_I.injmode_zzyls MoFAirFl_CtOffIfClass_V4_I.injmode_zzyls_rdnt MoFAirFl_CtOffIfClass_V4_I.stInjPfiDeactvAry MoFAirFl_CtOffIfClass_V4_I.stInjPfiDeactvAryRdnt MoFAirFl_CtOffIfClass_V4_I.stInjPfiDeactvBkupAry MoFAirFl_CtOffIfClass_V4_I.stInjTiPfi MoFAirFl_CtOffIfClass_V4_I.stInjTiPfiRdnt MoFAirFl_FfIfClass_V4_I.B_ethgg MoFAirFl_FfIfClass_V4_I.ethggRdnt MoFAirFl_FfIfClass_V4_I.facFuAdpn MoFAirFl_FfIfClass_V4_I.flgEthVld MoFAirFl_FfIfClass_V4_I.stEthVldRdnt MoFAirFl_FfIfClass_V4_I.stFuAdpnRdnt MoFAirFl_flgErrCom MoFAirFl_flgIrrvErrInMsg MoFAirFl_flgTestInMsg MoFAirFl_InjTmngIfClass_V4_I.bdemod MoFAirFl_InjTmngIfClass_V4_I.bdemodRdnt MoFAirFl_InjTmngIfClass_V4_I.cntrCylAdv MoFAirFl_InjTmngIfClass_V4_I.cntrCylAdvRdnt MoFAirFl_InjTmngIfClass_V4_I.stInjTmng MoFAirFl_InjTmngIfClass_V4_I.stInjTmngRdnt MoFAirFl_InjTmngIfClass_V4_I.zzylh MoFAirFl_InjTmngIfClass_V4_I.zzylhRdnt MoFAirFl_InjTmngIfClass_V4_I.zzylnsp MoFAirFl_InjTmngIfClass_V4_I.zzylnspRdnt MoFAirFl_InjTmngIfClass_V4_I.zzyls MoFAirFl_InjTmngIfClass_V4_I.zzylsRdnt MoFAirFl_MixMngtIfClass_V4_I.B_afimreq MoFAirFl_MixMngtIfClass_V4_I.facLamCtlPfiAry MoFAirFl_MixMngtIfClass_V4_I.facLamCtlPfiAryRdnt MoFAirFl_MixMngtIfClass_V4_I.facLamCtlPfiBkupAry MoFAirFl_MixMngtIfClass_V4_I.facMixCorrnLivc MoFAirFl_MixMngtIfClass_V4_I.facPcPfiRest MoFAirFl_MixMngtIfClass_V4_I.facPcRest MoFAirFl_MixMngtIfClass_V4_I.facPrtnPfi MoFAirFl_MixMngtIfClass_V4_I.facPrtnPfiAry MoFAirFl_MixMngtIfClass_V4_I.facPrtnPfiAryRdnt MoFAirFl_MixMngtIfClass_V4_I.facPrtnPfiBkupAry MoFAirFl_MixMngtIfClass_V4_I.ffuevali MoFAirFl_MixMngtIfClass_V4_I.ffuevalipfi MoFAirFl_MixMngtIfClass_V4_I.fkrkAry MoFAirFl_MixMngtIfClass_V4_I.fkrkPfiAry MoFAirFl_MixMngtIfClass_V4_I.fkrkPfiAryRdnt MoFAirFl_MixMngtIfClass_V4_I.fnsad MoFAirFl_MixMngtIfClass_V4_I.fr MoFAirFl_MixMngtIfClass_V4_I.fr2 MoFAirFl_MixMngtIfClass_V4_I.fragdi MoFAirFl_MixMngtIfClass_V4_I.fragdi2 MoFAirFl_MixMngtIfClass_V4_I.frapfi MoFAirFl_MixMngtIfClass_V4_I.frapfi2 MoFAirFl_MixMngtIfClass_V4_I.lamsbg MoFAirFl_MixMngtIfClass_V4_I.lamsbg2 MoFAirFl_MixMngtIfClass_V4_I.rCtlPriB1 MoFAirFl_MixMngtIfClass_V4_I.rCtlPriB2 MoFAirFl_MixMngtIfClass_V4_I.ratFuMCylInd MoFAirFl_MixMngtIfClass_V4_I.ratFuMGdi MoFAirFl_MixMngtIfClass_V4_I.ratFuMGdiBnk2 MoFAirFl_MixMngtIfClass_V4_I.ratFuMLivc MoFAirFl_MixMngtIfClass_V4_I.ratFuMLivcRdnt MoFAirFl_MixMngtIfClass_V4_I.ratFuMPfi MoFAirFl_MixMngtIfClass_V4_I.ratFuMPfiBnk2 MoFAirFl_MixMngtIfClass_V4_I.ratFuPrtnPfiInjAry MoFAirFl_MixMngtIfClass_V4_I.ratFuPrtnPfiInjAryRdnt MoFAirFl_MixMngtIfClass_V4_I.ratFuPrtnPfiInjBkupAry MoFAirFl_MixMngtIfClass_V4_I.ratPrdcAirPrtnPfiAry MoFAirFl_MixMngtIfClass_V4_I.ratPrdcAirPrtnPfiAryRdnt MoFAirFl_MixMngtIfClass_V4_I.ratPrdcAirPrtnPfiBkupAry MoFAirFl_MixMngtIfClass_V4_I.rkagdi MoFAirFl_MixMngtIfClass_V4_I.rkagdi2 MoFAirFl_MixMngtIfClass_V4_I.rkapfi MoFAirFl_MixMngtIfClass_V4_I.rkapfi2 MoFAirFl_MixMngtIfClass_V4_I.rkausg MoFAirFl_MixMngtIfClass_V4_I.rkte MoFAirFl_MixMngtIfClass_V4_I.rkteBnk1 MoFAirFl_MixMngtIfClass_V4_I.rkteBnk2 MoFAirFl_MixMngtIfClass_V4_I.rkukg MoFAirFl_MixMngtIfClass_V4_I.rkukgpfi MoFAirFl_MixMngtIfClass_V4_I.rlfg MoFAirFl_MixMngtIfClass_V4_I.rlfgBnk1 MoFAirFl_MixMngtIfClass_V4_I.rlfgBnk2 MoFAirFl_MixMngtIfClass_V4_I.rlp MoFAirFl_MixMngtIfClass_V4_I.rlpBnk1 MoFAirFl_MixMngtIfClass_V4_I.rlpBnk2 MoFAirFl_MixMngtIfClass_V4_I.rlrext MoFAirFl_MixMngtIfClass_V4_I.rlrextBnk1 MoFAirFl_MixMngtIfClass_V4_I.rlrextBnk2 MoFAirFl_MixMngtIfClass_V4_I.rlrint MoFAirFl_MixMngtIfClass_V4_I.rlrintBnk1 MoFAirFl_MixMngtIfClass_V4_I.rlrintBnk2 MoFAirFl_stInjTmng MoFAirFl_TrqActIfClass_V4_I.agIntkClsd MoFAirFl_TrqActIfClass_V4_I.agIntkClsdRdt MoFAirFl_TrqActIfClass_V4_I.etaaufte MoFAirFl_TrqActIfClass_V4_I.etazwist MoFAirFl_TrqActIfClass_V4_I.etazwistm MoFAirFl_TrqActIfClass_V4_I.miist MoFAirFl_TrqActIfClass_V4_I.zwcalcar MoFAirFl_TrqActIfClass_V4_I.zwcalcar_zzylzue MoFAirFl_TrqActIfClass_V4_I.zwcalcarcp MoFAirFl_TrqActIfClass_V4_I.zwopt MoFAirFl_TrqActIfClass_V4_I.zwout MoFAirFl_TrqActIfClass_V4_I.zwoutcpl MoFAirFl_TrqActIfClass_V4_I.zwouthiresl MoFAirFl_TrqActIfClass_V4_I.zwouthireslAry_zzylzue MoFAirFl_TrqActIfClass_V4_I.zwouthireslRdnt /end OUT_MEASUREMENT
 /begin LOC_MEASUREMENT MoFAirFlIn_bbOut1Cpl MoFAirFlIn_flgClr MoFAirFl_CdaCplIfClass_V4_I.bHemInjSyncCpl MoFAirFl_CdaCplIfClass_V4_I.bHmbvCpl MoFAirFl_CdaCplIfClass_V4_I.bHmbzylsyCpl MoFAirFl_CdaCplIfClass_V4_I.hmbcplCpl MoFAirFl_cntrComCntrS0Stat MoFAirFl_cntrComCntrS0StatCpl MoFAirFl_cntrComCntrS1Stat MoFAirFl_cntrComCntrS1StatCpl MoFAirFl_cntrComS0 MoFAirFl_cntrComS0Cpl MoFAirFl_cntrComS0Old MoFAirFl_cntrComS0OldCpl MoFAirFl_cntrComS0Rdnt MoFAirFl_cntrComS0RdntCpl MoFAirFl_cntrComS1 MoFAirFl_cntrComS1Cpl MoFAirFl_cntrComS1Old MoFAirFl_cntrComS1OldCpl MoFAirFl_cntrComS1Rdnt MoFAirFl_cntrComS1RdntCpl MoFAirFl_cntrDiagDebIn MoFAirFl_cntrErrDebInCom MoFAirFl_cntrErrDebInComCpl MoFAirFl_CtOffCplIfClass_V4_I.evz_auscplCpl MoFAirFl_CtOffCplIfClass_V4_I.evz_auscpl_memCpl MoFAirFl_CtOffCplIfClass_V4_I.evz_austotCpl MoFAirFl_CtOffCplIfClass_V4_I.evz_austot_memCpl MoFAirFl_CtOffCplIfClass_V4_I.flgInjEnadCpl MoFAirFl_CtOffCplIfClass_V4_I.injTrigCylMskCpl MoFAirFl_CtOffCplIfClass_V4_I.injTrigCylMskRdntCpl MoFAirFl_CtOffCplIfClass_V4_I.injmode_zzylhCpl MoFAirFl_CtOffCplIfClass_V4_I.injmode_zzylh_rdntCpl MoFAirFl_CtOffCplIfClass_V4_I.injmode_zzylnCpl MoFAirFl_CtOffCplIfClass_V4_I.injmode_zzyln_rdntCpl MoFAirFl_CtOffCplIfClass_V4_I.injmode_zzylsCpl MoFAirFl_CtOffCplIfClass_V4_I.injmode_zzyls_rdntCpl MoFAirFl_CtOffCplIfClass_V4_I.stInjPfiDeactvAryCpl MoFAirFl_CtOffCplIfClass_V4_I.stInjPfiDeactvAryRdntCpl MoFAirFl_CtOffCplIfClass_V4_I.stInjPfiDeactvBkupAryCpl MoFAirFl_CtOffCplIfClass_V4_I.stInjTiPfiCpl MoFAirFl_CtOffCplIfClass_V4_I.stInjTiPfiRdntCpl MoFAirFl_FfCplIfClass_V4_I.B_ethggCpl MoFAirFl_FfCplIfClass_V4_I.ethggRdntCpl MoFAirFl_FfCplIfClass_V4_I.facFuAdpnCpl MoFAirFl_FfCplIfClass_V4_I.flgEthVldCpl MoFAirFl_FfCplIfClass_V4_I.stEthVldRdntCpl MoFAirFl_FfCplIfClass_V4_I.stFuAdpnRdntCpl MoFAirFl_InjTmngCplIfClass_V4_I.bdemodCpl MoFAirFl_InjTmngCplIfClass_V4_I.bdemodRdntCpl MoFAirFl_InjTmngCplIfClass_V4_I.cntrCylAdvCpl MoFAirFl_InjTmngCplIfClass_V4_I.cntrCylAdvRdntCpl MoFAirFl_InjTmngCplIfClass_V4_I.stInjTmngCpl MoFAirFl_InjTmngCplIfClass_V4_I.stInjTmngRdntCpl MoFAirFl_InjTmngCplIfClass_V4_I.zzylhCpl MoFAirFl_InjTmngCplIfClass_V4_I.zzylhRdntCpl MoFAirFl_InjTmngCplIfClass_V4_I.zzylnspCpl MoFAirFl_InjTmngCplIfClass_V4_I.zzylnspRdntCpl MoFAirFl_InjTmngCplIfClass_V4_I.zzylsCpl MoFAirFl_InjTmngCplIfClass_V4_I.zzylsRdntCpl MoFAirFl_MixMngtCplIfClass_V4_I.B_afimreqCpl MoFAirFl_MixMngtCplIfClass_V4_I.facLamCtlPfiAryCpl MoFAirFl_MixMngtCplIfClass_V4_I.facLamCtlPfiAryRdntCpl MoFAirFl_MixMngtCplIfClass_V4_I.facLamCtlPfiBkupAryCpl MoFAirFl_MixMngtCplIfClass_V4_I.facMixCorrnLivcCpl MoFAirFl_MixMngtCplIfClass_V4_I.facPcPfiRestCpl MoFAirFl_MixMngtCplIfClass_V4_I.facPcRestCpl MoFAirFl_MixMngtCplIfClass_V4_I.facPrtnPfiAryCpl MoFAirFl_MixMngtCplIfClass_V4_I.facPrtnPfiAryRdntCpl MoFAirFl_MixMngtCplIfClass_V4_I.facPrtnPfiBkupAryCpl MoFAirFl_MixMngtCplIfClass_V4_I.facPrtnPfiCpl MoFAirFl_MixMngtCplIfClass_V4_I.ffuevaliCpl MoFAirFl_MixMngtCplIfClass_V4_I.ffuevalipfiCpl MoFAirFl_MixMngtCplIfClass_V4_I.fkrkAryCpl MoFAirFl_MixMngtCplIfClass_V4_I.fkrkPfiAryCpl MoFAirFl_MixMngtCplIfClass_V4_I.fkrkPfiAryRdntCpl MoFAirFl_MixMngtCplIfClass_V4_I.fnsadCpl MoFAirFl_MixMngtCplIfClass_V4_I.fr2Cpl MoFAirFl_MixMngtCplIfClass_V4_I.frCpl MoFAirFl_MixMngtCplIfClass_V4_I.fragdi2Cpl MoFAirFl_MixMngtCplIfClass_V4_I.fragdiCpl MoFAirFl_MixMngtCplIfClass_V4_I.frapfi2Cpl MoFAirFl_MixMngtCplIfClass_V4_I.frapfiCpl MoFAirFl_MixMngtCplIfClass_V4_I.lamsbg2Cpl MoFAirFl_MixMngtCplIfClass_V4_I.lamsbgCpl MoFAirFl_MixMngtCplIfClass_V4_I.rCtlPriB1Cpl MoFAirFl_MixMngtCplIfClass_V4_I.rCtlPriB2Cpl MoFAirFl_MixMngtCplIfClass_V4_I.ratFuMCylIndCpl MoFAirFl_MixMngtCplIfClass_V4_I.ratFuMGdiBnk2Cpl MoFAirFl_MixMngtCplIfClass_V4_I.ratFuMGdiCpl MoFAirFl_MixMngtCplIfClass_V4_I.ratFuMLivcCpl MoFAirFl_MixMngtCplIfClass_V4_I.ratFuMLivcRdntCpl MoFAirFl_MixMngtCplIfClass_V4_I.ratFuMPfiBnk2Cpl MoFAirFl_MixMngtCplIfClass_V4_I.ratFuMPfiCpl MoFAirFl_MixMngtCplIfClass_V4_I.ratFuPrtnPfiInjAryCpl MoFAirFl_MixMngtCplIfClass_V4_I.ratFuPrtnPfiInjAryRdntCpl MoFAirFl_MixMngtCplIfClass_V4_I.ratFuPrtnPfiInjBkupAryCpl MoFAirFl_MixMngtCplIfClass_V4_I.ratPrdcAirPrtnPfiAryCpl MoFAirFl_MixMngtCplIfClass_V4_I.ratPrdcAirPrtnPfiAryRdntCpl MoFAirFl_MixMngtCplIfClass_V4_I.ratPrdcAirPrtnPfiBkupAryCpl MoFAirFl_MixMngtCplIfClass_V4_I.rkagdi2Cpl MoFAirFl_MixMngtCplIfClass_V4_I.rkagdiCpl MoFAirFl_MixMngtCplIfClass_V4_I.rkapfi2Cpl MoFAirFl_MixMngtCplIfClass_V4_I.rkapfiCpl MoFAirFl_MixMngtCplIfClass_V4_I.rkausgCpl MoFAirFl_MixMngtCplIfClass_V4_I.rkteBnk1Cpl MoFAirFl_MixMngtCplIfClass_V4_I.rkteBnk2Cpl MoFAirFl_MixMngtCplIfClass_V4_I.rkteCpl MoFAirFl_MixMngtCplIfClass_V4_I.rkukgCpl MoFAirFl_MixMngtCplIfClass_V4_I.rkukgpfiCpl MoFAirFl_MixMngtCplIfClass_V4_I.rlfgBnk1Cpl MoFAirFl_MixMngtCplIfClass_V4_I.rlfgBnk2Cpl MoFAirFl_MixMngtCplIfClass_V4_I.rlfgCpl MoFAirFl_MixMngtCplIfClass_V4_I.rlpBnk1Cpl MoFAirFl_MixMngtCplIfClass_V4_I.rlpBnk2Cpl MoFAirFl_MixMngtCplIfClass_V4_I.rlpCpl MoFAirFl_MixMngtCplIfClass_V4_I.rlrextBnk1Cpl MoFAirFl_MixMngtCplIfClass_V4_I.rlrextBnk2Cpl MoFAirFl_MixMngtCplIfClass_V4_I.rlrextCpl MoFAirFl_MixMngtCplIfClass_V4_I.rlrintBnk1Cpl MoFAirFl_MixMngtCplIfClass_V4_I.rlrintBnk2Cpl MoFAirFl_MixMngtCplIfClass_V4_I.rlrintCpl MoFAirFl_nEngOld MoFAirFl_nEngOldCpl MoFAirFl_stErrCplIn MoFAirFl_stErrCplInCpl MoFAirFl_stInjTmngCpl MoFAirFl_TrqActCplIfClass_V4_I.agIntkClsdCpl MoFAirFl_TrqActCplIfClass_V4_I.agIntkClsdRdtCpl MoFAirFl_TrqActCplIfClass_V4_I.etaaufteCpl MoFAirFl_TrqActCplIfClass_V4_I.etazwistCpl MoFAirFl_TrqActCplIfClass_V4_I.etazwistmCpl MoFAirFl_TrqActCplIfClass_V4_I.miistCpl MoFAirFl_TrqActCplIfClass_V4_I.zwcalcarCpl MoFAirFl_TrqActCplIfClass_V4_I.zwcalcar_zzylzueCpl MoFAirFl_TrqActCplIfClass_V4_I.zwcalcarcpCpl MoFAirFl_TrqActCplIfClass_V4_I.zwoptCpl MoFAirFl_TrqActCplIfClass_V4_I.zwoutCpl MoFAirFl_TrqActCplIfClass_V4_I.zwoutcplCpl MoFAirFl_TrqActCplIfClass_V4_I.zwouthireslAry_zzylzueCpl MoFAirFl_TrqActCplIfClass_V4_I.zwouthireslCpl MoFAirFl_TrqActCplIfClass_V4_I.zwouthireslRdntCpl /end LOC_MEASUREMENT
 FUNCTION_VERSION "59.1.0" /end FUNCTION
/begin FUNCTION MoFAirFl_MixCtlGdi "14.1.0    Function Monitoring: Mixture control GDI"
 /begin DEF_CHARACTERISTIC MoFAirFl_cntrErrDebMaxMixCtlGdiChkAirFl_C MoFAirFl_cntrErrDebMaxMixCtlGdiChkCtrl_C MoFAirFl_cntrRstMaxMixCtlGdiChkAirFl_C MoFAirFl_cntrRstMaxMixCtlGdiChkCtrl_C MoFAirFl_facAftStrtCorrnGdiMax_T MoFAirFl_facLamAdpnMax_T MoFAirFl_facLamCtrlMax_C MoFAirFl_facMixCorrnLivcMax_C MoFAirFl_facTolrChkCpv_C MoFAirFl_facTolrRatFuMGdiChkMax_C MoFAirFl_facTolrRatFuMGdiChkMin_C MoFAirFl_nEngThdFuEvapChk_C MoFAirFl_nErrHndlgActvnMixCtlGdi_C MoFAirFl_ofsTolrChkCpv_C MoFAirFl_ofsTolrRatFuMGdiChk_C MoFAirFl_ratFuEvapMinHiEngSpd_C MoFAirFl_ratFuEvapMinLoEngSpd_C MoFAirFl_ratFuMLamAdpnGdiMax_C MoFAirFl_rLamCtlMaxPri_C MoFAirFl_rLamCtlMinPri_C MoFAirFl_stCfgAirFlMixCtl_C /end DEF_CHARACTERISTIC
 /begin REF_CHARACTERISTIC MoFAirFl_stCfgCylBnk_C MoFAirFl_stCfgMoFAirFl_C MoF_tEng_DST /end REF_CHARACTERISTIC
 /begin IN_MEASUREMENT MoFAirFl_InjTmngIfClass_V4_I.bdemod MoFAirFl_InjTmngIfClass_V4_I.bdemodRdnt MoFAirFl_InjTmngIfClass_V4_I.cntrCylAdv MoFAirFl_InjTmngIfClass_V4_I.cntrCylAdvRdnt MoFAirFl_InjTmngIfClass_V4_I.stInjTmng MoFAirFl_InjTmngIfClass_V4_I.stInjTmngRdnt MoFAirFl_InjTmngIfClass_V4_I.zzylh MoFAirFl_InjTmngIfClass_V4_I.zzylhRdnt MoFAirFl_InjTmngIfClass_V4_I.zzylnsp MoFAirFl_InjTmngIfClass_V4_I.zzylnspRdnt MoFAirFl_InjTmngIfClass_V4_I.zzyls MoFAirFl_InjTmngIfClass_V4_I.zzylsRdnt MoFAirFl_MixMngtIfClass_V4_I.B_afimreq MoFAirFl_MixMngtIfClass_V4_I.facLamCtlPfiAry MoFAirFl_MixMngtIfClass_V4_I.facLamCtlPfiAryRdnt MoFAirFl_MixMngtIfClass_V4_I.facLamCtlPfiBkupAry MoFAirFl_MixMngtIfClass_V4_I.facMixCorrnLivc MoFAirFl_MixMngtIfClass_V4_I.facPcPfiRest MoFAirFl_MixMngtIfClass_V4_I.facPcRest MoFAirFl_MixMngtIfClass_V4_I.facPrtnPfi MoFAirFl_MixMngtIfClass_V4_I.facPrtnPfiAry MoFAirFl_MixMngtIfClass_V4_I.facPrtnPfiAryRdnt MoFAirFl_MixMngtIfClass_V4_I.facPrtnPfiBkupAry MoFAirFl_MixMngtIfClass_V4_I.ffuevali MoFAirFl_MixMngtIfClass_V4_I.ffuevalipfi MoFAirFl_MixMngtIfClass_V4_I.fkrkAry MoFAirFl_MixMngtIfClass_V4_I.fkrkPfiAry MoFAirFl_MixMngtIfClass_V4_I.fkrkPfiAryRdnt MoFAirFl_MixMngtIfClass_V4_I.fnsad MoFAirFl_MixMngtIfClass_V4_I.fr MoFAirFl_MixMngtIfClass_V4_I.fr2 MoFAirFl_MixMngtIfClass_V4_I.fragdi MoFAirFl_MixMngtIfClass_V4_I.fragdi2 MoFAirFl_MixMngtIfClass_V4_I.frapfi MoFAirFl_MixMngtIfClass_V4_I.frapfi2 MoFAirFl_MixMngtIfClass_V4_I.lamsbg MoFAirFl_MixMngtIfClass_V4_I.lamsbg2 MoFAirFl_MixMngtIfClass_V4_I.rCtlPriB1 MoFAirFl_MixMngtIfClass_V4_I.rCtlPriB2 MoFAirFl_MixMngtIfClass_V4_I.ratFuMCylInd MoFAirFl_MixMngtIfClass_V4_I.ratFuMGdi MoFAirFl_MixMngtIfClass_V4_I.ratFuMGdiBnk2 MoFAirFl_MixMngtIfClass_V4_I.ratFuMLivc MoFAirFl_MixMngtIfClass_V4_I.ratFuMLivcRdnt MoFAirFl_MixMngtIfClass_V4_I.ratFuMPfi MoFAirFl_MixMngtIfClass_V4_I.ratFuMPfiBnk2 MoFAirFl_MixMngtIfClass_V4_I.ratFuPrtnPfiInjAry MoFAirFl_MixMngtIfClass_V4_I.ratFuPrtnPfiInjAryRdnt MoFAirFl_MixMngtIfClass_V4_I.ratFuPrtnPfiInjBkupAry MoFAirFl_MixMngtIfClass_V4_I.ratPrdcAirPrtnPfiAry MoFAirFl_MixMngtIfClass_V4_I.ratPrdcAirPrtnPfiAryRdnt MoFAirFl_MixMngtIfClass_V4_I.ratPrdcAirPrtnPfiBkupAry MoFAirFl_MixMngtIfClass_V4_I.rkagdi MoFAirFl_MixMngtIfClass_V4_I.rkagdi2 MoFAirFl_MixMngtIfClass_V4_I.rkapfi MoFAirFl_MixMngtIfClass_V4_I.rkapfi2 MoFAirFl_MixMngtIfClass_V4_I.rkausg MoFAirFl_MixMngtIfClass_V4_I.rkte MoFAirFl_MixMngtIfClass_V4_I.rkteBnk1 MoFAirFl_MixMngtIfClass_V4_I.rkteBnk2 MoFAirFl_MixMngtIfClass_V4_I.rkukg MoFAirFl_MixMngtIfClass_V4_I.rkukgpfi MoFAirFl_MixMngtIfClass_V4_I.rlfg MoFAirFl_MixMngtIfClass_V4_I.rlfgBnk1 MoFAirFl_MixMngtIfClass_V4_I.rlfgBnk2 MoFAirFl_MixMngtIfClass_V4_I.rlp MoFAirFl_MixMngtIfClass_V4_I.rlpBnk1 MoFAirFl_MixMngtIfClass_V4_I.rlpBnk2 MoFAirFl_MixMngtIfClass_V4_I.rlrext MoFAirFl_MixMngtIfClass_V4_I.rlrextBnk1 MoFAirFl_MixMngtIfClass_V4_I.rlrextBnk2 MoFAirFl_MixMngtIfClass_V4_I.rlrint MoFAirFl_MixMngtIfClass_V4_I.rlrintBnk1 MoFAirFl_MixMngtIfClass_V4_I.rlrintBnk2 MoFESpd_nEng MoF_bAirFlChkDisbl MoF_tEng MoF_tEng_DST_result Mo_bPostDrv Mo_bPreDrv Mo_ctRst Mo_ctRstCpl Mo_stCplChk Mo_stMoC Mo_stMoCCpl Mo_stMoF Mo_stMoFCpl /end IN_MEASUREMENT
 /begin OUT_MEASUREMENT MoFAirFl_flgIrrvErrMixCtlGdiChkAirFlMsg MoFAirFl_flgIrrvErrMixCtlGdiChkCtrlMsg MoFAirFl_flgTestMixCtlGdiChkAirFlMsg MoFAirFl_flgTestMixCtlGdiChkCtrlMsg MoFAirFl_ratFuMGdiAddl MoFAirFl_ratFuMTotGdiExpt MoFAirFl_ratFuMTotGdiExptBnk2 MoFAirFl_stErrMixCtlGdiChkAirFlMsg MoFAirFl_stErrMixCtlGdiChkCtrlMsg /end OUT_MEASUREMENT
 /begin LOC_MEASUREMENT MoFAirFlMixCtlGdiChkAirFl_flgClr MoFAirFlMixCtlGdiChkCtrl_flgClr MoFAirFlMixCtlGdi_nEng MoFAirFlMixCtlGdi_nEngCpl MoFAirFl_cntrDiagDebMixCtlGdiChkAirFl MoFAirFl_cntrDiagDebMixCtlGdiChkCtrl MoFAirFl_cntrErrDebMixCtlGdiChkAirFl MoFAirFl_cntrErrDebMixCtlGdiChkAirFlCpl MoFAirFl_cntrErrDebMixCtlGdiChkCtrl MoFAirFl_cntrErrDebMixCtlGdiChkCtrlCpl MoFAirFl_facAftStrtCorrn MoFAirFl_facAftStrtCorrnCpl MoFAirFl_facLamFuM MoFAirFl_facLamFuMCpl MoFAirFl_facPCFuM MoFAirFl_facPCFuMCpl MoFAirFl_MixCtlGdi_lamsbg_rCtlPri MoFAirFl_MixCtlGdi_lamsbg_rCtlPriCpl MoFAirFl_ratAirPrdcGdi MoFAirFl_ratAirPrdcGdiCpl MoFAirFl_ratFuMCpv MoFAirFl_ratFuMCpvCpl MoFAirFl_ratFuMCpvMin MoFAirFl_ratFuMCpvMinCpl MoFAirFl_ratFuMGdiAddlCpl MoFAirFl_ratFuMGdiExpt MoFAirFl_ratFuMGdiExptBnk2 MoFAirFl_ratFuMGdiExptBnk2Cpl MoFAirFl_ratFuMGdiExptCpl MoFAirFl_ratFuMMaxGdi MoFAirFl_ratFuMMaxGdiCpl MoFAirFl_ratFuMMinGdi MoFAirFl_ratFuMMinGdiCpl MoFAirFl_ratFuMTotExptGdi MoFAirFl_ratFuMTotExptGdiCpl MoFAirFl_ratFuMTotGdiExptBnk2Cpl MoFAirFl_ratFuMTotGdiExptCpl MoFAirFl_stErrAirFlTot MoFAirFl_stErrAirFlTotCpl MoFAirFl_stErrMixCtlGdiChkCtrl MoFAirFl_stErrMixCtlGdiChkCtrlCpl /end LOC_MEASUREMENT
 FUNCTION_VERSION "14.1.0" /end FUNCTION
/begin COMPU_METHOD B_TRUE "" TAB_VERB "%6.3" "" COMPU_TAB_REF B_TRUE /end COMPU_METHOD
/begin COMPU_VTAB B_TRUE "" TAB_VERB 2 0 "FALSE" 1 "TRUE" /end COMPU_VTAB
/begin COMPU_METHOD dez "" RAT_FUNC "%6.2" "" COEFFS 0 1 0 0 0 1 /end COMPU_METHOD
/begin COMPU_METHOD EngN "" RAT_FUNC "%6.3" "rpm" COEFFS 0 2 0 0 0 1 /end COMPU_METHOD
/begin COMPU_METHOD fak_sw_b1 "" RAT_FUNC "%7.6" "-" COEFFS 0 65536 0 0 0 2 /end COMPU_METHOD
/begin COMPU_METHOD fak_ub_b1 "" RAT_FUNC "%6.4" "-" COEFFS 0 256 0 0 0 1 /end COMPU_METHOD
/begin COMPU_METHOD fak_ub_b2 "" RAT_FUNC "%8.5" "-" COEFFS 0 256 0 0 0 2 /end COMPU_METHOD
/begin COMPU_METHOD fak_uw_b16 "" RAT_FUNC "%6.5" "-" COEFFS 0 65536 0 0 0 16 /end COMPU_METHOD
/begin COMPU_METHOD fak_uw_b2 "" RAT_FUNC "%7.6" "-" COEFFS 0 65536 0 0 0 2 /end COMPU_METHOD
/begin COMPU_METHOD fak_uw_b4 "" RAT_FUNC "%7.6" "-" COEFFS 0 65536 0 0 0 4 /end COMPU_METHOD
/begin COMPU_METHOD fak_uw_b64 "" RAT_FUNC "%6.5" "-" COEFFS 0 65536 0 0 0 64 /end COMPU_METHOD
/begin COMPU_METHOD kw_q0p0156 "" RAT_FUNC "%6.4" "Grad KW" COEFFS 0 64 0 0 0 1 /end COMPU_METHOD
/begin COMPU_METHOD MoCSOP_stCANFrTestState_mp_Compu "" TAB_VERB "%6.3" "" COMPU_TAB_REF MoCSOP_stCANFrTestState_mp_Compu /end COMPU_METHOD
/begin COMPU_VTAB MoCSOP_stCANFrTestState_mp_Compu "" TAB_VERB 13 0 "-" 1 "STEP_WAITFORPROTSTATE" 2 "STEP_WAITFORSTART" 3 "STEP_1" 4 "STEP_2" 5 "STEP_3" 6 "STEP_4" 7 "STEP_5" 8 "STEP_6" 9 "STEP_7" 10 "STEP_8" 11 "STEP_ERROR" 12 "STEP_FINISH" /end COMPU_VTAB
/begin COMPU_METHOD MoCSOP_stCheckStateCY329_mp_Compu "" TAB_VERB "%6.3" "" COMPU_TAB_REF MoCSOP_stCheckStateCY329_mp_Compu /end COMPU_METHOD
/begin COMPU_VTAB MoCSOP_stCheckStateCY329_mp_Compu "" TAB_VERB 19 0 "-" 1 "MOCSOP_CO_OUT_OF_DRIVE" 2 "MOCSOP_CO_POSITIVE_TEST_PREP" 3 "MOCSOP_CO_POSITIVE_TEST_DIA" 4 "MOCSOP_CO_WDA_TEST_PREP" 5 "MOCSOP_CO_WDA_TEST_DIA" 6 "MOCSOP_CO_MM2ERRSWITCH_TEST_PREP" 7 "MOCSOP_CO_MM2ERRSWITCH_TEST_DIA" 8 "MOCSOP_CO_ERRPIN_TEST_PREP" 9 "MOCSOP_CO_ERRPIN_TEST_DIA" 10 "MOCSOP_CO_ERR2WDASWITCH_TEST_PREP" 11 "MOCSOP_CO_ERR2WDASWITCH_TEST_DIA" 12 "MOCSOP_CO_OVERVOLTAGE_TEST_PREP" 13 "MOCSOP_CO_OVERVOLTAGE_TEST_DIA" 14 "MOCSOP_CO_POSITIVE_TEST_OVERVOLTAGE_PREP" 15 "MOCSOP_CO_POSITIVE_TEST_OVERVOLTAGE_DIA" 16 "MOCSOP_CO_ERR_CHECK" 17 "MOCSOP_CO_ERR_REACTION" 18 "MOCSOP_CO_TO_MOCCOM" /end COMPU_VTAB
/begin COMPU_METHOD MoCSOP_stEmmStateIFX_MP_Compu "" TAB_VERB "%6.3" "" COMPU_TAB_REF MoCSOP_stEmmStateIFX_MP_Compu /end COMPU_METHOD
/begin COMPU_VTAB MoCSOP_stEmmStateIFX_MP_Compu "" TAB_VERB 4 0 "SSM_START" 1 "SSM_RUN" 2 "SSM_FAULT" 32 "STATE_ERROR" /end COMPU_VTAB
/begin COMPU_METHOD MoCSOP_stErrPin_MP_Compu "" TAB_VERB "%6.3" "" COMPU_TAB_REF MoCSOP_stErrPin_MP_Compu /end COMPU_METHOD
/begin COMPU_VTAB MoCSOP_stErrPin_MP_Compu "" TAB_VERB 2 0 "ERRPIN_ACTIVE" 1 "ERRPIN_NOT_ACTIVE" /end COMPU_VTAB
/begin COMPU_METHOD MoCSOP_stErrReactnERPN_CA_Compu "" TAB_VERB "%6.3" "" COMPU_TAB_REF MoCSOP_stErrReactnERPN_CA_Compu /end COMPU_METHOD
/begin COMPU_VTAB MoCSOP_stErrReactnERPN_CA_Compu "" TAB_VERB 3 0 "MOCSOP_CO_REACTN_NORMAL_RUN" 1 "MOCSOP_CO_REACTN_ICO" 2 "MOCSOP_CO_REACTN_RESETLOOP" /end COMPU_VTAB
/begin COMPU_METHOD MoCSOP_stErrReactn_CA_Compu "" TAB_VERB "%6.3" "" COMPU_TAB_REF MoCSOP_stErrReactn_CA_Compu /end COMPU_METHOD
/begin COMPU_VTAB MoCSOP_stErrReactn_CA_Compu "" TAB_VERB 3 0 "MOCSOP_CO_REACTN_NORMAL_RUN" 1 "MOCSOP_CO_REACTN_ICO" 2 "MOCSOP_CO_REACTN_RESETLOOP" /end COMPU_VTAB
/begin COMPU_METHOD MoCSOP_stOVErrReactn_C_Compu "" TAB_VERB "%6.3" "" COMPU_TAB_REF MoCSOP_stOVErrReactn_C_Compu /end COMPU_METHOD
/begin COMPU_VTAB MoCSOP_stOVErrReactn_C_Compu "" TAB_VERB 2 1 "MOCSOP_CO_REACTN_ICO" 2 "MOCSOP_CO_REACTN_RESETLOOP" /end COMPU_VTAB
/begin COMPU_METHOD MoCSOP_Time_us "" RAT_FUNC "%6.2" "us" COEFFS 0 1 0 0 0 1 /end COMPU_METHOD
/begin COMPU_METHOD nmot_q40 "" RAT_FUNC "%6.1" "1/min" COEFFS 0 1 0 0 0 40 /end COMPU_METHOD
/begin COMPU_METHOD OneToOne "" RAT_FUNC "%6.2" "-" COEFFS 0 1 0 0 0 1 /end COMPU_METHOD
/begin COMPU_METHOD rel_sw_b1536 "" RAT_FUNC "%6.4" "%" COEFFS 0 65536 0 0 0 3072 /end COMPU_METHOD
/begin COMPU_METHOD rel_ub_q0p75 "" RAT_FUNC "%6.3" "%" COEFFS 0 1 0 0 0 0.75 /end COMPU_METHOD
/begin COMPU_METHOD rel_uw_b100 "" RAT_FUNC "%6.4" "%" COEFFS 0 65536 0 0 0 100 /end COMPU_METHOD
/begin COMPU_METHOD rel_uw_b3072 "" RAT_FUNC "%6.4" "%" COEFFS 0 65536 0 0 0 3072 /end COMPU_METHOD
/begin COMPU_METHOD rel_uw_q0p0234 "" RAT_FUNC "%6.4" "%" COEFFS 0 32 0 0 0 0.75 /end COMPU_METHOD
/begin COMPU_METHOD SY_HFMKOMP_Compu "" TAB_VERB "%6.3" "" COMPU_TAB_REF SY_HFMKOMP_Compu /end COMPU_METHOD
/begin COMPU_VTAB SY_HFMKOMP_Compu "" TAB_VERB 9 0 "No_Afs" 1 "Afs_AnIf" 2 "Afs_PwmIf_Corrn" 3 "Afs_PwmIf_WoCorrn" 4 "Afs_PwmIf_DblRng" 5 "Afs_AnIf_SelfDiag" 6 "Afs_SentIf" 7 "Afs_PwmIfWoCorrn_SentIf" 8 "Afs_PwmIfCorrn_SentIf" /end COMPU_VTAB
/begin COMPU_METHOD SY_HFMPANZ_Compu "" TAB_VERB "%6.3" "" COMPU_TAB_REF SY_HFMPANZ_Compu /end COMPU_METHOD
/begin COMPU_VTAB SY_HFMPANZ_Compu "" TAB_VERB 4 0 "No device" 1 "1 device" 2 "2 device" 3 "3 device" /end COMPU_VTAB
/begin COMPU_METHOD SY_HFM_ANZKL_Compu "" TAB_VERB "%6.3" "" COMPU_TAB_REF SY_HFM_ANZKL_Compu /end COMPU_METHOD
/begin COMPU_VTAB SY_HFM_ANZKL_Compu "" TAB_VERB 3 0 "no HFM" 1 "one HFM transfer curve" 2 "two HFM transfer curves" /end COMPU_VTAB
/begin COMPU_METHOD SY_HFM_Compu "" TAB_VERB "%6.3" "" COMPU_TAB_REF SY_HFM_Compu /end COMPU_METHOD
/begin COMPU_VTAB SY_HFM_Compu "" TAB_VERB 3 0 "kein HFM verbaut" 1 "HFM verbaut (vor Verdichter)" 2 "HFM verbaut (nach Verdichter)" /end COMPU_VTAB
/begin COMPU_METHOD SY_HKAT_Compu "" TAB_VERB "%6.3" "" COMPU_TAB_REF SY_HKAT_Compu /end COMPU_METHOD
/begin COMPU_VTAB SY_HKAT_Compu "" TAB_VERB 2 0 "kein Hauptkat Bank 1" 1 "Hauptkat Bank 1 vorhanden" /end COMPU_VTAB
/begin COMPU_METHOD SY_HKS_Compu "" TAB_VERB "%6.3" "" COMPU_TAB_REF SY_HKS_Compu /end COMPU_METHOD
/begin COMPU_VTAB SY_HKS_Compu "" TAB_VERB 2 0 "HomogenKlopfSchutz nicht vorhanden" 1 "HomogenKlopfSchutz vorhanden" /end COMPU_VTAB
/begin COMPU_METHOD SY_HLSHRTP_Compu "" TAB_VERB "%6.3" "" COMPU_TAB_REF SY_HLSHRTP_Compu /end COMPU_METHOD
/begin COMPU_VTAB SY_HLSHRTP_Compu "" TAB_VERB 2 0 "False" 1 "True" /end COMPU_VTAB
/begin COMPU_METHOD SY_HMBMBA_Compu "" TAB_VERB "%6.3" "" COMPU_TAB_REF SY_HMBMBA_Compu /end COMPU_METHOD
/begin COMPU_VTAB SY_HMBMBA_Compu "" TAB_VERB 2 0 "False" 1 "True" /end COMPU_VTAB
/begin COMPU_METHOD SY_HMB_Compu "" TAB_VERB "%6.3" "" COMPU_TAB_REF SY_HMB_Compu /end COMPU_METHOD
/begin COMPU_VTAB SY_HMB_Compu "" TAB_VERB 3 0 "No HMB" 1 "CDA" 2 "BDA" /end COMPU_VTAB
/begin COMPU_METHOD SY_HMM_Compu "" TAB_VERB "%6.3" "" COMPU_TAB_REF SY_HMM_Compu /end COMPU_METHOD
/begin COMPU_VTAB SY_HMM_Compu "" TAB_VERB 2 0 "kein HMM-Betrieb vorhanden" 1 "HMM-Betrieb vorhanden" /end COMPU_VTAB
/begin COMPU_METHOD SY_HOS_Compu "" TAB_VERB "%6.3" "" COMPU_TAB_REF SY_HOS_Compu /end COMPU_METHOD
/begin COMPU_VTAB SY_HOS_Compu "" TAB_VERB 2 0 "False" 1 "True" /end COMPU_VTAB
/begin COMPU_METHOD SY_HSG_Compu "" TAB_VERB "%6.3" "" COMPU_TAB_REF SY_HSG_Compu /end COMPU_METHOD
/begin COMPU_VTAB SY_HSG_Compu "" TAB_VERB 2 0 "False" 1 "True" /end COMPU_VTAB
/begin COMPU_METHOD SY_HSPMD_Compu "" TAB_VERB "%6.3" "" COMPU_TAB_REF SY_HSPMD_Compu /end COMPU_METHOD
/begin COMPU_VTAB SY_HSPMD_Compu "" TAB_VERB 3 0 "kein HSP-Betrieb (BDE)" 1 "HSP mit genauer Md-Modellierung" 2 "HSP mit genauer Md-Modellierung + LBK" /end COMPU_VTAB
/begin COMPU_METHOD SY_HSPNWS_Compu "" TAB_VERB "%6.3" "" COMPU_TAB_REF SY_HSPNWS_Compu /end COMPU_METHOD
/begin COMPU_VTAB SY_HSPNWS_Compu "" TAB_VERB 2 0 "False" 1 "True" /end COMPU_VTAB
/begin COMPU_METHOD SY_HSP_Compu "" TAB_VERB "%6.3" "" COMPU_TAB_REF SY_HSP_Compu /end COMPU_METHOD
/begin COMPU_VTAB SY_HSP_Compu "" TAB_VERB 2 0 "FALSE" 1 "TRUE" /end COMPU_VTAB
/begin COMPU_METHOD SY_IFOTMEN_Compu "" TAB_VERB "%6.3" "" COMPU_TAB_REF SY_IFOTMEN_Compu /end COMPU_METHOD
/begin COMPU_VTAB SY_IFOTMEN_Compu "" TAB_VERB 2 0 "SY_IFOTMEN = 0" 1 "SY_IFOTMEN = 1" /end COMPU_VTAB
/begin COMPU_METHOD SY_IFTCWRP_Compu "" TAB_VERB "%6.3" "" COMPU_TAB_REF SY_IFTCWRP_Compu /end COMPU_METHOD
/begin COMPU_VTAB SY_IFTCWRP_Compu "" TAB_VERB 2 0 "SY_IFTCWRP==0" 1 "SY_IFTCWRP>0" /end COMPU_VTAB
/begin COMPU_METHOD SY_IGIFLAG_Compu "" TAB_VERB "%6.3" "" COMPU_TAB_REF SY_IGIFLAG_Compu /end COMPU_METHOD
/begin COMPU_VTAB SY_IGIFLAG_Compu "" TAB_VERB 2 0 "False" 1 "True" /end COMPU_VTAB
/begin COMPU_METHOD SY_INHIBIT_Compu "" TAB_VERB "%6.3" "" COMPU_TAB_REF SY_INHIBIT_Compu /end COMPU_METHOD
/begin COMPU_VTAB SY_INHIBIT_Compu "" TAB_VERB 3 0 "Kein Inhibitor" 1 "Inhibitor zur Fehlerpfad-spezifischen Sperrung" 2 "Inhibitor zur Fehler-Typ-spezifischen Sperrung" /end COMPU_VTAB
/begin COMPU_METHOD SY_INI_OBD_Compu "" TAB_VERB "%6.3" "" COMPU_TAB_REF SY_INI_OBD_Compu /end COMPU_METHOD
/begin COMPU_VTAB SY_INI_OBD_Compu "" TAB_VERB 6 0 "ISO 14230-4 per WUP und ISO 9141-2 per 5Bd" 1 "ISO 14230-4 per 5Baud" 2 "ISO 9141-2 per 5Baud" 3 "ISO 14230-4 per WUP (fast Ini.)" 4 "kein CARB-Protokoll" 5 "ISO 15765-4 CAN" /end COMPU_VTAB
/begin COMPU_METHOD SY_INJADKM_Compu "" TAB_VERB "%6.3" "" COMPU_TAB_REF SY_INJADKM_Compu /end COMPU_METHOD
/begin COMPU_VTAB SY_INJADKM_Compu "" TAB_VERB 2 0 "False" 1 "True" /end COMPU_VTAB
/begin COMPU_METHOD SY_ISG_Compu "" TAB_VERB "%6.3" "" COMPU_TAB_REF SY_ISG_Compu /end COMPU_METHOD
/begin COMPU_VTAB SY_ISG_Compu "" TAB_VERB 2 0 "False" 1 "True" /end COMPU_VTAB
/begin COMPU_METHOD SY_IUMPR_Compu "" TAB_VERB "%6.3" "" COMPU_TAB_REF SY_IUMPR_Compu /end COMPU_METHOD
/begin COMPU_VTAB SY_IUMPR_Compu "" TAB_VERB 2 0 "keine Auswetung der IUMPR" 1 "Auswertung der IUMPR" /end COMPU_VTAB
/begin COMPU_METHOD SY_KDHFM_Compu "" TAB_VERB "%6.3" "" COMPU_TAB_REF SY_KDHFM_Compu /end COMPU_METHOD
/begin COMPU_VTAB SY_KDHFM_Compu "" TAB_VERB 2 0 "False" 1 "True" /end COMPU_VTAB
/begin COMPU_METHOD SY_KDS_Compu "" TAB_VERB "%6.3" "" COMPU_TAB_REF SY_KDS_Compu /end COMPU_METHOD
/begin COMPU_VTAB SY_KDS_Compu "" TAB_VERB 2 0 "False" 1 "True" /end COMPU_VTAB
/begin COMPU_METHOD SY_KFLRA_Compu "" TAB_VERB "%6.3" "" COMPU_TAB_REF SY_KFLRA_Compu /end COMPU_METHOD
/begin COMPU_VTAB SY_KFLRA_Compu "" TAB_VERB 2 0 "False" 1 "True" /end COMPU_VTAB
/begin COMPU_METHOD SY_KHETA_Compu "" TAB_VERB "%6.3" "" COMPU_TAB_REF SY_KHETA_Compu /end COMPU_METHOD
/begin COMPU_VTAB SY_KHETA_Compu "" TAB_VERB 2 0 "Momentenreserve" 1 "Wirkungsgrad" /end COMPU_VTAB
/begin COMPU_METHOD SY_KHTMSFH_Compu "" TAB_VERB "%6.3" "" COMPU_TAB_REF SY_KHTMSFH_Compu /end COMPU_METHOD
/begin COMPU_VTAB SY_KHTMSFH_Compu "" TAB_VERB 2 0 "KHTMSFH_LINE" 1 "KHTMSFH_MAP" /end COMPU_VTAB
/begin COMPU_METHOD SY_KJ_Compu "" TAB_VERB "%6.3" "" COMPU_TAB_REF SY_KJ_Compu /end COMPU_METHOD
/begin COMPU_VTAB SY_KJ_Compu "" TAB_VERB 2 0 "0" 1 "1" /end COMPU_VTAB
/begin COMPU_METHOD SY_KOLBSC_Compu "" RAT_FUNC "%6.2" "" COEFFS 0 1 0 0 0 1 /end COMPU_METHOD
/begin COMPU_METHOD temp_ub_q0p75_o48 "" RAT_FUNC "%6.2" "Grad C" COEFFS 0 1 48 0 0 0.75 /end COMPU_METHOD
/begin COMPU_METHOD zw_q0p05 "" RAT_FUNC "%6.4" "Grad KW" COEFFS 0 20 0 0 0 1 /end COMPU_METHOD
/begin COMPU_METHOD zw_q0p1 "" RAT_FUNC "%6.3" "Grad KW" COEFFS 0 10 0 0 0 1 /end COMPU_METHOD
/begin COMPU_METHOD zw_sb_q0p75 "" RAT_FUNC "%6.3" "Grad KW" COEFFS 0 255 0 0 0 191.25 /end COMPU_METHOD
/begin COMPU_METHOD default "" RAT_FUNC "%6.2" "" COEFFS 0 1 0 0 0 1 /end COMPU_METHOD
/*********** End of merged RECORD_LAYOUT blocks ***********/
/begin RECORD_LAYOUT Axis_Xs16 NO_AXIS_PTS_X 1 SWORD AXIS_PTS_X 2 SWORD INDEX_INCR DIRECT /end RECORD_LAYOUT
/begin RECORD_LAYOUT Axis_Xu16 NO_AXIS_PTS_X 1 UWORD AXIS_PTS_X 2 UWORD INDEX_INCR DIRECT /end RECORD_LAYOUT
/begin RECORD_LAYOUT Axis_Xu8 NO_AXIS_PTS_X 1 UBYTE AXIS_PTS_X 2 UBYTE INDEX_INCR DIRECT /end RECORD_LAYOUT
/begin RECORD_LAYOUT MapG_Ws16 FNC_VALUES 1 SWORD COLUMN_DIR DIRECT /end RECORD_LAYOUT
/begin RECORD_LAYOUT Map_Xs16Ys16Ws16 NO_AXIS_PTS_X 1 SWORD NO_AXIS_PTS_Y 2 SWORD AXIS_PTS_X 3 SWORD INDEX_INCR DIRECT AXIS_PTS_Y 4 SWORD INDEX_INCR DIRECT FNC_VALUES 5 SWORD COLUMN_DIR DIRECT /end RECORD_LAYOUT
/begin RECORD_LAYOUT Mo_DataCurveSstU16WU16 NO_AXIS_PTS_X 1 UWORD AXIS_PTS_X 2 UWORD INDEX_INCR DIRECT FNC_VALUES 3 UWORD COLUMN_DIR DIRECT /end RECORD_LAYOUT
/begin RECORD_LAYOUT ValA_Wu16 FNC_VALUES 1 UWORD COLUMN_DIR DIRECT /end RECORD_LAYOUT
/begin RECORD_LAYOUT ValA_Wu32 FNC_VALUES 1 ULONG COLUMN_DIR DIRECT /end RECORD_LAYOUT
/begin RECORD_LAYOUT ValA_Wu8 FNC_VALUES 1 UBYTE COLUMN_DIR DIRECT /end RECORD_LAYOUT
/begin RECORD_LAYOUT Val_Ws16 FNC_VALUES 1 SWORD COLUMN_DIR DIRECT /end RECORD_LAYOUT
/begin RECORD_LAYOUT Val_Wu16 FNC_VALUES 1 UWORD COLUMN_DIR DIRECT /end RECORD_LAYOUT
/begin RECORD_LAYOUT Val_Wu8 FNC_VALUES 1 UBYTE COLUMN_DIR DIRECT /end RECORD_LAYOUT
/end MODULE
/end PROJECT
