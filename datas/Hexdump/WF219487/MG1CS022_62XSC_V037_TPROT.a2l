ASAP2_VERSION 1 60
/begin PROJECT MG1CS022 "MG1CS022"
/begin HEADER "" VERSION "MG1CS022_62XSC_V037_TPROT" PROJECT_NO MG1CS022 /end HEADER
/begin MODULE DIM ""
/begin MOD_COMMON "" BYTE_ORDER MSB_LAST ALIGNMENT_BYTE 1 ALIGNMENT_WORD 2 ALIGNMENT_LONG 4 ALIGNMENT_INT64 4 ALIGNMENT_FLOAT32_IEEE 4 ALIGNMENT_FLOAT64_IEEE 4 DATA_SIZE 32 /end MOD_COMMON
/begin CHARACTERISTIC CWDSKVR "Codeword to disable high pressure sensor diagnosis" VALUE 0x8053A880 RB_Val_Wu8 255.0 dez 0.00 255.0 FORMAT "%5.1" /end CHARACTERISTIC
/begin CHARACTERISTIC CWDSKVR1 "Codeword for high pressure sensor diagnosis" VALUE 0x8053A881 RB_Val_Wu8 255.0 dez 0.00 255.0 FORMAT "%5.1" /end CHARACTERISTIC
/begin CHARACTERISTIC DDRC_DebArCtrBase.MyCtrBasedClass_2.isJmpDwnActv_C "Parameters of ArCtrBase debouncing /  / Jump at change from ""Failed"" to ""Passed"" debouncing" VALUE 0x8053A7EA RB_Val_Wu8 1.000 OneToOne 0.00 1.000 FORMAT "%5.3" EXTENDED_LIMITS 0.00 255.0 /end CHARACTERISTIC
/begin CHARACTERISTIC DDRC_DebArCtrBase.MyCtrBasedClass_2.isJmpUpActv_C "Parameters of ArCtrBase debouncing /  / Jump at change from ""Passed"" to ""Failed"" debouncing" VALUE 0x8053A7EB RB_Val_Wu8 1.000 OneToOne 0.00 1.000 FORMAT "%5.3" EXTENDED_LIMITS 0.00 255.0 /end CHARACTERISTIC
/begin CHARACTERISTIC DDRC_DebArCtrBase.MyCtrBasedClass_2.limPassd_C "Parameters of ArCtrBase debouncing /  / ""Passed"" limit" VALUE 0x8053A7EC RB_Val_Ws16 32767.00 OneToOne -32768.00 -1.00 FORMAT "%8.2" EXTENDED_LIMITS -32768.00 32767.00 /end CHARACTERISTIC
/begin CHARACTERISTIC DDRC_DebArCtrBase.MyCtrBasedClass_2.limFaild_C "Parameters of ArCtrBase debouncing /  / ""Failed"" limit" VALUE 0x8053A7EE RB_Val_Ws16 32766.00 OneToOne 1.00 32767.00 FORMAT "%8.2" EXTENDED_LIMITS -32768.00 32767.00 /end CHARACTERISTIC
/begin CHARACTERISTIC DDRC_DebArCtrBase.MyCtrBasedClass_2.jmpUpVal_C "Parameters of ArCtrBase debouncing /  / Jumppoint direction ""Failed""" VALUE 0x8053A7F0 RB_Val_Ws16 65535.00 OneToOne -32768.00 32767.00 FORMAT "%8.2" /end CHARACTERISTIC
/begin CHARACTERISTIC DDRC_DebArCtrBase.MyCtrBasedClass_2.jmpDwnVal_C "Parameters of ArCtrBase debouncing /  / Jumppoint direction ""Passed""" VALUE 0x8053A7F2 RB_Val_Ws16 65535.00 OneToOne -32768.00 32767.00 FORMAT "%8.2" /end CHARACTERISTIC
/begin CHARACTERISTIC DDRC_DebArCtrBase.MyCtrBasedClass_2.stepUp_C "Parameters of ArCtrBase debouncing /  / Stepsize of ""Failed"" direction" VALUE 0x8053A7F4 RB_Val_Ws16 32766.00 OneToOne 1.00 32767.00 FORMAT "%8.2" EXTENDED_LIMITS -32768.00 32767.00 /end CHARACTERISTIC
/begin CHARACTERISTIC DDRC_DebArCtrBase.MyCtrBasedClass_2.stepDwn_C "Parameters of ArCtrBase debouncing /  / Stepsize of ""Passed"" direction" VALUE 0x8053A7F6 RB_Val_Ws16 32767.00 OneToOne -32768.00 -1.00 FORMAT "%8.2" EXTENDED_LIMITS -32768.00 32767.00 /end CHARACTERISTIC
/begin CHARACTERISTIC DDRC_DebArCtrBase.MyCtrBasedClass_1.isJmpDwnActv_C "Parameters of ArCtrBase debouncing /  / Jump at change from ""Failed"" to ""Passed"" debouncing" VALUE 0x8053A7F8 RB_Val_Wu8 1.000 OneToOne 0.00 1.000 FORMAT "%5.3" EXTENDED_LIMITS 0.00 255.0 /end CHARACTERISTIC
/begin CHARACTERISTIC DDRC_DebArCtrBase.MyCtrBasedClass_1.isJmpUpActv_C "Parameters of ArCtrBase debouncing /  / Jump at change from ""Passed"" to ""Failed"" debouncing" VALUE 0x8053A7F9 RB_Val_Wu8 1.000 OneToOne 0.00 1.000 FORMAT "%5.3" EXTENDED_LIMITS 0.00 255.0 /end CHARACTERISTIC
/begin CHARACTERISTIC DDRC_DebArCtrBase.MyCtrBasedClass_1.limPassd_C "Parameters of ArCtrBase debouncing /  / ""Passed"" limit" VALUE 0x8053A7FA RB_Val_Ws16 32767.00 OneToOne -32768.00 -1.00 FORMAT "%8.2" EXTENDED_LIMITS -32768.00 32767.00 /end CHARACTERISTIC
/begin CHARACTERISTIC DDRC_DebArCtrBase.MyCtrBasedClass_1.limFaild_C "Parameters of ArCtrBase debouncing /  / ""Failed"" limit" VALUE 0x8053A7FC RB_Val_Ws16 32766.00 OneToOne 1.00 32767.00 FORMAT "%8.2" EXTENDED_LIMITS -32768.00 32767.00 /end CHARACTERISTIC
/begin CHARACTERISTIC DDRC_DebArCtrBase.MyCtrBasedClass_1.jmpUpVal_C "Parameters of ArCtrBase debouncing /  / Jumppoint direction ""Failed""" VALUE 0x8053A7FE RB_Val_Ws16 65535.00 OneToOne -32768.00 32767.00 FORMAT "%8.2" /end CHARACTERISTIC
/begin CHARACTERISTIC DDRC_DebArCtrBase.MyCtrBasedClass_1.jmpDwnVal_C "Parameters of ArCtrBase debouncing /  / Jumppoint direction ""Passed""" VALUE 0x8053A800 RB_Val_Ws16 65535.00 OneToOne -32768.00 32767.00 FORMAT "%8.2" /end CHARACTERISTIC
/begin CHARACTERISTIC DDRC_DebArCtrBase.MyCtrBasedClass_1.stepUp_C "Parameters of ArCtrBase debouncing /  / Stepsize of ""Failed"" direction" VALUE 0x8053A802 RB_Val_Ws16 32766.00 OneToOne 1.00 32767.00 FORMAT "%8.2" EXTENDED_LIMITS -32768.00 32767.00 /end CHARACTERISTIC
/begin CHARACTERISTIC DDRC_DebArCtrBase.MyCtrBasedClass_1.stepDwn_C "Parameters of ArCtrBase debouncing /  / Stepsize of ""Passed"" direction" VALUE 0x8053A804 RB_Val_Ws16 32767.00 OneToOne -32768.00 -1.00 FORMAT "%8.2" EXTENDED_LIMITS -32768.00 32767.00 /end CHARACTERISTIC
/begin CHARACTERISTIC DDRC_DebArCtrBase.DemDebounceCounterBasedClass_standard.isJmpDwnActv_C "Parameters of ArCtrBase debouncing /  / Jump at change from ""Failed"" to ""Passed"" debouncing" VALUE 0x8053A806 RB_Val_Wu8 1.000 OneToOne 0.00 1.000 FORMAT "%5.3" EXTENDED_LIMITS 0.00 255.0 /end CHARACTERISTIC
/begin CHARACTERISTIC DDRC_DebArCtrBase.DemDebounceCounterBasedClass_standard.isJmpUpActv_C "Parameters of ArCtrBase debouncing /  / Jump at change from ""Passed"" to ""Failed"" debouncing" VALUE 0x8053A807 RB_Val_Wu8 1.000 OneToOne 0.00 1.000 FORMAT "%5.3" EXTENDED_LIMITS 0.00 255.0 /end CHARACTERISTIC
/begin CHARACTERISTIC DDRC_DebArCtrBase.DemDebounceCounterBasedClass_standard.limPassd_C "Parameters of ArCtrBase debouncing /  / ""Passed"" limit" VALUE 0x8053A808 RB_Val_Ws16 32767.00 OneToOne -32768.00 -1.00 FORMAT "%8.2" EXTENDED_LIMITS -32768.00 32767.00 /end CHARACTERISTIC
/begin CHARACTERISTIC DDRC_DebArCtrBase.DemDebounceCounterBasedClass_standard.limFaild_C "Parameters of ArCtrBase debouncing /  / ""Failed"" limit" VALUE 0x8053A80A RB_Val_Ws16 32766.00 OneToOne 1.00 32767.00 FORMAT "%8.2" EXTENDED_LIMITS -32768.00 32767.00 /end CHARACTERISTIC
/begin CHARACTERISTIC DDRC_DebArCtrBase.DemDebounceCounterBasedClass_standard.jmpUpVal_C "Parameters of ArCtrBase debouncing /  / Jumppoint direction ""Failed""" VALUE 0x8053A80C RB_Val_Ws16 65535.00 OneToOne -32768.00 32767.00 FORMAT "%8.2" /end CHARACTERISTIC
/begin CHARACTERISTIC DDRC_DebArCtrBase.DemDebounceCounterBasedClass_standard.jmpDwnVal_C "Parameters of ArCtrBase debouncing /  / Jumppoint direction ""Passed""" VALUE 0x8053A80E RB_Val_Ws16 65535.00 OneToOne -32768.00 32767.00 FORMAT "%8.2" /end CHARACTERISTIC
/begin CHARACTERISTIC DDRC_DebArCtrBase.DemDebounceCounterBasedClass_standard.stepUp_C "Parameters of ArCtrBase debouncing /  / Stepsize of ""Failed"" direction" VALUE 0x8053A810 RB_Val_Ws16 32766.00 OneToOne 1.00 32767.00 FORMAT "%8.2" EXTENDED_LIMITS -32768.00 32767.00 /end CHARACTERISTIC
/begin CHARACTERISTIC DDRC_DebArCtrBase.DemDebounceCounterBasedClass_standard.stepDwn_C "Parameters of ArCtrBase debouncing /  / Stepsize of ""Passed"" direction" VALUE 0x8053A812 RB_Val_Ws16 32767.00 OneToOne -32768.00 -1.00 FORMAT "%8.2" EXTENDED_LIMITS -32768.00 32767.00 /end CHARACTERISTIC
/begin CHARACTERISTIC DDRC_DebArTime.DFC_BusDiagCANAPPLBusOff.tiLimFaild_C "Parameters of ArTime debouncing /  / ""Failed"" limit" VALUE 0x8053A814 RB_Val_Ws16 327660.0 DDRCTime_ms 10.0 327670.0 FORMAT "%8.1" EXTENDED_LIMITS -327680.0 327670.0 /end CHARACTERISTIC
/begin CHARACTERISTIC DDRC_DebArTime.DFC_BusDiagCANAPPLBusOff.tiLimPassd_C "Parameters of ArTime debouncing /  / ""Passed"" limit" VALUE 0x8053A816 RB_Val_Ws16 327670.0 DDRCTime_ms -327680.0 -10.0 FORMAT "%8.1" EXTENDED_LIMITS -327680.0 327670.0 /end CHARACTERISTIC
/begin CHARACTERISTIC DDRC_DebArTime.DFC_BusDiagCANCANCBusOff.tiLimFaild_C "Parameters of ArTime debouncing /  / ""Failed"" limit" VALUE 0x8053A81A RB_Val_Ws16 327660.0 DDRCTime_ms 10.0 327670.0 FORMAT "%8.1" EXTENDED_LIMITS -327680.0 327670.0 /end CHARACTERISTIC
/begin CHARACTERISTIC DDRC_DebArTime.DFC_BusDiagCANCANCBusOff.tiLimPassd_C "Parameters of ArTime debouncing /  / ""Passed"" limit" VALUE 0x8053A81C RB_Val_Ws16 327670.0 DDRCTime_ms -327680.0 -10.0 FORMAT "%8.1" EXTENDED_LIMITS -327680.0 327670.0 /end CHARACTERISTIC
/begin CHARACTERISTIC DDRC_DebArTime.DFC_BusDiagCANVEHICLEBusOff.tiLimFaild_C "Parameters of ArTime debouncing /  / ""Failed"" limit" VALUE 0x8053A820 RB_Val_Ws16 327660.0 DDRCTime_ms 10.0 327670.0 FORMAT "%8.1" EXTENDED_LIMITS -327680.0 327670.0 /end CHARACTERISTIC
/begin CHARACTERISTIC DDRC_DebArTime.DFC_BusDiagCANVEHICLEBusOff.tiLimPassd_C "Parameters of ArTime debouncing /  / ""Passed"" limit" VALUE 0x8053A822 RB_Val_Ws16 327670.0 DDRCTime_ms -327680.0 -10.0 FORMAT "%8.1" EXTENDED_LIMITS -327680.0 327670.0 /end CHARACTERISTIC
/begin CHARACTERISTIC DDRC_DebArTime.DFC_RBA_IODIAGPWR_rba_IoExtCy329_SignalVltSply_0.tiLimFaild_C "Parameters of ArTime debouncing /  / ""Failed"" limit" VALUE 0x8053A826 RB_Val_Ws16 327660.0 DDRCTime_ms 10.0 327670.0 FORMAT "%8.1" EXTENDED_LIMITS -327680.0 327670.0 /end CHARACTERISTIC
/begin CHARACTERISTIC DDRC_DebArTime.DFC_RBA_IODIAGPWR_rba_IoExtCy329_SignalVltSply_0.tiLimPassd_C "Parameters of ArTime debouncing /  / ""Passed"" limit" VALUE 0x8053A828 RB_Val_Ws16 327670.0 DDRCTime_ms -327680.0 -10.0 FORMAT "%8.1" EXTENDED_LIMITS -327680.0 327670.0 /end CHARACTERISTIC
/begin CHARACTERISTIC DDRC_DebArTime.DFC_RBA_IODIAGPWR_rba_IoExtCy329_SignalVltSply_0OT.tiLimFaild_C "Parameters of ArTime debouncing /  / ""Failed"" limit" VALUE 0x8053A82C RB_Val_Ws16 327660.0 DDRCTime_ms 10.0 327670.0 FORMAT "%8.1" EXTENDED_LIMITS -327680.0 327670.0 /end CHARACTERISTIC
/begin CHARACTERISTIC DDRC_DebArTime.DFC_RBA_IODIAGPWR_rba_IoExtCy329_SignalVltSply_0OT.tiLimPassd_C "Parameters of ArTime debouncing /  / ""Passed"" limit" VALUE 0x8053A82E RB_Val_Ws16 327670.0 DDRCTime_ms -327680.0 -10.0 FORMAT "%8.1" EXTENDED_LIMITS -327680.0 327670.0 /end CHARACTERISTIC
/begin CHARACTERISTIC DDRC_DebArTime.DFC_RBA_IODIAGPWR_rba_IoExtCy329_SignalVltSply_0OV.tiLimFaild_C "Parameters of ArTime debouncing /  / ""Failed"" limit" VALUE 0x8053A832 RB_Val_Ws16 327660.0 DDRCTime_ms 10.0 327670.0 FORMAT "%8.1" EXTENDED_LIMITS -327680.0 327670.0 /end CHARACTERISTIC
/begin CHARACTERISTIC DDRC_DebArTime.DFC_RBA_IODIAGPWR_rba_IoExtCy329_SignalVltSply_0OV.tiLimPassd_C "Parameters of ArTime debouncing /  / ""Passed"" limit" VALUE 0x8053A834 RB_Val_Ws16 327670.0 DDRCTime_ms -327680.0 -10.0 FORMAT "%8.1" EXTENDED_LIMITS -327680.0 327670.0 /end CHARACTERISTIC
/begin CHARACTERISTIC DDRC_DebArTime.DFC_RBA_IODIAGPWR_rba_IoExtCy329_SignalVltSply_0SCG.tiLimFaild_C "Parameters of ArTime debouncing /  / ""Failed"" limit" VALUE 0x8053A838 RB_Val_Ws16 327660.0 DDRCTime_ms 10.0 327670.0 FORMAT "%8.1" EXTENDED_LIMITS -327680.0 327670.0 /end CHARACTERISTIC
/begin CHARACTERISTIC DDRC_DebArTime.DFC_RBA_IODIAGPWR_rba_IoExtCy329_SignalVltSply_0SCG.tiLimPassd_C "Parameters of ArTime debouncing /  / ""Passed"" limit" VALUE 0x8053A83A RB_Val_Ws16 327670.0 DDRCTime_ms -327680.0 -10.0 FORMAT "%8.1" EXTENDED_LIMITS -327680.0 327670.0 /end CHARACTERISTIC
/begin CHARACTERISTIC DDRC_DebArTime.DFC_RBA_IODIAGPWR_rba_IoExtCy329_SignalVltSply_0UV.tiLimFaild_C "Parameters of ArTime debouncing /  / ""Failed"" limit" VALUE 0x8053A83E RB_Val_Ws16 327660.0 DDRCTime_ms 10.0 327670.0 FORMAT "%8.1" EXTENDED_LIMITS -327680.0 327670.0 /end CHARACTERISTIC
/begin CHARACTERISTIC DDRC_DebArTime.DFC_RBA_IODIAGPWR_rba_IoExtCy329_SignalVltSply_0UV.tiLimPassd_C "Parameters of ArTime debouncing /  / ""Passed"" limit" VALUE 0x8053A840 RB_Val_Ws16 327670.0 DDRCTime_ms -327680.0 -10.0 FORMAT "%8.1" EXTENDED_LIMITS -327680.0 327670.0 /end CHARACTERISTIC
/begin CHARACTERISTIC DDRC_DebArTime.DFC_RBA_IODIAGPWR_rba_IoExtCy329_SignalVltSply_1.tiLimFaild_C "Parameters of ArTime debouncing /  / ""Failed"" limit" VALUE 0x8053A844 RB_Val_Ws16 327660.0 DDRCTime_ms 10.0 327670.0 FORMAT "%8.1" EXTENDED_LIMITS -327680.0 327670.0 /end CHARACTERISTIC
/begin CHARACTERISTIC DDRC_DebArTime.DFC_RBA_IODIAGPWR_rba_IoExtCy329_SignalVltSply_1.tiLimPassd_C "Parameters of ArTime debouncing /  / ""Passed"" limit" VALUE 0x8053A846 RB_Val_Ws16 327670.0 DDRCTime_ms -327680.0 -10.0 FORMAT "%8.1" EXTENDED_LIMITS -327680.0 327670.0 /end CHARACTERISTIC
/begin CHARACTERISTIC DDRC_DebArTime.DFC_RBA_IODIAGPWR_rba_IoExtCy329_SignalVltSply_1OT.tiLimFaild_C "Parameters of ArTime debouncing /  / ""Failed"" limit" VALUE 0x8053A84A RB_Val_Ws16 327660.0 DDRCTime_ms 10.0 327670.0 FORMAT "%8.1" EXTENDED_LIMITS -327680.0 327670.0 /end CHARACTERISTIC
/begin CHARACTERISTIC DDRC_DebArTime.DFC_RBA_IODIAGPWR_rba_IoExtCy329_SignalVltSply_1OT.tiLimPassd_C "Parameters of ArTime debouncing /  / ""Passed"" limit" VALUE 0x8053A84C RB_Val_Ws16 327670.0 DDRCTime_ms -327680.0 -10.0 FORMAT "%8.1" EXTENDED_LIMITS -327680.0 327670.0 /end CHARACTERISTIC
/begin CHARACTERISTIC DDRC_DebArTime.DFC_RBA_IODIAGPWR_rba_IoExtCy329_SignalVltSply_1OV.tiLimFaild_C "Parameters of ArTime debouncing /  / ""Failed"" limit" VALUE 0x8053A850 RB_Val_Ws16 327660.0 DDRCTime_ms 10.0 327670.0 FORMAT "%8.1" EXTENDED_LIMITS -327680.0 327670.0 /end CHARACTERISTIC
/begin CHARACTERISTIC DDRC_DebArTime.DFC_RBA_IODIAGPWR_rba_IoExtCy329_SignalVltSply_1OV.tiLimPassd_C "Parameters of ArTime debouncing /  / ""Passed"" limit" VALUE 0x8053A852 RB_Val_Ws16 327670.0 DDRCTime_ms -327680.0 -10.0 FORMAT "%8.1" EXTENDED_LIMITS -327680.0 327670.0 /end CHARACTERISTIC
/begin CHARACTERISTIC DDRC_DebArTime.DFC_RBA_IODIAGPWR_rba_IoExtCy329_SignalVltSply_1SCG.tiLimFaild_C "Parameters of ArTime debouncing /  / ""Failed"" limit" VALUE 0x8053A856 RB_Val_Ws16 327660.0 DDRCTime_ms 10.0 327670.0 FORMAT "%8.1" EXTENDED_LIMITS -327680.0 327670.0 /end CHARACTERISTIC
/begin CHARACTERISTIC DDRC_DebArTime.DFC_RBA_IODIAGPWR_rba_IoExtCy329_SignalVltSply_1SCG.tiLimPassd_C "Parameters of ArTime debouncing /  / ""Passed"" limit" VALUE 0x8053A858 RB_Val_Ws16 327670.0 DDRCTime_ms -327680.0 -10.0 FORMAT "%8.1" EXTENDED_LIMITS -327680.0 327670.0 /end CHARACTERISTIC
/begin CHARACTERISTIC DDRC_DebArTime.DFC_RBA_IODIAGPWR_rba_IoExtCy329_SignalVltSply_1UV.tiLimFaild_C "Parameters of ArTime debouncing /  / ""Failed"" limit" VALUE 0x8053A85C RB_Val_Ws16 327660.0 DDRCTime_ms 10.0 327670.0 FORMAT "%8.1" EXTENDED_LIMITS -327680.0 327670.0 /end CHARACTERISTIC
/begin CHARACTERISTIC DDRC_DebArTime.DFC_RBA_IODIAGPWR_rba_IoExtCy329_SignalVltSply_1UV.tiLimPassd_C "Parameters of ArTime debouncing /  / ""Passed"" limit" VALUE 0x8053A85E RB_Val_Ws16 327670.0 DDRCTime_ms -327680.0 -10.0 FORMAT "%8.1" EXTENDED_LIMITS -327680.0 327670.0 /end CHARACTERISTIC
/begin CHARACTERISTIC DDRC_DebArTime.DFC_RBA_IODIAGPWR_rba_IoExtCy329_SignalVltSply_2.tiLimFaild_C "Parameters of ArTime debouncing /  / ""Failed"" limit" VALUE 0x8053A862 RB_Val_Ws16 327660.0 DDRCTime_ms 10.0 327670.0 FORMAT "%8.1" EXTENDED_LIMITS -327680.0 327670.0 /end CHARACTERISTIC
/begin CHARACTERISTIC DDRC_DebArTime.DFC_RBA_IODIAGPWR_rba_IoExtCy329_SignalVltSply_2.tiLimPassd_C "Parameters of ArTime debouncing /  / ""Passed"" limit" VALUE 0x8053A864 RB_Val_Ws16 327670.0 DDRCTime_ms -327680.0 -10.0 FORMAT "%8.1" EXTENDED_LIMITS -327680.0 327670.0 /end CHARACTERISTIC
/begin CHARACTERISTIC DDRC_DebArTime.DFC_RBA_IODIAGPWR_rba_IoExtCy329_SignalVltSply_2OT.tiLimFaild_C "Parameters of ArTime debouncing /  / ""Failed"" limit" VALUE 0x8053A868 RB_Val_Ws16 327660.0 DDRCTime_ms 10.0 327670.0 FORMAT "%8.1" EXTENDED_LIMITS -327680.0 327670.0 /end CHARACTERISTIC
/begin CHARACTERISTIC DDRC_DebArTime.DFC_RBA_IODIAGPWR_rba_IoExtCy329_SignalVltSply_2OT.tiLimPassd_C "Parameters of ArTime debouncing /  / ""Passed"" limit" VALUE 0x8053A86A RB_Val_Ws16 327670.0 DDRCTime_ms -327680.0 -10.0 FORMAT "%8.1" EXTENDED_LIMITS -327680.0 327670.0 /end CHARACTERISTIC
/begin CHARACTERISTIC DDRC_DebArTime.DFC_RBA_IODIAGPWR_rba_IoExtCy329_SignalVltSply_2OV.tiLimFaild_C "Parameters of ArTime debouncing /  / ""Failed"" limit" VALUE 0x8053A86E RB_Val_Ws16 327660.0 DDRCTime_ms 10.0 327670.0 FORMAT "%8.1" EXTENDED_LIMITS -327680.0 327670.0 /end CHARACTERISTIC
/begin CHARACTERISTIC DDRC_DebArTime.DFC_RBA_IODIAGPWR_rba_IoExtCy329_SignalVltSply_2OV.tiLimPassd_C "Parameters of ArTime debouncing /  / ""Passed"" limit" VALUE 0x8053A870 RB_Val_Ws16 327670.0 DDRCTime_ms -327680.0 -10.0 FORMAT "%8.1" EXTENDED_LIMITS -327680.0 327670.0 /end CHARACTERISTIC
/begin CHARACTERISTIC DDRC_DebArTime.DFC_RBA_IODIAGPWR_rba_IoExtCy329_SignalVltSply_2SCG.tiLimFaild_C "Parameters of ArTime debouncing /  / ""Failed"" limit" VALUE 0x8053A874 RB_Val_Ws16 327660.0 DDRCTime_ms 10.0 327670.0 FORMAT "%8.1" EXTENDED_LIMITS -327680.0 327670.0 /end CHARACTERISTIC
/begin CHARACTERISTIC DDRC_DebArTime.DFC_RBA_IODIAGPWR_rba_IoExtCy329_SignalVltSply_2SCG.tiLimPassd_C "Parameters of ArTime debouncing /  / ""Passed"" limit" VALUE 0x8053A876 RB_Val_Ws16 327670.0 DDRCTime_ms -327680.0 -10.0 FORMAT "%8.1" EXTENDED_LIMITS -327680.0 327670.0 /end CHARACTERISTIC
/begin CHARACTERISTIC DDRC_DebArTime.DFC_RBA_IODIAGPWR_rba_IoExtCy329_SignalVltSply_2UV.tiLimFaild_C "Parameters of ArTime debouncing /  / ""Failed"" limit" VALUE 0x8053A87A RB_Val_Ws16 327660.0 DDRCTime_ms 10.0 327670.0 FORMAT "%8.1" EXTENDED_LIMITS -327680.0 327670.0 /end CHARACTERISTIC
/begin CHARACTERISTIC DDRC_DebArTime.DFC_RBA_IODIAGPWR_rba_IoExtCy329_SignalVltSply_2UV.tiLimPassd_C "Parameters of ArTime debouncing /  / ""Passed"" limit" VALUE 0x8053A87C RB_Val_Ws16 327670.0 DDRCTime_ms -327680.0 -10.0 FORMAT "%8.1" EXTENDED_LIMITS -327680.0 327670.0 /end CHARACTERISTIC
/begin CHARACTERISTIC DDRC_RatDeb.Com_tiCntTCU12UDRat_C "Ratioof up-down debouncing / Defect / Heal Ratio for check DFC_ComCntTCU12" VALUE 0x804F57A8 Val_Wu8 3.00000000000 DDRC_Ratio 1.00000000000 4.00000000000 FORMAT "%13.11" /end CHARACTERISTIC
/begin CHARACTERISTIC DDRC_RatDeb.Com_tiCntTCU13UDRat_C "Ratioof up-down debouncing / Defect / Heal Ratio for check DFC_ComCntTCU13" VALUE 0x804F57A9 Val_Wu8 3.00000000000 DDRC_Ratio 1.00000000000 4.00000000000 FORMAT "%13.11" /end CHARACTERISTIC
/begin CHARACTERISTIC DDRC_RatDeb.Com_tiCntTCU2UDRat_C "Ratioof up-down debouncing / Defect / Heal Ratio for check DFC_ComCntTCU2" VALUE 0x804F57AA Val_Wu8 3.00000000000 DDRC_Ratio 1.00000000000 4.00000000000 FORMAT "%13.11" /end CHARACTERISTIC
/begin CHARACTERISTIC DDRC_RatDeb.Com_tiCntTCU3UDRat_C "Ratioof up-down debouncing / Defect / Heal Ratio for check DFC_ComCntTCU3" VALUE 0x804F57AB Val_Wu8 3.00000000000 DDRC_Ratio 1.00000000000 4.00000000000 FORMAT "%13.11" /end CHARACTERISTIC
/begin CHARACTERISTIC DDRC_RatDeb.Com_tiCntTCU4UDRat_C "Ratioof up-down debouncing / Defect / Heal Ratio for check DFC_ComCntTCU4" VALUE 0x804F57AC Val_Wu8 3.00000000000 DDRC_Ratio 1.00000000000 4.00000000000 FORMAT "%13.11" /end CHARACTERISTIC
/begin CHARACTERISTIC DDRC_RatDeb.Com_tiTOutTCU01UDRat_C "Ratioof up-down debouncing / Defect / Heal Ratio for check DFC_ComTOutTCU01" VALUE 0x804F57AD Val_Wu8 3.00000000000 DDRC_Ratio 1.00000000000 4.00000000000 FORMAT "%13.11" /end CHARACTERISTIC
/begin CHARACTERISTIC DDRC_RatDeb.Com_tiTOutTCU02UDRat_C "Ratioof up-down debouncing / Defect / Heal Ratio for check DFC_ComTOutTCU02" VALUE 0x804F57AE Val_Wu8 3.00000000000 DDRC_Ratio 1.00000000000 4.00000000000 FORMAT "%13.11" /end CHARACTERISTIC
/begin CHARACTERISTIC DDRC_RatDeb.Com_tiTOutTCU1UDRat_C "Ratioof up-down debouncing / Defect / Heal Ratio for check DFC_ComTOutTCU1" VALUE 0x804F57AF Val_Wu8 3.00000000000 DDRC_Ratio 1.00000000000 4.00000000000 FORMAT "%13.11" /end CHARACTERISTIC
/begin CHARACTERISTIC DDRC_RatDeb.Com_tiTOutTCU11UDRat_C "Ratioof up-down debouncing / Defect / Heal Ratio for check DFC_ComTOutTCU11" VALUE 0x804F57B0 Val_Wu8 3.00000000000 DDRC_Ratio 1.00000000000 4.00000000000 FORMAT "%13.11" /end CHARACTERISTIC
/begin CHARACTERISTIC DDRC_RatDeb.Com_tiTOutTCU12UDRat_C "Ratioof up-down debouncing / Defect / Heal Ratio for check DFC_ComTOutTCU12" VALUE 0x804F57B1 Val_Wu8 3.00000000000 DDRC_Ratio 1.00000000000 4.00000000000 FORMAT "%13.11" /end CHARACTERISTIC
/begin CHARACTERISTIC DDRC_RatDeb.Com_tiTOutTCU13UDRat_C "Ratioof up-down debouncing / Defect / Heal Ratio for check DFC_ComTOutTCU13" VALUE 0x804F57B2 Val_Wu8 3.00000000000 DDRC_Ratio 1.00000000000 4.00000000000 FORMAT "%13.11" /end CHARACTERISTIC
/begin CHARACTERISTIC DDRC_RatDeb.Com_tiTOutTCU14UDRat_C "Ratioof up-down debouncing / Defect / Heal Ratio for check DFC_ComTOutTCU14" VALUE 0x804F57B3 Val_Wu8 3.00000000000 DDRC_Ratio 1.00000000000 4.00000000000 FORMAT "%13.11" /end CHARACTERISTIC
/begin CHARACTERISTIC DDRC_RatDeb.Com_tiTOutTCU2UDRat_C "Ratioof up-down debouncing / Defect / Heal Ratio for check DFC_ComTOutTCU2" VALUE 0x804F57B4 Val_Wu8 3.00000000000 DDRC_Ratio 1.00000000000 4.00000000000 FORMAT "%13.11" /end CHARACTERISTIC
/begin CHARACTERISTIC DDRC_RatDeb.Com_tiTOutTCU3UDRat_C "Ratioof up-down debouncing / Defect / Heal Ratio for check DFC_ComTOutTCU3" VALUE 0x804F57B5 Val_Wu8 3.00000000000 DDRC_Ratio 1.00000000000 4.00000000000 FORMAT "%13.11" /end CHARACTERISTIC
/begin CHARACTERISTIC DDRC_RatDeb.Com_tiTOutTCU4UDRat_C "Ratioof up-down debouncing / Defect / Heal Ratio for check DFC_ComTOutTCU4" VALUE 0x804F57B6 Val_Wu8 3.00000000000 DDRC_Ratio 1.00000000000 4.00000000000 FORMAT "%13.11" /end CHARACTERISTIC
/begin CHARACTERISTIC DDRC_RatDeb.DevLib_tiBattUHiUDRat_C "Ratioof up-down debouncing / Defect / Heal Ratio for check DFC_DevLibBattUHi" VALUE 0x804F57B7 Val_Wu8 3.00000000000 DDRC_Ratio 1.00000000000 4.00000000000 FORMAT "%13.11" /end CHARACTERISTIC
/begin CHARACTERISTIC DDRC_RatDeb.DevLib_tiBattULoUDRat_C "Ratioof up-down debouncing / Defect / Heal Ratio for check DFC_DevLibBattULo" VALUE 0x804F57B8 Val_Wu8 3.00000000000 DDRC_Ratio 1.00000000000 4.00000000000 FORMAT "%13.11" /end CHARACTERISTIC
/begin CHARACTERISTIC DDRC_RatDeb.EGRVlv_tiFailSafeActvUDRat_C "Ratioof up-down debouncing / Defect / Heal Ratio for check DFC_EGRVlvFailSafeActv" VALUE 0x804F57B9 Val_Wu8 3.00000000000 DDRC_Ratio 1.00000000000 4.00000000000 FORMAT "%13.11" /end CHARACTERISTIC
/begin CHARACTERISTIC DDRC_RatDeb.EGRVlv_tiGovDvtCldUDRat_C "Ratioof up-down debouncing / Defect / Heal Ratio for check DFC_EGRVlvGovDvtCld" VALUE 0x804F57BA Val_Wu8 3.00000000000 DDRC_Ratio 1.00000000000 4.00000000000 FORMAT "%13.11" /end CHARACTERISTIC
/begin CHARACTERISTIC DDRC_RatDeb.EGRVlv_tiPhysSRCMaxUDRat_C "Ratioof up-down debouncing / Defect / Heal Ratio for check DFC_EGRVlvPhysSRCMax" VALUE 0x804F57BB Val_Wu8 3.00000000000 DDRC_Ratio 1.00000000000 4.00000000000 FORMAT "%13.11" /end CHARACTERISTIC
/begin CHARACTERISTIC DDRC_RatDeb.EGRVlv_tiPhysSRCMinUDRat_C "Ratioof up-down debouncing / Defect / Heal Ratio for check DFC_EGRVlvPhysSRCMin" VALUE 0x804F57BC Val_Wu8 3.00000000000 DDRC_Ratio 1.00000000000 4.00000000000 FORMAT "%13.11" /end CHARACTERISTIC
/begin CHARACTERISTIC DDRC_RatDeb.Fan_tiDIOOLUDRat_C "Ratioof up-down debouncing / Defect / Heal Ratio for check DFC_FanDIOOL" VALUE 0x804F57BD Val_Wu8 3.00000000000 DDRC_Ratio 1.00000000000 4.00000000000 FORMAT "%13.11" /end CHARACTERISTIC
/begin CHARACTERISTIC DDRC_RatDeb.Fan_tiDIOOvrTempUDRat_C "Ratioof up-down debouncing / Defect / Heal Ratio for check DFC_FanDIOOvrTemp" VALUE 0x804F57BE Val_Wu8 3.00000000000 DDRC_Ratio 1.00000000000 4.00000000000 FORMAT "%13.11" /end CHARACTERISTIC
/begin CHARACTERISTIC DDRC_RatDeb.Fan_tiDIOSCBUDRat_C "Ratioof up-down debouncing / Defect / Heal Ratio for check DFC_FanDIOSCB" VALUE 0x804F57BF Val_Wu8 3.00000000000 DDRC_Ratio 1.00000000000 4.00000000000 FORMAT "%13.11" /end CHARACTERISTIC
/begin CHARACTERISTIC DDRC_RatDeb.Fan_tiDIOSCGUDRat_C "Ratioof up-down debouncing / Defect / Heal Ratio for check DFC_FanDIOSCG" VALUE 0x804F57C0 Val_Wu8 3.00000000000 DDRC_Ratio 1.00000000000 4.00000000000 FORMAT "%13.11" /end CHARACTERISTIC
/begin CHARACTERISTIC DDRC_RatDeb.MRlyDcOL_tisigOLUDRat_C "Ratioof up-down debouncing / Defect / Heal Ratio for check DFC_MRlyDcOL" VALUE 0x804F57C1 Val_Wu8 3.00000000000 DDRC_Ratio 1.00000000000 4.00000000000 FORMAT "%13.11" /end CHARACTERISTIC
/begin CHARACTERISTIC DDRC_RatDeb.MRlyDcSCB_tisigSCBUDRat_C "Ratioof up-down debouncing / Defect / Heal Ratio for check DFC_MRlyDcSCB" VALUE 0x804F57C2 Val_Wu8 3.00000000000 DDRC_Ratio 1.00000000000 4.00000000000 FORMAT "%13.11" /end CHARACTERISTIC
/begin CHARACTERISTIC DDRC_RatDeb.MRlyDcSCG_tisigSCGUDRat_C "Ratioof up-down debouncing / Defect / Heal Ratio for check DFC_MRlyDcSCG" VALUE 0x804F57C3 Val_Wu8 3.00000000000 DDRC_Ratio 1.00000000000 4.00000000000 FORMAT "%13.11" /end CHARACTERISTIC
/begin CHARACTERISTIC DDRC_RatDeb.PSP_tiOLUDRat_C "Ratioof up-down debouncing / Defect / Heal Ratio for check DFC_PSPOL" VALUE 0x804F57C4 Val_Wu8 3.00000000000 DDRC_Ratio 1.00000000000 4.00000000000 FORMAT "%13.11" /end CHARACTERISTIC
/begin CHARACTERISTIC DDRC_RatDeb.PSP_tiOvrTempUDRat_C "Ratioof up-down debouncing / Defect / Heal Ratio for check DFC_PSPOvrTemp" VALUE 0x804F57C5 Val_Wu8 3.00000000000 DDRC_Ratio 1.00000000000 4.00000000000 FORMAT "%13.11" /end CHARACTERISTIC
/begin CHARACTERISTIC DDRC_RatDeb.PSP_tiSCBUDRat_C "Ratioof up-down debouncing / Defect / Heal Ratio for check DFC_PSPSCB" VALUE 0x804F57C6 Val_Wu8 3.00000000000 DDRC_Ratio 1.00000000000 4.00000000000 FORMAT "%13.11" /end CHARACTERISTIC
/begin CHARACTERISTIC DDRC_RatDeb.PSP_tiSCGUDRat_C "Ratioof up-down debouncing / Defect / Heal Ratio for check DFC_PSPSCG" VALUE 0x804F57C7 Val_Wu8 3.00000000000 DDRC_Ratio 1.00000000000 4.00000000000 FORMAT "%13.11" /end CHARACTERISTIC
/begin CHARACTERISTIC DDRC_RatDeb.T50_tiErrUDRat_C "Ratioof up-down debouncing / Defect / Heal Ratio for check DFC_T50Err" VALUE 0x804F57C8 Val_Wu8 3.00000000000 DDRC_Ratio 1.00000000000 4.00000000000 FORMAT "%13.11" /end CHARACTERISTIC
/begin CHARACTERISTIC DDRC_RatDeb.ThrVlv_tiLoBattB1UDRat_C "Ratioof up-down debouncing / Defect / Heal Ratio for check DFC_ThrVlvLoBattB1" VALUE 0x804F57C9 Val_Wu8 3.00000000000 DDRC_Ratio 1.00000000000 4.00000000000 FORMAT "%13.11" /end CHARACTERISTIC
/begin CHARACTERISTIC DDRC_RatDeb.UEGO_tiOperPlausUDRat_C "Ratioof up-down debouncing / Defect / Heal Ratio for check DFC_UegoSigOperPlausS1B1" VALUE 0x804F57CA Val_Wu8 3.00000000000 DDRC_Ratio 1.00000000000 4.00000000000 FORMAT "%13.11" /end CHARACTERISTIC
/begin CHARACTERISTIC DDRC_RatDeb.VehV_tiCANSigFLUDRat_C "Ratioof up-down debouncing / Defect / Heal Ratio for check DFC_VehVSigFL" VALUE 0x804F57CB Val_Wu8 3.00000000000 DDRC_Ratio 1.00000000000 4.00000000000 FORMAT "%13.11" /end CHARACTERISTIC
/begin CHARACTERISTIC DDRC_RatDeb.VehV_tiCANSigFRUDRat_C "Ratioof up-down debouncing / Defect / Heal Ratio for check DFC_VehVSigFR" VALUE 0x804F57CC Val_Wu8 3.00000000000 DDRC_Ratio 1.00000000000 4.00000000000 FORMAT "%13.11" /end CHARACTERISTIC
/begin CHARACTERISTIC DDRC_RatDeb.VehV_tiCANSigRLUDRat_C "Ratioof up-down debouncing / Defect / Heal Ratio for check DFC_VehVSigRL" VALUE 0x804F57CD Val_Wu8 3.00000000000 DDRC_Ratio 1.00000000000 4.00000000000 FORMAT "%13.11" /end CHARACTERISTIC
/begin CHARACTERISTIC DDRC_RatDeb.VehV_tiCANSigRRUDRat_C "Ratioof up-down debouncing / Defect / Heal Ratio for check DFC_VehVSigRR" VALUE 0x804F57CE Val_Wu8 3.00000000000 DDRC_Ratio 1.00000000000 4.00000000000 FORMAT "%13.11" /end CHARACTERISTIC
/begin CHARACTERISTIC DDRC_RatDeb.VehV_tiOLUDRat_C "Ratioof up-down debouncing / Defect / Heal Ratio for check DFC_VehVSclOutOL" VALUE 0x804F57CF Val_Wu8 3.00000000000 DDRC_Ratio 1.00000000000 4.00000000000 FORMAT "%13.11" /end CHARACTERISTIC
/begin CHARACTERISTIC DDRC_RatDeb.VehV_tiOTUDRat_C "Ratioof up-down debouncing / Defect / Heal Ratio for check DFC_VehVSclOutOT" VALUE 0x804F57D0 Val_Wu8 3.00000000000 DDRC_Ratio 1.00000000000 4.00000000000 FORMAT "%13.11" /end CHARACTERISTIC
/begin CHARACTERISTIC DDRC_RatDeb.VehV_tiPhysRngHiUDRat_C "Ratioof up-down debouncing / Defect / Heal Ratio for check DFC_VehVPhysRngHi" VALUE 0x804F57D1 Val_Wu8 3.00000000000 DDRC_Ratio 1.00000000000 4.00000000000 FORMAT "%13.11" /end CHARACTERISTIC
/begin CHARACTERISTIC DDRC_RatDeb.VehV_tiSCBUDRat_C "Ratioof up-down debouncing / Defect / Heal Ratio for check DFC_VehVSclOutSCB" VALUE 0x804F57D2 Val_Wu8 3.00000000000 DDRC_Ratio 1.00000000000 4.00000000000 FORMAT "%13.11" /end CHARACTERISTIC
/begin CHARACTERISTIC DDRC_RatDeb.VehV_tiSCGUDRat_C "Ratioof up-down debouncing / Defect / Heal Ratio for check DFC_VehVSclOutSCG" VALUE 0x804F57D3 Val_Wu8 3.00000000000 DDRC_Ratio 1.00000000000 4.00000000000 FORMAT "%13.11" /end CHARACTERISTIC
/begin CHARACTERISTIC DDRC_RatDeb.VehV_tiSnsrARngHiUDRat_C "Ratioof up-down debouncing / Defect / Heal Ratio for check DFC_VehVSnsrARngHi" VALUE 0x804F57D4 Val_Wu8 3.00000000000 DDRC_Ratio 1.00000000000 4.00000000000 FORMAT "%13.11" /end CHARACTERISTIC
/begin CHARACTERISTIC DDRC_RatDeb.VehV_tiSnsrBRngHiUDRat_C "Ratioof up-down debouncing / Defect / Heal Ratio for check DFC_VehVSnsrBRngHi" VALUE 0x804F57D5 Val_Wu8 3.00000000000 DDRC_Ratio 1.00000000000 4.00000000000 FORMAT "%13.11" /end CHARACTERISTIC
/begin CHARACTERISTIC DDRC_RatDeb.VehV_tiSpdRtyDiagUDRat_C "Ratioof up-down debouncing / Defect / Heal Ratio for check DFC_VehVSpdRtyDiag" VALUE 0x804F57D6 Val_Wu8 3.00000000000 DDRC_Ratio 1.00000000000 4.00000000000 FORMAT "%13.11" /end CHARACTERISTIC
/begin CHARACTERISTIC DDRC_RatDeb.DDHFHD_numDhfDebDef_CUDRat_C "Ratioof up-down debouncing / Defect / Heal Ratio for check DFC_DHFHD" VALUE 0x804F57D7 Val_Wu8 3.00000000000 DDRC_Ratio 1.00000000000 4.00000000000 FORMAT "%13.11" /end CHARACTERISTIC
/begin CHARACTERISTIC DDRC_RatDeb.InjVlv_numDcDcUDRat_C "Ratioof up-down debouncing / Defect / Heal Ratio for check DFC_InjVlv_DI_DcDc" VALUE 0x804F57D8 Val_Wu8 3.00000000000 DDRC_Ratio 1.00000000000 4.00000000000 FORMAT "%13.11" /end CHARACTERISTIC
/begin CHARACTERISTIC DDRC_RatDeb.InjVlv_numNoLdUDRat_C "Ratioof up-down debouncing / Defect / Heal Ratio for check DFC_InjVlv_DI_NoLd" VALUE 0x804F57D9 Val_Wu8 3.00000000000 DDRC_Ratio 1.00000000000 4.00000000000 FORMAT "%13.11" /end CHARACTERISTIC
/begin CHARACTERISTIC DDRC_RatDeb.InjVlv_numScBnkUDRat_C "Ratioof up-down debouncing / Defect / Heal Ratio for check DFC_InjVlv_DI_ScBnk" VALUE 0x804F57DA Val_Wu8 3.00000000000 DDRC_Ratio 1.00000000000 4.00000000000 FORMAT "%13.11" /end CHARACTERISTIC
/begin CHARACTERISTIC DDRC_RatDeb.InjVlv_numScCylUDRat_C "Ratioof up-down debouncing / Defect / Heal Ratio for check DFC_InjVlv_DI_ScCyl" VALUE 0x804F57DB Val_Wu8 3.00000000000 DDRC_Ratio 1.00000000000 4.00000000000 FORMAT "%13.11" /end CHARACTERISTIC
/begin CHARACTERISTIC DDRC_RatDeb.InjVlv_numScHsLsUDRat_C "Ratioof up-down debouncing / Defect / Heal Ratio for check DFC_InjVlv_DI_ScHsLs" VALUE 0x804F57DC Val_Wu8 3.00000000000 DDRC_Ratio 1.00000000000 4.00000000000 FORMAT "%13.11" /end CHARACTERISTIC
/begin CHARACTERISTIC DDRC_RatDeb.MfPsDia_numOpenLoadUDRat_C "Ratioof up-down debouncing / Defect / Heal Ratio for check DFC_MfPsDiaOpenLoad1" VALUE 0x804F57DD Val_Wu8 3.00000000000 DDRC_Ratio 1.00000000000 4.00000000000 FORMAT "%13.11" /end CHARACTERISTIC
/begin CHARACTERISTIC DDRC_RatDeb.MfPsDia_numScHiSUDRat_C "Ratioof up-down debouncing / Defect / Heal Ratio for check DFC_MfPsDiaScHiS1" VALUE 0x804F57DE Val_Wu8 3.00000000000 DDRC_Ratio 1.00000000000 4.00000000000 FORMAT "%13.11" /end CHARACTERISTIC
/begin CHARACTERISTIC DDRC_RatDeb.MfPsDia_numScHiSLowSUDRat_C "Ratioof up-down debouncing / Defect / Heal Ratio for check DFC_MfPsDiaScHiSLowS1" VALUE 0x804F57DF Val_Wu8 3.00000000000 DDRC_Ratio 1.00000000000 4.00000000000 FORMAT "%13.11" /end CHARACTERISTIC
/begin CHARACTERISTIC DDRC_RatDeb.MfPsDia_numScLowSUDRat_C "Ratioof up-down debouncing / Defect / Heal Ratio for check DFC_MfPsDiaScLowS1" VALUE 0x804F57E0 Val_Wu8 3.00000000000 DDRC_Ratio 1.00000000000 4.00000000000 FORMAT "%13.11" /end CHARACTERISTIC
/begin CHARACTERISTIC DDRC_RatDeb.ACEvpT_tiPhysRngHiUDRat_C "Ratioof up-down debouncing / Defect / Heal Ratio for check DFC_ACEvpTPhysRngHi" VALUE 0x804F57E1 Val_Wu8 3.00000000000 DDRC_Ratio 1.00000000000 4.00000000000 FORMAT "%13.11" /end CHARACTERISTIC
/begin CHARACTERISTIC DDRC_RatDeb.ACEvpT_tiPhysRngLoUDRat_C "Ratioof up-down debouncing / Defect / Heal Ratio for check DFC_ACEvpTPhysRngLo" VALUE 0x804F57E2 Val_Wu8 3.00000000000 DDRC_Ratio 1.00000000000 4.00000000000 FORMAT "%13.11" /end CHARACTERISTIC
/begin CHARACTERISTIC DDRC_RatDeb.ACEvpT_tiSRCMaxUDRat_C "Ratioof up-down debouncing / Defect / Heal Ratio for check DFC_ACEvpTSRCMax" VALUE 0x804F57E3 Val_Wu8 3.00000000000 DDRC_Ratio 1.00000000000 4.00000000000 FORMAT "%13.11" /end CHARACTERISTIC
/begin CHARACTERISTIC DDRC_RatDeb.ACEvpT_tiSRCMinUDRat_C "Ratioof up-down debouncing / Defect / Heal Ratio for check DFC_ACEvpTSRCMin" VALUE 0x804F57E4 Val_Wu8 3.00000000000 DDRC_Ratio 1.00000000000 4.00000000000 FORMAT "%13.11" /end CHARACTERISTIC
/begin CHARACTERISTIC DDRC_RatDeb.AFS_tiRawSigRngHiB1UDRat_C "Ratioof up-down debouncing / Defect / Heal Ratio for check DFC_AfsRawSigRngHiB1" VALUE 0x804F57E5 Val_Wu8 3.00000000000 DDRC_Ratio 1.00000000000 4.00000000000 FORMAT "%13.11" /end CHARACTERISTIC
/begin CHARACTERISTIC DDRC_RatDeb.AFS_tiRawSigRngLoB1UDRat_C "Ratioof up-down debouncing / Defect / Heal Ratio for check DFC_AfsRawSigRngLoB1" VALUE 0x804F57E6 Val_Wu8 3.00000000000 DDRC_Ratio 1.00000000000 4.00000000000 FORMAT "%13.11" /end CHARACTERISTIC
/begin CHARACTERISTIC DDRC_RatDeb.AFS_tiSnsrErrB1UDRat_C "Ratioof up-down debouncing / Defect / Heal Ratio for check DFC_AfsSnsrErrB1" VALUE 0x804F57E7 Val_Wu8 3.00000000000 DDRC_Ratio 1.00000000000 4.00000000000 FORMAT "%13.11" /end CHARACTERISTIC
/begin CHARACTERISTIC DDRC_RatDeb.AirC_tiClntSRCMaxUDRat_C "Ratioof up-down debouncing / Defect / Heal Ratio for check DFC_AirCClntPAnaSRCMax" VALUE 0x804F57E8 Val_Wu8 3.00000000000 DDRC_Ratio 1.00000000000 4.00000000000 FORMAT "%13.11" /end CHARACTERISTIC
/begin CHARACTERISTIC DDRC_RatDeb.AirC_tiClntSRCMinUDRat_C "Ratioof up-down debouncing / Defect / Heal Ratio for check DFC_AirCClntPAnaSRCMin" VALUE 0x804F57E9 Val_Wu8 3.00000000000 DDRC_Ratio 1.00000000000 4.00000000000 FORMAT "%13.11" /end CHARACTERISTIC
/begin CHARACTERISTIC DDRC_RatDeb.AirC_tiSwtNplUDRat_C "Ratioof up-down debouncing / Defect / Heal Ratio for check DFC_AirCSwtNpl" VALUE 0x804F57EA Val_Wu8 3.00000000000 DDRC_Ratio 1.00000000000 4.00000000000 FORMAT "%13.11" /end CHARACTERISTIC
/begin CHARACTERISTIC DDRC_RatDeb.AirC_tiSwtSigUDRat_C "Ratioof up-down debouncing / Defect / Heal Ratio for check DFC_AirCSwtSig" VALUE 0x804F57EB Val_Wu8 3.00000000000 DDRC_Ratio 1.00000000000 4.00000000000 FORMAT "%13.11" /end CHARACTERISTIC
/begin CHARACTERISTIC DDRC_RatDeb.BrkBstP_tiSCBUDRat_C "Ratioof up-down debouncing / Defect / Heal Ratio for check DFC_BrkBstSensSCB" VALUE 0x804F57EC Val_Wu8 3.00000000000 DDRC_Ratio 1.00000000000 4.00000000000 FORMAT "%13.11" /end CHARACTERISTIC
/begin CHARACTERISTIC DDRC_RatDeb.BrkBstP_tiSCGUDRat_C "Ratioof up-down debouncing / Defect / Heal Ratio for check DFC_BrkBstSensSCG" VALUE 0x804F57ED Val_Wu8 3.00000000000 DDRC_Ratio 1.00000000000 4.00000000000 FORMAT "%13.11" /end CHARACTERISTIC
/begin CHARACTERISTIC DDRC_RatDeb.Brk_tiUDRat_C "Ratioof up-down debouncing / Defect / Heal Ratio for check DFC_Brk" VALUE 0x804F57EE Val_Wu8 3.00000000000 DDRC_Ratio 1.00000000000 4.00000000000 FORMAT "%13.11" /end CHARACTERISTIC
/begin CHARACTERISTIC DDRC_RatDeb.Brk_tiSigUDRat_C "Ratioof up-down debouncing / Defect / Heal Ratio for check DFC_BrkSig" VALUE 0x804F57EF Val_Wu8 3.00000000000 DDRC_Ratio 1.00000000000 4.00000000000 FORMAT "%13.11" /end CHARACTERISTIC
/begin CHARACTERISTIC DDRC_RatDeb.Clth_tiSigUDRat_C "Ratioof up-down debouncing / Defect / Heal Ratio for check DFC_ClthSig" VALUE 0x804F57F0 Val_Wu8 3.00000000000 DDRC_Ratio 1.00000000000 4.00000000000 FORMAT "%13.11" /end CHARACTERISTIC
/begin CHARACTERISTIC DDRC_RatDeb.EGRVlv_tiCurrLimUDRat_C "Ratioof up-down debouncing / Defect / Heal Ratio for check DFC_EGRVlvCurrLim" VALUE 0x804F57F1 Val_Wu8 3.00000000000 DDRC_Ratio 1.00000000000 4.00000000000 FORMAT "%13.11" /end CHARACTERISTIC
/begin CHARACTERISTIC DDRC_RatDeb.EGRVlv_tiOLUDRat_C "Ratioof up-down debouncing / Defect / Heal Ratio for check DFC_EGRVlvOL" VALUE 0x804F57F2 Val_Wu8 3.00000000000 DDRC_Ratio 1.00000000000 4.00000000000 FORMAT "%13.11" /end CHARACTERISTIC
/begin CHARACTERISTIC DDRC_RatDeb.EGRVlv_tiOvrTempUDRat_C "Ratioof up-down debouncing / Defect / Heal Ratio for check DFC_EGRVlvOvrTemp" VALUE 0x804F57F3 Val_Wu8 3.00000000000 DDRC_Ratio 1.00000000000 4.00000000000 FORMAT "%13.11" /end CHARACTERISTIC
/begin CHARACTERISTIC DDRC_RatDeb.EGRVlv_tiSCBUDRat_C "Ratioof up-down debouncing / Defect / Heal Ratio for check DFC_EGRVlvSCB" VALUE 0x804F57F4 Val_Wu8 3.00000000000 DDRC_Ratio 1.00000000000 4.00000000000 FORMAT "%13.11" /end CHARACTERISTIC
/begin CHARACTERISTIC DDRC_RatDeb.EGRVlv_tiSCGUDRat_C "Ratioof up-down debouncing / Defect / Heal Ratio for check DFC_EGRVlvSCG" VALUE 0x804F57F5 Val_Wu8 3.00000000000 DDRC_Ratio 1.00000000000 4.00000000000 FORMAT "%13.11" /end CHARACTERISTIC
/begin CHARACTERISTIC DDRC_RatDeb.EGRVlv_tiSRCMaxUDRat_C "Ratioof up-down debouncing / Defect / Heal Ratio for check DFC_EGRVlvSRCMax" VALUE 0x804F57F6 Val_Wu8 3.00000000000 DDRC_Ratio 1.00000000000 4.00000000000 FORMAT "%13.11" /end CHARACTERISTIC
/begin CHARACTERISTIC DDRC_RatDeb.EGRVlv_tiSRCMinUDRat_C "Ratioof up-down debouncing / Defect / Heal Ratio for check DFC_EGRVlvSRCMin" VALUE 0x804F57F7 Val_Wu8 3.00000000000 DDRC_Ratio 1.00000000000 4.00000000000 FORMAT "%13.11" /end CHARACTERISTIC
/begin CHARACTERISTIC DDRC_RatDeb.HLSDem_tiOvhtUDRat_C "Ratioof up-down debouncing / Defect / Heal Ratio for check DFC_HLSDemOvhtEngLim" VALUE 0x804F57F8 Val_Wu8 3.00000000000 DDRC_Ratio 1.00000000000 4.00000000000 FORMAT "%13.11" /end CHARACTERISTIC
/begin CHARACTERISTIC DDRC_RatDeb.Oil_tiSRCMaxPSwmpUDRat_C "Ratioof up-down debouncing / Defect / Heal Ratio for check DFC_OilPSwmpSRCMax" VALUE 0x804F57F9 Val_Wu8 3.00000000000 DDRC_Ratio 1.00000000000 4.00000000000 FORMAT "%13.11" /end CHARACTERISTIC
/begin CHARACTERISTIC DDRC_RatDeb.Oil_tiSRCMinPSwmpUDRat_C "Ratioof up-down debouncing / Defect / Heal Ratio for check DFC_OilPSwmpSRCMin" VALUE 0x804F57FA Val_Wu8 3.00000000000 DDRC_Ratio 1.00000000000 4.00000000000 FORMAT "%13.11" /end CHARACTERISTIC
/begin CHARACTERISTIC DDRC_RatDeb.PIntkVUs_tiLineHiB1UDRat_C "Ratioof up-down debouncing / Defect / Heal Ratio for check DFC_PIntkVUsLineHiB1" VALUE 0x804F57FB Val_Wu8 3.00000000000 DDRC_Ratio 1.00000000000 4.00000000000 FORMAT "%13.11" /end CHARACTERISTIC
/begin CHARACTERISTIC DDRC_RatDeb.PIntkVUs_tiLineLoB1UDRat_C "Ratioof up-down debouncing / Defect / Heal Ratio for check DFC_PIntkVUsLineLoB1" VALUE 0x804F57FC Val_Wu8 3.00000000000 DDRC_Ratio 1.00000000000 4.00000000000 FORMAT "%13.11" /end CHARACTERISTIC
/begin CHARACTERISTIC DDRC_RatDeb.VehV_tiPhysRngLoUDRat_C "Ratioof up-down debouncing / Defect / Heal Ratio for check DFC_VehVPhysRngLo" VALUE 0x804F57FD Val_Wu8 3.00000000000 DDRC_Ratio 1.00000000000 4.00000000000 FORMAT "%13.11" /end CHARACTERISTIC
/begin CHARACTERISTIC DDRC_RatDeb.VehV_tiSigCanUDRat_C "Ratioof up-down debouncing / Defect / Heal Ratio for check DFC_VehVSigCan" VALUE 0x804F57FE Val_Wu8 3.00000000000 DDRC_Ratio 1.00000000000 4.00000000000 FORMAT "%13.11" /end CHARACTERISTIC
/begin CHARACTERISTIC DDRC_RatDeb.VehV_tiSigCanSafeUDRat_C "Ratioof up-down debouncing / Defect / Heal Ratio for check DFC_VehVSigCanSafe" VALUE 0x804F57FF Val_Wu8 3.00000000000 DDRC_Ratio 1.00000000000 4.00000000000 FORMAT "%13.11" /end CHARACTERISTIC
/begin CHARACTERISTIC DDRC_RatDeb.VlvLft_tiSRCMaxOilPSnsrIntk11UDRat_C "Ratioof up-down debouncing / Defect / Heal Ratio for check DFC_VlvLftFbOilPSnsrIntk11SRCMax" VALUE 0x804F5800 Val_Wu8 3.00000000000 DDRC_Ratio 1.00000000000 4.00000000000 FORMAT "%13.11" /end CHARACTERISTIC
/begin CHARACTERISTIC DDRC_RatDeb.VlvLft_tiSRCMinOilPSnsrIntk11UDRat_C "Ratioof up-down debouncing / Defect / Heal Ratio for check DFC_VlvLftFbOilPSnsrIntk11SRCMin" VALUE 0x804F5801 Val_Wu8 3.00000000000 DDRC_Ratio 1.00000000000 4.00000000000 FORMAT "%13.11" /end CHARACTERISTIC
/begin CHARACTERISTIC DDRC_RatDeb.Clth_numPlaUDRat_C "Ratioof up-down debouncing / Defect / Heal Ratio for check DFC_ClthNpl" VALUE 0x804F5802 Val_Wu8 3.00000000000 DDRC_Ratio 1.00000000000 4.00000000000 FORMAT "%13.11" /end CHARACTERISTIC
/begin CHARACTERISTIC DDRC_RatDeb.Gbx_numPNPosnDrvCdnUDRat_C "Ratioof up-down debouncing / Defect / Heal Ratio for check DFC_GbxPNPosnDrvCdn" VALUE 0x804F5803 Val_Wu8 3.00000000000 DDRC_Ratio 1.00000000000 4.00000000000 FORMAT "%13.11" /end CHARACTERISTIC
/begin CHARACTERISTIC DDRC_RatDeb.Gbx_numPNPosnPlausyUDRat_C "Ratioof up-down debouncing / Defect / Heal Ratio for check DFC_GbxPNPosnPlausy" VALUE 0x804F5804 Val_Wu8 3.00000000000 DDRC_Ratio 1.00000000000 4.00000000000 FORMAT "%13.11" /end CHARACTERISTIC
/begin CHARACTERISTIC DDSKVFRAMN "min threshold for fra mixture deviation" VALUE 0x8053A882 RB_Val_Wu16 1.999969 fak_uw_b2 0.00 1.999969 FORMAT "%8.6" /end CHARACTERISTIC
/begin CHARACTERISTIC DDSKVFRAMX "max threshold for fra mixture deviation" VALUE 0x8053A884 RB_Val_Wu16 1.999969 fak_uw_b2 0.00 1.999969 FORMAT "%8.6" /end CHARACTERISTIC
/begin CHARACTERISTIC DDSKVORAMN "min threshold for ora mixture deviation" VALUE 0x8053A886 RB_Val_Ws16 3071.953 rel_sw_b1536 -1536.000 1535.953 FORMAT "%8.3" /end CHARACTERISTIC
/begin CHARACTERISTIC DDSKVORAMX "max threshold for ora mixture deviation" VALUE 0x8053A888 RB_Val_Ws16 3071.953 rel_sw_b1536 -1536.000 1535.953 FORMAT "%8.3" /end CHARACTERISTIC
/begin CHARACTERISTIC DevLib_DigOutDbgSig_C "Calibration parameter to select the Digital out signal for which the debugging information is to be updated into the measuring points" VALUE 0x8058AFBC Val_Wu16 65535.00 OneToOne 0.00 65535.00 FORMAT "%8.2" /end CHARACTERISTIC
/begin CHARACTERISTIC Devlib_PsDisbl.facLowHysLo_C "Structure containing hysterisis limits for battery voltage correction factor / Lower hysterisis limit for battery correction factor LOW." VALUE 0x8058AFC0 Kw_Ws16 1.000000 Fact 0.00 1.000000 FORMAT "%8.6" EXTENDED_LIMITS -4.000000 3.999878 /end CHARACTERISTIC
/begin CHARACTERISTIC Devlib_PsDisbl.facLowHysHi_C "Structure containing hysterisis limits for battery voltage correction factor / Higher hysterisis limit for battery correction factor LOW." VALUE 0x8058AFC2 Kw_Ws16 1.000000 Fact 0.00 1.000000 FORMAT "%8.6" EXTENDED_LIMITS -4.000000 3.999878 /end CHARACTERISTIC
/begin CHARACTERISTIC Devlib_PsDisbl.facHighHysLo_C "Structure containing hysterisis limits for battery voltage correction factor / Lower hysterisis limit for battery correction factor HIGH." VALUE 0x8058AFC4 Kw_Ws16 2.000000 Fact 1.000000 3.000000 FORMAT "%8.6" EXTENDED_LIMITS -4.000000 3.999878 /end CHARACTERISTIC
/begin CHARACTERISTIC Devlib_PsDisbl.facHighHysHi_C "Structure containing hysterisis limits for battery voltage correction factor / Higher hysterisis limit for battery correction factor HIGH." VALUE 0x8058AFC6 Kw_Ws16 2.000000 Fact 1.000000 3.000000 FORMAT "%8.6" EXTENDED_LIMITS -4.000000 3.999878 /end CHARACTERISTIC
/begin CHARACTERISTIC DevLib_PWMOutDbgSig_C "Calibration parameter to select the PWM out signal for which the debugging information is to be updated into the measuring points" VALUE 0x8058AFBE Val_Wu16 65535.00 OneToOne 0.00 65535.00 FORMAT "%8.2" /end CHARACTERISTIC
/begin CHARACTERISTIC Devlib_PwrStg.BattLoHysLo_C "Structure containing hysterisis check for battery voltage LOW/HIGH / Lower limit for battery voltage LOW hysterisis check." VALUE 0x8058AFC8 Kw_Ws16 9000.000 Volt_Batt 3000.00 12000.00 FORMAT "%8.2" EXTENDED_LIMITS -655360.0 655340.0 /end CHARACTERISTIC
/begin CHARACTERISTIC Devlib_PwrStg.BattLoHysHi_C "Structure containing hysterisis check for battery voltage LOW/HIGH / Higher limit for battery voltage LOW hysterisis check" VALUE 0x8058AFCA Kw_Ws16 9000.000 Volt_Batt 3000.00 12000.00 FORMAT "%8.2" EXTENDED_LIMITS -655360.0 655340.0 /end CHARACTERISTIC
/begin CHARACTERISTIC Devlib_PwrStg.BattHiHysLo_C "Structure containing hysterisis check for battery voltage LOW/HIGH / Lower limit for battery voltage HIGH hysterisis check" VALUE 0x8058AFCC Kw_Ws16 24000.00 Volt_Batt 12000.00 36000.00 FORMAT "%8.2" EXTENDED_LIMITS -655360.0 655340.0 /end CHARACTERISTIC
/begin CHARACTERISTIC Devlib_PwrStg.BattHiHysHi_C "Structure containing hysterisis check for battery voltage LOW/HIGH / Upper limit for battery voltage HIGH hysterisis check" VALUE 0x8058AFCE Kw_Ws16 24000.00 Volt_Batt 12000.00 36000.00 FORMAT "%8.2" EXTENDED_LIMITS -655360.0 655340.0 /end CHARACTERISTIC
/begin CHARACTERISTIC DSKVTABST "delay time to recognize cold soak" VALUE 0x8053A88A RB_Val_Wu16 65535.00 t1sxs_uw_q1 0.00 65535.00 FORMAT "%8.2" /end CHARACTERISTIC
/begin CHARACTERISTIC DTMSTANSO "upper threshold for the closed intervall between tum and tans" VALUE 0x8053A88C RB_Val_Wu8 191.3 temp_ub_q0p75_o48 -48.0 143.3 FORMAT "%5.1" /end CHARACTERISTIC
/begin CHARACTERISTIC DTMSTTUMO "upper threshold for the difference of ambient air temperature and engine start temperature" VALUE 0x8053A88D RB_Val_Wu8 191.3 temp_ub_q0p75_o48 -48.0 143.3 FORMAT "%5.1" /end CHARACTERISTIC
/begin CHARACTERISTIC DTMSTTUMU "lower threshold for the difference of ambient air temperature and engine start temperature" VALUE 0x8053A88E RB_Val_Wu8 191.3 temp_ub_q0p75_o48 -48.0 143.3 FORMAT "%5.1" /end CHARACTERISTIC
/begin CHARACTERISTIC DTUMTANSU "lower threshold for the difference of ambient air temperature and intake air temperature" VALUE 0x8053A88F RB_Val_Wu8 191.3 temp_ub_q0p75_o48 -48.0 143.3 FORMAT "%5.1" /end CHARACTERISTIC
/begin CHARACTERISTIC FuPHi_pAftPreDrvMin_C "absolute pressure threshold for ekp prerun pressure" VALUE 0x8053A890 RB_Val_Wu16 131.0700 RBPtCel_p_0p002_1 0.00 131.0700 FORMAT "%8.4" /end CHARACTERISTIC
/begin CHARACTERISTIC FuPHi_pNegOffsSuspcThd_C "threshold for negative offset" VALUE 0x8053A892 RB_Val_Wu16 131.0700 RBPtCel_p_0p002_1 0.00 131.0700 FORMAT "%8.4" /end CHARACTERISTIC
/begin CHARACTERISTIC FuPHi_pPosOffsAftPreRunThd_C "threshold for positive offset after PSP prerun" VALUE 0x8053A894 RB_Val_Wu16 131.0700 RBPtCel_p_0p002_1 0.00 131.0700 FORMAT "%8.4" /end CHARACTERISTIC
/begin CHARACTERISTIC FuPHi_pPosOffsSuspcThd_C "threshold for suspicion positive offset" VALUE 0x8053A896 RB_Val_Wu16 131.0700 RBPtCel_p_0p002_1 0.00 131.0700 FORMAT "%8.4" /end CHARACTERISTIC
/begin CHARACTERISTIC FuPHi_pRngChkMaxExtd_T "Table for upper limit of range check, dependent on nmot" CURVE 0x8053A898 RB_Curve_U8_U16_Static 131.0700 RBPtCel_p_0p002_1 0.00 131.0700 FORMAT "%8.4"
 /begin AXIS_DESCR STD_AXIS Epm_nEngLRes nmot_ub_q40 5 0.00 10200. FORMAT "%5.0" DEPOSIT ABSOLUTE /end AXIS_DESCR
/end CHARACTERISTIC
/begin CHARACTERISTIC FuPHi_pRngChkMin_C "minimum value for plausible rail pressure" VALUE 0x8053A8A8 RB_Val_Ws16 131.0700 RBPtCel_p_0p002_1 -65.53600 65.53400 FORMAT "%8.5" /end CHARACTERISTIC
/begin CHARACTERISTIC FuPHi_pSpstPhdMin_C "pressure threshold for ban of stop" VALUE 0x8053A8AA RB_Val_Wu16 131.0700 RBPtCel_p_0p002_1 0.00 131.0700 FORMAT "%8.4" /end CHARACTERISTIC
/begin CHARACTERISTIC KLTDDSNO "threshold to avoid fault diagnosis, air in System" CURVE 0x8053A8AC RB_Curve_U16_U8_Static 2.550 t_q0p01 0.00 2.550 FORMAT "%5.3"
 /begin AXIS_DESCR STD_AXIS tiekp_w t_q0p1 6 0.00 6553.500 FORMAT "%8.3" DEPOSIT ABSOLUTE /end AXIS_DESCR
/end CHARACTERISTIC
/begin CHARACTERISTIC NDECJ "Engine speed threshold for power stage diagnosis" VALUE 0x8058A312 KwWU8 10200. EngN_LRes 0.00 10200. FORMAT "%5.0" /end CHARACTERISTIC
/begin CHARACTERISTIC NETHSEOSC_C "number of signal edges for detection of oscillating el. error ethanol sensor" VALUE 0x8053A8D6 RB_Val_Wu8 255.0 dez 0.00 255.0 FORMAT "%5.1" /end CHARACTERISTIC
/begin CHARACTERISTIC TATMDIFF "temperature limit for changeable ambient conditions before start" VALUE 0x8053A8C0 RB_Val_Wu8 191.3 temp_ub_q0p75_o48 -48.0 143.3 FORMAT "%5.1" /end CHARACTERISTIC
/begin CHARACTERISTIC TDEKPON "delay time EKP-pre run" VALUE 0x8053A8C1 RB_Val_Wu8 2.550 t_q0p01 0.00 2.550 FORMAT "%5.3" /end CHARACTERISTIC
/begin CHARACTERISTIC TDEKPPRE "delay time EKP-pre run in predrive" VALUE 0x8053A8C2 RB_Val_Wu8 2.550 t_q0p01 0.00 2.550 FORMAT "%5.3" /end CHARACTERISTIC
/begin CHARACTERISTIC TDETHSE_C "debounce time el. error ethanol sensor" VALUE 0x8053A8D7 RB_Val_Wu8 51.00 t_q0p2 0.00 51.00 FORMAT "%5.2" /end CHARACTERISTIC
/begin CHARACTERISTIC TDETHSF_C "debounce time signal error frequency ethanol sensor" VALUE 0x8053A8D8 RB_Val_Wu8 51.00 t_q0p2 0.00 51.00 FORMAT "%5.2" /end CHARACTERISTIC
/begin CHARACTERISTIC TDETHSPW_C "debounce time signal error negative pulse width ethanol sensor" VALUE 0x8053A8D9 RB_Val_Wu8 51.00 t_q0p2 0.00 51.00 FORMAT "%5.2" /end CHARACTERISTIC
/begin CHARACTERISTIC TETHSEOSC_C "time interval for detection of oscillating el. error ethanol sensor" VALUE 0x8053A8DA RB_Val_Wu8 51.00 t_q0p2 0.00 51.00 FORMAT "%5.2" /end CHARACTERISTIC
/begin CHARACTERISTIC TMABSDSO "temperature threshold tmotab to recognize cold soak" VALUE 0x8053A8C3 RB_Val_Wu8 191.3 temp_ub_q0p75_o48 -48.0 143.3 FORMAT "%5.1" /end CHARACTERISTIC
/begin CHARACTERISTIC TMMXREQ "tmot threshold for ban of stop" VALUE 0x8053A8C4 RB_Val_Wu8 191.3 temp_ub_q0p75_o48 -48.0 143.3 FORMAT "%5.1" /end CHARACTERISTIC
/begin CHARACTERISTIC TMSTSDSO "temperature threshold tmst to recognize cold soak" VALUE 0x8053A8C5 RB_Val_Wu8 191.3 temp_ub_q0p75_o48 -48.0 143.3 FORMAT "%5.1" /end CHARACTERISTIC
/begin CHARACTERISTIC TMTADIFF "temperature limit for auxiliary heating before start" VALUE 0x8053A8C6 RB_Val_Wu8 191.3 temp_ub_q0p75_o48 -48.0 143.3 FORMAT "%5.1" /end CHARACTERISTIC
/begin CHARACTERISTIC TNSEDDSKV "max delay for retrigger after engine start" VALUE 0x8053A8C8 RB_Val_Wu16 6553.500 t_q0p1 0.00 6553.500 FORMAT "%8.3" /end CHARACTERISTIC
/begin CHARACTERISTIC TSTENDDSNO "threshold to avoid fault diagnosis, failure EKP or empty fuel tank" VALUE 0x8053A8CA RB_Val_Wu16 3276.750 t_q0p05 0.00 3276.750 FORMAT "%8.3" /end CHARACTERISTIC
/begin CHARACTERISTIC TVDDSKV "delay time for retrigger of cold soak condition" VALUE 0x8053A8CC RB_Val_Wu16 655.3500 t_q0p01 0.00 655.3500 FORMAT "%8.4" /end CHARACTERISTIC
/begin CHARACTERISTIC TVDDSKVEO "delay time for ban of stop" VALUE 0x8053A8CE RB_Val_Wu8 12.75 t_q0p05 0.00 12.75 FORMAT "%5.2" /end CHARACTERISTIC
/begin CHARACTERISTIC TVDDSKVSEO "delay time for reset of ban of stop" VALUE 0x8053A8D0 RB_Val_Wu16 3276.750 t_q0p05 0.00 3276.750 FORMAT "%8.3" /end CHARACTERISTIC
/begin CHARACTERISTIC TVDSKVRH "Time constant for healing of pressure sensor error" VALUE 0x8053A8D2 RB_Val_Wu8 12.75 t_q0p05 0.00 12.75 FORMAT "%5.2" /end CHARACTERISTIC
/begin CHARACTERISTIC TVDSKVRHL "Time constant for healing range check of pressure sensor error" VALUE 0x8053A8D3 RB_Val_Wu8 12.75 t_q0p05 0.00 12.75 FORMAT "%5.2" /end CHARACTERISTIC
/begin CHARACTERISTIC TVPRMNPL "Debouncing time of high pressure sensor range check" VALUE 0x8053A8D4 RB_Val_Wu8 12.75 t_q0p05 0.00 12.75 FORMAT "%5.2" /end CHARACTERISTIC
/begin CHARACTERISTIC UBCJMN "Min. Ubat-threshold for release of the power stage diagnosis" VALUE 0x8058A314 KwWU16 15000.00 Volt_Batt 0.00 15000.00 FORMAT "%8.2" EXTENDED_LIMITS 0.00 1310700. /end CHARACTERISTIC
/begin CHARACTERISTIC UBCJMX "Max. Ubat-threshold f. release of the BSP 752 R-power stage diagnosis" VALUE 0x8058A316 KwWU16 25500.00 Volt_Batt 0.00 25500.00 FORMAT "%8.2" EXTENDED_LIMITS 0.00 1310700. /end CHARACTERISTIC
/begin MEASUREMENT Air_tEGRClrLPDs_f "" FLOAT32_IEEE RBPtCel_t_1p0_3 1 100 -1.00000000E+037 1.00000000E+037 FORMAT "%13.3" ECU_ADDRESS 0x60003AD4 /end MEASUREMENT
/begin MEASUREMENT BrkBstP_p_f "Actual physical value" FLOAT32_IEEE RBPtCel_p_1p0_1 1 100 -1.00000000E+037 1.00000000E+037 FORMAT "%13.3" ECU_ADDRESS 0x60003AD0 /end MEASUREMENT
/begin MEASUREMENT B_bhdtf "Time window for blockheater detection finished" UBYTE B_TRUE 1 100 0.00 1.00000000000 BIT_MASK 0x1 FORMAT "%13.11" ECU_ADDRESS 0x60000112 /end MEASUREMENT
/begin MEASUREMENT B_coskneg "no negative offset" UBYTE B_TRUE 1 100 0.00 1.00000000000 BIT_MASK 0x1 FORMAT "%13.11" ECU_ADDRESS 0x60000111 /end MEASUREMENT
/begin MEASUREMENT B_coskretr "Retrigger of DDSKV cold soak condition" UBYTE B_TRUE 1 100 0.00 1.00000000000 BIT_MASK 0x1 FORMAT "%13.11" ECU_ADDRESS 0x60000110 /end MEASUREMENT
/begin MEASUREMENT B_deseehr_msg "Diagnosis power stage after the main Relay: entry conditions fulfilled" UBYTE B_TRUE 1 100 0.00 1.00000000000 BIT_MASK 0x1 FORMAT "%13.11" ECU_ADDRESS 0x70000C14 /end MEASUREMENT
/begin MEASUREMENT B_desee_msg "Diagnosis power stages, entry conditions fulfilled" UBYTE B_TRUE 1 100 0.00 1.00000000000 BIT_MASK 0x1 FORMAT "%13.11" ECU_ADDRESS 0x70000C15 /end MEASUREMENT
/begin MEASUREMENT B_dskvcosk_msg "condition cold soak" UBYTE B_TRUE 1 100 0.00 1.00000000000 BIT_MASK 0x1 FORMAT "%13.11" ECU_ADDRESS 0x6000023E /end MEASUREMENT
/begin MEASUREMENT B_dskvekpv "positive offset suspicion via ekp prerun pressure" UBYTE B_TRUE 1 100 0.00 1.00000000000 BIT_MASK 0x1 FORMAT "%13.11" ECU_ADDRESS 0x60036DEB /end MEASUREMENT
/begin MEASUREMENT B_dskveno "condition negative offset error" UBYTE B_TRUE 1 100 0.00 1.00000000000 BIT_MASK 0x1 FORMAT "%13.11" ECU_ADDRESS 0x6000010F /end MEASUREMENT
/begin MEASUREMENT B_dskvepo_msg "condition positive offset error" UBYTE B_TRUE 1 100 0.00 1.00000000000 BIT_MASK 0x1 FORMAT "%13.11" ECU_ADDRESS 0x6000023D /end MEASUREMENT
/begin MEASUREMENT B_dskvnng_msg "condition suspicion negative offset" UBYTE B_TRUE 1 100 0.00 1.00000000000 BIT_MASK 0x1 FORMAT "%13.11" ECU_ADDRESS 0x6000023C /end MEASUREMENT
/begin MEASUREMENT B_dskvnno_msg "condition no negative offset error" UBYTE B_TRUE 1 100 0.00 1.00000000000 BIT_MASK 0x1 FORMAT "%13.11" ECU_ADDRESS 0x6000023B /end MEASUREMENT
/begin MEASUREMENT B_dskvnpl "condition negative offset error (npl (error)" UBYTE B_TRUE 1 100 0.00 1.00000000000 BIT_MASK 0x1 FORMAT "%13.11" ECU_ADDRESS 0x6000010E /end MEASUREMENT
/begin MEASUREMENT B_dskvnpo_msg "condition no positive offset" UBYTE B_TRUE 1 100 0.00 1.00000000000 BIT_MASK 0x1 FORMAT "%13.11" ECU_ADDRESS 0x6000023A /end MEASUREMENT
/begin MEASUREMENT B_dskvpwf "condition power failure" UBYTE B_TRUE 1 100 0.00 1.00000000000 BIT_MASK 0x1 FORMAT "%13.11" ECU_ADDRESS 0x60036DEA /end MEASUREMENT
/begin MEASUREMENT B_dskvsepo_msg "condition suspicion positive offset error" UBYTE B_TRUE 1 100 0.00 1.00000000000 BIT_MASK 0x1 FORMAT "%13.11" ECU_ADDRESS 0x60036E3B /end MEASUREMENT
/begin MEASUREMENT B_dskvsig_msg "condition positive offset error(sig error)" UBYTE B_TRUE 1 100 0.00 1.00000000000 BIT_MASK 0x1 FORMAT "%13.11" ECU_ADDRESS 0x60000239 /end MEASUREMENT
/begin MEASUREMENT B_dskvsno_msg "condition suspicion negative offset error" UBYTE B_TRUE 1 100 0.00 1.00000000000 BIT_MASK 0x1 FORMAT "%13.11" ECU_ADDRESS 0x60036E3A /end MEASUREMENT
/begin MEASUREMENT B_dskvspoi_msg "condition suspicion positive offset" UBYTE B_TRUE 1 100 0.00 1.00000000000 BIT_MASK 0x1 FORMAT "%13.11" ECU_ADDRESS 0x60000238 /end MEASUREMENT
/begin MEASUREMENT B_dskvspo_msg "condition suspicion positive offset" UBYTE B_TRUE 1 100 0.00 1.00000000000 BIT_MASK 0x1 FORMAT "%13.11" ECU_ADDRESS 0x60036E39 /end MEASUREMENT
/begin MEASUREMENT B_dskvtank_msg "condition fuel is in tank and ekp is ok" UBYTE B_TRUE 1 100 0.00 1.00000000000 BIT_MASK 0x1 FORMAT "%13.11" ECU_ADDRESS 0x60000237 /end MEASUREMENT
/begin MEASUREMENT B_ekpvlpre "condition ekp pre-run in predrive ended" UBYTE B_TRUE 1 100 0.00 1.00000000000 BIT_MASK 0x1 FORMAT "%13.11" ECU_ADDRESS 0x60036DE9 /end MEASUREMENT
/begin MEASUREMENT B_ethseosc_msg "ethanol sensor, electrical error oscillating between min. and max. error" UBYTE B_TRUE 1 100 0.00 1.00000000000 BIT_MASK 0x1 FORMAT "%13.11" ECU_ADDRESS 0x6000EEAA /end MEASUREMENT
/begin MEASUREMENT B_initpr "init pressure is available" UBYTE B_TRUE 1 100 0.00 1.00000000000 BIT_MASK 0x1 FORMAT "%13.11" ECU_ADDRESS 0x6000010D /end MEASUREMENT
/begin MEASUREMENT B_nmotno_msg "condition nmot not" UBYTE B_TRUE 1 100 0.00 1.00000000000 BIT_MASK 0x1 FORMAT "%13.11" ECU_ADDRESS 0x600001F1 /end MEASUREMENT
/begin MEASUREMENT B_plprroh_msg "Condition high pressure sensor plausible" UBYTE B_TRUE 1 100 0.00 1.00000000000 BIT_MASK 0x1 FORMAT "%13.11" ECU_ADDRESS 0x600001E5 /end MEASUREMENT
/begin MEASUREMENT B_PmdInit_msg "Reset of standard powerstage diagnosis required" UBYTE B_TRUE 1 100 0.00 1.00000000000 BIT_MASK 0x1 FORMAT "%13.11" ECU_ADDRESS 0x70000C42 /end MEASUREMENT
/begin MEASUREMENT B_prcproh "condition range check no error" UBYTE B_TRUE 1 100 0.00 1.00000000000 BIT_MASK 0x1 FORMAT "%13.11" ECU_ADDRESS 0x6000010C /end MEASUREMENT
/begin MEASUREMENT B_prini "condition: rail pressure at ini2 pressent" UBYTE B_TRUE 1 100 0.00 1.00000000000 BIT_MASK 0x1 FORMAT "%13.11" ECU_ADDRESS 0x6000010B /end MEASUREMENT
/begin MEASUREMENT B_propre "condition: rail pressure at predrive" UBYTE B_TRUE 1 100 0.00 1.00000000000 BIT_MASK 0x1 FORMAT "%13.11" ECU_ADDRESS 0x6000010A /end MEASUREMENT
/begin MEASUREMENT B_proten "condition: rail pressure at ini2 calculate" UBYTE B_TRUE 1 100 0.00 1.00000000000 BIT_MASK 0x1 FORMAT "%13.11" ECU_ADDRESS 0x60000109 /end MEASUREMENT
/begin MEASUREMENT B_prpre "condition: rail pressure at predrive before ekp prerun present" UBYTE B_TRUE 1 100 0.00 1.00000000000 BIT_MASK 0x1 FORMAT "%13.11" ECU_ADDRESS 0x60036DE8 /end MEASUREMENT
/begin MEASUREMENT B_reqddskv_msg "Condition request action of fuel mixture adaptation because of a suspicion high pressure sensor offset" UBYTE B_TRUE 1 100 0.00 1.00000000000 BIT_MASK 0x1 FORMAT "%13.11" ECU_ADDRESS 0x600001DC /end MEASUREMENT
/begin MEASUREMENT B_tiekold "recognizing ekp prerun" UBYTE B_TRUE 1 100 0.00 1.00000000000 BIT_MASK 0x1 FORMAT "%13.11" ECU_ADDRESS 0x60000108 /end MEASUREMENT
/begin MEASUREMENT CEngDsT_t_f "" FLOAT32_IEEE RBPtCel_t_1p0_3 1 100 -1.00000000E+037 1.00000000E+037 FORMAT "%13.3" ECU_ADDRESS 0x50004D60 /end MEASUREMENT
/begin MEASUREMENT CEngDsT_t_f_Sq "" UBYTE SigQly_COMPU_VERB 1 100 0.00 15.0000000000 FORMAT "%13.10" ECU_ADDRESS 0x6000F784 /end MEASUREMENT
/begin MEASUREMENT CEngUsT_t_f "Actual physical value" FLOAT32_IEEE RBPtCel_t_1p0_3 1 100 -1.00000000E+037 1.00000000E+037 FORMAT "%13.3" ECU_ADDRESS 0x60003ACC /end MEASUREMENT
/begin MEASUREMENT DDRC_ctArDebLvl.DFC_BusDiagCANAPPLBusOff "Debouncing counters / Debounce Timer or Event counter for check DFC_BusDiagCANAPPLBusOff" SWORD DFC_OneToOne 1 100 -32768.00 32767.00 FORMAT "%8.2" ECU_ADDRESS 0x500058AE /end MEASUREMENT
/begin MEASUREMENT DDRC_ctArDebLvl.DFC_BusDiagCANCANCBusOff "Debouncing counters / Debounce Timer or Event counter for check DFC_BusDiagCANCANCBusOff" SWORD DFC_OneToOne 1 100 -32768.00 32767.00 FORMAT "%8.2" ECU_ADDRESS 0x500058B0 /end MEASUREMENT
/begin MEASUREMENT DDRC_ctArDebLvl.DFC_BusDiagCANVEHICLEBusOff "Debouncing counters / Debounce Timer or Event counter for check DFC_BusDiagCANVEHICLEBusOff" SWORD DFC_OneToOne 1 100 -32768.00 32767.00 FORMAT "%8.2" ECU_ADDRESS 0x500058B2 /end MEASUREMENT
/begin MEASUREMENT DDRC_ctArDebLvl.DFC_RBA_IODIAGPWR_rba_IoExtCy329_SignalVltSply_0 "Debouncing counters / Debounce Timer or Event counter for check DFC_RBA_IODIAGPWR_rba_IoExtCy329_SignalVltSply_0" SWORD DFC_OneToOne 1 100 -32768.00 32767.00 FORMAT "%8.2" ECU_ADDRESS 0x500058B4 /end MEASUREMENT
/begin MEASUREMENT DDRC_ctArDebLvl.DFC_RBA_IODIAGPWR_rba_IoExtCy329_SignalVltSply_0OT "Debouncing counters / Debounce Timer or Event counter for check DFC_RBA_IODIAGPWR_rba_IoExtCy329_SignalVltSply_0OT" SWORD DFC_OneToOne 1 100 -32768.00 32767.00 FORMAT "%8.2" ECU_ADDRESS 0x500058B6 /end MEASUREMENT
/begin MEASUREMENT DDRC_ctArDebLvl.DFC_RBA_IODIAGPWR_rba_IoExtCy329_SignalVltSply_0OV "Debouncing counters / Debounce Timer or Event counter for check DFC_RBA_IODIAGPWR_rba_IoExtCy329_SignalVltSply_0OV" SWORD DFC_OneToOne 1 100 -32768.00 32767.00 FORMAT "%8.2" ECU_ADDRESS 0x500058B8 /end MEASUREMENT
/begin MEASUREMENT DDRC_ctArDebLvl.DFC_RBA_IODIAGPWR_rba_IoExtCy329_SignalVltSply_0SCG "Debouncing counters / Debounce Timer or Event counter for check DFC_RBA_IODIAGPWR_rba_IoExtCy329_SignalVltSply_0SCG" SWORD DFC_OneToOne 1 100 -32768.00 32767.00 FORMAT "%8.2" ECU_ADDRESS 0x500058BA /end MEASUREMENT
/begin MEASUREMENT DDRC_ctArDebLvl.DFC_RBA_IODIAGPWR_rba_IoExtCy329_SignalVltSply_0UV "Debouncing counters / Debounce Timer or Event counter for check DFC_RBA_IODIAGPWR_rba_IoExtCy329_SignalVltSply_0UV" SWORD DFC_OneToOne 1 100 -32768.00 32767.00 FORMAT "%8.2" ECU_ADDRESS 0x500058BC /end MEASUREMENT
/begin MEASUREMENT DDRC_ctArDebLvl.DFC_RBA_IODIAGPWR_rba_IoExtCy329_SignalVltSply_1 "Debouncing counters / Debounce Timer or Event counter for check DFC_RBA_IODIAGPWR_rba_IoExtCy329_SignalVltSply_1" SWORD DFC_OneToOne 1 100 -32768.00 32767.00 FORMAT "%8.2" ECU_ADDRESS 0x500058BE /end MEASUREMENT
/begin MEASUREMENT DDRC_ctArDebLvl.DFC_RBA_IODIAGPWR_rba_IoExtCy329_SignalVltSply_1OT "Debouncing counters / Debounce Timer or Event counter for check DFC_RBA_IODIAGPWR_rba_IoExtCy329_SignalVltSply_1OT" SWORD DFC_OneToOne 1 100 -32768.00 32767.00 FORMAT "%8.2" ECU_ADDRESS 0x500058C0 /end MEASUREMENT
/begin MEASUREMENT DDRC_ctArDebLvl.DFC_RBA_IODIAGPWR_rba_IoExtCy329_SignalVltSply_1OV "Debouncing counters / Debounce Timer or Event counter for check DFC_RBA_IODIAGPWR_rba_IoExtCy329_SignalVltSply_1OV" SWORD DFC_OneToOne 1 100 -32768.00 32767.00 FORMAT "%8.2" ECU_ADDRESS 0x500058C2 /end MEASUREMENT
/begin MEASUREMENT DDRC_ctArDebLvl.DFC_RBA_IODIAGPWR_rba_IoExtCy329_SignalVltSply_1SCG "Debouncing counters / Debounce Timer or Event counter for check DFC_RBA_IODIAGPWR_rba_IoExtCy329_SignalVltSply_1SCG" SWORD DFC_OneToOne 1 100 -32768.00 32767.00 FORMAT "%8.2" ECU_ADDRESS 0x500058C4 /end MEASUREMENT
/begin MEASUREMENT DDRC_ctArDebLvl.DFC_RBA_IODIAGPWR_rba_IoExtCy329_SignalVltSply_1UV "Debouncing counters / Debounce Timer or Event counter for check DFC_RBA_IODIAGPWR_rba_IoExtCy329_SignalVltSply_1UV" SWORD DFC_OneToOne 1 100 -32768.00 32767.00 FORMAT "%8.2" ECU_ADDRESS 0x500058C6 /end MEASUREMENT
/begin MEASUREMENT DDRC_ctArDebLvl.DFC_RBA_IODIAGPWR_rba_IoExtCy329_SignalVltSply_2 "Debouncing counters / Debounce Timer or Event counter for check DFC_RBA_IODIAGPWR_rba_IoExtCy329_SignalVltSply_2" SWORD DFC_OneToOne 1 100 -32768.00 32767.00 FORMAT "%8.2" ECU_ADDRESS 0x500058C8 /end MEASUREMENT
/begin MEASUREMENT DDRC_ctArDebLvl.DFC_RBA_IODIAGPWR_rba_IoExtCy329_SignalVltSply_2OT "Debouncing counters / Debounce Timer or Event counter for check DFC_RBA_IODIAGPWR_rba_IoExtCy329_SignalVltSply_2OT" SWORD DFC_OneToOne 1 100 -32768.00 32767.00 FORMAT "%8.2" ECU_ADDRESS 0x500058CA /end MEASUREMENT
/begin MEASUREMENT DDRC_ctArDebLvl.DFC_RBA_IODIAGPWR_rba_IoExtCy329_SignalVltSply_2OV "Debouncing counters / Debounce Timer or Event counter for check DFC_RBA_IODIAGPWR_rba_IoExtCy329_SignalVltSply_2OV" SWORD DFC_OneToOne 1 100 -32768.00 32767.00 FORMAT "%8.2" ECU_ADDRESS 0x500058CC /end MEASUREMENT
/begin MEASUREMENT DDRC_ctArDebLvl.DFC_RBA_IODIAGPWR_rba_IoExtCy329_SignalVltSply_2SCG "Debouncing counters / Debounce Timer or Event counter for check DFC_RBA_IODIAGPWR_rba_IoExtCy329_SignalVltSply_2SCG" SWORD DFC_OneToOne 1 100 -32768.00 32767.00 FORMAT "%8.2" ECU_ADDRESS 0x500058CE /end MEASUREMENT
/begin MEASUREMENT DDRC_ctArDebLvl.DFC_RBA_IODIAGPWR_rba_IoExtCy329_SignalVltSply_2UV "Debouncing counters / Debounce Timer or Event counter for check DFC_RBA_IODIAGPWR_rba_IoExtCy329_SignalVltSply_2UV" SWORD DFC_OneToOne 1 100 -32768.00 32767.00 FORMAT "%8.2" ECU_ADDRESS 0x500058D0 /end MEASUREMENT
/begin MEASUREMENT DDRC_ctArDebLvl.DFC_CAN_E_TIMEOUT "Debouncing counters / Debounce Timer or Event counter for check DFC_CAN_E_TIMEOUT" SWORD DFC_OneToOne 1 100 -32768.00 32767.00 FORMAT "%8.2" ECU_ADDRESS 0x500058D2 /end MEASUREMENT
/begin MEASUREMENT DDRC_ctArDebLvl.DFC_LIN_E_TIMEOUT "Debouncing counters / Debounce Timer or Event counter for check DFC_LIN_E_TIMEOUT" SWORD DFC_OneToOne 1 100 -32768.00 32767.00 FORMAT "%8.2" ECU_ADDRESS 0x500058D4 /end MEASUREMENT
/begin MEASUREMENT DDRC_ctArDebLvl.DFC_MRlyOL "Debouncing counters / Debounce Timer or Event counter for check DFC_MRlyOL" SWORD DFC_OneToOne 1 100 -32768.00 32767.00 FORMAT "%8.2" ECU_ADDRESS 0x500058D6 /end MEASUREMENT
/begin MEASUREMENT DDRC_ctArDebLvl.DFC_MRlySCB "Debouncing counters / Debounce Timer or Event counter for check DFC_MRlySCB" SWORD DFC_OneToOne 1 100 -32768.00 32767.00 FORMAT "%8.2" ECU_ADDRESS 0x500058D8 /end MEASUREMENT
/begin MEASUREMENT DDRC_ctArDebLvl.DFC_MRlySCG "Debouncing counters / Debounce Timer or Event counter for check DFC_MRlySCG" SWORD DFC_OneToOne 1 100 -32768.00 32767.00 FORMAT "%8.2" ECU_ADDRESS 0x500058DA /end MEASUREMENT
/begin MEASUREMENT DDRC_ctArDebLvl.DFC_rba_MultiStackTrace_Threshold "Debouncing counters / Debounce Timer or Event counter for check DFC_rba_MultiStackTrace_Threshold" SWORD DFC_OneToOne 1 100 -32768.00 32767.00 FORMAT "%8.2" ECU_ADDRESS 0x500058DC /end MEASUREMENT
/begin MEASUREMENT DDRC_stLstRprtEve.DFC_BusDiagCANAPPLBusOff "Monitoring state / Monitoring state of DFC_BusDiagCANAPPLBusOff" UBYTE DDRC_LstRprtEve_VERB 1 100 0.00 255.000000000 FORMAT "%13.9" ECU_ADDRESS 0x600106D9 /end MEASUREMENT
/begin MEASUREMENT DDRC_stLstRprtEve.DFC_BusDiagCANCANCBusOff "Monitoring state / Monitoring state of DFC_BusDiagCANCANCBusOff" UBYTE DDRC_LstRprtEve_VERB 1 100 0.00 255.000000000 FORMAT "%13.9" ECU_ADDRESS 0x600106DA /end MEASUREMENT
/begin MEASUREMENT DDRC_stLstRprtEve.DFC_BusDiagCANVEHICLEBusOff "Monitoring state / Monitoring state of DFC_BusDiagCANVEHICLEBusOff" UBYTE DDRC_LstRprtEve_VERB 1 100 0.00 255.000000000 FORMAT "%13.9" ECU_ADDRESS 0x600106DB /end MEASUREMENT
/begin MEASUREMENT DDRC_stLstRprtEve.DFC_RBA_IODIAGPWR_rba_IoExtCy329_SignalVltSply_0 "Monitoring state / Monitoring state of DFC_RBA_IODIAGPWR_rba_IoExtCy329_SignalVltSply_0" UBYTE DDRC_LstRprtEve_VERB 1 100 0.00 255.000000000 FORMAT "%13.9" ECU_ADDRESS 0x600106DC /end MEASUREMENT
/begin MEASUREMENT DDRC_stLstRprtEve.DFC_RBA_IODIAGPWR_rba_IoExtCy329_SignalVltSply_0OT "Monitoring state / Monitoring state of DFC_RBA_IODIAGPWR_rba_IoExtCy329_SignalVltSply_0OT" UBYTE DDRC_LstRprtEve_VERB 1 100 0.00 255.000000000 FORMAT "%13.9" ECU_ADDRESS 0x600106DD /end MEASUREMENT
/begin MEASUREMENT DDRC_stLstRprtEve.DFC_RBA_IODIAGPWR_rba_IoExtCy329_SignalVltSply_0OV "Monitoring state / Monitoring state of DFC_RBA_IODIAGPWR_rba_IoExtCy329_SignalVltSply_0OV" UBYTE DDRC_LstRprtEve_VERB 1 100 0.00 255.000000000 FORMAT "%13.9" ECU_ADDRESS 0x600106DE /end MEASUREMENT
/begin MEASUREMENT DDRC_stLstRprtEve.DFC_RBA_IODIAGPWR_rba_IoExtCy329_SignalVltSply_0SCG "Monitoring state / Monitoring state of DFC_RBA_IODIAGPWR_rba_IoExtCy329_SignalVltSply_0SCG" UBYTE DDRC_LstRprtEve_VERB 1 100 0.00 255.000000000 FORMAT "%13.9" ECU_ADDRESS 0x600106DF /end MEASUREMENT
/begin MEASUREMENT DDRC_stLstRprtEve.DFC_RBA_IODIAGPWR_rba_IoExtCy329_SignalVltSply_0UV "Monitoring state / Monitoring state of DFC_RBA_IODIAGPWR_rba_IoExtCy329_SignalVltSply_0UV" UBYTE DDRC_LstRprtEve_VERB 1 100 0.00 255.000000000 FORMAT "%13.9" ECU_ADDRESS 0x600106E0 /end MEASUREMENT
/begin MEASUREMENT DDRC_stLstRprtEve.DFC_RBA_IODIAGPWR_rba_IoExtCy329_SignalVltSply_1 "Monitoring state / Monitoring state of DFC_RBA_IODIAGPWR_rba_IoExtCy329_SignalVltSply_1" UBYTE DDRC_LstRprtEve_VERB 1 100 0.00 255.000000000 FORMAT "%13.9" ECU_ADDRESS 0x600106E1 /end MEASUREMENT
/begin MEASUREMENT DDRC_stLstRprtEve.DFC_RBA_IODIAGPWR_rba_IoExtCy329_SignalVltSply_1OT "Monitoring state / Monitoring state of DFC_RBA_IODIAGPWR_rba_IoExtCy329_SignalVltSply_1OT" UBYTE DDRC_LstRprtEve_VERB 1 100 0.00 255.000000000 FORMAT "%13.9" ECU_ADDRESS 0x600106E2 /end MEASUREMENT
/begin MEASUREMENT DDRC_stLstRprtEve.DFC_RBA_IODIAGPWR_rba_IoExtCy329_SignalVltSply_1OV "Monitoring state / Monitoring state of DFC_RBA_IODIAGPWR_rba_IoExtCy329_SignalVltSply_1OV" UBYTE DDRC_LstRprtEve_VERB 1 100 0.00 255.000000000 FORMAT "%13.9" ECU_ADDRESS 0x600106E3 /end MEASUREMENT
/begin MEASUREMENT DDRC_stLstRprtEve.DFC_RBA_IODIAGPWR_rba_IoExtCy329_SignalVltSply_1SCG "Monitoring state / Monitoring state of DFC_RBA_IODIAGPWR_rba_IoExtCy329_SignalVltSply_1SCG" UBYTE DDRC_LstRprtEve_VERB 1 100 0.00 255.000000000 FORMAT "%13.9" ECU_ADDRESS 0x600106E4 /end MEASUREMENT
/begin MEASUREMENT DDRC_stLstRprtEve.DFC_RBA_IODIAGPWR_rba_IoExtCy329_SignalVltSply_1UV "Monitoring state / Monitoring state of DFC_RBA_IODIAGPWR_rba_IoExtCy329_SignalVltSply_1UV" UBYTE DDRC_LstRprtEve_VERB 1 100 0.00 255.000000000 FORMAT "%13.9" ECU_ADDRESS 0x600106E5 /end MEASUREMENT
/begin MEASUREMENT DDRC_stLstRprtEve.DFC_RBA_IODIAGPWR_rba_IoExtCy329_SignalVltSply_2 "Monitoring state / Monitoring state of DFC_RBA_IODIAGPWR_rba_IoExtCy329_SignalVltSply_2" UBYTE DDRC_LstRprtEve_VERB 1 100 0.00 255.000000000 FORMAT "%13.9" ECU_ADDRESS 0x600106E6 /end MEASUREMENT
/begin MEASUREMENT DDRC_stLstRprtEve.DFC_RBA_IODIAGPWR_rba_IoExtCy329_SignalVltSply_2OT "Monitoring state / Monitoring state of DFC_RBA_IODIAGPWR_rba_IoExtCy329_SignalVltSply_2OT" UBYTE DDRC_LstRprtEve_VERB 1 100 0.00 255.000000000 FORMAT "%13.9" ECU_ADDRESS 0x600106E7 /end MEASUREMENT
/begin MEASUREMENT DDRC_stLstRprtEve.DFC_RBA_IODIAGPWR_rba_IoExtCy329_SignalVltSply_2OV "Monitoring state / Monitoring state of DFC_RBA_IODIAGPWR_rba_IoExtCy329_SignalVltSply_2OV" UBYTE DDRC_LstRprtEve_VERB 1 100 0.00 255.000000000 FORMAT "%13.9" ECU_ADDRESS 0x600106E8 /end MEASUREMENT
/begin MEASUREMENT DDRC_stLstRprtEve.DFC_RBA_IODIAGPWR_rba_IoExtCy329_SignalVltSply_2SCG "Monitoring state / Monitoring state of DFC_RBA_IODIAGPWR_rba_IoExtCy329_SignalVltSply_2SCG" UBYTE DDRC_LstRprtEve_VERB 1 100 0.00 255.000000000 FORMAT "%13.9" ECU_ADDRESS 0x600106E9 /end MEASUREMENT
/begin MEASUREMENT DDRC_stLstRprtEve.DFC_RBA_IODIAGPWR_rba_IoExtCy329_SignalVltSply_2UV "Monitoring state / Monitoring state of DFC_RBA_IODIAGPWR_rba_IoExtCy329_SignalVltSply_2UV" UBYTE DDRC_LstRprtEve_VERB 1 100 0.00 255.000000000 FORMAT "%13.9" ECU_ADDRESS 0x600106EA /end MEASUREMENT
/begin MEASUREMENT DDRC_stLstRprtEve.DFC_CAN_E_TIMEOUT "Monitoring state / Monitoring state of DFC_CAN_E_TIMEOUT" UBYTE DDRC_LstRprtEve_VERB 1 100 0.00 255.000000000 FORMAT "%13.9" ECU_ADDRESS 0x600106EB /end MEASUREMENT
/begin MEASUREMENT DDRC_stLstRprtEve.DFC_LIN_E_TIMEOUT "Monitoring state / Monitoring state of DFC_LIN_E_TIMEOUT" UBYTE DDRC_LstRprtEve_VERB 1 100 0.00 255.000000000 FORMAT "%13.9" ECU_ADDRESS 0x600106EC /end MEASUREMENT
/begin MEASUREMENT DDRC_stLstRprtEve.DFC_MRlyOL "Monitoring state / Monitoring state of DFC_MRlyOL" UBYTE DDRC_LstRprtEve_VERB 1 100 0.00 255.000000000 FORMAT "%13.9" ECU_ADDRESS 0x600106ED /end MEASUREMENT
/begin MEASUREMENT DDRC_stLstRprtEve.DFC_MRlySCB "Monitoring state / Monitoring state of DFC_MRlySCB" UBYTE DDRC_LstRprtEve_VERB 1 100 0.00 255.000000000 FORMAT "%13.9" ECU_ADDRESS 0x600106EE /end MEASUREMENT
/begin MEASUREMENT DDRC_stLstRprtEve.DFC_MRlySCG "Monitoring state / Monitoring state of DFC_MRlySCG" UBYTE DDRC_LstRprtEve_VERB 1 100 0.00 255.000000000 FORMAT "%13.9" ECU_ADDRESS 0x600106EF /end MEASUREMENT
/begin MEASUREMENT DDRC_stLstRprtEve.DFC_rba_MultiStackTrace_Threshold "Monitoring state / Monitoring state of DFC_rba_MultiStackTrace_Threshold" UBYTE DDRC_LstRprtEve_VERB 1 100 0.00 255.000000000 FORMAT "%13.9" ECU_ADDRESS 0x600106F0 /end MEASUREMENT
/begin MEASUREMENT DELib_idxArrSnsr "" UWORD OneToOne 1 100 0.00 65535.00 FORMAT "%8.2" ARRAY_SIZE 18 ECU_ADDRESS 0x50005C64 /end MEASUREMENT
/begin MEASUREMENT DELib_numVar_mp "SW Version variant of DELibPackage (110 = DELibPackage_1.1.0)" UWORD OneToOne 1 100 0. 65535. FORMAT "%10.0" ECU_ADDRESS 0x600095EE /end MEASUREMENT
/begin MEASUREMENT DELib_num_mp "e_:SW Version of DELibPackage (1110 = DELibPackage.1.11.0):_e;d_:SW Version der DELibPackage 1110 = DELibPackage.1.11.0):_d" UWORD OneToOne 1 100 0. 65535. FORMAT "%10.0" ECU_ADDRESS 0x600095EC /end MEASUREMENT
/begin MEASUREMENT DELib_stArrSnsr "e_:SW Version of DELib calibration data:_e;d_:SW Version der Applikationsdaten:_d" UBYTE OneToOne 1 100 0.00 255.0 FORMAT "%5.1" ARRAY_SIZE 18 ECU_ADDRESS 0x6000F87D /end MEASUREMENT
/begin MEASUREMENT DELib_stEepTEngOff "Status bits of Eep Read/Write Process of the Engine Temperature" UBYTE OneToOne 1 100 0.00 255.0 FORMAT "%5.1" ECU_ADDRESS 0x6000F950 /end MEASUREMENT
/begin MEASUREMENT DELib_stFirstPreDrvOverCopy "" UBYTE OneToOne 1 100 0.00 255.0 FORMAT "%5.1" ECU_ADDRESS 0x6000F87C /end MEASUREMENT
/begin MEASUREMENT DELib_tEngOffEEP "" SWORD Temp_Cels 1 100 -3549.940 3003.560 FORMAT "%8.3" ECU_ADDRESS 0x600095B6 /end MEASUREMENT
/begin MEASUREMENT DELib_xArrSnsr "" FLOAT32_IEEE OneToOne 1 100 -1.00000000E+037 1.00000000E+037 FORMAT "%13.3" ARRAY_SIZE 18 ECU_ADDRESS 0x50004DC4 /end MEASUREMENT
/begin MEASUREMENT Dem_disableEventStatusUpdateGroup "Bit encoded DTCGroups disabled for EventStatusUpdate" UBYTE OneToOne 1 100 0.00 255.0 FORMAT "%5.1" ECU_ADDRESS 0x70006A87 /end MEASUREMENT
/begin MEASUREMENT Dem_DTCFltForFltDetnCntr "Adapter to transform DSM interfaces to DEM interfaces" UBYTE OneToOne 1 100 0.00 255.0 FORMAT "%5.1" ARRAY_SIZE 2 ECU_ADDRESS 0x70006A8A /end MEASUREMENT
/begin MEASUREMENT Dem_DTCFltFormat "DTCFormat parameter of current Dem_SetDTCFilter() request" UBYTE OneToOne 1 100 0.00 255.0 FORMAT "%5.1" ARRAY_SIZE 2 ECU_ADDRESS 0x70006A92 /end MEASUREMENT
/begin MEASUREMENT Dem_DTCFltOrigin "DTCOrigin parameter of current Dem_SetDTCFilter() request" UWORD OneToOne 1 100 0.00 65535.00 FORMAT "%8.2" ARRAY_SIZE 2 ECU_ADDRESS 0x700057A2 /end MEASUREMENT
/begin MEASUREMENT Dem_DTCFltProcCnt "Number of DTCs found to current Dem_SetDTCFilter() request" UWORD OneToOne 1 100 0.00 65535.00 FORMAT "%8.2" ARRAY_SIZE 2 ECU_ADDRESS 0x700057AE /end MEASUREMENT
/begin MEASUREMENT Dem_DTCFltProcIdx "Loop index for asynchron Dem_SetDTCFilter() processing" UWORD OneToOne 1 100 0.00 65535.00 FORMAT "%8.2" ARRAY_SIZE 2 ECU_ADDRESS 0x700057B2 /end MEASUREMENT
/begin MEASUREMENT Dem_DTCFltRecFormat "DTCFormat parameter of current Dem_SetFreezeFrameRecordFilter() request" UBYTE OneToOne 1 100 0.00 255.0 FORMAT "%5.1" ARRAY_SIZE 2 ECU_ADDRESS 0x70006A8C /end MEASUREMENT
/begin MEASUREMENT Dem_DTCFltRecRsltIdx "Index variable for incremental GetNextFilteredRecord output" UWORD OneToOne 1 100 0.00 65535.00 FORMAT "%8.2" ARRAY_SIZE 2 ECU_ADDRESS 0x700057A6 /end MEASUREMENT
/begin MEASUREMENT Dem_DTCFltRsltIdx "Index variable for incremental GetNextFilteredDTCxxx output" UWORD OneToOne 1 100 0.00 65535.00 FORMAT "%8.2" ARRAY_SIZE 2 ECU_ADDRESS 0x700057AA /end MEASUREMENT
/begin MEASUREMENT Dem_DTCFltSeverity "DTCSeverity parameter of current Dem_SetDTCFilter() request" UBYTE OneToOne 1 100 0.00 255.0 FORMAT "%5.1" ARRAY_SIZE 2 ECU_ADDRESS 0x70006A8E /end MEASUREMENT
/begin MEASUREMENT Dem_DTCFltSt "Current state of Dem_SetDTCFilter() processing" UBYTE Dem_DTCFltSt_Verb 1 100 0.00 5.00000000000 FORMAT "%13.11" ARRAY_SIZE 2 ECU_ADDRESS 0x70006A88 /end MEASUREMENT
/begin MEASUREMENT Dem_DTCFltStatusMask "DTCStatusMask parameter of current Dem_SetDTCFilter() request" UBYTE OneToOne 1 100 0.00 255.0 FORMAT "%5.1" ARRAY_SIZE 2 ECU_ADDRESS 0x70006A94 /end MEASUREMENT
/begin MEASUREMENT Dem_DTCFltWithSev "Adapter to transform DSM interfaces to DEM interfaces" UBYTE OneToOne 1 100 0.00 255.0 FORMAT "%5.1" ARRAY_SIZE 2 ECU_ADDRESS 0x70006A90 /end MEASUREMENT
/begin MEASUREMENT DETHSDFC_ctReIni "Counter used to re-initialize the variables by removing the re-ini proc" UBYTE OneToOne 1 100 0.00 255.0 FORMAT "%5.1" ECU_ADDRESS 0x6000E825 /end MEASUREMENT
/begin MEASUREMENT DevLib_stDigOutErr_mp "Measuring point that contains the error information received from HWE for the digital out signal selected by DevLib_DigOutDbgSig_C" ULONG OneToOne 1 100 0.00 4294967295.00 FORMAT "%13.2" ECU_ADDRESS 0x70009C34 /end MEASUREMENT
/begin MEASUREMENT DevLib_stDigOutPrevTst_mp "Measuring point for the previous test result for the digital out signal selected by DevLib_DigOutDbgSig_C" UWORD OneToOne 1 100 0.00 65535.00 FORMAT "%8.2" ECU_ADDRESS 0x70009EDA /end MEASUREMENT
/begin MEASUREMENT DevLib_stDigOutTstImp_mp "Measuring point for the frequency of the test impulse sent to the digital out powerstage selected by DevLib_DigOutDbgSig_C" UBYTE OneToOne 1 100 0.00 255.0 FORMAT "%5.1" ECU_ADDRESS 0x70009FE6 /end MEASUREMENT
/begin MEASUREMENT DevLib_stPWMOutErr_mp "Measuring point that contains the error information received from HWE for the PWM out signal selected by DevLib_PWMOutDbgSig_C" ULONG OneToOne 1 100 0.00 4294967295.00 FORMAT "%13.2" ECU_ADDRESS 0x70009C30 /end MEASUREMENT
/begin MEASUREMENT DevLib_stPWMOutPrevTst_mp "Measuring point for the previous test result for the PWM out signal selected by DevLib_PWMOutDbgSig_C" UWORD OneToOne 1 100 0.00 65535.00 FORMAT "%8.2" ECU_ADDRESS 0x70009ED8 /end MEASUREMENT
/begin MEASUREMENT DevLib_stPWMOutTstImp_mp "Measuring point for the frequency of the test impulse sent to the PWM out powerstage selected by DevLib_PWMOutDbgSig_C" UBYTE OneToOne 1 100 0.00 255.0 FORMAT "%5.1" ECU_ADDRESS 0x70009FE5 /end MEASUREMENT
/begin MEASUREMENT DevLib_stPwrStgEnaCond "" UWORD OneToOne 1 100 0.00 65535.00 FORMAT "%8.2" ECU_ADDRESS 0x600094D6 /end MEASUREMENT
/begin MEASUREMENT DFC_b.TST_AAVEmax "Bit encoding / Tested bit for check DFC_AAVEmax" UBYTE DFC_OneToOne 1 100 0.00 1.000 BIT_MASK 0x8 FORMAT "%5.3" ECU_ADDRESS 0x60036EBB /end MEASUREMENT
/begin MEASUREMENT DFC_b.TST_AAVEmin "Bit encoding / Tested bit for check DFC_AAVEmin" UBYTE DFC_OneToOne 1 100 0.00 1.000 BIT_MASK 0x8 FORMAT "%5.3" ECU_ADDRESS 0x60036EBC /end MEASUREMENT
/begin MEASUREMENT DFC_b.TST_AAVEsig "Bit encoding / Tested bit for check DFC_AAVEsig" UBYTE DFC_OneToOne 1 100 0.00 1.000 BIT_MASK 0x8 FORMAT "%5.3" ECU_ADDRESS 0x60036EBD /end MEASUREMENT
/begin MEASUREMENT DFC_b.TST_AltIOACGFailr "Bit encoding / Tested bit for check DFC_AltIOACGFailr" UBYTE DFC_OneToOne 1 100 0.00 1.000 BIT_MASK 0x8 FORMAT "%5.3" ECU_ADDRESS 0x60036EBE /end MEASUREMENT
/begin MEASUREMENT DFC_b.TST_AltIOACGHiVltg "Bit encoding / Tested bit for check DFC_AltIOACGHiVltg" UBYTE DFC_OneToOne 1 100 0.00 1.000 BIT_MASK 0x8 FORMAT "%5.3" ECU_ADDRESS 0x60036EBF /end MEASUREMENT
/begin MEASUREMENT DFC_b.TST_AltIOACGLoVltg "Bit encoding / Tested bit for check DFC_AltIOACGLoVltg" UBYTE DFC_OneToOne 1 100 0.00 1.000 BIT_MASK 0x8 FORMAT "%5.3" ECU_ADDRESS 0x60036EC0 /end MEASUREMENT
/begin MEASUREMENT DFC_b.TST_AltIOACGTHi "Bit encoding / Tested bit for check DFC_AltIOACGTHi" UBYTE DFC_OneToOne 1 100 0.00 1.000 BIT_MASK 0x8 FORMAT "%5.3" ECU_ADDRESS 0x60036EC1 /end MEASUREMENT
/begin MEASUREMENT DFC_b.TST_AltIODConnACG "Bit encoding / Tested bit for check DFC_AltIODConnACG" UBYTE DFC_OneToOne 1 100 0.00 1.000 BIT_MASK 0x8 FORMAT "%5.3" ECU_ADDRESS 0x60036EC2 /end MEASUREMENT
/begin MEASUREMENT DFC_b.TST_BGOELWAF "Bit encoding / Tested bit for check DFC_BGOELWAF" UBYTE DFC_OneToOne 1 100 0.00 1.000 BIT_MASK 0x8 FORMAT "%5.3" ECU_ADDRESS 0x60036EC3 /end MEASUREMENT
/begin MEASUREMENT DFC_b.TST_BattUHiFailr "Bit encoding / Tested bit for check DFC_BattUHiFailr" UBYTE DFC_OneToOne 1 100 0.00 1.000 BIT_MASK 0x8 FORMAT "%5.3" ECU_ADDRESS 0x60036EC4 /end MEASUREMENT
/begin MEASUREMENT DFC_b.TST_BattULoFailr "Bit encoding / Tested bit for check DFC_BattULoFailr" UBYTE DFC_OneToOne 1 100 0.00 1.000 BIT_MASK 0x8 FORMAT "%5.3" ECU_ADDRESS 0x60036EC5 /end MEASUREMENT
/begin MEASUREMENT DFC_b.TST_BrkBstPDriftHiErr "Bit encoding / Tested bit for check DFC_BrkBstPDriftHiErr" UBYTE DFC_OneToOne 1 100 0.00 1.000 BIT_MASK 0x8 FORMAT "%5.3" ECU_ADDRESS 0x60036EC6 /end MEASUREMENT
/begin MEASUREMENT DFC_b.TST_BrkBstPDriftLoErr "Bit encoding / Tested bit for check DFC_BrkBstPDriftLoErr" UBYTE DFC_OneToOne 1 100 0.00 1.000 BIT_MASK 0x8 FORMAT "%5.3" ECU_ADDRESS 0x60036EC7 /end MEASUREMENT
/begin MEASUREMENT DFC_b.TST_BrkBstPSnsrStuck "Bit encoding / Tested bit for check DFC_BrkBstPSnsrStuck" UBYTE DFC_OneToOne 1 100 0.00 1.000 BIT_MASK 0x8 FORMAT "%5.3" ECU_ADDRESS 0x60036EC8 /end MEASUREMENT
/begin MEASUREMENT DFC_b.TST_BrkMnSwtContOn "Bit encoding / Tested bit for check DFC_BrkMnSwtContOn" UBYTE DFC_OneToOne 1 100 0.00 1.000 BIT_MASK 0x8 FORMAT "%5.3" ECU_ADDRESS 0x60036EC9 /end MEASUREMENT
/begin MEASUREMENT DFC_b.TST_BrkMnSwtNotStp "Bit encoding / Tested bit for check DFC_BrkMnSwtNotStp" UBYTE DFC_OneToOne 1 100 0.00 1.000 BIT_MASK 0x8 FORMAT "%5.3" ECU_ADDRESS 0x60036ECA /end MEASUREMENT
/begin MEASUREMENT DFC_b.TST_BrkNpl "Bit encoding / Tested bit for check DFC_BrkNpl" UBYTE DFC_OneToOne 1 100 0.00 1.000 BIT_MASK 0x8 FORMAT "%5.3" ECU_ADDRESS 0x60036ECB /end MEASUREMENT
/begin MEASUREMENT DFC_b.TST_BrkRdntSwtContOn "Bit encoding / Tested bit for check DFC_BrkRdntSwtContOn" UBYTE DFC_OneToOne 1 100 0.00 1.000 BIT_MASK 0x8 FORMAT "%5.3" ECU_ADDRESS 0x60036ECC /end MEASUREMENT
/begin MEASUREMENT DFC_b.TST_BrkRdntSwtNotStp "Bit encoding / Tested bit for check DFC_BrkRdntSwtNotStp" UBYTE DFC_OneToOne 1 100 0.00 1.000 BIT_MASK 0x8 FORMAT "%5.3" ECU_ADDRESS 0x60036ECD /end MEASUREMENT
/begin MEASUREMENT DFC_b.TST_Clth3ONStuck "Bit encoding / Tested bit for check DFC_Clth3ONStuck" UBYTE DFC_OneToOne 1 100 0.00 1.000 BIT_MASK 0x8 FORMAT "%5.3" ECU_ADDRESS 0x60036ECE /end MEASUREMENT
/begin MEASUREMENT DFC_b.TST_Clth4OFFStuck "Bit encoding / Tested bit for check DFC_Clth4OFFStuck" UBYTE DFC_OneToOne 1 100 0.00 1.000 BIT_MASK 0x8 FORMAT "%5.3" ECU_ADDRESS 0x60036ECF /end MEASUREMENT
/begin MEASUREMENT DFC_b.TST_ClthOFFStuck "Bit encoding / Tested bit for check DFC_ClthOFFStuck" UBYTE DFC_OneToOne 1 100 0.00 1.000 BIT_MASK 0x8 FORMAT "%5.3" ECU_ADDRESS 0x60036ED0 /end MEASUREMENT
/begin MEASUREMENT DFC_b.TST_ClthONStuck "Bit encoding / Tested bit for check DFC_ClthONStuck" UBYTE DFC_OneToOne 1 100 0.00 1.000 BIT_MASK 0x8 FORMAT "%5.3" ECU_ADDRESS 0x60036ED1 /end MEASUREMENT
/begin MEASUREMENT DFC_b.TST_ClthStkFailInfo "Bit encoding / Tested bit for check DFC_ClthStkFailInfo" UBYTE DFC_OneToOne 1 100 0.00 1.000 BIT_MASK 0x8 FORMAT "%5.3" ECU_ADDRESS 0x60036ED2 /end MEASUREMENT
/begin MEASUREMENT DFC_b.TST_ComACFailInfo "Bit encoding / Tested bit for check DFC_ComACFailInfo" UBYTE DFC_OneToOne 1 100 0.00 1.000 BIT_MASK 0x8 FORMAT "%5.3" ECU_ADDRESS 0x60036ED3 /end MEASUREMENT
/begin MEASUREMENT DFC_b.TST_ComATFTValErr "Bit encoding / Tested bit for check DFC_ComATFTValErr" UBYTE DFC_OneToOne 1 100 0.00 1.000 BIT_MASK 0x8 FORMAT "%5.3" ECU_ADDRESS 0x60036ED4 /end MEASUREMENT
/begin MEASUREMENT DFC_b.TST_ComATMILReq "Bit encoding / Tested bit for check DFC_ComATMILReq" UBYTE DFC_OneToOne 1 100 0.00 1.000 BIT_MASK 0x8 FORMAT "%5.3" ECU_ADDRESS 0x60036ED5 /end MEASUREMENT
/begin MEASUREMENT DFC_b.TST_ComAYCAChksum "Bit encoding / Tested bit for check DFC_ComAYCAChksum" UBYTE DFC_OneToOne 1 100 0.00 1.000 BIT_MASK 0x8 FORMAT "%5.3" ECU_ADDRESS 0x60036ED6 /end MEASUREMENT
/begin MEASUREMENT DFC_b.TST_ComAYCARingCnt "Bit encoding / Tested bit for check DFC_ComAYCARingCnt" UBYTE DFC_OneToOne 1 100 0.00 1.000 BIT_MASK 0x8 FORMAT "%5.3" ECU_ADDRESS 0x60036ED7 /end MEASUREMENT
/begin MEASUREMENT DFC_b.TST_ComAYCATOut "Bit encoding / Tested bit for check DFC_ComAYCATOut" UBYTE DFC_OneToOne 1 100 0.00 1.000 BIT_MASK 0x8 FORMAT "%5.3" ECU_ADDRESS 0x60036ED8 /end MEASUREMENT
/begin MEASUREMENT DFC_b.TST_ComAYCDChkSum "Bit encoding / Tested bit for check DFC_ComAYCDChkSum" UBYTE DFC_OneToOne 1 100 0.00 1.000 BIT_MASK 0x8 FORMAT "%5.3" ECU_ADDRESS 0x60036ED9 /end MEASUREMENT
/begin MEASUREMENT DFC_b.TST_ComAYCDTOut "Bit encoding / Tested bit for check DFC_ComAYCDTOut" UBYTE DFC_OneToOne 1 100 0.00 1.000 BIT_MASK 0x8 FORMAT "%5.3" ECU_ADDRESS 0x60036EDA /end MEASUREMENT
/begin MEASUREMENT DFC_b.TST_ComAYCFChksum "Bit encoding / Tested bit for check DFC_ComAYCFChksum" UBYTE DFC_OneToOne 1 100 0.00 1.000 BIT_MASK 0x8 FORMAT "%5.3" ECU_ADDRESS 0x60036EDB /end MEASUREMENT
/begin MEASUREMENT DFC_b.TST_ComAYCFRingCnt "Bit encoding / Tested bit for check DFC_ComAYCFRingCnt" UBYTE DFC_OneToOne 1 100 0.00 1.000 BIT_MASK 0x8 FORMAT "%5.3" ECU_ADDRESS 0x60036EDC /end MEASUREMENT
/begin MEASUREMENT DFC_b.TST_ComAYCFTOut "Bit encoding / Tested bit for check DFC_ComAYCFTOut" UBYTE DFC_OneToOne 1 100 0.00 1.000 BIT_MASK 0x8 FORMAT "%5.3" ECU_ADDRESS 0x60036EDD /end MEASUREMENT
/begin MEASUREMENT DFC_b.TST_ComAYCGChksum "Bit encoding / Tested bit for check DFC_ComAYCGChksum" UBYTE DFC_OneToOne 1 100 0.00 1.000 BIT_MASK 0x8 FORMAT "%5.3" ECU_ADDRESS 0x60036EDE /end MEASUREMENT
/begin MEASUREMENT DFC_b.TST_ComAYCGRingCnt "Bit encoding / Tested bit for check DFC_ComAYCGRingCnt" UBYTE DFC_OneToOne 1 100 0.00 1.000 BIT_MASK 0x8 FORMAT "%5.3" ECU_ADDRESS 0x60036EDF /end MEASUREMENT
/begin MEASUREMENT DFC_b.TST_ComAYCGTOut "Bit encoding / Tested bit for check DFC_ComAYCGTOut" UBYTE DFC_OneToOne 1 100 0.00 1.000 BIT_MASK 0x8 FORMAT "%5.3" ECU_ADDRESS 0x60036EE0 /end MEASUREMENT
/begin MEASUREMENT DFC_b.TST_ComAYCIChkSum "Bit encoding / Tested bit for check DFC_ComAYCIChkSum" UBYTE DFC_OneToOne 1 100 0.00 1.000 BIT_MASK 0x8 FORMAT "%5.3" ECU_ADDRESS 0x60036EE1 /end MEASUREMENT
/begin MEASUREMENT DFC_b.TST_ComAYCIRingCnt "Bit encoding / Tested bit for check DFC_ComAYCIRingCnt" UBYTE DFC_OneToOne 1 100 0.00 1.000 BIT_MASK 0x8 FORMAT "%5.3" ECU_ADDRESS 0x60036EE2 /end MEASUREMENT
/begin MEASUREMENT DFC_b.TST_ComAYCITOut "Bit encoding / Tested bit for check DFC_ComAYCITOut" UBYTE DFC_OneToOne 1 100 0.00 1.000 BIT_MASK 0x8 FORMAT "%5.3" ECU_ADDRESS 0x60036EE3 /end MEASUREMENT
/begin MEASUREMENT DFC_b.TST_ComBCM1ChkSum "Bit encoding / Tested bit for check DFC_ComBCM1ChkSum" UBYTE DFC_OneToOne 1 100 0.00 1.000 BIT_MASK 0x8 FORMAT "%5.3" ECU_ADDRESS 0x60036EE4 /end MEASUREMENT
/begin MEASUREMENT DFC_b.TST_ComBCM1RingCnt "Bit encoding / Tested bit for check DFC_ComBCM1RingCnt" UBYTE DFC_OneToOne 1 100 0.00 1.000 BIT_MASK 0x8 FORMAT "%5.3" ECU_ADDRESS 0x60036EE5 /end MEASUREMENT
/begin MEASUREMENT DFC_b.TST_ComBCM1TOut "Bit encoding / Tested bit for check DFC_ComBCM1TOut" UBYTE DFC_OneToOne 1 100 0.00 1.000 BIT_MASK 0x8 FORMAT "%5.3" ECU_ADDRESS 0x60036EE6 /end MEASUREMENT
/begin MEASUREMENT DFC_b.TST_ComCANABusOffErr "Bit encoding / Tested bit for check DFC_ComCANABusOffErr" UBYTE DFC_OneToOne 1 100 0.00 1.000 BIT_MASK 0x8 FORMAT "%5.3" ECU_ADDRESS 0x60036EE7 /end MEASUREMENT
/begin MEASUREMENT DFC_b.TST_ComCANBBusOffErr "Bit encoding / Tested bit for check DFC_ComCANBBusOffErr" UBYTE DFC_OneToOne 1 100 0.00 1.000 BIT_MASK 0x8 FORMAT "%5.3" ECU_ADDRESS 0x60036EE8 /end MEASUREMENT
/begin MEASUREMENT DFC_b.TST_ComCANCBusOffErr "Bit encoding / Tested bit for check DFC_ComCANCBusOffErr" UBYTE DFC_OneToOne 1 100 0.00 1.000 BIT_MASK 0x8 FORMAT "%5.3" ECU_ADDRESS 0x60036EE9 /end MEASUREMENT
/begin MEASUREMENT DFC_b.TST_ComCGW1ChkSum "Bit encoding / Tested bit for check DFC_ComCGW1ChkSum" UBYTE DFC_OneToOne 1 100 0.00 1.000 BIT_MASK 0x8 FORMAT "%5.3" ECU_ADDRESS 0x60036EEA /end MEASUREMENT
/begin MEASUREMENT DFC_b.TST_ComCGW1RingCnt "Bit encoding / Tested bit for check DFC_ComCGW1RingCnt" UBYTE DFC_OneToOne 1 100 0.00 1.000 BIT_MASK 0x8 FORMAT "%5.3" ECU_ADDRESS 0x60036EEB /end MEASUREMENT
/begin MEASUREMENT DFC_b.TST_ComCGW1TOut "Bit encoding / Tested bit for check DFC_ComCGW1TOut" UBYTE DFC_OneToOne 1 100 0.00 1.000 BIT_MASK 0x8 FORMAT "%5.3" ECU_ADDRESS 0x60036EEC /end MEASUREMENT
/begin MEASUREMENT DFC_b.TST_ComConvBoostErr "Bit encoding / Tested bit for check DFC_ComConvBoostErr" UBYTE DFC_OneToOne 1 100 0.00 1.000 BIT_MASK 0x8 FORMAT "%5.3" ECU_ADDRESS 0x60036EED /end MEASUREMENT
/begin MEASUREMENT DFC_b.TST_ComConvSlipErr "Bit encoding / Tested bit for check DFC_ComConvSlipErr" UBYTE DFC_OneToOne 1 100 0.00 1.000 BIT_MASK 0x8 FORMAT "%5.3" ECU_ADDRESS 0x60036EEE /end MEASUREMENT
/begin MEASUREMENT DFC_b.TST_ComDCDCPrfmncErr "Bit encoding / Tested bit for check DFC_ComDCDCPrfmncErr" UBYTE DFC_OneToOne 1 100 0.00 1.000 BIT_MASK 0x8 FORMAT "%5.3" ECU_ADDRESS 0x60036EEF /end MEASUREMENT
/begin MEASUREMENT DFC_b.TST_ComDCDCTempWarn "Bit encoding / Tested bit for check DFC_ComDCDCTempWarn" UBYTE DFC_OneToOne 1 100 0.00 1.000 BIT_MASK 0x8 FORMAT "%5.3" ECU_ADDRESS 0x60036EF0 /end MEASUREMENT
/begin MEASUREMENT DFC_b.TST_ComEAT10Chksum "Bit encoding / Tested bit for check DFC_ComEAT10Chksum" UBYTE DFC_OneToOne 1 100 0.00 1.000 BIT_MASK 0x8 FORMAT "%5.3" ECU_ADDRESS 0x60036EF1 /end MEASUREMENT
/begin MEASUREMENT DFC_b.TST_ComEAT10RingCnt "Bit encoding / Tested bit for check DFC_ComEAT10RingCnt" UBYTE DFC_OneToOne 1 100 0.00 1.000 BIT_MASK 0x8 FORMAT "%5.3" ECU_ADDRESS 0x60036EF2 /end MEASUREMENT
/begin MEASUREMENT DFC_b.TST_ComEAT10TOut "Bit encoding / Tested bit for check DFC_ComEAT10TOut" UBYTE DFC_OneToOne 1 100 0.00 1.000 BIT_MASK 0x8 FORMAT "%5.3" ECU_ADDRESS 0x60036EF3 /end MEASUREMENT
/begin MEASUREMENT DFC_b.TST_ComEAT11ChkSum "Bit encoding / Tested bit for check DFC_ComEAT11ChkSum" UBYTE DFC_OneToOne 1 100 0.00 1.000 BIT_MASK 0x8 FORMAT "%5.3" ECU_ADDRESS 0x60036EF4 /end MEASUREMENT
/begin MEASUREMENT DFC_b.TST_ComEAT11RingCnt "Bit encoding / Tested bit for check DFC_ComEAT11RingCnt" UBYTE DFC_OneToOne 1 100 0.00 1.000 BIT_MASK 0x8 FORMAT "%5.3" ECU_ADDRESS 0x60036EF5 /end MEASUREMENT
/begin MEASUREMENT DFC_b.TST_ComEAT11TOut "Bit encoding / Tested bit for check DFC_ComEAT11TOut" UBYTE DFC_OneToOne 1 100 0.00 1.000 BIT_MASK 0x8 FORMAT "%5.3" ECU_ADDRESS 0x60036EF6 /end MEASUREMENT
/begin MEASUREMENT DFC_b.TST_ComEAT12ChkSum "Bit encoding / Tested bit for check DFC_ComEAT12ChkSum" UBYTE DFC_OneToOne 1 100 0.00 1.000 BIT_MASK 0x8 FORMAT "%5.3" ECU_ADDRESS 0x60036EF7 /end MEASUREMENT
/begin MEASUREMENT DFC_b.TST_ComEAT12RingCnt "Bit encoding / Tested bit for check DFC_ComEAT12RingCnt" UBYTE DFC_OneToOne 1 100 0.00 1.000 BIT_MASK 0x8 FORMAT "%5.3" ECU_ADDRESS 0x60036EF8 /end MEASUREMENT
/begin MEASUREMENT DFC_b.TST_ComEAT12TOut "Bit encoding / Tested bit for check DFC_ComEAT12TOut" UBYTE DFC_OneToOne 1 100 0.00 1.000 BIT_MASK 0x8 FORMAT "%5.3" ECU_ADDRESS 0x60036EF9 /end MEASUREMENT
/begin MEASUREMENT DFC_b.TST_ComEAT13ChkSum "Bit encoding / Tested bit for check DFC_ComEAT13ChkSum" UBYTE DFC_OneToOne 1 100 0.00 1.000 BIT_MASK 0x8 FORMAT "%5.3" ECU_ADDRESS 0x60036EFA /end MEASUREMENT
/begin MEASUREMENT DFC_b.TST_ComEAT13RingCnt "Bit encoding / Tested bit for check DFC_ComEAT13RingCnt" UBYTE DFC_OneToOne 1 100 0.00 1.000 BIT_MASK 0x8 FORMAT "%5.3" ECU_ADDRESS 0x60036EFB /end MEASUREMENT
/begin MEASUREMENT DFC_b.TST_ComEAT13TOut "Bit encoding / Tested bit for check DFC_ComEAT13TOut" UBYTE DFC_OneToOne 1 100 0.00 1.000 BIT_MASK 0x8 FORMAT "%5.3" ECU_ADDRESS 0x60036EFC /end MEASUREMENT
/begin MEASUREMENT DFC_b.TST_ComEAT1Chksum "Bit encoding / Tested bit for check DFC_ComEAT1Chksum" UBYTE DFC_OneToOne 1 100 0.00 1.000 BIT_MASK 0x8 FORMAT "%5.3" ECU_ADDRESS 0x60036EFD /end MEASUREMENT
/begin MEASUREMENT DFC_b.TST_ComEAT1RingCnt "Bit encoding / Tested bit for check DFC_ComEAT1RingCnt" UBYTE DFC_OneToOne 1 100 0.00 1.000 BIT_MASK 0x8 FORMAT "%5.3" ECU_ADDRESS 0x60036EFE /end MEASUREMENT
/begin MEASUREMENT DFC_b.TST_ComEAT1TOut "Bit encoding / Tested bit for check DFC_ComEAT1TOut" UBYTE DFC_OneToOne 1 100 0.00 1.000 BIT_MASK 0x8 FORMAT "%5.3" ECU_ADDRESS 0x60036EFF /end MEASUREMENT
/begin MEASUREMENT DFC_b.TST_ComEAT2ChkSum "Bit encoding / Tested bit for check DFC_ComEAT2ChkSum" UBYTE DFC_OneToOne 1 100 0.00 1.000 BIT_MASK 0x8 FORMAT "%5.3" ECU_ADDRESS 0x60036F00 /end MEASUREMENT
/begin MEASUREMENT DFC_b.TST_ComEAT2RingCnt "Bit encoding / Tested bit for check DFC_ComEAT2RingCnt" UBYTE DFC_OneToOne 1 100 0.00 1.000 BIT_MASK 0x8 FORMAT "%5.3" ECU_ADDRESS 0x60036F01 /end MEASUREMENT
/begin MEASUREMENT DFC_b.TST_ComEAT2TOut "Bit encoding / Tested bit for check DFC_ComEAT2TOut" UBYTE DFC_OneToOne 1 100 0.00 1.000 BIT_MASK 0x8 FORMAT "%5.3" ECU_ADDRESS 0x60036F02 /end MEASUREMENT
/begin MEASUREMENT DFC_b.TST_ComEAT4ChkSum "Bit encoding / Tested bit for check DFC_ComEAT4ChkSum" UBYTE DFC_OneToOne 1 100 0.00 1.000 BIT_MASK 0x8 FORMAT "%5.3" ECU_ADDRESS 0x60036F03 /end MEASUREMENT
/begin MEASUREMENT DFC_b.TST_ComEAT4RingCnt "Bit encoding / Tested bit for check DFC_ComEAT4RingCnt" UBYTE DFC_OneToOne 1 100 0.00 1.000 BIT_MASK 0x8 FORMAT "%5.3" ECU_ADDRESS 0x60036F04 /end MEASUREMENT
/begin MEASUREMENT DFC_b.TST_ComEAT4TOut "Bit encoding / Tested bit for check DFC_ComEAT4TOut" UBYTE DFC_OneToOne 1 100 0.00 1.000 BIT_MASK 0x8 FORMAT "%5.3" ECU_ADDRESS 0x60036F05 /end MEASUREMENT
/begin MEASUREMENT DFC_b.TST_ComEAT6Chksum "Bit encoding / Tested bit for check DFC_ComEAT6Chksum" UBYTE DFC_OneToOne 1 100 0.00 1.000 BIT_MASK 0x8 FORMAT "%5.3" ECU_ADDRESS 0x60036F06 /end MEASUREMENT
/begin MEASUREMENT DFC_b.TST_ComEAT6RingCnt "Bit encoding / Tested bit for check DFC_ComEAT6RingCnt" UBYTE DFC_OneToOne 1 100 0.00 1.000 BIT_MASK 0x8 FORMAT "%5.3" ECU_ADDRESS 0x60036F07 /end MEASUREMENT
/begin MEASUREMENT DFC_b.TST_ComEAT6TOut "Bit encoding / Tested bit for check DFC_ComEAT6TOut" UBYTE DFC_OneToOne 1 100 0.00 1.000 BIT_MASK 0x8 FORMAT "%5.3" ECU_ADDRESS 0x60036F08 /end MEASUREMENT
/begin MEASUREMENT DFC_b.TST_ComEAT7Chksum "Bit encoding / Tested bit for check DFC_ComEAT7Chksum" UBYTE DFC_OneToOne 1 100 0.00 1.000 BIT_MASK 0x8 FORMAT "%5.3" ECU_ADDRESS 0x60036F09 /end MEASUREMENT
/begin MEASUREMENT DFC_b.TST_ComEAT7RingCnt "Bit encoding / Tested bit for check DFC_ComEAT7RingCnt" UBYTE DFC_OneToOne 1 100 0.00 1.000 BIT_MASK 0x8 FORMAT "%5.3" ECU_ADDRESS 0x60036F0A /end MEASUREMENT
/begin MEASUREMENT DFC_b.TST_ComEAT7TOut "Bit encoding / Tested bit for check DFC_ComEAT7TOut" UBYTE DFC_OneToOne 1 100 0.00 1.000 BIT_MASK 0x8 FORMAT "%5.3" ECU_ADDRESS 0x60036F0B /end MEASUREMENT
/begin MEASUREMENT DFC_b.TST_ComEAT8Chksum "Bit encoding / Tested bit for check DFC_ComEAT8Chksum" UBYTE DFC_OneToOne 1 100 0.00 1.000 BIT_MASK 0x8 FORMAT "%5.3" ECU_ADDRESS 0x60036F0C /end MEASUREMENT
/begin MEASUREMENT DFC_b.TST_ComEAT8RingCnt "Bit encoding / Tested bit for check DFC_ComEAT8RingCnt" UBYTE DFC_OneToOne 1 100 0.00 1.000 BIT_MASK 0x8 FORMAT "%5.3" ECU_ADDRESS 0x60036F0D /end MEASUREMENT
/begin MEASUREMENT DFC_b.TST_ComEAT8TOut "Bit encoding / Tested bit for check DFC_ComEAT8TOut" UBYTE DFC_OneToOne 1 100 0.00 1.000 BIT_MASK 0x8 FORMAT "%5.3" ECU_ADDRESS 0x60036F0E /end MEASUREMENT
/begin MEASUREMENT DFC_b.TST_ComEATAChksum "Bit encoding / Tested bit for check DFC_ComEATAChksum" UBYTE DFC_OneToOne 1 100 0.00 1.000 BIT_MASK 0x8 FORMAT "%5.3" ECU_ADDRESS 0x60036F0F /end MEASUREMENT
/begin MEASUREMENT DFC_b.TST_ComEATARingCnt "Bit encoding / Tested bit for check DFC_ComEATARingCnt" UBYTE DFC_OneToOne 1 100 0.00 1.000 BIT_MASK 0x8 FORMAT "%5.3" ECU_ADDRESS 0x60036F10 /end MEASUREMENT
/begin MEASUREMENT DFC_b.TST_ComEATATOut "Bit encoding / Tested bit for check DFC_ComEATATOut" UBYTE DFC_OneToOne 1 100 0.00 1.000 BIT_MASK 0x8 FORMAT "%5.3" ECU_ADDRESS 0x60036F11 /end MEASUREMENT
/begin MEASUREMENT DFC_b.TST_ComEATBChkSum "Bit encoding / Tested bit for check DFC_ComEATBChkSum" UBYTE DFC_OneToOne 1 100 0.00 1.000 BIT_MASK 0x8 FORMAT "%5.3" ECU_ADDRESS 0x60036F12 /end MEASUREMENT
/begin MEASUREMENT DFC_b.TST_ComEATBRingCnt "Bit encoding / Tested bit for check DFC_ComEATBRingCnt" UBYTE DFC_OneToOne 1 100 0.00 1.000 BIT_MASK 0x8 FORMAT "%5.3" ECU_ADDRESS 0x60036F13 /end MEASUREMENT
/begin MEASUREMENT DFC_b.TST_ComEATBTOut "Bit encoding / Tested bit for check DFC_ComEATBTOut" UBYTE DFC_OneToOne 1 100 0.00 1.000 BIT_MASK 0x8 FORMAT "%5.3" ECU_ADDRESS 0x60036F14 /end MEASUREMENT
/begin MEASUREMENT DFC_b.TST_ComEATCChksum "Bit encoding / Tested bit for check DFC_ComEATCChksum" UBYTE DFC_OneToOne 1 100 0.00 1.000 BIT_MASK 0x8 FORMAT "%5.3" ECU_ADDRESS 0x60036F15 /end MEASUREMENT
/begin MEASUREMENT DFC_b.TST_ComEATCRingCnt "Bit encoding / Tested bit for check DFC_ComEATCRingCnt" UBYTE DFC_OneToOne 1 100 0.00 1.000 BIT_MASK 0x8 FORMAT "%5.3" ECU_ADDRESS 0x60036F16 /end MEASUREMENT
/begin MEASUREMENT DFC_b.TST_ComEATCTOut "Bit encoding / Tested bit for check DFC_ComEATCTOut" UBYTE DFC_OneToOne 1 100 0.00 1.000 BIT_MASK 0x8 FORMAT "%5.3" ECU_ADDRESS 0x60036F17 /end MEASUREMENT
/begin MEASUREMENT DFC_b.TST_ComEPBBChkSum "Bit encoding / Tested bit for check DFC_ComEPBBChkSum" UBYTE DFC_OneToOne 1 100 0.00 1.000 BIT_MASK 0x8 FORMAT "%5.3" ECU_ADDRESS 0x60036F18 /end MEASUREMENT
/begin MEASUREMENT DFC_b.TST_ComEPBBRingCnt "Bit encoding / Tested bit for check DFC_ComEPBBRingCnt" UBYTE DFC_OneToOne 1 100 0.00 1.000 BIT_MASK 0x8 FORMAT "%5.3" ECU_ADDRESS 0x60036F19 /end MEASUREMENT
/begin MEASUREMENT DFC_b.TST_ComEPBBTOut "Bit encoding / Tested bit for check DFC_ComEPBBTOut" UBYTE DFC_OneToOne 1 100 0.00 1.000 BIT_MASK 0x8 FORMAT "%5.3" ECU_ADDRESS 0x60036F1A /end MEASUREMENT
/begin MEASUREMENT DFC_b.TST_ComEPBChksum "Bit encoding / Tested bit for check DFC_ComEPBChksum" UBYTE DFC_OneToOne 1 100 0.00 1.000 BIT_MASK 0x8 FORMAT "%5.3" ECU_ADDRESS 0x60036F1B /end MEASUREMENT
/begin MEASUREMENT DFC_b.TST_ComEPBTOut "Bit encoding / Tested bit for check DFC_ComEPBTOut" UBYTE DFC_OneToOne 1 100 0.00 1.000 BIT_MASK 0x8 FORMAT "%5.3" ECU_ADDRESS 0x60036F1C /end MEASUREMENT
/begin MEASUREMENT DFC_b.TST_ComEPBctRing "Bit encoding / Tested bit for check DFC_ComEPBctRing" UBYTE DFC_OneToOne 1 100 0.00 1.000 BIT_MASK 0x8 FORMAT "%5.3" ECU_ADDRESS 0x60036F1D /end MEASUREMENT
/begin MEASUREMENT DFC_b.TST_ComEPS1Chksum "Bit encoding / Tested bit for check DFC_ComEPS1Chksum" UBYTE DFC_OneToOne 1 100 0.00 1.000 BIT_MASK 0x8 FORMAT "%5.3" ECU_ADDRESS 0x60036F1E /end MEASUREMENT
/begin MEASUREMENT DFC_b.TST_ComEPS1RingCnt "Bit encoding / Tested bit for check DFC_ComEPS1RingCnt" UBYTE DFC_OneToOne 1 100 0.00 1.000 BIT_MASK 0x8 FORMAT "%5.3" ECU_ADDRESS 0x60036F1F /end MEASUREMENT
/begin MEASUREMENT DFC_b.TST_ComEPS1TOut "Bit encoding / Tested bit for check DFC_ComEPS1TOut" UBYTE DFC_OneToOne 1 100 0.00 1.000 BIT_MASK 0x8 FORMAT "%5.3" ECU_ADDRESS 0x60036F20 /end MEASUREMENT
/begin MEASUREMENT DFC_b.TST_ComEngCanRxErr "Bit encoding / Tested bit for check DFC_ComEngCanRxErr" UBYTE DFC_OneToOne 1 100 0.00 1.000 BIT_MASK 0x8 FORMAT "%5.3" ECU_ADDRESS 0x60036F21 /end MEASUREMENT
/begin MEASUREMENT DFC_b.TST_ComGrvySnsrErr "Bit encoding / Tested bit for check DFC_ComGrvySnsrErr" UBYTE DFC_OneToOne 1 100 0.00 1.000 BIT_MASK 0x8 FORMAT "%5.3" ECU_ADDRESS 0x60036F22 /end MEASUREMENT
/begin MEASUREMENT DFC_b.TST_ComGwIMG1ChkSum "Bit encoding / Tested bit for check DFC_ComGwIMG1ChkSum" UBYTE DFC_OneToOne 1 100 0.00 1.000 BIT_MASK 0x8 FORMAT "%5.3" ECU_ADDRESS 0x60036F23 /end MEASUREMENT
/begin MEASUREMENT DFC_b.TST_ComGwIMG1RingCnt "Bit encoding / Tested bit for check DFC_ComGwIMG1RingCnt" UBYTE DFC_OneToOne 1 100 0.00 1.000 BIT_MASK 0x8 FORMAT "%5.3" ECU_ADDRESS 0x60036F24 /end MEASUREMENT
/begin MEASUREMENT DFC_b.TST_ComGwIMG1TOut "Bit encoding / Tested bit for check DFC_ComGwIMG1TOut" UBYTE DFC_OneToOne 1 100 0.00 1.000 BIT_MASK 0x8 FORMAT "%5.3" ECU_ADDRESS 0x60036F25 /end MEASUREMENT
/begin MEASUREMENT DFC_b.TST_ComGwIMG3ChkSum "Bit encoding / Tested bit for check DFC_ComGwIMG3ChkSum" UBYTE DFC_OneToOne 1 100 0.00 1.000 BIT_MASK 0x8 FORMAT "%5.3" ECU_ADDRESS 0x60036F26 /end MEASUREMENT
/begin MEASUREMENT DFC_b.TST_ComGwIMG3RingCnt "Bit encoding / Tested bit for check DFC_ComGwIMG3RingCnt" UBYTE DFC_OneToOne 1 100 0.00 1.000 BIT_MASK 0x8 FORMAT "%5.3" ECU_ADDRESS 0x60036F27 /end MEASUREMENT
/begin MEASUREMENT DFC_b.TST_ComGwIMG3TOut "Bit encoding / Tested bit for check DFC_ComGwIMG3TOut" UBYTE DFC_OneToOne 1 100 0.00 1.000 BIT_MASK 0x8 FORMAT "%5.3" ECU_ADDRESS 0x60036F28 /end MEASUREMENT
/begin MEASUREMENT DFC_b.TST_ComGwIMG4ChkSum "Bit encoding / Tested bit for check DFC_ComGwIMG4ChkSum" UBYTE DFC_OneToOne 1 100 0.00 1.000 BIT_MASK 0x8 FORMAT "%5.3" ECU_ADDRESS 0x60036F29 /end MEASUREMENT
/begin MEASUREMENT DFC_b.TST_ComGwIMG4RingCnt "Bit encoding / Tested bit for check DFC_ComGwIMG4RingCnt" UBYTE DFC_OneToOne 1 100 0.00 1.000 BIT_MASK 0x8 FORMAT "%5.3" ECU_ADDRESS 0x60036F2A /end MEASUREMENT
/begin MEASUREMENT DFC_b.TST_ComGwIMG4TOut "Bit encoding / Tested bit for check DFC_ComGwIMG4TOut" UBYTE DFC_OneToOne 1 100 0.00 1.000 BIT_MASK 0x8 FORMAT "%5.3" ECU_ADDRESS 0x60036F2B /end MEASUREMENT
/begin MEASUREMENT DFC_b.TST_ComGwIMG5ChkSum "Bit encoding / Tested bit for check DFC_ComGwIMG5ChkSum" UBYTE DFC_OneToOne 1 100 0.00 1.000 BIT_MASK 0x8 FORMAT "%5.3" ECU_ADDRESS 0x60036F2C /end MEASUREMENT
/begin MEASUREMENT DFC_b.TST_ComGwIMG5RingCnt "Bit encoding / Tested bit for check DFC_ComGwIMG5RingCnt" UBYTE DFC_OneToOne 1 100 0.00 1.000 BIT_MASK 0x8 FORMAT "%5.3" ECU_ADDRESS 0x60036F2D /end MEASUREMENT
/begin MEASUREMENT DFC_b.TST_ComGwIMG5TOut "Bit encoding / Tested bit for check DFC_ComGwIMG5TOut" UBYTE DFC_OneToOne 1 100 0.00 1.000 BIT_MASK 0x8 FORMAT "%5.3" ECU_ADDRESS 0x60036F2E /end MEASUREMENT
/begin MEASUREMENT DFC_b.TST_ComGwIMG6ChkSum "Bit encoding / Tested bit for check DFC_ComGwIMG6ChkSum" UBYTE DFC_OneToOne 1 100 0.00 1.000 BIT_MASK 0x8 FORMAT "%5.3" ECU_ADDRESS 0x60036F2F /end MEASUREMENT
/begin MEASUREMENT DFC_b.TST_ComGwIMG6RingCnt "Bit encoding / Tested bit for check DFC_ComGwIMG6RingCnt" UBYTE DFC_OneToOne 1 100 0.00 1.000 BIT_MASK 0x8 FORMAT "%5.3" ECU_ADDRESS 0x60036F30 /end MEASUREMENT
/begin MEASUREMENT DFC_b.TST_ComGwIMG6TOut "Bit encoding / Tested bit for check DFC_ComGwIMG6TOut" UBYTE DFC_OneToOne 1 100 0.00 1.000 BIT_MASK 0x8 FORMAT "%5.3" ECU_ADDRESS 0x60036F31 /end MEASUREMENT
/begin MEASUREMENT DFC_b.TST_ComIDASBChksum "Bit encoding / Tested bit for check DFC_ComIDASBChksum" UBYTE DFC_OneToOne 1 100 0.00 1.000 BIT_MASK 0x8 FORMAT "%5.3" ECU_ADDRESS 0x60036F32 /end MEASUREMENT
/begin MEASUREMENT DFC_b.TST_ComIDASBRingCnt "Bit encoding / Tested bit for check DFC_ComIDASBRingCnt" UBYTE DFC_OneToOne 1 100 0.00 1.000 BIT_MASK 0x8 FORMAT "%5.3" ECU_ADDRESS 0x60036F33 /end MEASUREMENT
/begin MEASUREMENT DFC_b.TST_ComIDASBTOut "Bit encoding / Tested bit for check DFC_ComIDASBTOut" UBYTE DFC_OneToOne 1 100 0.00 1.000 BIT_MASK 0x8 FORMAT "%5.3" ECU_ADDRESS 0x60036F34 /end MEASUREMENT
/begin MEASUREMENT DFC_b.TST_ComIMGMILReq "Bit encoding / Tested bit for check DFC_ComIMGMILReq" UBYTE DFC_OneToOne 1 100 0.00 1.000 BIT_MASK 0x8 FORMAT "%5.3" ECU_ADDRESS 0x60036F35 /end MEASUREMENT
/begin MEASUREMENT DFC_b.TST_ComISSPrms "Bit encoding / Tested bit for check DFC_ComISSPrms" UBYTE DFC_OneToOne 1 100 0.00 1.000 BIT_MASK 0x8 FORMAT "%5.3" ECU_ADDRESS 0x60036F36 /end MEASUREMENT
/begin MEASUREMENT DFC_b.TST_ComMETAChksum "Bit encoding / Tested bit for check DFC_ComMETAChksum" UBYTE DFC_OneToOne 1 100 0.00 1.000 BIT_MASK 0x8 FORMAT "%5.3" ECU_ADDRESS 0x60036F37 /end MEASUREMENT
/begin MEASUREMENT DFC_b.TST_ComMETAChksumPstDrv "Bit encoding / Tested bit for check DFC_ComMETAChksumPstDrv" UBYTE DFC_OneToOne 1 100 0.00 1.000 BIT_MASK 0x8 FORMAT "%5.3" ECU_ADDRESS 0x60036F38 /end MEASUREMENT
/begin MEASUREMENT DFC_b.TST_ComMETARingCnt "Bit encoding / Tested bit for check DFC_ComMETARingCnt" UBYTE DFC_OneToOne 1 100 0.00 1.000 BIT_MASK 0x8 FORMAT "%5.3" ECU_ADDRESS 0x60036F39 /end MEASUREMENT
/begin MEASUREMENT DFC_b.TST_ComMETARingCntPstDrv "Bit encoding / Tested bit for check DFC_ComMETARingCntPstDrv" UBYTE DFC_OneToOne 1 100 0.00 1.000 BIT_MASK 0x8 FORMAT "%5.3" ECU_ADDRESS 0x60036F3A /end MEASUREMENT
/begin MEASUREMENT DFC_b.TST_ComMETATOut "Bit encoding / Tested bit for check DFC_ComMETATOut" UBYTE DFC_OneToOne 1 100 0.00 1.000 BIT_MASK 0x8 FORMAT "%5.3" ECU_ADDRESS 0x60036F3B /end MEASUREMENT
/begin MEASUREMENT DFC_b.TST_ComMETATOutPstDrv "Bit encoding / Tested bit for check DFC_ComMETATOutPstDrv" UBYTE DFC_OneToOne 1 100 0.00 1.000 BIT_MASK 0x8 FORMAT "%5.3" ECU_ADDRESS 0x60036F3C /end MEASUREMENT
/begin MEASUREMENT DFC_b.TST_ComMETCChksum "Bit encoding / Tested bit for check DFC_ComMETCChksum" UBYTE DFC_OneToOne 1 100 0.00 1.000 BIT_MASK 0x8 FORMAT "%5.3" ECU_ADDRESS 0x60036F3D /end MEASUREMENT
/begin MEASUREMENT DFC_b.TST_ComMETCRingCnt "Bit encoding / Tested bit for check DFC_ComMETCRingCnt" UBYTE DFC_OneToOne 1 100 0.00 1.000 BIT_MASK 0x8 FORMAT "%5.3" ECU_ADDRESS 0x60036F3E /end MEASUREMENT
/begin MEASUREMENT DFC_b.TST_ComMETCTOut "Bit encoding / Tested bit for check DFC_ComMETCTOut" UBYTE DFC_OneToOne 1 100 0.00 1.000 BIT_MASK 0x8 FORMAT "%5.3" ECU_ADDRESS 0x60036F3F /end MEASUREMENT
/begin MEASUREMENT DFC_b.TST_ComMETDChksum "Bit encoding / Tested bit for check DFC_ComMETDChksum" UBYTE DFC_OneToOne 1 100 0.00 1.000 BIT_MASK 0x8 FORMAT "%5.3" ECU_ADDRESS 0x60036F40 /end MEASUREMENT
/begin MEASUREMENT DFC_b.TST_ComMETDRingCnt "Bit encoding / Tested bit for check DFC_ComMETDRingCnt" UBYTE DFC_OneToOne 1 100 0.00 1.000 BIT_MASK 0x8 FORMAT "%5.3" ECU_ADDRESS 0x60036F41 /end MEASUREMENT
/begin MEASUREMENT DFC_b.TST_ComMETDTOut "Bit encoding / Tested bit for check DFC_ComMETDTOut" UBYTE DFC_OneToOne 1 100 0.00 1.000 BIT_MASK 0x8 FORMAT "%5.3" ECU_ADDRESS 0x60036F42 /end MEASUREMENT
/begin MEASUREMENT DFC_b.TST_ComMETE2Chksum "Bit encoding / Tested bit for check DFC_ComMETE2Chksum" UBYTE DFC_OneToOne 1 100 0.00 1.000 BIT_MASK 0x8 FORMAT "%5.3" ECU_ADDRESS 0x60036F43 /end MEASUREMENT
/begin MEASUREMENT DFC_b.TST_ComMETE2RingCnt "Bit encoding / Tested bit for check DFC_ComMETE2RingCnt" UBYTE DFC_OneToOne 1 100 0.00 1.000 BIT_MASK 0x8 FORMAT "%5.3" ECU_ADDRESS 0x60036F44 /end MEASUREMENT
/begin MEASUREMENT DFC_b.TST_ComMETE2TOut "Bit encoding / Tested bit for check DFC_ComMETE2TOut" UBYTE DFC_OneToOne 1 100 0.00 1.000 BIT_MASK 0x8 FORMAT "%5.3" ECU_ADDRESS 0x60036F45 /end MEASUREMENT
/begin MEASUREMENT DFC_b.TST_ComMETFChksum "Bit encoding / Tested bit for check DFC_ComMETFChksum" UBYTE DFC_OneToOne 1 100 0.00 1.000 BIT_MASK 0x8 FORMAT "%5.3" ECU_ADDRESS 0x60036F46 /end MEASUREMENT
/begin MEASUREMENT DFC_b.TST_ComMETFRingCnt "Bit encoding / Tested bit for check DFC_ComMETFRingCnt" UBYTE DFC_OneToOne 1 100 0.00 1.000 BIT_MASK 0x8 FORMAT "%5.3" ECU_ADDRESS 0x60036F47 /end MEASUREMENT
/begin MEASUREMENT DFC_b.TST_ComMETFTOut "Bit encoding / Tested bit for check DFC_ComMETFTOut" UBYTE DFC_OneToOne 1 100 0.00 1.000 BIT_MASK 0x8 FORMAT "%5.3" ECU_ADDRESS 0x60036F48 /end MEASUREMENT
/begin MEASUREMENT DFC_b.TST_ComMETGChksum "Bit encoding / Tested bit for check DFC_ComMETGChksum" UBYTE DFC_OneToOne 1 100 0.00 1.000 BIT_MASK 0x8 FORMAT "%5.3" ECU_ADDRESS 0x60036F49 /end MEASUREMENT
/begin MEASUREMENT DFC_b.TST_ComMETGRingCnt "Bit encoding / Tested bit for check DFC_ComMETGRingCnt" UBYTE DFC_OneToOne 1 100 0.00 1.000 BIT_MASK 0x8 FORMAT "%5.3" ECU_ADDRESS 0x60036F4A /end MEASUREMENT
/begin MEASUREMENT DFC_b.TST_ComMETGTOut "Bit encoding / Tested bit for check DFC_ComMETGTOut" UBYTE DFC_OneToOne 1 100 0.00 1.000 BIT_MASK 0x8 FORMAT "%5.3" ECU_ADDRESS 0x60036F4B /end MEASUREMENT
/begin MEASUREMENT DFC_b.TST_ComMETH2Chksum "Bit encoding / Tested bit for check DFC_ComMETH2Chksum" UBYTE DFC_OneToOne 1 100 0.00 1.000 BIT_MASK 0x8 FORMAT "%5.3" ECU_ADDRESS 0x60036F4C /end MEASUREMENT
/begin MEASUREMENT DFC_b.TST_ComMETH2RingCnt "Bit encoding / Tested bit for check DFC_ComMETH2RingCnt" UBYTE DFC_OneToOne 1 100 0.00 1.000 BIT_MASK 0x8 FORMAT "%5.3" ECU_ADDRESS 0x60036F4D /end MEASUREMENT
/begin MEASUREMENT DFC_b.TST_ComMETH2TOut "Bit encoding / Tested bit for check DFC_ComMETH2TOut" UBYTE DFC_OneToOne 1 100 0.00 1.000 BIT_MASK 0x8 FORMAT "%5.3" ECU_ADDRESS 0x60036F4E /end MEASUREMENT
/begin MEASUREMENT DFC_b.TST_ComMETHChksum "Bit encoding / Tested bit for check DFC_ComMETHChksum" UBYTE DFC_OneToOne 1 100 0.00 1.000 BIT_MASK 0x8 FORMAT "%5.3" ECU_ADDRESS 0x60036F4F /end MEASUREMENT
/begin MEASUREMENT DFC_b.TST_ComMETHRingCnt "Bit encoding / Tested bit for check DFC_ComMETHRingCnt" UBYTE DFC_OneToOne 1 100 0.00 1.000 BIT_MASK 0x8 FORMAT "%5.3" ECU_ADDRESS 0x60036F50 /end MEASUREMENT
/begin MEASUREMENT DFC_b.TST_ComMETHTOut "Bit encoding / Tested bit for check DFC_ComMETHTOut" UBYTE DFC_OneToOne 1 100 0.00 1.000 BIT_MASK 0x8 FORMAT "%5.3" ECU_ADDRESS 0x60036F51 /end MEASUREMENT
/begin MEASUREMENT DFC_b.TST_ComMETIChksum "Bit encoding / Tested bit for check DFC_ComMETIChksum" UBYTE DFC_OneToOne 1 100 0.00 1.000 BIT_MASK 0x8 FORMAT "%5.3" ECU_ADDRESS 0x60036F52 /end MEASUREMENT
/begin MEASUREMENT DFC_b.TST_ComMETIRingCnt "Bit encoding / Tested bit for check DFC_ComMETIRingCnt" UBYTE DFC_OneToOne 1 100 0.00 1.000 BIT_MASK 0x8 FORMAT "%5.3" ECU_ADDRESS 0x60036F53 /end MEASUREMENT
/begin MEASUREMENT DFC_b.TST_ComMETITOut "Bit encoding / Tested bit for check DFC_ComMETITOut" UBYTE DFC_OneToOne 1 100 0.00 1.000 BIT_MASK 0x8 FORMAT "%5.3" ECU_ADDRESS 0x60036F54 /end MEASUREMENT
/begin MEASUREMENT DFC_b.TST_ComMETKChksum "Bit encoding / Tested bit for check DFC_ComMETKChksum" UBYTE DFC_OneToOne 1 100 0.00 1.000 BIT_MASK 0x8 FORMAT "%5.3" ECU_ADDRESS 0x60036F55 /end MEASUREMENT
/begin MEASUREMENT DFC_b.TST_ComMETKRingCnt "Bit encoding / Tested bit for check DFC_ComMETKRingCnt" UBYTE DFC_OneToOne 1 100 0.00 1.000 BIT_MASK 0x8 FORMAT "%5.3" ECU_ADDRESS 0x60036F56 /end MEASUREMENT
/begin MEASUREMENT DFC_b.TST_ComMETKTOut "Bit encoding / Tested bit for check DFC_ComMETKTOut" UBYTE DFC_OneToOne 1 100 0.00 1.000 BIT_MASK 0x8 FORMAT "%5.3" ECU_ADDRESS 0x60036F57 /end MEASUREMENT
/begin MEASUREMENT DFC_b.TST_ComMETLChksum "Bit encoding / Tested bit for check DFC_ComMETLChksum" UBYTE DFC_OneToOne 1 100 0.00 1.000 BIT_MASK 0x8 FORMAT "%5.3" ECU_ADDRESS 0x60036F58 /end MEASUREMENT
/begin MEASUREMENT DFC_b.TST_ComMETLRingCnt "Bit encoding / Tested bit for check DFC_ComMETLRingCnt" UBYTE DFC_OneToOne 1 100 0.00 1.000 BIT_MASK 0x8 FORMAT "%5.3" ECU_ADDRESS 0x60036F59 /end MEASUREMENT
/begin MEASUREMENT DFC_b.TST_ComMETLTOut "Bit encoding / Tested bit for check DFC_ComMETLTOut" UBYTE DFC_OneToOne 1 100 0.00 1.000 BIT_MASK 0x8 FORMAT "%5.3" ECU_ADDRESS 0x60036F5A /end MEASUREMENT
/begin MEASUREMENT DFC_b.TST_ComMETMChksum "Bit encoding / Tested bit for check DFC_ComMETMChksum" UBYTE DFC_OneToOne 1 100 0.00 1.000 BIT_MASK 0x8 FORMAT "%5.3" ECU_ADDRESS 0x60036F5B /end MEASUREMENT
/begin MEASUREMENT DFC_b.TST_ComMETMRingCnt "Bit encoding / Tested bit for check DFC_ComMETMRingCnt" UBYTE DFC_OneToOne 1 100 0.00 1.000 BIT_MASK 0x8 FORMAT "%5.3" ECU_ADDRESS 0x60036F5C /end MEASUREMENT
/begin MEASUREMENT DFC_b.TST_ComMETMTOut "Bit encoding / Tested bit for check DFC_ComMETMTOut" UBYTE DFC_OneToOne 1 100 0.00 1.000 BIT_MASK 0x8 FORMAT "%5.3" ECU_ADDRESS 0x60036F5D /end MEASUREMENT
/begin MEASUREMENT DFC_b.TST_ComMETNChksum "Bit encoding / Tested bit for check DFC_ComMETNChksum" UBYTE DFC_OneToOne 1 100 0.00 1.000 BIT_MASK 0x8 FORMAT "%5.3" ECU_ADDRESS 0x60036F5E /end MEASUREMENT
/begin MEASUREMENT DFC_b.TST_ComMETNRingCnt "Bit encoding / Tested bit for check DFC_ComMETNRingCnt" UBYTE DFC_OneToOne 1 100 0.00 1.000 BIT_MASK 0x8 FORMAT "%5.3" ECU_ADDRESS 0x60036F5F /end MEASUREMENT
/begin MEASUREMENT DFC_b.TST_ComMETNTOut "Bit encoding / Tested bit for check DFC_ComMETNTOut" UBYTE DFC_OneToOne 1 100 0.00 1.000 BIT_MASK 0x8 FORMAT "%5.3" ECU_ADDRESS 0x60036F60 /end MEASUREMENT
/begin MEASUREMENT DFC_b.TST_ComMtrCom "Bit encoding / Tested bit for check DFC_ComMtrCom" UBYTE DFC_OneToOne 1 100 0.00 1.000 BIT_MASK 0x8 FORMAT "%5.3" ECU_ADDRESS 0x60036F61 /end MEASUREMENT
/begin MEASUREMENT DFC_b.TST_ComPCUChkSum "Bit encoding / Tested bit for check DFC_ComPCUChkSum" UBYTE DFC_OneToOne 1 100 0.00 1.000 BIT_MASK 0x8 FORMAT "%5.3" ECU_ADDRESS 0x60036F62 /end MEASUREMENT
/begin MEASUREMENT DFC_b.TST_ComPCURingCnt "Bit encoding / Tested bit for check DFC_ComPCURingCnt" UBYTE DFC_OneToOne 1 100 0.00 1.000 BIT_MASK 0x8 FORMAT "%5.3" ECU_ADDRESS 0x60036F63 /end MEASUREMENT
/begin MEASUREMENT DFC_b.TST_ComPCUTOut "Bit encoding / Tested bit for check DFC_ComPCUTOut" UBYTE DFC_OneToOne 1 100 0.00 1.000 BIT_MASK 0x8 FORMAT "%5.3" ECU_ADDRESS 0x60036F64 /end MEASUREMENT
/begin MEASUREMENT DFC_b.TST_ComSRSAChksum "Bit encoding / Tested bit for check DFC_ComSRSAChksum" UBYTE DFC_OneToOne 1 100 0.00 1.000 BIT_MASK 0x8 FORMAT "%5.3" ECU_ADDRESS 0x60036F65 /end MEASUREMENT
/begin MEASUREMENT DFC_b.TST_ComSRSARingCnt "Bit encoding / Tested bit for check DFC_ComSRSARingCnt" UBYTE DFC_OneToOne 1 100 0.00 1.000 BIT_MASK 0x8 FORMAT "%5.3" ECU_ADDRESS 0x60036F66 /end MEASUREMENT
/begin MEASUREMENT DFC_b.TST_ComSRSATOut "Bit encoding / Tested bit for check DFC_ComSRSATOut" UBYTE DFC_OneToOne 1 100 0.00 1.000 BIT_MASK 0x8 FORMAT "%5.3" ECU_ADDRESS 0x60036F67 /end MEASUREMENT
/begin MEASUREMENT DFC_b.TST_ComSRSBChksum "Bit encoding / Tested bit for check DFC_ComSRSBChksum" UBYTE DFC_OneToOne 1 100 0.00 1.000 BIT_MASK 0x8 FORMAT "%5.3" ECU_ADDRESS 0x60036F68 /end MEASUREMENT
/begin MEASUREMENT DFC_b.TST_ComSRSBRingCnt "Bit encoding / Tested bit for check DFC_ComSRSBRingCnt" UBYTE DFC_OneToOne 1 100 0.00 1.000 BIT_MASK 0x8 FORMAT "%5.3" ECU_ADDRESS 0x60036F69 /end MEASUREMENT
/begin MEASUREMENT DFC_b.TST_ComSRSBTOut "Bit encoding / Tested bit for check DFC_ComSRSBTOut" UBYTE DFC_OneToOne 1 100 0.00 1.000 BIT_MASK 0x8 FORMAT "%5.3" ECU_ADDRESS 0x60036F6A /end MEASUREMENT
/begin MEASUREMENT DFC_b.TST_ComSRSChksum "Bit encoding / Tested bit for check DFC_ComSRSChksum" UBYTE DFC_OneToOne 1 100 0.00 1.000 BIT_MASK 0x8 FORMAT "%5.3" ECU_ADDRESS 0x60036F6B /end MEASUREMENT
/begin MEASUREMENT DFC_b.TST_ComSRSErr "Bit encoding / Tested bit for check DFC_ComSRSErr" UBYTE DFC_OneToOne 1 100 0.00 1.000 BIT_MASK 0x8 FORMAT "%5.3" ECU_ADDRESS 0x60036F6C /end MEASUREMENT
/begin MEASUREMENT DFC_b.TST_ComSRSRingCnt "Bit encoding / Tested bit for check DFC_ComSRSRingCnt" UBYTE DFC_OneToOne 1 100 0.00 1.000 BIT_MASK 0x8 FORMAT "%5.3" ECU_ADDRESS 0x60036F6D /end MEASUREMENT
/begin MEASUREMENT DFC_b.TST_ComSRSTOut "Bit encoding / Tested bit for check DFC_ComSRSTOut" UBYTE DFC_OneToOne 1 100 0.00 1.000 BIT_MASK 0x8 FORMAT "%5.3" ECU_ADDRESS 0x60036F6E /end MEASUREMENT
/begin MEASUREMENT DFC_b.TST_ComVehSpdPndFltTCU "Bit encoding / Tested bit for check DFC_ComVehSpdPndFltTCU" UBYTE DFC_OneToOne 1 100 0.00 1.000 BIT_MASK 0x8 FORMAT "%5.3" ECU_ADDRESS 0x60036F6F /end MEASUREMENT
/begin MEASUREMENT DFC_b.TST_EbsChartcCurrErr "Bit encoding / Tested bit for check DFC_EbsChartcCurrErr" UBYTE DFC_OneToOne 1 100 0.00 1.000 BIT_MASK 0x8 FORMAT "%5.3" ECU_ADDRESS 0x60036F70 /end MEASUREMENT
/begin MEASUREMENT DFC_b.TST_EbsSelfDiagErr "Bit encoding / Tested bit for check DFC_EbsSelfDiagErr" UBYTE DFC_OneToOne 1 100 0.00 1.000 BIT_MASK 0x8 FORMAT "%5.3" ECU_ADDRESS 0x60036F71 /end MEASUREMENT
/begin MEASUREMENT DFC_b.TST_GEVlvPhaCsersIntkB1 "Bit encoding / Tested bit for check DFC_GEVlvPhaCsersIntkB1" UBYTE DFC_OneToOne 1 100 0.00 1.000 BIT_MASK 0x8 FORMAT "%5.3" ECU_ADDRESS 0x60036F72 /end MEASUREMENT
/begin MEASUREMENT DFC_b.TST_GEVlvPhaPsOpenLoadIntkB1 "Bit encoding / Tested bit for check DFC_GEVlvPhaPsOpenLoadIntkB1" UBYTE DFC_OneToOne 1 100 0.00 1.000 BIT_MASK 0x8 FORMAT "%5.3" ECU_ADDRESS 0x60036F73 /end MEASUREMENT
/begin MEASUREMENT DFC_b.TST_GEVlvPhaPsShoToBattIntkB1 "Bit encoding / Tested bit for check DFC_GEVlvPhaPsShoToBattIntkB1" UBYTE DFC_OneToOne 1 100 0.00 1.000 BIT_MASK 0x8 FORMAT "%5.3" ECU_ADDRESS 0x60036F74 /end MEASUREMENT
/begin MEASUREMENT DFC_b.TST_GEVlvPhaPsShoToGndIntkB1 "Bit encoding / Tested bit for check DFC_GEVlvPhaPsShoToGndIntkB1" UBYTE DFC_OneToOne 1 100 0.00 1.000 BIT_MASK 0x8 FORMAT "%5.3" ECU_ADDRESS 0x60036F75 /end MEASUREMENT
/begin MEASUREMENT DFC_b.TST_GbxCANDigPlausErr "Bit encoding / Tested bit for check DFC_GbxCANDigPlausErr" UBYTE DFC_OneToOne 1 100 0.00 1.000 BIT_MASK 0x8 FORMAT "%5.3" ECU_ADDRESS 0x60036F76 /end MEASUREMENT
/begin MEASUREMENT DFC_b.TST_GbxNPos1SRCMax "Bit encoding / Tested bit for check DFC_GbxNPos1SRCMax" UBYTE DFC_OneToOne 1 100 0.00 1.000 BIT_MASK 0x8 FORMAT "%5.3" ECU_ADDRESS 0x60036F77 /end MEASUREMENT
/begin MEASUREMENT DFC_b.TST_GbxNPos1SRCMin "Bit encoding / Tested bit for check DFC_GbxNPos1SRCMin" UBYTE DFC_OneToOne 1 100 0.00 1.000 BIT_MASK 0x8 FORMAT "%5.3" ECU_ADDRESS 0x60036F78 /end MEASUREMENT
/begin MEASUREMENT DFC_b.TST_GbxNPos2SRCMax "Bit encoding / Tested bit for check DFC_GbxNPos2SRCMax" UBYTE DFC_OneToOne 1 100 0.00 1.000 BIT_MASK 0x8 FORMAT "%5.3" ECU_ADDRESS 0x60036F79 /end MEASUREMENT
/begin MEASUREMENT DFC_b.TST_GbxNPos2SRCMin "Bit encoding / Tested bit for check DFC_GbxNPos2SRCMin" UBYTE DFC_OneToOne 1 100 0.00 1.000 BIT_MASK 0x8 FORMAT "%5.3" ECU_ADDRESS 0x60036F7A /end MEASUREMENT
/begin MEASUREMENT DFC_b.TST_GbxNPosAlvChk "Bit encoding / Tested bit for check DFC_GbxNPosAlvChk" UBYTE DFC_OneToOne 1 100 0.00 1.000 BIT_MASK 0x8 FORMAT "%5.3" ECU_ADDRESS 0x60036F7B /end MEASUREMENT
/begin MEASUREMENT DFC_b.TST_GbxNPosSyncErr "Bit encoding / Tested bit for check DFC_GbxNPosSyncErr" UBYTE DFC_OneToOne 1 100 0.00 1.000 BIT_MASK 0x8 FORMAT "%5.3" ECU_ADDRESS 0x60036F7C /end MEASUREMENT
/begin MEASUREMENT DFC_b.TST_HEGOS2B1HtrPsMax "Bit encoding / Tested bit for check DFC_HEGOS2B1HtrPsMax" UBYTE DFC_OneToOne 1 100 0.00 1.000 BIT_MASK 0x8 FORMAT "%5.3" ECU_ADDRESS 0x60036F7D /end MEASUREMENT
/begin MEASUREMENT DFC_b.TST_HEGOS2B1HtrPsMin "Bit encoding / Tested bit for check DFC_HEGOS2B1HtrPsMin" UBYTE DFC_OneToOne 1 100 0.00 1.000 BIT_MASK 0x8 FORMAT "%5.3" ECU_ADDRESS 0x60036F7E /end MEASUREMENT
/begin MEASUREMENT DFC_b.TST_HEGOS2B1HtrPsSig "Bit encoding / Tested bit for check DFC_HEGOS2B1HtrPsSig" UBYTE DFC_OneToOne 1 100 0.00 1.000 BIT_MASK 0x8 FORMAT "%5.3" ECU_ADDRESS 0x60036F7F /end MEASUREMENT
/begin MEASUREMENT DFC_b.TST_LinCSErrACG "Bit encoding / Tested bit for check DFC_LinCSErrACG" UBYTE DFC_OneToOne 1 100 0.00 1.000 BIT_MASK 0x8 FORMAT "%5.3" ECU_ADDRESS 0x60036F80 /end MEASUREMENT
/begin MEASUREMENT DFC_b.TST_LinCSErrAEV "Bit encoding / Tested bit for check DFC_LinCSErrAEV" UBYTE DFC_OneToOne 1 100 0.00 1.000 BIT_MASK 0x8 FORMAT "%5.3" ECU_ADDRESS 0x60036F81 /end MEASUREMENT
/begin MEASUREMENT DFC_b.TST_LinCSErrDCDC "Bit encoding / Tested bit for check DFC_LinCSErrDCDC" UBYTE DFC_OneToOne 1 100 0.00 1.000 BIT_MASK 0x8 FORMAT "%5.3" ECU_ADDRESS 0x60036F82 /end MEASUREMENT
/begin MEASUREMENT DFC_b.TST_LinCSErrEBS "Bit encoding / Tested bit for check DFC_LinCSErrEBS" UBYTE DFC_OneToOne 1 100 0.00 1.000 BIT_MASK 0x8 FORMAT "%5.3" ECU_ADDRESS 0x60036F83 /end MEASUREMENT
/begin MEASUREMENT DFC_b.TST_LinHdrTimeoutErrACG "Bit encoding / Tested bit for check DFC_LinHdrTimeoutErrACG" UBYTE DFC_OneToOne 1 100 0.00 1.000 BIT_MASK 0x8 FORMAT "%5.3" ECU_ADDRESS 0x60036F84 /end MEASUREMENT
/begin MEASUREMENT DFC_b.TST_LinHdrTimeoutErrAEV "Bit encoding / Tested bit for check DFC_LinHdrTimeoutErrAEV" UBYTE DFC_OneToOne 1 100 0.00 1.000 BIT_MASK 0x8 FORMAT "%5.3" ECU_ADDRESS 0x60036F85 /end MEASUREMENT
/begin MEASUREMENT DFC_b.TST_LinHdrTimeoutErrDCDC "Bit encoding / Tested bit for check DFC_LinHdrTimeoutErrDCDC" UBYTE DFC_OneToOne 1 100 0.00 1.000 BIT_MASK 0x8 FORMAT "%5.3" ECU_ADDRESS 0x60036F86 /end MEASUREMENT
/begin MEASUREMENT DFC_b.TST_LinHdrTimeoutErrEBS "Bit encoding / Tested bit for check DFC_LinHdrTimeoutErrEBS" UBYTE DFC_OneToOne 1 100 0.00 1.000 BIT_MASK 0x8 FORMAT "%5.3" ECU_ADDRESS 0x60036F87 /end MEASUREMENT
/begin MEASUREMENT DFC_b.TST_LinMsgTimeoutErrACG "Bit encoding / Tested bit for check DFC_LinMsgTimeoutErrACG" UBYTE DFC_OneToOne 1 100 0.00 1.000 BIT_MASK 0x8 FORMAT "%5.3" ECU_ADDRESS 0x60036F88 /end MEASUREMENT
/begin MEASUREMENT DFC_b.TST_LinMsgTimeoutErrAEV "Bit encoding / Tested bit for check DFC_LinMsgTimeoutErrAEV" UBYTE DFC_OneToOne 1 100 0.00 1.000 BIT_MASK 0x8 FORMAT "%5.3" ECU_ADDRESS 0x60036F89 /end MEASUREMENT
/begin MEASUREMENT DFC_b.TST_LinMsgTimeoutErrDCDC "Bit encoding / Tested bit for check DFC_LinMsgTimeoutErrDCDC" UBYTE DFC_OneToOne 1 100 0.00 1.000 BIT_MASK 0x8 FORMAT "%5.3" ECU_ADDRESS 0x60036F8A /end MEASUREMENT
/begin MEASUREMENT DFC_b.TST_LinMsgTimeoutErrEBS "Bit encoding / Tested bit for check DFC_LinMsgTimeoutErrEBS" UBYTE DFC_OneToOne 1 100 0.00 1.000 BIT_MASK 0x8 FORMAT "%5.3" ECU_ADDRESS 0x60036F8B /end MEASUREMENT
/begin MEASUREMENT DFC_b.TST_LinNoStrtComErr "Bit encoding / Tested bit for check DFC_LinNoStrtComErr" UBYTE DFC_OneToOne 1 100 0.00 1.000 BIT_MASK 0x8 FORMAT "%5.3" ECU_ADDRESS 0x60036F8C /end MEASUREMENT
/begin MEASUREMENT DFC_b.TST_LowPresOilP "Bit encoding / Tested bit for check DFC_LowPresOilP" UBYTE DFC_OneToOne 1 100 0.00 1.000 BIT_MASK 0x8 FORMAT "%5.3" ECU_ADDRESS 0x60036F8D /end MEASUREMENT
/begin MEASUREMENT DFC_b.TST_MisfDetVWhlFrntLeOORHi "Bit encoding / Tested bit for check DFC_MisfDetVWhlFrntLeOORHi" UBYTE DFC_OneToOne 1 100 0.00 1.000 BIT_MASK 0x8 FORMAT "%5.3" ECU_ADDRESS 0x60036F8E /end MEASUREMENT
/begin MEASUREMENT DFC_b.TST_MisfDetVWhlFrntLeRatyHi "Bit encoding / Tested bit for check DFC_MisfDetVWhlFrntLeRatyHi" UBYTE DFC_OneToOne 1 100 0.00 1.000 BIT_MASK 0x8 FORMAT "%5.3" ECU_ADDRESS 0x60036F8F /end MEASUREMENT
/begin MEASUREMENT DFC_b.TST_MisfDetVWhlFrntLeRatyLo "Bit encoding / Tested bit for check DFC_MisfDetVWhlFrntLeRatyLo" UBYTE DFC_OneToOne 1 100 0.00 1.000 BIT_MASK 0x8 FORMAT "%5.3" ECU_ADDRESS 0x60036F90 /end MEASUREMENT
/begin MEASUREMENT DFC_b.TST_MisfDetVWhlFrntLeStuck "Bit encoding / Tested bit for check DFC_MisfDetVWhlFrntLeStuck" UBYTE DFC_OneToOne 1 100 0.00 1.000 BIT_MASK 0x8 FORMAT "%5.3" ECU_ADDRESS 0x60036F91 /end MEASUREMENT
/begin MEASUREMENT DFC_b.TST_MisfDetVWhlFrntRiOORHi "Bit encoding / Tested bit for check DFC_MisfDetVWhlFrntRiOORHi" UBYTE DFC_OneToOne 1 100 0.00 1.000 BIT_MASK 0x8 FORMAT "%5.3" ECU_ADDRESS 0x60036F92 /end MEASUREMENT
/begin MEASUREMENT DFC_b.TST_MisfDetVWhlFrntRiRatyHi "Bit encoding / Tested bit for check DFC_MisfDetVWhlFrntRiRatyHi" UBYTE DFC_OneToOne 1 100 0.00 1.000 BIT_MASK 0x8 FORMAT "%5.3" ECU_ADDRESS 0x60036F93 /end MEASUREMENT
/begin MEASUREMENT DFC_b.TST_MisfDetVWhlFrntRiRatyLo "Bit encoding / Tested bit for check DFC_MisfDetVWhlFrntRiRatyLo" UBYTE DFC_OneToOne 1 100 0.00 1.000 BIT_MASK 0x8 FORMAT "%5.3" ECU_ADDRESS 0x60036F94 /end MEASUREMENT
/begin MEASUREMENT DFC_b.TST_MisfDetVWhlFrntRiStuck "Bit encoding / Tested bit for check DFC_MisfDetVWhlFrntRiStuck" UBYTE DFC_OneToOne 1 100 0.00 1.000 BIT_MASK 0x8 FORMAT "%5.3" ECU_ADDRESS 0x60036F95 /end MEASUREMENT
/begin MEASUREMENT DFC_b.TST_MisfDetVWhlReLeOORHi "Bit encoding / Tested bit for check DFC_MisfDetVWhlReLeOORHi" UBYTE DFC_OneToOne 1 100 0.00 1.000 BIT_MASK 0x8 FORMAT "%5.3" ECU_ADDRESS 0x60036F96 /end MEASUREMENT
/begin MEASUREMENT DFC_b.TST_MisfDetVWhlReLeRatyHi "Bit encoding / Tested bit for check DFC_MisfDetVWhlReLeRatyHi" UBYTE DFC_OneToOne 1 100 0.00 1.000 BIT_MASK 0x8 FORMAT "%5.3" ECU_ADDRESS 0x60036F97 /end MEASUREMENT
/begin MEASUREMENT DFC_b.TST_MisfDetVWhlReLeRatyLo "Bit encoding / Tested bit for check DFC_MisfDetVWhlReLeRatyLo" UBYTE DFC_OneToOne 1 100 0.00 1.000 BIT_MASK 0x8 FORMAT "%5.3" ECU_ADDRESS 0x60036F98 /end MEASUREMENT
/begin MEASUREMENT DFC_b.TST_MisfDetVWhlReLeStuck "Bit encoding / Tested bit for check DFC_MisfDetVWhlReLeStuck" UBYTE DFC_OneToOne 1 100 0.00 1.000 BIT_MASK 0x8 FORMAT "%5.3" ECU_ADDRESS 0x60036F99 /end MEASUREMENT
/begin MEASUREMENT DFC_b.TST_MisfDetVWhlReRiOORHi "Bit encoding / Tested bit for check DFC_MisfDetVWhlReRiOORHi" UBYTE DFC_OneToOne 1 100 0.00 1.000 BIT_MASK 0x8 FORMAT "%5.3" ECU_ADDRESS 0x60036F9A /end MEASUREMENT
/begin MEASUREMENT DFC_b.TST_MisfDetVWhlReRiRatyHi "Bit encoding / Tested bit for check DFC_MisfDetVWhlReRiRatyHi" UBYTE DFC_OneToOne 1 100 0.00 1.000 BIT_MASK 0x8 FORMAT "%5.3" ECU_ADDRESS 0x60036F9B /end MEASUREMENT
/begin MEASUREMENT DFC_b.TST_MisfDetVWhlReRiRatyLo "Bit encoding / Tested bit for check DFC_MisfDetVWhlReRiRatyLo" UBYTE DFC_OneToOne 1 100 0.00 1.000 BIT_MASK 0x8 FORMAT "%5.3" ECU_ADDRESS 0x60036F9C /end MEASUREMENT
/begin MEASUREMENT DFC_b.TST_MisfDetVWhlReRiStuck "Bit encoding / Tested bit for check DFC_MisfDetVWhlReRiStuck" UBYTE DFC_OneToOne 1 100 0.00 1.000 BIT_MASK 0x8 FORMAT "%5.3" ECU_ADDRESS 0x60036F9D /end MEASUREMENT
/begin MEASUREMENT DFC_b.TST_MisfDetdVWhlFrntLePlaus "Bit encoding / Tested bit for check DFC_MisfDetdVWhlFrntLePlaus" UBYTE DFC_OneToOne 1 100 0.00 1.000 BIT_MASK 0x8 FORMAT "%5.3" ECU_ADDRESS 0x60036F9E /end MEASUREMENT
/begin MEASUREMENT DFC_b.TST_MisfDetdVWhlFrntRiPlaus "Bit encoding / Tested bit for check DFC_MisfDetdVWhlFrntRiPlaus" UBYTE DFC_OneToOne 1 100 0.00 1.000 BIT_MASK 0x8 FORMAT "%5.3" ECU_ADDRESS 0x60036F9F /end MEASUREMENT
/begin MEASUREMENT DFC_b.TST_MisfDetdVWhlReLePlaus "Bit encoding / Tested bit for check DFC_MisfDetdVWhlReLePlaus" UBYTE DFC_OneToOne 1 100 0.00 1.000 BIT_MASK 0x8 FORMAT "%5.3" ECU_ADDRESS 0x60036FA0 /end MEASUREMENT
/begin MEASUREMENT DFC_b.TST_MisfDetdVWhlReRiPlaus "Bit encoding / Tested bit for check DFC_MisfDetdVWhlReRiPlaus" UBYTE DFC_OneToOne 1 100 0.00 1.000 BIT_MASK 0x8 FORMAT "%5.3" ECU_ADDRESS 0x60036FA1 /end MEASUREMENT
/begin MEASUREMENT DFC_b.TST_PEnvSigRngMax "Bit encoding / Tested bit for check DFC_PEnvSigRngMax" UBYTE DFC_OneToOne 1 100 0.00 1.000 BIT_MASK 0x8 FORMAT "%5.3" ECU_ADDRESS 0x60036FA2 /end MEASUREMENT
/begin MEASUREMENT DFC_b.TST_PEnvSigRngMin "Bit encoding / Tested bit for check DFC_PEnvSigRngMin" UBYTE DFC_OneToOne 1 100 0.00 1.000 BIT_MASK 0x8 FORMAT "%5.3" ECU_ADDRESS 0x60036FA3 /end MEASUREMENT
/begin MEASUREMENT DFC_b.TST_StmFault "Bit encoding / Tested bit for check DFC_StmFault" UBYTE DFC_OneToOne 1 100 0.00 1.000 BIT_MASK 0x8 FORMAT "%5.3" ECU_ADDRESS 0x60036FA4 /end MEASUREMENT
/begin MEASUREMENT DFC_b.TST_StrtCtOffPth "Bit encoding / Tested bit for check DFC_StrtCtOffPth" UBYTE DFC_OneToOne 1 100 0.00 1.000 BIT_MASK 0x8 FORMAT "%5.3" ECU_ADDRESS 0x60036FA5 /end MEASUREMENT
/begin MEASUREMENT DFC_b.TST_StrtCtlErr "Bit encoding / Tested bit for check DFC_StrtCtlErr" UBYTE DFC_OneToOne 1 100 0.00 1.000 BIT_MASK 0x8 FORMAT "%5.3" ECU_ADDRESS 0x60036FA6 /end MEASUREMENT
/begin MEASUREMENT DFC_b.TST_StrtFault "Bit encoding / Tested bit for check DFC_StrtFault" UBYTE DFC_OneToOne 1 100 0.00 1.000 BIT_MASK 0x8 FORMAT "%5.3" ECU_ADDRESS 0x60036FA7 /end MEASUREMENT
/begin MEASUREMENT EngDa_tEng_f "" FLOAT32_IEEE RBPtCel_t_1p0_3 1 100 -1.00000000E+037 1.00000000E+037 FORMAT "%13.3" ECU_ADDRESS 0x60003AC8 /end MEASUREMENT
/begin MEASUREMENT EnvP_p_f "Actual physical value" FLOAT32_IEEE RBPtCel_p_1p0_1 1 100 -1.00000000E+037 1.00000000E+037 FORMAT "%13.3" ECU_ADDRESS 0x50004EB0 /end MEASUREMENT
/begin MEASUREMENT EnvT_t_f "envt" FLOAT32_IEEE RBPtCel_t_1p0_3 1 100 -1.00000000E+037 1.00000000E+037 FORMAT "%13.3" ECU_ADDRESS 0x60003AC4 /end MEASUREMENT
/begin MEASUREMENT EnvT_t_f_Sq "" UBYTE SigQly_COMPU_VERB 1 100 0.00 15.0000000000 FORMAT "%13.10" ECU_ADDRESS 0x6000F444 /end MEASUREMENT
/begin MEASUREMENT ExhMod_pRelPfilDs_f "Modelled relative pressure downstream of particulate filter" FLOAT32_IEEE RBPtCel_p_1p0_1 1 100 -1.00000000E+037 1.00000000E+037 FORMAT "%13.3" ECU_ADDRESS 0x60003ABC /end MEASUREMENT
/begin MEASUREMENT ExhMod_tExhCat1DsB1_f "exhaust gas temperature catalyst 1 downstream" FLOAT32_IEEE RBPtCel_t_1p0_3 1 100 -1.00000000E+037 1.00000000E+037 FORMAT "%13.3" ECU_ADDRESS 0x60003AB8 /end MEASUREMENT
/begin MEASUREMENT FuelT_t_f "Actual physical value" FLOAT32_IEEE RBPtCel_t_1p0_3 1 100 -1.00000000E+037 1.00000000E+037 FORMAT "%13.3" ECU_ADDRESS 0x60003AB4 /end MEASUREMENT
/begin MEASUREMENT FuPHi_flgDSMClrDSKVRNpl10ms "handshake variable for DSM-Clear handling" UBYTE B_TRUE 1 100 0.00 1.00000000000 BIT_MASK 0x1 FORMAT "%13.11" ECU_ADDRESS 0x70000384 /end MEASUREMENT
/begin MEASUREMENT FuPHi_flgDSMClrDSKVRNpl50ms "handshake variable for DSM-Clear handling" UBYTE B_TRUE 1 100 0.00 1.00000000000 BIT_MASK 0x1 FORMAT "%13.11" ECU_ADDRESS 0x70000383 /end MEASUREMENT
/begin MEASUREMENT FuPHi_flgDSMClrDSKVRSig10ms "handshake variable for DSM-Clear handling" UBYTE B_TRUE 1 100 0.00 1.00000000000 BIT_MASK 0x1 FORMAT "%13.11" ECU_ADDRESS 0x70000382 /end MEASUREMENT
/begin MEASUREMENT FuPHi_flgDSMClrDSKVRSig50ms "handshake variable for DSM-Clear handling" UBYTE B_TRUE 1 100 0.00 1.00000000000 BIT_MASK 0x1 FORMAT "%13.11" ECU_ADDRESS 0x70000381 /end MEASUREMENT
/begin MEASUREMENT FuPHi_flgEnaStoreLoP_msg "activate storage ekp pressure (low pressure)" UBYTE B_TRUE 1 100 0.00 1.00000000000 BIT_MASK 0x1 FORMAT "%13.11" ECU_ADDRESS 0x600001B1 /end MEASUREMENT
/begin MEASUREMENT FuPHi_pRawRelInit "fuel rail pressure raw value (relative value) before start" UWORD RBPtCel_p_0p002_1 1 100 0.00 131.0700 FORMAT "%8.4" ECU_ADDRESS 0x60001618 /end MEASUREMENT
/begin MEASUREMENT FuPHi_stDetSleep "state for detection of power on" ULONG OneToOne 1 100 0.00 4294967295.00 FORMAT "%13.2" ECU_ADDRESS 0x70039BF4 /end MEASUREMENT
/begin MEASUREMENT IntkAirT_t_f "Actual physical value" FLOAT32_IEEE RBPtCel_t_1p0_3 1 100 -1.00000000E+037 1.00000000E+037 FORMAT "%13.3" ECU_ADDRESS 0x60003AB0 /end MEASUREMENT
/begin MEASUREMENT OilP_p_f "Actual physical value" FLOAT32_IEEE RBPtCel_p_1p0_1 1 100 -1.00000000E+037 1.00000000E+037 FORMAT "%13.3" ECU_ADDRESS 0x60003AAC /end MEASUREMENT
/begin MEASUREMENT OilSwmpT_t_f "e_:Global Function for Sensor Selection:_e;d_:Service Funktion fuer Sensorauswahl:_d" FLOAT32_IEEE RBPtCel_t_1p0_3 1 100 -1.00000000E+037 1.00000000E+037 FORMAT "%13.3" ECU_ADDRESS 0x60003AA8 /end MEASUREMENT
/begin MEASUREMENT pnekp_w "Unfiltered rail pressure real value (relative pressure) after ekp prerun" UWORD RBPtCel_p_0p002_1 1 100 0.00 131.0700 FORMAT "%8.4" ECU_ADDRESS 0x60001060 /end MEASUREMENT
/begin MEASUREMENT prnekpvl_w "rail pressure real value (abs.) after ekp prerun" UWORD RBPtCel_p_0p002_1 1 100 0.00 131.0700 FORMAT "%8.4" ECU_ADDRESS 0x6000105E /end MEASUREMENT
/begin MEASUREMENT prprekp_w "Unfiltered rail pressure real value (relative pressure) predrive after ekp prerun" UWORD RBPtCel_p_0p002_1 1 100 0.00 131.0700 FORMAT "%8.4" ECU_ADDRESS 0x60039482 /end MEASUREMENT
/begin MEASUREMENT prpre_w "Unfiltered rail pressure real value (relative pressure) predrive" UWORD RBPtCel_p_0p002_1 1 100 0.00 131.0700 FORMAT "%8.4" ECU_ADDRESS 0x60039480 /end MEASUREMENT
/begin MEASUREMENT prvekpvl_w "rail pressure real value (abs.) before ekp prerun" UWORD RBPtCel_p_0p002_1 1 100 0.00 131.0700 FORMAT "%8.4" ECU_ADDRESS 0x6000105C /end MEASUREMENT
/begin MEASUREMENT tiekpold "system time after EKP prerun" ULONG t_q10_ms 1 100 0.00 42949672950.0 FORMAT "%13.1" ECU_ADDRESS 0x60001058 /end MEASUREMENT
/begin MEASUREMENT tiekp_w "time duration after B_ekp" UWORD t_q0p1 1 100 0.00 6553.500 FORMAT "%8.3" ECU_ADDRESS 0x60001056 /end MEASUREMENT
/begin FUNCTION DDRC "30000.21.1Diagnostic Debounce and Report of Check"
 /begin DEF_CHARACTERISTIC DDRC_RatDeb.Com_tiCntTCU12UDRat_C DDRC_RatDeb.Com_tiCntTCU13UDRat_C DDRC_RatDeb.Com_tiCntTCU2UDRat_C DDRC_RatDeb.Com_tiCntTCU3UDRat_C DDRC_RatDeb.Com_tiCntTCU4UDRat_C DDRC_RatDeb.Com_tiTOutTCU01UDRat_C DDRC_RatDeb.Com_tiTOutTCU02UDRat_C DDRC_RatDeb.Com_tiTOutTCU1UDRat_C DDRC_RatDeb.Com_tiTOutTCU11UDRat_C DDRC_RatDeb.Com_tiTOutTCU12UDRat_C DDRC_RatDeb.Com_tiTOutTCU13UDRat_C DDRC_RatDeb.Com_tiTOutTCU14UDRat_C DDRC_RatDeb.Com_tiTOutTCU2UDRat_C DDRC_RatDeb.Com_tiTOutTCU3UDRat_C DDRC_RatDeb.Com_tiTOutTCU4UDRat_C DDRC_RatDeb.DevLib_tiBattUHiUDRat_C DDRC_RatDeb.DevLib_tiBattULoUDRat_C DDRC_RatDeb.EGRVlv_tiFailSafeActvUDRat_C DDRC_RatDeb.EGRVlv_tiGovDvtCldUDRat_C DDRC_RatDeb.EGRVlv_tiPhysSRCMaxUDRat_C DDRC_RatDeb.EGRVlv_tiPhysSRCMinUDRat_C DDRC_RatDeb.Fan_tiDIOOLUDRat_C DDRC_RatDeb.Fan_tiDIOOvrTempUDRat_C DDRC_RatDeb.Fan_tiDIOSCBUDRat_C DDRC_RatDeb.Fan_tiDIOSCGUDRat_C DDRC_RatDeb.MRlyDcOL_tisigOLUDRat_C DDRC_RatDeb.MRlyDcSCB_tisigSCBUDRat_C DDRC_RatDeb.MRlyDcSCG_tisigSCGUDRat_C DDRC_RatDeb.PSP_tiOLUDRat_C DDRC_RatDeb.PSP_tiOvrTempUDRat_C DDRC_RatDeb.PSP_tiSCBUDRat_C DDRC_RatDeb.PSP_tiSCGUDRat_C DDRC_RatDeb.T50_tiErrUDRat_C DDRC_RatDeb.ThrVlv_tiLoBattB1UDRat_C DDRC_RatDeb.UEGO_tiOperPlausUDRat_C DDRC_RatDeb.VehV_tiCANSigFLUDRat_C DDRC_RatDeb.VehV_tiCANSigFRUDRat_C DDRC_RatDeb.VehV_tiCANSigRLUDRat_C DDRC_RatDeb.VehV_tiCANSigRRUDRat_C DDRC_RatDeb.VehV_tiOLUDRat_C DDRC_RatDeb.VehV_tiOTUDRat_C DDRC_RatDeb.VehV_tiPhysRngHiUDRat_C DDRC_RatDeb.VehV_tiSCBUDRat_C DDRC_RatDeb.VehV_tiSCGUDRat_C DDRC_RatDeb.VehV_tiSnsrARngHiUDRat_C DDRC_RatDeb.VehV_tiSnsrBRngHiUDRat_C DDRC_RatDeb.VehV_tiSpdRtyDiagUDRat_C DDRC_RatDeb.DDHFHD_numDhfDebDef_CUDRat_C DDRC_RatDeb.InjVlv_numDcDcUDRat_C DDRC_RatDeb.InjVlv_numNoLdUDRat_C DDRC_RatDeb.InjVlv_numScBnkUDRat_C DDRC_RatDeb.InjVlv_numScCylUDRat_C DDRC_RatDeb.InjVlv_numScHsLsUDRat_C DDRC_RatDeb.MfPsDia_numOpenLoadUDRat_C DDRC_RatDeb.MfPsDia_numScHiSUDRat_C DDRC_RatDeb.MfPsDia_numScHiSLowSUDRat_C DDRC_RatDeb.MfPsDia_numScLowSUDRat_C DDRC_RatDeb.ACEvpT_tiPhysRngHiUDRat_C DDRC_RatDeb.ACEvpT_tiPhysRngLoUDRat_C DDRC_RatDeb.ACEvpT_tiSRCMaxUDRat_C DDRC_RatDeb.ACEvpT_tiSRCMinUDRat_C DDRC_RatDeb.AFS_tiRawSigRngHiB1UDRat_C DDRC_RatDeb.AFS_tiRawSigRngLoB1UDRat_C DDRC_RatDeb.AFS_tiSnsrErrB1UDRat_C DDRC_RatDeb.AirC_tiClntSRCMaxUDRat_C DDRC_RatDeb.AirC_tiClntSRCMinUDRat_C DDRC_RatDeb.AirC_tiSwtNplUDRat_C DDRC_RatDeb.AirC_tiSwtSigUDRat_C DDRC_RatDeb.BrkBstP_tiSCBUDRat_C DDRC_RatDeb.BrkBstP_tiSCGUDRat_C DDRC_RatDeb.Brk_tiUDRat_C DDRC_RatDeb.Brk_tiSigUDRat_C DDRC_RatDeb.Clth_tiSigUDRat_C DDRC_RatDeb.EGRVlv_tiCurrLimUDRat_C DDRC_RatDeb.EGRVlv_tiOLUDRat_C DDRC_RatDeb.EGRVlv_tiOvrTempUDRat_C DDRC_RatDeb.EGRVlv_tiSCBUDRat_C DDRC_RatDeb.EGRVlv_tiSCGUDRat_C DDRC_RatDeb.EGRVlv_tiSRCMaxUDRat_C DDRC_RatDeb.EGRVlv_tiSRCMinUDRat_C DDRC_RatDeb.HLSDem_tiOvhtUDRat_C DDRC_RatDeb.Oil_tiSRCMaxPSwmpUDRat_C DDRC_RatDeb.Oil_tiSRCMinPSwmpUDRat_C DDRC_RatDeb.PIntkVUs_tiLineHiB1UDRat_C DDRC_RatDeb.PIntkVUs_tiLineLoB1UDRat_C DDRC_RatDeb.VehV_tiPhysRngLoUDRat_C DDRC_RatDeb.VehV_tiSigCanUDRat_C DDRC_RatDeb.VehV_tiSigCanSafeUDRat_C DDRC_RatDeb.VlvLft_tiSRCMaxOilPSnsrIntk11UDRat_C DDRC_RatDeb.VlvLft_tiSRCMinOilPSnsrIntk11UDRat_C DDRC_RatDeb.Clth_numPlaUDRat_C DDRC_RatDeb.Gbx_numPNPosnDrvCdnUDRat_C DDRC_RatDeb.Gbx_numPNPosnPlausyUDRat_C /end DEF_CHARACTERISTIC
 FUNCTION_VERSION "30000.21.1" /end FUNCTION
/begin FUNCTION DDRC_DemDeb ""
 /begin DEF_CHARACTERISTIC DDRC_DebArCtrBase.MyCtrBasedClass_2.isJmpDwnActv_C DDRC_DebArCtrBase.MyCtrBasedClass_2.isJmpUpActv_C DDRC_DebArCtrBase.MyCtrBasedClass_2.limPassd_C DDRC_DebArCtrBase.MyCtrBasedClass_2.limFaild_C DDRC_DebArCtrBase.MyCtrBasedClass_2.jmpUpVal_C DDRC_DebArCtrBase.MyCtrBasedClass_2.jmpDwnVal_C DDRC_DebArCtrBase.MyCtrBasedClass_2.stepUp_C DDRC_DebArCtrBase.MyCtrBasedClass_2.stepDwn_C DDRC_DebArCtrBase.MyCtrBasedClass_1.isJmpDwnActv_C DDRC_DebArCtrBase.MyCtrBasedClass_1.isJmpUpActv_C DDRC_DebArCtrBase.MyCtrBasedClass_1.limPassd_C DDRC_DebArCtrBase.MyCtrBasedClass_1.limFaild_C DDRC_DebArCtrBase.MyCtrBasedClass_1.jmpUpVal_C DDRC_DebArCtrBase.MyCtrBasedClass_1.jmpDwnVal_C DDRC_DebArCtrBase.MyCtrBasedClass_1.stepUp_C DDRC_DebArCtrBase.MyCtrBasedClass_1.stepDwn_C DDRC_DebArCtrBase.DemDebounceCounterBasedClass_standard.isJmpDwnActv_C DDRC_DebArCtrBase.DemDebounceCounterBasedClass_standard.isJmpUpActv_C DDRC_DebArCtrBase.DemDebounceCounterBasedClass_standard.limPassd_C DDRC_DebArCtrBase.DemDebounceCounterBasedClass_standard.limFaild_C DDRC_DebArCtrBase.DemDebounceCounterBasedClass_standard.jmpUpVal_C DDRC_DebArCtrBase.DemDebounceCounterBasedClass_standard.jmpDwnVal_C DDRC_DebArCtrBase.DemDebounceCounterBasedClass_standard.stepUp_C DDRC_DebArCtrBase.DemDebounceCounterBasedClass_standard.stepDwn_C DDRC_DebArTime.DFC_BusDiagCANAPPLBusOff.tiLimFaild_C DDRC_DebArTime.DFC_BusDiagCANAPPLBusOff.tiLimPassd_C DDRC_DebArTime.DFC_BusDiagCANCANCBusOff.tiLimFaild_C DDRC_DebArTime.DFC_BusDiagCANCANCBusOff.tiLimPassd_C DDRC_DebArTime.DFC_BusDiagCANVEHICLEBusOff.tiLimFaild_C DDRC_DebArTime.DFC_BusDiagCANVEHICLEBusOff.tiLimPassd_C DDRC_DebArTime.DFC_RBA_IODIAGPWR_rba_IoExtCy329_SignalVltSply_0.tiLimFaild_C DDRC_DebArTime.DFC_RBA_IODIAGPWR_rba_IoExtCy329_SignalVltSply_0.tiLimPassd_C DDRC_DebArTime.DFC_RBA_IODIAGPWR_rba_IoExtCy329_SignalVltSply_0OT.tiLimFaild_C DDRC_DebArTime.DFC_RBA_IODIAGPWR_rba_IoExtCy329_SignalVltSply_0OT.tiLimPassd_C DDRC_DebArTime.DFC_RBA_IODIAGPWR_rba_IoExtCy329_SignalVltSply_0OV.tiLimFaild_C DDRC_DebArTime.DFC_RBA_IODIAGPWR_rba_IoExtCy329_SignalVltSply_0OV.tiLimPassd_C DDRC_DebArTime.DFC_RBA_IODIAGPWR_rba_IoExtCy329_SignalVltSply_0SCG.tiLimFaild_C DDRC_DebArTime.DFC_RBA_IODIAGPWR_rba_IoExtCy329_SignalVltSply_0SCG.tiLimPassd_C DDRC_DebArTime.DFC_RBA_IODIAGPWR_rba_IoExtCy329_SignalVltSply_0UV.tiLimFaild_C DDRC_DebArTime.DFC_RBA_IODIAGPWR_rba_IoExtCy329_SignalVltSply_0UV.tiLimPassd_C DDRC_DebArTime.DFC_RBA_IODIAGPWR_rba_IoExtCy329_SignalVltSply_1.tiLimFaild_C DDRC_DebArTime.DFC_RBA_IODIAGPWR_rba_IoExtCy329_SignalVltSply_1.tiLimPassd_C DDRC_DebArTime.DFC_RBA_IODIAGPWR_rba_IoExtCy329_SignalVltSply_1OT.tiLimFaild_C DDRC_DebArTime.DFC_RBA_IODIAGPWR_rba_IoExtCy329_SignalVltSply_1OT.tiLimPassd_C DDRC_DebArTime.DFC_RBA_IODIAGPWR_rba_IoExtCy329_SignalVltSply_1OV.tiLimFaild_C DDRC_DebArTime.DFC_RBA_IODIAGPWR_rba_IoExtCy329_SignalVltSply_1OV.tiLimPassd_C DDRC_DebArTime.DFC_RBA_IODIAGPWR_rba_IoExtCy329_SignalVltSply_1SCG.tiLimFaild_C DDRC_DebArTime.DFC_RBA_IODIAGPWR_rba_IoExtCy329_SignalVltSply_1SCG.tiLimPassd_C DDRC_DebArTime.DFC_RBA_IODIAGPWR_rba_IoExtCy329_SignalVltSply_1UV.tiLimFaild_C DDRC_DebArTime.DFC_RBA_IODIAGPWR_rba_IoExtCy329_SignalVltSply_1UV.tiLimPassd_C DDRC_DebArTime.DFC_RBA_IODIAGPWR_rba_IoExtCy329_SignalVltSply_2.tiLimFaild_C DDRC_DebArTime.DFC_RBA_IODIAGPWR_rba_IoExtCy329_SignalVltSply_2.tiLimPassd_C DDRC_DebArTime.DFC_RBA_IODIAGPWR_rba_IoExtCy329_SignalVltSply_2OT.tiLimFaild_C DDRC_DebArTime.DFC_RBA_IODIAGPWR_rba_IoExtCy329_SignalVltSply_2OT.tiLimPassd_C DDRC_DebArTime.DFC_RBA_IODIAGPWR_rba_IoExtCy329_SignalVltSply_2OV.tiLimFaild_C DDRC_DebArTime.DFC_RBA_IODIAGPWR_rba_IoExtCy329_SignalVltSply_2OV.tiLimPassd_C DDRC_DebArTime.DFC_RBA_IODIAGPWR_rba_IoExtCy329_SignalVltSply_2SCG.tiLimFaild_C DDRC_DebArTime.DFC_RBA_IODIAGPWR_rba_IoExtCy329_SignalVltSply_2SCG.tiLimPassd_C DDRC_DebArTime.DFC_RBA_IODIAGPWR_rba_IoExtCy329_SignalVltSply_2UV.tiLimFaild_C DDRC_DebArTime.DFC_RBA_IODIAGPWR_rba_IoExtCy329_SignalVltSply_2UV.tiLimPassd_C /end DEF_CHARACTERISTIC
 /begin LOC_MEASUREMENT DDRC_ctArDebLvl.DFC_BusDiagCANAPPLBusOff DDRC_ctArDebLvl.DFC_BusDiagCANCANCBusOff DDRC_ctArDebLvl.DFC_BusDiagCANVEHICLEBusOff DDRC_ctArDebLvl.DFC_RBA_IODIAGPWR_rba_IoExtCy329_SignalVltSply_0 DDRC_ctArDebLvl.DFC_RBA_IODIAGPWR_rba_IoExtCy329_SignalVltSply_0OT DDRC_ctArDebLvl.DFC_RBA_IODIAGPWR_rba_IoExtCy329_SignalVltSply_0OV DDRC_ctArDebLvl.DFC_RBA_IODIAGPWR_rba_IoExtCy329_SignalVltSply_0SCG DDRC_ctArDebLvl.DFC_RBA_IODIAGPWR_rba_IoExtCy329_SignalVltSply_0UV DDRC_ctArDebLvl.DFC_RBA_IODIAGPWR_rba_IoExtCy329_SignalVltSply_1 DDRC_ctArDebLvl.DFC_RBA_IODIAGPWR_rba_IoExtCy329_SignalVltSply_1OT DDRC_ctArDebLvl.DFC_RBA_IODIAGPWR_rba_IoExtCy329_SignalVltSply_1OV DDRC_ctArDebLvl.DFC_RBA_IODIAGPWR_rba_IoExtCy329_SignalVltSply_1SCG DDRC_ctArDebLvl.DFC_RBA_IODIAGPWR_rba_IoExtCy329_SignalVltSply_1UV DDRC_ctArDebLvl.DFC_RBA_IODIAGPWR_rba_IoExtCy329_SignalVltSply_2 DDRC_ctArDebLvl.DFC_RBA_IODIAGPWR_rba_IoExtCy329_SignalVltSply_2OT DDRC_ctArDebLvl.DFC_RBA_IODIAGPWR_rba_IoExtCy329_SignalVltSply_2OV DDRC_ctArDebLvl.DFC_RBA_IODIAGPWR_rba_IoExtCy329_SignalVltSply_2SCG DDRC_ctArDebLvl.DFC_RBA_IODIAGPWR_rba_IoExtCy329_SignalVltSply_2UV DDRC_ctArDebLvl.DFC_CAN_E_TIMEOUT DDRC_ctArDebLvl.DFC_LIN_E_TIMEOUT DDRC_ctArDebLvl.DFC_MRlyOL DDRC_ctArDebLvl.DFC_MRlySCB DDRC_ctArDebLvl.DFC_MRlySCG DDRC_ctArDebLvl.DFC_rba_MultiStackTrace_Threshold DDRC_stLstRprtEve.DFC_BusDiagCANAPPLBusOff DDRC_stLstRprtEve.DFC_BusDiagCANCANCBusOff DDRC_stLstRprtEve.DFC_BusDiagCANVEHICLEBusOff DDRC_stLstRprtEve.DFC_RBA_IODIAGPWR_rba_IoExtCy329_SignalVltSply_0 DDRC_stLstRprtEve.DFC_RBA_IODIAGPWR_rba_IoExtCy329_SignalVltSply_0OT DDRC_stLstRprtEve.DFC_RBA_IODIAGPWR_rba_IoExtCy329_SignalVltSply_0OV DDRC_stLstRprtEve.DFC_RBA_IODIAGPWR_rba_IoExtCy329_SignalVltSply_0SCG DDRC_stLstRprtEve.DFC_RBA_IODIAGPWR_rba_IoExtCy329_SignalVltSply_0UV DDRC_stLstRprtEve.DFC_RBA_IODIAGPWR_rba_IoExtCy329_SignalVltSply_1 DDRC_stLstRprtEve.DFC_RBA_IODIAGPWR_rba_IoExtCy329_SignalVltSply_1OT DDRC_stLstRprtEve.DFC_RBA_IODIAGPWR_rba_IoExtCy329_SignalVltSply_1OV DDRC_stLstRprtEve.DFC_RBA_IODIAGPWR_rba_IoExtCy329_SignalVltSply_1SCG DDRC_stLstRprtEve.DFC_RBA_IODIAGPWR_rba_IoExtCy329_SignalVltSply_1UV DDRC_stLstRprtEve.DFC_RBA_IODIAGPWR_rba_IoExtCy329_SignalVltSply_2 DDRC_stLstRprtEve.DFC_RBA_IODIAGPWR_rba_IoExtCy329_SignalVltSply_2OT DDRC_stLstRprtEve.DFC_RBA_IODIAGPWR_rba_IoExtCy329_SignalVltSply_2OV DDRC_stLstRprtEve.DFC_RBA_IODIAGPWR_rba_IoExtCy329_SignalVltSply_2SCG DDRC_stLstRprtEve.DFC_RBA_IODIAGPWR_rba_IoExtCy329_SignalVltSply_2UV DDRC_stLstRprtEve.DFC_CAN_E_TIMEOUT DDRC_stLstRprtEve.DFC_LIN_E_TIMEOUT DDRC_stLstRprtEve.DFC_MRlyOL DDRC_stLstRprtEve.DFC_MRlySCB DDRC_stLstRprtEve.DFC_MRlySCG DDRC_stLstRprtEve.DFC_rba_MultiStackTrace_Threshold /end LOC_MEASUREMENT
/end FUNCTION
/begin FUNCTION DDSKV "51.22.0   Diagnosis; high pressure sensor"
 /begin DEF_CHARACTERISTIC CWDSKVR CWDSKVR1 DDSKVFRAMN DDSKVFRAMX DDSKVORAMN DDSKVORAMX DSKVTABST DTMSTANSO DTMSTTUMO DTMSTTUMU DTUMTANSU FuPHi_pAftPreDrvMin_C FuPHi_pNegOffsSuspcThd_C FuPHi_pPosOffsAftPreRunThd_C FuPHi_pPosOffsSuspcThd_C FuPHi_pRngChkMaxExtd_T FuPHi_pRngChkMin_C FuPHi_pSpstPhdMin_C KLTDDSNO TATMDIFF TDEKPON TDEKPPRE TMABSDSO TMMXREQ TMSTSDSO TMTADIFF TNSEDDSKV TSTENDDSNO TVDDSKV TVDDSKVEO TVDDSKVSEO TVDSKVRH TVDSKVRHL TVPRMNPL /end DEF_CHARACTERISTIC
 /begin IN_MEASUREMENT B_ebfmod_msg B_enbhtr_msg B_nbhtr_msg B_nibhtr_msg B_prrohrg_msg B_tmsrt_msg CEngDsT_t CEngDsT_tStop CEngDsT_tStrt Eep_EnvRamHist Eep_EnvRamInvld EngStrt_bFrstStrtEnd EnvT_t EpmCrS_stSigMode Epm_nEngLRes Epm_stSpd fra_w_msg FuPHi_pRawRel ora_w_msg PSP_st SyC_stSub SyC_stSubOld SyC_tiDrv tans_msg TiEngOff_stTi TiEngOff_ti tnse_w_msg /end IN_MEASUREMENT
 /begin OUT_MEASUREMENT B_dskvcosk_msg B_dskvepo_msg B_dskvnng_msg B_dskvnno_msg B_dskvnpo_msg B_dskvsepo_msg B_dskvsig_msg B_dskvsno_msg B_dskvspoi_msg B_dskvspo_msg B_dskvtank_msg B_nmotno_msg B_plprroh_msg B_reqddskv_msg FuPHi_flgEnaStoreLoP_msg FuPHi_pRawRelInit /end OUT_MEASUREMENT
 /begin LOC_MEASUREMENT B_bhdtf B_coskneg B_coskretr B_dskvekpv B_dskveno B_dskvnpl B_dskvpwf B_ekpvlpre B_initpr B_prcproh B_prini B_propre B_proten B_prpre B_tiekold FuPHi_flgDSMClrDSKVRNpl10ms FuPHi_flgDSMClrDSKVRNpl50ms FuPHi_flgDSMClrDSKVRSig10ms FuPHi_flgDSMClrDSKVRSig50ms FuPHi_stDetSleep pnekp_w prnekpvl_w prprekp_w prpre_w prvekpvl_w tiekpold tiekp_w /end LOC_MEASUREMENT
 FUNCTION_VERSION "51.22.0" /end FUNCTION
/begin FUNCTION DECJ "100.4.0   standard powerstage diagnosis enabling" /begin DEF_CHARACTERISTIC NDECJ UBCJMN UBCJMX /end DEF_CHARACTERISTIC /begin IN_MEASUREMENT BattU_u Epm_nEngLRes SyC_stSub /end IN_MEASUREMENT /begin OUT_MEASUREMENT B_deseehr_msg B_desee_msg B_PmdInit_msg /end OUT_MEASUREMENT FUNCTION_VERSION "100.4.0" /end FUNCTION
/begin FUNCTION DELib "1.67.0_1.7.0Library Device Encapsulation" FUNCTION_VERSION "1.67.0_1.7.0" /end FUNCTION
/begin FUNCTION DELib_ActrCoorrSimple "1.4.0     Simple Coordinator Layer for Actuators" FUNCTION_VERSION "1.4.0" /end FUNCTION
/begin FUNCTION DELib_ActrElecDrvrSimple "1.5.0     Simple Electrical Driver Layer for Actuators" FUNCTION_VERSION "1.5.0" /end FUNCTION
/begin FUNCTION DELib_ActrElecMonSimple "1.5.0     Simple Electrical Monitoring Layer for Actuators" FUNCTION_VERSION "1.5.0" /end FUNCTION
/begin FUNCTION DELib_ActrHldILimnSimple "1.4.0     Simple Holding Current Limitation for Actuators" FUNCTION_VERSION "1.4.0" /end FUNCTION
/begin FUNCTION DELib_ActrPsDrvrSimple "1.6.0     Simple Power Stage Driver for Actuators" FUNCTION_VERSION "1.6.0" /end FUNCTION
/begin FUNCTION DELib_ActrPwrStgDrvr "3.0.0     Actuator power stage driver" FUNCTION_VERSION "3.0.0" /end FUNCTION
/begin FUNCTION DELib_ActrRCalcn "2.2.0     Electrical resistance calculation of coils" FUNCTION_VERSION "2.2.0" /end FUNCTION
/begin FUNCTION DELib_ActvnDeactvnCdn "2.0.0     Activation and Deactivation Conditions" FUNCTION_VERSION "2.0.0" /end FUNCTION
/begin FUNCTION DELib_DevDrvrOutpDutyCycRamp "1.1.0     Device Driver - Duty Cycle Ramp" FUNCTION_VERSION "1.1.0" /end FUNCTION
/begin FUNCTION DELib_ElecActr "26.4.0    single source library for closed loop controlled actuators" /begin OUT_MEASUREMENT DELib_stEepTEngOff DELib_tEngOffEEP /end OUT_MEASUREMENT FUNCTION_VERSION "26.4.0" /end FUNCTION
/begin FUNCTION DELib_ElecActrAdpvPosnCtrlInp "4.0.0     Function to handle the input calculation of the adaptive position governor" FUNCTION_VERSION "4.0.0" /end FUNCTION
/begin FUNCTION DELib_ElecActrAvs "2.1.0     AVS Functions for ElecActr" FUNCTION_VERSION "2.1.0" /end FUNCTION
/begin FUNCTION DELib_ElecActrCoorrLib "12.1.0    Electrical Actuator Coordinator Library" FUNCTION_VERSION "12.1.0" /end FUNCTION
/begin FUNCTION DELib_ElecactrDdSnsrReadLib "1.25.0    Library to support the Reading of Raw values from Sensor" FUNCTION_VERSION "1.25.0" /end FUNCTION
/begin FUNCTION DELib_ElecActrElecDiagLib "1.13.0    Library for Electrical diagnosis support" FUNCTION_VERSION "1.13.0" /end FUNCTION
/begin FUNCTION DELib_ElecActrGovrLib "13.0.0    Governor library for closed loop controlled actuators" FUNCTION_VERSION "13.0.0" /end FUNCTION
/begin FUNCTION DELib_ElecActrSpArbn "3.0.0     FC for actuator set-point arbitration" FUNCTION_VERSION "3.0.0" /end FUNCTION
/begin FUNCTION DELib_ElecActrVdMonLib "17.0.0    Library to support the Monitoring functions of Electrical Actuator" FUNCTION_VERSION "17.0.0" /end FUNCTION
/begin FUNCTION DELib_ElecActrVdPosnGovrInpLib "14.2.0    Library to support the Positition governor input functions" FUNCTION_VERSION "14.2.0" /end FUNCTION
/begin FUNCTION DELib_ElecActrVdPosnGovrLib "10.1.0    Library to support the Position Governor" FUNCTION_VERSION "10.1.0" /end FUNCTION
/begin FUNCTION DELib_ElecActrVdSnsrLib "13.2.0    Device Encapsulation Library - Electrical Actuators VdSnsr" FUNCTION_VERSION "13.2.0" /end FUNCTION
/begin FUNCTION DELib_Fir "1.2.0     Fir" FUNCTION_VERSION "1.2.0" /end FUNCTION
/begin FUNCTION DELib_GlbActrLimnCntr "1.1.0     Actuator Limitation Counter" FUNCTION_VERSION "1.1.0" /end FUNCTION
/begin FUNCTION DELib_GlbAdp "10.2.0    DELib Adapter"
 /begin IN_MEASUREMENT Air_tEGRClrLPDs BrkBstP_p CEngDsT_t CEngDsT_t_Sq CEngUsT_t EngDa_tEng EnvP_p EnvT_t EnvT_t_Sq ExhMod_pRelPfilDs ExhMod_tExhCat1DsB1 FuelT_t IntkAirT_t OilP_p OilSwmpT_t /end IN_MEASUREMENT
 /begin OUT_MEASUREMENT Air_tEGRClrLPDs_f BrkBstP_p_f CEngDsT_t_f CEngDsT_t_f_Sq CEngUsT_t_f EngDa_tEng_f EnvP_p_f EnvT_t_f EnvT_t_f_Sq ExhMod_pRelPfilDs_f ExhMod_tExhCat1DsB1_f FuelT_t_f IntkAirT_t_f OilP_p_f OilSwmpT_t_f /end OUT_MEASUREMENT
 FUNCTION_VERSION "10.2.0" /end FUNCTION
/begin FUNCTION DELib_GlbArAdpr "2.0.0     Adapter for global MSR to AUTOSAR interfaces" /begin IN_MEASUREMENT BattU_facCor DevLib_stPwrStgEnaCond SyC_ctPostDrvLeave /end IN_MEASUREMENT FUNCTION_VERSION "2.0.0" /end FUNCTION
/begin FUNCTION DELib_GlbDef "31.6.0    DELib_GlbDef :" FUNCTION_VERSION "31.6.0" /end FUNCTION
/begin FUNCTION DELib_GlbDefAc "15.0.0    Autocode of Global Functions of DELib" FUNCTION_VERSION "15.0.0" /end FUNCTION
/begin FUNCTION DELib_GlbSrvAdvTstrSrvRels "4.0.0     Global Function for Advanced Tester Service release" FUNCTION_VERSION "4.0.0" /end FUNCTION
/begin FUNCTION DELib_GlbSrvDdReadFil "1.14.0    Global Function for Device Library Filter read" FUNCTION_VERSION "1.14.0" /end FUNCTION
/begin FUNCTION DELib_GlbSrvDesValCntr "2.0.0     Global Service for the Desired Value Counter" FUNCTION_VERSION "2.0.0" /end FUNCTION
/begin FUNCTION DELib_GlbSrvEcuModDetn "1.2.0     Function for ECU mode detection" FUNCTION_VERSION "1.2.0" /end FUNCTION
/begin FUNCTION DELib_GlbSrvElecDd "1.8.0     Internal Library for DELib Electrical Layer driving" FUNCTION_VERSION "1.8.0" /end FUNCTION
/begin FUNCTION DELib_GlbSrvFloat "2.0.0     Global Function for Float" FUNCTION_VERSION "2.0.0" /end FUNCTION
/begin FUNCTION DELib_GlbSrvGovrOutpRamp "1.0.0     Global Service Governor Output Ramp" FUNCTION_VERSION "1.0.0" /end FUNCTION
/begin FUNCTION DELib_GlbSrvGrdtLimn "4.0.0     DELib Service Library for gradient limitation" FUNCTION_VERSION "4.0.0" /end FUNCTION
/begin FUNCTION DELib_GlbSrvHldgILimn "1.9.0     Global Function for Holding Current Limitation" FUNCTION_VERSION "1.9.0" /end FUNCTION
/begin FUNCTION DELib_GlbSrvJamHeal "3.1.0     DELib Global Service Library for jam healing" FUNCTION_VERSION "3.1.0" /end FUNCTION
/begin FUNCTION DELib_GlbSrvObd "5.0.0     Global Function for On Board Diagnosis" FUNCTION_VERSION "5.0.0" /end FUNCTION
/begin FUNCTION DELib_GlbSrvPosnChgCntr "3.0.0     Global Service for the Position Change Counter" FUNCTION_VERSION "3.0.0" /end FUNCTION
/begin FUNCTION DELib_GlbSrvSnsrSeln "8.3.0     Global Function for Sensor Selection"
 /begin IN_MEASUREMENT Air_tEGRClrLPDs_f BrkBstP_p_f CEngDsT_t_f CEngUsT_t_f DELib_idxArrSnsr DELib_stArrSnsr DELib_xArrSnsr EngDa_tEng_f EnvP_p_f EnvT_t_f ExhMod_pRelPfilDs_f ExhMod_tExhCat1DsB1_f FuelT_t_f IntkAirT_t_f OilP_p_f OilSwmpT_t_f SyC_stSub T15_st /end IN_MEASUREMENT
 /begin OUT_MEASUREMENT DELib_numVar_mp DELib_num_mp DELib_stFirstPreDrvOverCopy /end OUT_MEASUREMENT
 FUNCTION_VERSION "8.3.0" /end FUNCTION
/begin FUNCTION DELib_GlbSrvSnsrSeln_Auto "" /begin OUT_MEASUREMENT DELib_idxArrSnsr DELib_stArrSnsr DELib_xArrSnsr /end OUT_MEASUREMENT /end FUNCTION
/begin FUNCTION DELib_GlbSrvSpFil "3.0.0     DELib Global Service Library for set-point filtering" FUNCTION_VERSION "3.0.0" /end FUNCTION
/begin FUNCTION DELib_GlbTst "1.17.0    Tester functions for the actuators configured in DELib" FUNCTION_VERSION "1.17.0" /end FUNCTION
/begin FUNCTION DELib_GovrDeMonLib "4.4.0     Library for Governor Deviation Monitoring" FUNCTION_VERSION "4.4.0" /end FUNCTION
/begin FUNCTION DELib_Pll "1.1.0     PLL - Phase Locked Loop" FUNCTION_VERSION "1.1.0" /end FUNCTION
/begin FUNCTION DELib_StcFctActr "1.1.0     Statistic Functions Actuator" FUNCTION_VERSION "1.1.0" /end FUNCTION
/begin FUNCTION DELib_VrntCodSimple "1.4.0     Simple Variant Coding" FUNCTION_VERSION "1.4.0" /end FUNCTION
/begin FUNCTION DemDcmIf "30000.14.0_2.0.0Dem-Dcm Interfaces" /begin IN_MEASUREMENT DFES_stOutstate DSMAUX_ctWUC DSMRdy_xPId1 DSMRdy_xPId41 /end IN_MEASUREMENT /begin OUT_MEASUREMENT Dem_disableEventStatusUpdateGroup /end OUT_MEASUREMENT
 /begin LOC_MEASUREMENT Dem_DTCFltForFltDetnCntr Dem_DTCFltFormat Dem_DTCFltOrigin Dem_DTCFltProcCnt Dem_DTCFltProcIdx Dem_DTCFltRecFormat Dem_DTCFltRecRsltIdx Dem_DTCFltRsltIdx Dem_DTCFltSeverity Dem_DTCFltSt Dem_DTCFltStatusMask Dem_DTCFltWithSev /end LOC_MEASUREMENT
 FUNCTION_VERSION "30000.14.0_2.0.0" /end FUNCTION
/begin FUNCTION DETHSDFC "13.2.0    Diagnosis ethanol sensor connection to fault code memory" /begin DEF_CHARACTERISTIC NETHSEOSC_C TDETHSE_C TDETHSF_C TDETHSPW_C TETHSEOSC_C /end DEF_CHARACTERISTIC /begin REF_CHARACTERISTIC FfPrm_stEna_C /end REF_CHARACTERISTIC
 /begin IN_MEASUREMENT BattU_stErrDSQ B_ethsemn_msg B_ethsemx_msg B_ethsen_msg B_ethsfmn_msg B_ethsfmx_msg B_ethsfsi_msg B_ethsnpl_msg B_ethsplh_msg B_ethspwmn_msg B_ethspwmx_msg B_ethspwsi_msg B_ethstnpl_msg B_ethstplh_msg B_fvdeths_msg DSM_TripChgFinshd ETHSCP_flgErrDrvCyc SyC_ctPostDrvLeave SyC_stSub /end IN_MEASUREMENT
 /begin OUT_MEASUREMENT B_ethseosc_msg /end OUT_MEASUREMENT
 /begin LOC_MEASUREMENT DETHSDFC_ctReIni /end LOC_MEASUREMENT
 FUNCTION_VERSION "13.2.0" /end FUNCTION
/begin FUNCTION DevLib_DigOutErrHndlr "1.147.0   Digital Output Error handling module" /begin DEF_CHARACTERISTIC DevLib_DigOutDbgSig_C /end DEF_CHARACTERISTIC
 /begin LOC_MEASUREMENT DevLib_stDigOutErr_mp DevLib_stDigOutPrevTst_mp DevLib_stDigOutTstImp_mp /end LOC_MEASUREMENT
 FUNCTION_VERSION "1.147.0" /end FUNCTION
/begin FUNCTION DevLib_PhysRngChk "1.145.0   Device library for physical range check" FUNCTION_VERSION "1.145.0" /end FUNCTION
/begin FUNCTION DevLib_PsDiag "1.148.0   Common part of Digital and PWM powerstage diagnosis" FUNCTION_VERSION "1.148.0" /end FUNCTION
/begin FUNCTION DevLib_PWMOutErrHndlr "100.1.0   PWM Output error handling module" /begin DEF_CHARACTERISTIC DevLib_PWMOutDbgSig_C /end DEF_CHARACTERISTIC
 /begin LOC_MEASUREMENT DevLib_stPWMOutErr_mp DevLib_stPWMOutPrevTst_mp DevLib_stPWMOutTstImp_mp /end LOC_MEASUREMENT
 FUNCTION_VERSION "100.1.0" /end FUNCTION
/begin FUNCTION DevLib_PwrStgState "100.7.0   Power Stage State"
 /begin DEF_CHARACTERISTIC Devlib_PsDisbl.facLowHysLo_C Devlib_PsDisbl.facLowHysHi_C Devlib_PsDisbl.facHighHysLo_C Devlib_PsDisbl.facHighHysHi_C Devlib_PwrStg.BattLoHysLo_C Devlib_PwrStg.BattLoHysHi_C Devlib_PwrStg.BattHiHysLo_C Devlib_PwrStg.BattHiHysHi_C /end DEF_CHARACTERISTIC
 /begin IN_MEASUREMENT BattU_facCor BattU_u DSM_TripChgFinshd MoCSOP_stRdy MoCSOP_stRdyMsg SyC_stSub /end IN_MEASUREMENT
 /begin OUT_MEASUREMENT DevLib_stPwrStgEnaCond /end OUT_MEASUREMENT
 FUNCTION_VERSION "100.7.0" /end FUNCTION
/begin FUNCTION DevLib_SRC "1.145.0   Device Library electrical Signal Range Check" FUNCTION_VERSION "1.145.0" /end FUNCTION
/begin FUNCTION DevLib_TransStage "1.149.0   Device Library Transition Stage for sensor replacement values" FUNCTION_VERSION "1.149.0" /end FUNCTION
/begin FUNCTION DFC "30000.33.0_1.1.0Diagnostic Fault Check"
 /begin OUT_MEASUREMENT DFC_b.TST_AAVEmax DFC_b.TST_AAVEmin DFC_b.TST_AAVEsig DFC_b.TST_AltIOACGFailr DFC_b.TST_AltIOACGHiVltg DFC_b.TST_AltIOACGLoVltg DFC_b.TST_AltIOACGTHi DFC_b.TST_AltIODConnACG DFC_b.TST_BGOELWAF DFC_b.TST_BattUHiFailr DFC_b.TST_BattULoFailr DFC_b.TST_BrkBstPDriftHiErr DFC_b.TST_BrkBstPDriftLoErr DFC_b.TST_BrkBstPSnsrStuck DFC_b.TST_BrkMnSwtContOn DFC_b.TST_BrkMnSwtNotStp DFC_b.TST_BrkNpl DFC_b.TST_BrkRdntSwtContOn DFC_b.TST_BrkRdntSwtNotStp DFC_b.TST_Clth3ONStuck DFC_b.TST_Clth4OFFStuck DFC_b.TST_ClthOFFStuck DFC_b.TST_ClthONStuck DFC_b.TST_ClthStkFailInfo DFC_b.TST_ComACFailInfo DFC_b.TST_ComATFTValErr DFC_b.TST_ComATMILReq DFC_b.TST_ComAYCAChksum DFC_b.TST_ComAYCARingCnt DFC_b.TST_ComAYCATOut DFC_b.TST_ComAYCDChkSum DFC_b.TST_ComAYCDTOut DFC_b.TST_ComAYCFChksum DFC_b.TST_ComAYCFRingCnt DFC_b.TST_ComAYCFTOut DFC_b.TST_ComAYCGChksum DFC_b.TST_ComAYCGRingCnt DFC_b.TST_ComAYCGTOut DFC_b.TST_ComAYCIChkSum DFC_b.TST_ComAYCIRingCnt DFC_b.TST_ComAYCITOut DFC_b.TST_ComBCM1ChkSum DFC_b.TST_ComBCM1RingCnt DFC_b.TST_ComBCM1TOut DFC_b.TST_ComCANABusOffErr DFC_b.TST_ComCANBBusOffErr DFC_b.TST_ComCANCBusOffErr DFC_b.TST_ComCGW1ChkSum DFC_b.TST_ComCGW1RingCnt DFC_b.TST_ComCGW1TOut DFC_b.TST_ComConvBoostErr DFC_b.TST_ComConvSlipErr DFC_b.TST_ComDCDCPrfmncErr DFC_b.TST_ComDCDCTempWarn DFC_b.TST_ComEAT10Chksum DFC_b.TST_ComEAT10RingCnt DFC_b.TST_ComEAT10TOut DFC_b.TST_ComEAT11ChkSum DFC_b.TST_ComEAT11RingCnt DFC_b.TST_ComEAT11TOut DFC_b.TST_ComEAT12ChkSum DFC_b.TST_ComEAT12RingCnt DFC_b.TST_ComEAT12TOut DFC_b.TST_ComEAT13ChkSum DFC_b.TST_ComEAT13RingCnt DFC_b.TST_ComEAT13TOut DFC_b.TST_ComEAT1Chksum DFC_b.TST_ComEAT1RingCnt DFC_b.TST_ComEAT1TOut DFC_b.TST_ComEAT2ChkSum DFC_b.TST_ComEAT2RingCnt DFC_b.TST_ComEAT2TOut DFC_b.TST_ComEAT4ChkSum DFC_b.TST_ComEAT4RingCnt DFC_b.TST_ComEAT4TOut DFC_b.TST_ComEAT6Chksum DFC_b.TST_ComEAT6RingCnt DFC_b.TST_ComEAT6TOut DFC_b.TST_ComEAT7Chksum DFC_b.TST_ComEAT7RingCnt DFC_b.TST_ComEAT7TOut DFC_b.TST_ComEAT8Chksum DFC_b.TST_ComEAT8RingCnt DFC_b.TST_ComEAT8TOut DFC_b.TST_ComEATAChksum DFC_b.TST_ComEATARingCnt DFC_b.TST_ComEATATOut DFC_b.TST_ComEATBChkSum DFC_b.TST_ComEATBRingCnt DFC_b.TST_ComEATBTOut DFC_b.TST_ComEATCChksum DFC_b.TST_ComEATCRingCnt DFC_b.TST_ComEATCTOut DFC_b.TST_ComEPBBChkSum DFC_b.TST_ComEPBBRingCnt DFC_b.TST_ComEPBBTOut DFC_b.TST_ComEPBChksum DFC_b.TST_ComEPBTOut DFC_b.TST_ComEPBctRing DFC_b.TST_ComEPS1Chksum DFC_b.TST_ComEPS1RingCnt DFC_b.TST_ComEPS1TOut DFC_b.TST_ComEngCanRxErr DFC_b.TST_ComGrvySnsrErr DFC_b.TST_ComGwIMG1ChkSum DFC_b.TST_ComGwIMG1RingCnt DFC_b.TST_ComGwIMG1TOut DFC_b.TST_ComGwIMG3ChkSum DFC_b.TST_ComGwIMG3RingCnt DFC_b.TST_ComGwIMG3TOut DFC_b.TST_ComGwIMG4ChkSum DFC_b.TST_ComGwIMG4RingCnt DFC_b.TST_ComGwIMG4TOut DFC_b.TST_ComGwIMG5ChkSum DFC_b.TST_ComGwIMG5RingCnt DFC_b.TST_ComGwIMG5TOut DFC_b.TST_ComGwIMG6ChkSum DFC_b.TST_ComGwIMG6RingCnt DFC_b.TST_ComGwIMG6TOut DFC_b.TST_ComIDASBChksum DFC_b.TST_ComIDASBRingCnt DFC_b.TST_ComIDASBTOut DFC_b.TST_ComIMGMILReq DFC_b.TST_ComISSPrms DFC_b.TST_ComMETAChksum DFC_b.TST_ComMETAChksumPstDrv DFC_b.TST_ComMETARingCnt DFC_b.TST_ComMETARingCntPstDrv DFC_b.TST_ComMETATOut DFC_b.TST_ComMETATOutPstDrv DFC_b.TST_ComMETCChksum DFC_b.TST_ComMETCRingCnt DFC_b.TST_ComMETCTOut DFC_b.TST_ComMETDChksum DFC_b.TST_ComMETDRingCnt DFC_b.TST_ComMETDTOut DFC_b.TST_ComMETE2Chksum DFC_b.TST_ComMETE2RingCnt DFC_b.TST_ComMETE2TOut DFC_b.TST_ComMETFChksum DFC_b.TST_ComMETFRingCnt DFC_b.TST_ComMETFTOut DFC_b.TST_ComMETGChksum DFC_b.TST_ComMETGRingCnt DFC_b.TST_ComMETGTOut DFC_b.TST_ComMETH2Chksum DFC_b.TST_ComMETH2RingCnt DFC_b.TST_ComMETH2TOut DFC_b.TST_ComMETHChksum DFC_b.TST_ComMETHRingCnt DFC_b.TST_ComMETHTOut DFC_b.TST_ComMETIChksum DFC_b.TST_ComMETIRingCnt DFC_b.TST_ComMETITOut DFC_b.TST_ComMETKChksum DFC_b.TST_ComMETKRingCnt DFC_b.TST_ComMETKTOut DFC_b.TST_ComMETLChksum DFC_b.TST_ComMETLRingCnt DFC_b.TST_ComMETLTOut DFC_b.TST_ComMETMChksum DFC_b.TST_ComMETMRingCnt DFC_b.TST_ComMETMTOut DFC_b.TST_ComMETNChksum DFC_b.TST_ComMETNRingCnt DFC_b.TST_ComMETNTOut DFC_b.TST_ComMtrCom DFC_b.TST_ComPCUChkSum DFC_b.TST_ComPCURingCnt DFC_b.TST_ComPCUTOut DFC_b.TST_ComSRSAChksum DFC_b.TST_ComSRSARingCnt DFC_b.TST_ComSRSATOut DFC_b.TST_ComSRSBChksum DFC_b.TST_ComSRSBRingCnt DFC_b.TST_ComSRSBTOut DFC_b.TST_ComSRSChksum DFC_b.TST_ComSRSErr DFC_b.TST_ComSRSRingCnt DFC_b.TST_ComSRSTOut DFC_b.TST_ComVehSpdPndFltTCU DFC_b.TST_EbsChartcCurrErr DFC_b.TST_EbsSelfDiagErr DFC_b.TST_GEVlvPhaCsersIntkB1 DFC_b.TST_GEVlvPhaPsOpenLoadIntkB1 DFC_b.TST_GEVlvPhaPsShoToBattIntkB1 DFC_b.TST_GEVlvPhaPsShoToGndIntkB1 DFC_b.TST_GbxCANDigPlausErr DFC_b.TST_GbxNPos1SRCMax DFC_b.TST_GbxNPos1SRCMin DFC_b.TST_GbxNPos2SRCMax DFC_b.TST_GbxNPos2SRCMin DFC_b.TST_GbxNPosAlvChk DFC_b.TST_GbxNPosSyncErr DFC_b.TST_HEGOS2B1HtrPsMax DFC_b.TST_HEGOS2B1HtrPsMin DFC_b.TST_HEGOS2B1HtrPsSig DFC_b.TST_LinCSErrACG DFC_b.TST_LinCSErrAEV DFC_b.TST_LinCSErrDCDC DFC_b.TST_LinCSErrEBS DFC_b.TST_LinHdrTimeoutErrACG DFC_b.TST_LinHdrTimeoutErrAEV DFC_b.TST_LinHdrTimeoutErrDCDC DFC_b.TST_LinHdrTimeoutErrEBS DFC_b.TST_LinMsgTimeoutErrACG DFC_b.TST_LinMsgTimeoutErrAEV DFC_b.TST_LinMsgTimeoutErrDCDC DFC_b.TST_LinMsgTimeoutErrEBS DFC_b.TST_LinNoStrtComErr DFC_b.TST_LowPresOilP DFC_b.TST_MisfDetVWhlFrntLeOORHi DFC_b.TST_MisfDetVWhlFrntLeRatyHi DFC_b.TST_MisfDetVWhlFrntLeRatyLo DFC_b.TST_MisfDetVWhlFrntLeStuck DFC_b.TST_MisfDetVWhlFrntRiOORHi DFC_b.TST_MisfDetVWhlFrntRiRatyHi DFC_b.TST_MisfDetVWhlFrntRiRatyLo DFC_b.TST_MisfDetVWhlFrntRiStuck DFC_b.TST_MisfDetVWhlReLeOORHi DFC_b.TST_MisfDetVWhlReLeRatyHi DFC_b.TST_MisfDetVWhlReLeRatyLo DFC_b.TST_MisfDetVWhlReLeStuck DFC_b.TST_MisfDetVWhlReRiOORHi DFC_b.TST_MisfDetVWhlReRiRatyHi DFC_b.TST_MisfDetVWhlReRiRatyLo DFC_b.TST_MisfDetVWhlReRiStuck DFC_b.TST_MisfDetdVWhlFrntLePlaus DFC_b.TST_MisfDetdVWhlFrntRiPlaus DFC_b.TST_MisfDetdVWhlReLePlaus DFC_b.TST_MisfDetdVWhlReRiPlaus DFC_b.TST_PEnvSigRngMax DFC_b.TST_PEnvSigRngMin DFC_b.TST_StmFault DFC_b.TST_StrtCtOffPth DFC_b.TST_StrtCtlErr DFC_b.TST_StrtFault /end OUT_MEASUREMENT
 FUNCTION_VERSION "30000.33.0_1.1.0" /end FUNCTION
/begin COMPU_METHOD B_TRUE "" TAB_VERB "%6.3" "" COMPU_TAB_REF B_TRUE /end COMPU_METHOD
/begin COMPU_VTAB B_TRUE "" TAB_VERB 2 0 "FALSE" 1 "TRUE" /end COMPU_VTAB
/begin COMPU_METHOD DDRCTime_ms "" RAT_FUNC "%6.1" "ms" COEFFS 0 1 0 0 0 10 /end COMPU_METHOD
/begin COMPU_METHOD DDRC_LstRprtEve_VERB "" TAB_VERB "%6.3" "" COMPU_TAB_REF DDRC_LstRprtEve_VERB /end COMPU_METHOD
/begin COMPU_VTAB DDRC_LstRprtEve_VERB "" TAB_VERB 5 0 "PASSED" 1 "FAILED" 2 "PREPASSED" 3 "PREFAILED" 255 "INVALID" /end COMPU_VTAB
/begin COMPU_METHOD DDRC_Ratio "" TAB_VERB "%6.3" "-" COMPU_TAB_REF DDRC_Ratio /end COMPU_METHOD
/begin COMPU_VTAB DDRC_Ratio "" TAB_VERB 4 1 "Ratio1" 2 "Ratio2" 3 "Ratio3" 4 "Ratio4" /end COMPU_VTAB
/begin COMPU_METHOD Dem_DTCFltSt_Verb "" TAB_VERB "%6.3" "-" COMPU_TAB_REF Dem_DTCFltSt_Verb /end COMPU_METHOD
/begin COMPU_VTAB Dem_DTCFltSt_Verb "" TAB_VERB 6 0 "IDLE" 1 "UDS_ENTRIES_PENDING" 2 "UDS_DTCS_PENDING" 3 "UDS_ENTRIES_RSLT" 4 "OBD_ENTRIES_RSLT" 5 "UDS_DTCS_RSLT" /end COMPU_VTAB
/begin COMPU_METHOD dez "" RAT_FUNC "%6.2" "" COEFFS 0 1 0 0 0 1 /end COMPU_METHOD
/begin COMPU_METHOD DFC_OneToOne "" RAT_FUNC "%6.2" "-" COEFFS 0 1 0 0 0 1 /end COMPU_METHOD
/begin COMPU_METHOD EGSDIA_SYMTRANONLY_SC_Compu "" TAB_VERB "%6.3" "" COMPU_TAB_REF EGSDIA_SYMTRANONLY_SC_Compu /end COMPU_METHOD
/begin COMPU_VTAB EGSDIA_SYMTRANONLY_SC_Compu "" TAB_VERB 2 0 "False" 1 "True" /end COMPU_VTAB
/begin COMPU_METHOD EGSDIA_VAR_SY_Compu "" TAB_VERB "%6.3" "" COMPU_TAB_REF EGSDIA_VAR_SY_Compu /end COMPU_METHOD
/begin COMPU_VTAB EGSDIA_VAR_SY_Compu "" TAB_VERB 51 0 "kein Kundenbezug" 1 "DAI" 3 "VWW" 4 "POR" 5 "AUD" 6 "OPE" 9 "FIA" 11 "BMW" 14 "PSA" 15 "REN" 17 "ALF" 18 "SAB" 19 "VOL" 20 "NIS" 21 "GMU" 22 "FOR" 26 "IMJ" 36 "MAN" 51 "SEA" 53 "CHR" 54 "JAG" 55 "ROL" 69 "FER" 72 "TOY" 112 "BMWMotorradAG" 123 "MIT" 147 "HYU" 159 "HON" 160 "MAZ" 183 "CU" 190 "LRG" 204 "VVW" 214 "AVT" 242 "Iveco" 243 "DMC" 248 "SUZ" 267 "SSANGYONG" 270 "KEF" 289 "AMG" 308 "TAT" 319 "MVM" 385 "UAES" 578 "AL" 590 "Scania" 760 "WEICHAI" 828 "RBCD" 966 "International" 998 "S1" 999 "ALL" 2887 "NONOX" 9454 "Fuso" /end COMPU_VTAB
/begin COMPU_METHOD EGSDNOX_TRANDS_SC_Compu "" TAB_VERB "%6.3" "" COMPU_TAB_REF EGSDNOX_TRANDS_SC_Compu /end COMPU_METHOD
/begin COMPU_VTAB EGSDNOX_TRANDS_SC_Compu "" TAB_VERB 2 0 "False" 1 "True" /end COMPU_VTAB
/begin COMPU_METHOD EGSDO2_SYMCDYNDIAG_SC_Compu "" TAB_VERB "%6.3" "" COMPU_TAB_REF EGSDO2_SYMCDYNDIAG_SC_Compu /end COMPU_METHOD
/begin COMPU_VTAB EGSDO2_SYMCDYNDIAG_SC_Compu "" TAB_VERB 2 0 "False" 1 "True" /end COMPU_VTAB
/begin COMPU_METHOD EGSDUFILDYN_SC_Compu "" TAB_VERB "%6.3" "" COMPU_TAB_REF EGSDUFILDYN_SC_Compu /end COMPU_METHOD
/begin COMPU_VTAB EGSDUFILDYN_SC_Compu "" TAB_VERB 2 0 "False" 1 "True" /end COMPU_VTAB
/begin COMPU_METHOD EGSDU_CRSSBNK_SC_Compu "" TAB_VERB "%6.3" "" COMPU_TAB_REF EGSDU_CRSSBNK_SC_Compu /end COMPU_METHOD
/begin COMPU_VTAB EGSDU_CRSSBNK_SC_Compu "" TAB_VERB 2 0 "False" 1 "True" /end COMPU_VTAB
/begin COMPU_METHOD EGSDU_DLYLEAN_SC_Compu "" TAB_VERB "%6.3" "" COMPU_TAB_REF EGSDU_DLYLEAN_SC_Compu /end COMPU_METHOD
/begin COMPU_VTAB EGSDU_DLYLEAN_SC_Compu "" TAB_VERB 2 0 "False" 1 "True" /end COMPU_VTAB
/begin COMPU_METHOD EGSDU_EVLNPASDS_SC_Compu "" TAB_VERB "%6.3" "" COMPU_TAB_REF EGSDU_EVLNPASDS_SC_Compu /end COMPU_METHOD
/begin COMPU_VTAB EGSDU_EVLNPASDS_SC_Compu "" TAB_VERB 2 0 "False" 1 "True" /end COMPU_VTAB
/begin COMPU_METHOD EGSDU_FCO_SC_Compu "" TAB_VERB "%6.3" "" COMPU_TAB_REF EGSDU_FCO_SC_Compu /end COMPU_METHOD
/begin COMPU_VTAB EGSDU_FCO_SC_Compu "" TAB_VERB 2 0 "False" 1 "True" /end COMPU_VTAB
/begin COMPU_METHOD EGSDU_LIMDS_SC_Compu "" TAB_VERB "%6.3" "" COMPU_TAB_REF EGSDU_LIMDS_SC_Compu /end COMPU_METHOD
/begin COMPU_VTAB EGSDU_LIMDS_SC_Compu "" TAB_VERB 2 0 "False" 1 "True" /end COMPU_VTAB
/begin COMPU_METHOD EGSDU_STKUS_SC_Compu "" TAB_VERB "%6.3" "" COMPU_TAB_REF EGSDU_STKUS_SC_Compu /end COMPU_METHOD
/begin COMPU_VTAB EGSDU_STKUS_SC_Compu "" TAB_VERB 2 0 "False" 1 "True" /end COMPU_VTAB
/begin COMPU_METHOD EGSDU_TRANPAS_SC_Compu "" TAB_VERB "%6.3" "" COMPU_TAB_REF EGSDU_TRANPAS_SC_Compu /end COMPU_METHOD
/begin COMPU_VTAB EGSDU_TRANPAS_SC_Compu "" TAB_VERB 2 0 "False" 1 "True" /end COMPU_VTAB
/begin COMPU_METHOD EGSPREPN_ENANOXEGTDS_SC_Compu "" TAB_VERB "%6.3" "" COMPU_TAB_REF EGSPREPN_ENANOXEGTDS_SC_Compu /end COMPU_METHOD
/begin COMPU_VTAB EGSPREPN_ENANOXEGTDS_SC_Compu "" TAB_VERB 2 0 "False" 1 "True" /end COMPU_VTAB
/begin COMPU_METHOD EGSPREPN_VAR_SY_Compu "" TAB_VERB "%6.3" "" COMPU_TAB_REF EGSPREPN_VAR_SY_Compu /end COMPU_METHOD
/begin COMPU_VTAB EGSPREPN_VAR_SY_Compu "" TAB_VERB 51 0 "kein_Kundenbezug" 1 "DAI" 3 "VWW" 4 "POR" 5 "AUD" 6 "OPE" 9 "FIA" 11 "BMW" 14 "PSA" 15 "REN" 17 "ALF" 18 "SAB" 19 "VOL" 20 "NIS" 21 "GMU" 22 "FOR" 26 "IMJ" 36 "MAN" 51 "SEA" 53 "CHR" 54 "JAG" 55 "ROL" 69 "FER" 72 "TOY" 112 "BMWMotorradAG" 123 "MIT" 147 "HYU" 159 "HON" 160 "MAZ" 183 "CU" 190 "LRG" 204 "VVW" 214 "AVT" 242 "Iveco" 243 "DMC" 248 "SUZ" 267 "SSANGYONG" 270 "KEF" 289 "AMG" 308 "TAT" 319 "MVM" 385 "UAES" 578 "AL" 590 "Scania" 760 "WEICHAI" 828 "RBCD" 966 "International" 998 "S1" 999 "All" 2887 "NONOX" 9454 "Fuso" /end COMPU_VTAB
/begin COMPU_METHOD EGSSIG_CRSSSNVTYHIRESLENGSPD_SC_Compu "" TAB_VERB "%6.3" "" COMPU_TAB_REF EGSSIG_CRSSSNVTYHIRESLENGSPD_SC_Compu /end COMPU_METHOD
/begin COMPU_VTAB EGSSIG_CRSSSNVTYHIRESLENGSPD_SC_Compu "" TAB_VERB 2 0 "False" 1 "True" /end COMPU_VTAB
/begin COMPU_METHOD EGSSIG_DICORRNHSP_SC_Compu "" TAB_VERB "%6.3" "" COMPU_TAB_REF EGSSIG_DICORRNHSP_SC_Compu /end COMPU_METHOD
/begin COMPU_VTAB EGSSIG_DICORRNHSP_SC_Compu "" TAB_VERB 2 0 "False" 1 "True" /end COMPU_VTAB
/begin COMPU_METHOD EGSSIG_DLYMEASBUFSIZE_SC_Compu "" RAT_FUNC "%6.2" "" COEFFS 0 1 0 0 0 1 /end COMPU_METHOD
/begin COMPU_METHOD EGSSIG_ENACORRNEOM_SC_Compu "" TAB_VERB "%6.3" "" COMPU_TAB_REF EGSSIG_ENACORRNEOM_SC_Compu /end COMPU_METHOD
/begin COMPU_VTAB EGSSIG_ENACORRNEOM_SC_Compu "" TAB_VERB 2 0 "False" 1 "True" /end COMPU_VTAB
/begin COMPU_METHOD EGSSIG_ENACORRNFUINJ_SC_Compu "" TAB_VERB "%6.3" "" COMPU_TAB_REF EGSSIG_ENACORRNFUINJ_SC_Compu /end COMPU_METHOD
/begin COMPU_VTAB EGSSIG_ENACORRNFUINJ_SC_Compu "" TAB_VERB 2 0 "False" 1 "True" /end COMPU_VTAB
/begin COMPU_METHOD EGSSIG_ENALAMPENVCORRD_SC_Compu "" TAB_VERB "%6.3" "" COMPU_TAB_REF EGSSIG_ENALAMPENVCORRD_SC_Compu /end COMPU_METHOD
/begin COMPU_VTAB EGSSIG_ENALAMPENVCORRD_SC_Compu "" TAB_VERB 2 0 "False" 1 "True" /end COMPU_VTAB
/begin COMPU_METHOD EGSSIG_SELNOXTWC2DS_SC_Compu "" TAB_VERB "%6.3" "" COMPU_TAB_REF EGSSIG_SELNOXTWC2DS_SC_Compu /end COMPU_METHOD
/begin COMPU_VTAB EGSSIG_SELNOXTWC2DS_SC_Compu "" TAB_VERB 7 0 "0" 1 "1" 2 "2" 3 "3" 4 "4" 6 "6" 255 "255" /end COMPU_VTAB
/begin COMPU_METHOD EGSSIG_SELNOXTWC2US_SC_Compu "" TAB_VERB "%6.3" "" COMPU_TAB_REF EGSSIG_SELNOXTWC2US_SC_Compu /end COMPU_METHOD
/begin COMPU_VTAB EGSSIG_SELNOXTWC2US_SC_Compu "" TAB_VERB 7 0 "0" 1 "1" 2 "2" 3 "3" 4 "4" 6 "6" 255 "255" /end COMPU_VTAB
/begin COMPU_METHOD EGSSIG_SELNOXTWCDS_SC_Compu "" TAB_VERB "%6.3" "" COMPU_TAB_REF EGSSIG_SELNOXTWCDS_SC_Compu /end COMPU_METHOD
/begin COMPU_VTAB EGSSIG_SELNOXTWCDS_SC_Compu "" TAB_VERB 7 0 "0" 1 "1" 2 "2" 3 "3" 4 "4" 6 "6" 255 "255" /end COMPU_VTAB
/begin COMPU_METHOD EGSSIG_SELNOXTWCUS_SC_Compu "" TAB_VERB "%6.3" "" COMPU_TAB_REF EGSSIG_SELNOXTWCUS_SC_Compu /end COMPU_METHOD
/begin COMPU_VTAB EGSSIG_SELNOXTWCUS_SC_Compu "" TAB_VERB 7 0 "0" 1 "1" 2 "2" 3 "3" 4 "4" 6 "6" 255 "255" /end COMPU_VTAB
/begin COMPU_METHOD EGSSIG_SELO2ENGDS_SC_Compu "" TAB_VERB "%6.3" "" COMPU_TAB_REF EGSSIG_SELO2ENGDS_SC_Compu /end COMPU_METHOD
/begin COMPU_VTAB EGSSIG_SELO2ENGDS_SC_Compu "" TAB_VERB 4 0 "NO_SNSR_SEL" 1 "SNSR1" 2 "SNSR2" 3 "SNSR_VIA_CAL" /end COMPU_VTAB
/begin COMPU_METHOD EGSSIG_SELO2TWC2DS_SC_Compu "" TAB_VERB "%6.3" "" COMPU_TAB_REF EGSSIG_SELO2TWC2DS_SC_Compu /end COMPU_METHOD
/begin COMPU_VTAB EGSSIG_SELO2TWC2DS_SC_Compu "" TAB_VERB 7 0 "0" 1 "1" 2 "2" 3 "3" 4 "4" 6 "6" 255 "255" /end COMPU_VTAB
/begin COMPU_METHOD EGSSIG_SELO2TWC2US_SC_Compu "" TAB_VERB "%6.3" "" COMPU_TAB_REF EGSSIG_SELO2TWC2US_SC_Compu /end COMPU_METHOD
/begin COMPU_VTAB EGSSIG_SELO2TWC2US_SC_Compu "" TAB_VERB 7 0 "0" 1 "1" 2 "2" 3 "3" 4 "4" 6 "6" 255 "255" /end COMPU_VTAB
/begin COMPU_METHOD EGSSIG_SELO2TWCDS_SC_Compu "" TAB_VERB "%6.3" "" COMPU_TAB_REF EGSSIG_SELO2TWCDS_SC_Compu /end COMPU_METHOD
/begin COMPU_VTAB EGSSIG_SELO2TWCDS_SC_Compu "" TAB_VERB 7 0 "0" 1 "1" 2 "2" 3 "3" 4 "4" 6 "6" 255 "255" /end COMPU_VTAB
/begin COMPU_METHOD EGSSIG_SELO2TWCUS_SC_Compu "" TAB_VERB "%6.3" "" COMPU_TAB_REF EGSSIG_SELO2TWCUS_SC_Compu /end COMPU_METHOD
/begin COMPU_VTAB EGSSIG_SELO2TWCUS_SC_Compu "" TAB_VERB 7 0 "0" 1 "1" 2 "2" 3 "3" 4 "4" 6 "6" 255 "255" /end COMPU_VTAB
/begin COMPU_METHOD EGSSIG_SWTENAEGSSIG_SC_Compu "" TAB_VERB "%6.3" "" COMPU_TAB_REF EGSSIG_SWTENAEGSSIG_SC_Compu /end COMPU_METHOD
/begin COMPU_VTAB EGSSIG_SWTENAEGSSIG_SC_Compu "" TAB_VERB 2 0 "Deactivated" 1 "Activated" /end COMPU_VTAB
/begin COMPU_METHOD EGSSIG_SWTENAO2AIRPADPN_SC_Compu "" TAB_VERB "%6.3" "" COMPU_TAB_REF EGSSIG_SWTENAO2AIRPADPN_SC_Compu /end COMPU_METHOD
/begin COMPU_VTAB EGSSIG_SWTENAO2AIRPADPN_SC_Compu "" TAB_VERB 2 0 "False" 1 "True" /end COMPU_VTAB
/begin COMPU_METHOD EGSSIG_SWTENAO2SWADPR_SC_Compu "" TAB_VERB "%6.3" "" COMPU_TAB_REF EGSSIG_SWTENAO2SWADPR_SC_Compu /end COMPU_METHOD
/begin COMPU_VTAB EGSSIG_SWTENAO2SWADPR_SC_Compu "" TAB_VERB 2 0 "False" 1 "True" /end COMPU_VTAB
/begin COMPU_METHOD EGTFact "" RAT_FUNC "%6.5" "-" COEFFS 0 1000 0 0 0 1 /end COMPU_METHOD
/begin COMPU_METHOD EGTSwt "" RAT_FUNC "%10.9" "-" COEFFS 0 16384000 0 0 0 1 /end COMPU_METHOD
/begin COMPU_METHOD EGTSwt_S16 "" RAT_FUNC "%7.6" "-" COEFFS 0 16384 0 0 0 1 /end COMPU_METHOD
/begin COMPU_METHOD ELDEV_DSQACTVT_SC_Compu "" TAB_VERB "%6.3" "" COMPU_TAB_REF ELDEV_DSQACTVT_SC_Compu /end COMPU_METHOD
/begin COMPU_VTAB ELDEV_DSQACTVT_SC_Compu "" TAB_VERB 2 0 "Inactive" 1 "Active" /end COMPU_VTAB
/begin COMPU_METHOD ELDEV_VAR_SY_Compu "" TAB_VERB "%6.3" "" COMPU_TAB_REF ELDEV_VAR_SY_Compu /end COMPU_METHOD
/begin COMPU_VTAB ELDEV_VAR_SY_Compu "" TAB_VERB 44 1 "DAI" 3 "VWW" 4 "POR" 5 "AUD" 6 "OPE" 9 "FIA" 11 "BMW" 14 "PSA" 15 "REN" 17 "ALF" 18 "SAB" 19 "VOL" 20 "NIS" 21 "GMU" 22 "FOR" 26 "IMJ" 51 "SEA" 53 "CHR" 54 "JAG" 55 "ROL" 69 "FER" 72 "TOY" 123 "MIT" 147 "HYU" 159 "HON" 160 "MAZ" 183 "CU" 190 "LRG" 204 "VVW" 214 "AVT" 242 "Iveco" 243 "DMC" 248 "SUZ" 267 "SSANGYONG" 270 "KEF" 289 "AMG" 308 "TAT" 319 "MVM" 385 "UAES" 590 "Scania" 828 "RBCD" 999 "ALL" 2887 "Nonox" 9454 "Fuso" /end COMPU_VTAB
/begin COMPU_METHOD ELECCMPRPRSNT_SC_Compu "" TAB_VERB "%6.3" "" COMPU_TAB_REF ELECCMPRPRSNT_SC_Compu /end COMPU_METHOD
/begin COMPU_VTAB ELECCMPRPRSNT_SC_Compu "" TAB_VERB 2 0 "False" 1 "True" /end COMPU_VTAB
/begin COMPU_METHOD ELECDRVENGDRG_SC_Compu "" TAB_VERB "%6.3" "" COMPU_TAB_REF ELECDRVENGDRG_SC_Compu /end COMPU_METHOD
/begin COMPU_VTAB ELECDRVENGDRG_SC_Compu "" TAB_VERB 2 0 "False" 1 "True" /end COMPU_VTAB
/begin COMPU_METHOD ELECDRVGPSBL_SC_Compu "" TAB_VERB "%6.3" "" COMPU_TAB_REF ELECDRVGPSBL_SC_Compu /end COMPU_METHOD
/begin COMPU_VTAB ELECDRVGPSBL_SC_Compu "" TAB_VERB 2 0 "False" 1 "True" /end COMPU_VTAB
/begin COMPU_METHOD ELECLDSENS_SC_Compu "" TAB_VERB "%6.3" "" COMPU_TAB_REF ELECLDSENS_SC_Compu /end COMPU_METHOD
/begin COMPU_VTAB ELECLDSENS_SC_Compu "" TAB_VERB 2 0 "False" 1 "True" /end COMPU_VTAB
/begin COMPU_METHOD ELMGOV_SC_Compu "" TAB_VERB "%6.3" "" COMPU_TAB_REF ELMGOV_SC_Compu /end COMPU_METHOD
/begin COMPU_VTAB ELMGOV_SC_Compu "" TAB_VERB 2 0 "not_available" 1 "available" /end COMPU_VTAB
/begin COMPU_METHOD EM01PRSNT_SC_Compu "" TAB_VERB "%6.3" "" COMPU_TAB_REF EM01PRSNT_SC_Compu /end COMPU_METHOD
/begin COMPU_VTAB EM01PRSNT_SC_Compu "" TAB_VERB 2 0 "False" 1 "True" /end COMPU_VTAB
/begin COMPU_METHOD EMGYSHOFFIN2_TYPAVL_SC_Compu "" TAB_VERB "%6.3" "" COMPU_TAB_REF EMGYSHOFFIN2_TYPAVL_SC_Compu /end COMPU_METHOD
/begin COMPU_VTAB EMGYSHOFFIN2_TYPAVL_SC_Compu "" TAB_VERB 2 0 "FALSE" 1 "TRUE" /end COMPU_VTAB
/begin COMPU_METHOD EMGYSTRTSWT2_TYPAVL_SC_Compu "" TAB_VERB "%6.3" "" COMPU_TAB_REF EMGYSTRTSWT2_TYPAVL_SC_Compu /end COMPU_METHOD
/begin COMPU_VTAB EMGYSTRTSWT2_TYPAVL_SC_Compu "" TAB_VERB 2 0 "False" 1 "True" /end COMPU_VTAB
/begin COMPU_METHOD EMLVTYP_SC_Compu "" TAB_VERB "%6.3" "" COMPU_TAB_REF EMLVTYP_SC_Compu /end COMPU_METHOD
/begin COMPU_VTAB EMLVTYP_SC_Compu "" TAB_VERB 3 0 "No_ElM" 1 "Valeo" 2 "Mitsubishi" /end COMPU_VTAB
/begin COMPU_METHOD EMMVTYP_SC_Compu "" TAB_VERB "%6.3" "" COMPU_TAB_REF EMMVTYP_SC_Compu /end COMPU_METHOD
/begin COMPU_VTAB EMMVTYP_SC_Compu "" TAB_VERB 4 0 "No_ElM" 1 "Bosch" 2 "Valeo" 3 "Conti" /end COMPU_VTAB
/begin COMPU_METHOD ENADATASETID_CALPAR_SC_Compu "" TAB_VERB "%6.3" "" COMPU_TAB_REF ENADATASETID_CALPAR_SC_Compu /end COMPU_METHOD
/begin COMPU_VTAB ENADATASETID_CALPAR_SC_Compu "" TAB_VERB 2 0 "False" 1 "True" /end COMPU_VTAB
/begin COMPU_METHOD Energy "" RAT_FUNC "%6.2" "kJ" COEFFS 0 1 0 0 0 1 /end COMPU_METHOD
/begin COMPU_METHOD Energy_J_HiRes "" RAT_FUNC "%6.2" "J" COEFFS 0 1 0 0 0 1 /end COMPU_METHOD
/begin COMPU_METHOD Energy_q0p0001 "" RAT_FUNC "%7.6" "kJ" COEFFS 0 10000 0 0 0 1 /end COMPU_METHOD
/begin COMPU_METHOD Energy_q0p001_COMPU "" RAT_FUNC "%6.5" "kJ" COEFFS 0 1000 0 0 0 1 /end COMPU_METHOD
/begin COMPU_METHOD ENGBRK_SC_Compu "" TAB_VERB "%6.3" "" COMPU_TAB_REF ENGBRK_SC_Compu /end COMPU_METHOD
/begin COMPU_VTAB ENGBRK_SC_Compu "" TAB_VERB 2 0 "False" 1 "True" /end COMPU_VTAB
/begin COMPU_METHOD ENGCMPTMTT_TYPAVL_SY_Compu "" TAB_VERB "%6.3" "" COMPU_TAB_REF ENGCMPTMTT_TYPAVL_SY_Compu /end COMPU_METHOD
/begin COMPU_VTAB ENGCMPTMTT_TYPAVL_SY_Compu "" TAB_VERB 2 0 "False" 1 "True" /end COMPU_VTAB
/begin COMPU_METHOD ENGCOUPLSPDPREDAVL_SC_Compu "" TAB_VERB "%6.3" "" COMPU_TAB_REF ENGCOUPLSPDPREDAVL_SC_Compu /end COMPU_METHOD
/begin COMPU_VTAB ENGCOUPLSPDPREDAVL_SC_Compu "" TAB_VERB 2 0 "False" 1 "True" /end COMPU_VTAB
/begin COMPU_METHOD ENGDA_CTFLD_NUM_Compu "" RAT_FUNC "%6.2" "" COEFFS 0 1 0 0 0 1 /end COMPU_METHOD
/begin COMPU_METHOD ENGDA_TIENGONOBD_SY_Compu "" TAB_VERB "%6.3" "" COMPU_TAB_REF ENGDA_TIENGONOBD_SY_Compu /end COMPU_METHOD
/begin COMPU_VTAB ENGDA_TIENGONOBD_SY_Compu "" TAB_VERB 2 0 "FALSE" 1 "TRUE" /end COMPU_VTAB
/begin COMPU_METHOD ENGDEMTQINC_SC_Compu "" TAB_VERB "%6.3" "" COMPU_TAB_REF ENGDEMTQINC_SC_Compu /end COMPU_METHOD
/begin COMPU_VTAB ENGDEMTQINC_SC_Compu "" TAB_VERB 2 0 "False" 1 "True" /end COMPU_VTAB
/begin COMPU_METHOD ENGDEM_OPERMODTQLIMN_SC_Compu "" TAB_VERB "%6.3" "" COMPU_TAB_REF ENGDEM_OPERMODTQLIMN_SC_Compu /end COMPU_METHOD
/begin COMPU_VTAB ENGDEM_OPERMODTQLIMN_SC_Compu "" TAB_VERB 2 0 "FALSE" 1 "TRUE" /end COMPU_VTAB
/begin COMPU_METHOD ENGDEM_VAR_SY_Compu "" TAB_VERB "%6.3" "" COMPU_TAB_REF ENGDEM_VAR_SY_Compu /end COMPU_METHOD
/begin COMPU_VTAB ENGDEM_VAR_SY_Compu "" TAB_VERB 56 0 "kein Kundenbezug" 1 "DAI" 3 "VWW" 4 "POR" 5 "AUD" 6 "OPE" 9 "FIA" 11 "BMW" 14 "PSA" 15 "REN" 17 "ALF" 18 "SAB" 19 "VOL" 20 "NIS" 21 "GMU" 22 "FOR" 26 "IMJ" 36 "MAN" 51 "SEA" 53 "CHR" 54 "JAG" 55 "ROL" 69 "FER" 72 "TOY" 123 "MIT" 147 "HYU" 159 "HON" 160 "MAZ" 183 "CU" 190 "LRG" 204 "VVW" 214 "AVT" 226 "YUCHAI_OHW" 242 "Iveco" 243 "DMC" 248 "SUZ" 267 "SSANGYONG" 270 "KEF" 289 "AMG" 308 "TAT" 319 "MVM" 328 "MM" 385 "UAES" 578 "AL" 590 "SCANIA" 746 "Naveco" 760 "WEICHAI" 828 "RBCD" 898 "MFTBC" 944 "Doosan" 966 "International" 999 "ALL" 2887 "NONOX" 9047 "No 1 Tractors China" 9347 "SDFG" 9454 "Fuso" /end COMPU_VTAB
/begin COMPU_METHOD ENGMIDT_ADCSENS_SY_Compu "" TAB_VERB "%6.3" "" COMPU_TAB_REF ENGMIDT_ADCSENS_SY_Compu /end COMPU_METHOD
/begin COMPU_VTAB ENGMIDT_ADCSENS_SY_Compu "" TAB_VERB 2 0 "False" 1 "True" /end COMPU_VTAB
/begin COMPU_METHOD ENGMIDT_COLDSTRTDIAG_SC_Compu "" TAB_VERB "%6.3" "" COMPU_TAB_REF ENGMIDT_COLDSTRTDIAG_SC_Compu /end COMPU_METHOD
/begin COMPU_VTAB ENGMIDT_COLDSTRTDIAG_SC_Compu "" TAB_VERB 2 0 "False" 1 "True" /end COMPU_VTAB
/begin COMPU_METHOD ENGMIDT_TYPAVL_SC_Compu "" TAB_VERB "%6.3" "" COMPU_TAB_REF ENGMIDT_TYPAVL_SC_Compu /end COMPU_METHOD
/begin COMPU_VTAB ENGMIDT_TYPAVL_SC_Compu "" TAB_VERB 2 0 "False" 1 "True" /end COMPU_VTAB
/begin COMPU_METHOD ENGM_OILCTRL_SC_Compu "" TAB_VERB "%6.3" "" COMPU_TAB_REF ENGM_OILCTRL_SC_Compu /end COMPU_METHOD
/begin COMPU_VTAB ENGM_OILCTRL_SC_Compu "" TAB_VERB 2 0 "NoOilCtl" 1 "ActvdOilCtl" /end COMPU_VTAB
/begin COMPU_METHOD EngNRmp_Hi "" RAT_FUNC "%6.3" "rpm" COEFFS 0 10 0 0 0 1 /end COMPU_METHOD
/begin COMPU_METHOD ENGNSP_PFAVL_SC_Compu "" TAB_VERB "%6.3" "" COMPU_TAB_REF ENGNSP_PFAVL_SC_Compu /end COMPU_METHOD
/begin COMPU_VTAB ENGNSP_PFAVL_SC_Compu "" TAB_VERB 2 0 "EngNSp_NotAvl" 1 "EngNSp_Avl" /end COMPU_VTAB
/begin COMPU_METHOD ENGNSP_PFREQACTV_SC_Compu "" TAB_VERB "%6.3" "" COMPU_TAB_REF ENGNSP_PFREQACTV_SC_Compu /end COMPU_METHOD
/begin COMPU_VTAB ENGNSP_PFREQACTV_SC_Compu "" TAB_VERB 2 0 "False" 1 "True" /end COMPU_VTAB
/begin COMPU_METHOD EngN_HiRes "" RAT_FUNC "%6.4" "rpm" COEFFS 0 32 0 0 0 1 /end COMPU_METHOD
/begin COMPU_METHOD EngN_LRes "" RAT_FUNC "%6.1" "rpm" COEFFS 0 0.025 0 0 0 1 /end COMPU_METHOD
/begin COMPU_METHOD ENGOILT_TYPAVL_SC_Compu "" TAB_VERB "%6.3" "" COMPU_TAB_REF ENGOILT_TYPAVL_SC_Compu /end COMPU_METHOD
/begin COMPU_VTAB ENGOILT_TYPAVL_SC_Compu "" TAB_VERB 2 0 "False" 1 "True" /end COMPU_VTAB
/begin COMPU_METHOD ENGOPMODE_SY_Compu "" TAB_VERB "%6.3" "" COMPU_TAB_REF ENGOPMODE_SY_Compu /end COMPU_METHOD
/begin COMPU_VTAB ENGOPMODE_SY_Compu "" TAB_VERB 2 0 "False" 1 "True" /end COMPU_VTAB
/begin COMPU_METHOD ENGRESTRT_SY_Compu "" TAB_VERB "%6.3" "" COMPU_TAB_REF ENGRESTRT_SY_Compu /end COMPU_METHOD
/begin COMPU_VTAB ENGRESTRT_SY_Compu "" TAB_VERB 2 0 "False" 1 "True" /end COMPU_VTAB
/begin COMPU_METHOD ENGRSTRTVRNT_SC_Compu "" TAB_VERB "%6.3" "" COMPU_TAB_REF ENGRSTRTVRNT_SC_Compu /end COMPU_METHOD
/begin COMPU_VTAB ENGRSTRTVRNT_SC_Compu "" TAB_VERB 3 0 "NO_RESTART" 1 "RESTART_TASK" 2 "RESTART_EVENT" /end COMPU_VTAB
/begin COMPU_METHOD ENGSPDHI_SC_Compu "" TAB_VERB "%6.3" "" COMPU_TAB_REF ENGSPDHI_SC_Compu /end COMPU_METHOD
/begin COMPU_VTAB ENGSPDHI_SC_Compu "" TAB_VERB 2 0 "False" 1 "True" /end COMPU_VTAB
/begin COMPU_METHOD ENGSPDLIMN_INHOUSE_SC_Compu "" TAB_VERB "%6.3" "" COMPU_TAB_REF ENGSPDLIMN_INHOUSE_SC_Compu /end COMPU_METHOD
/begin COMPU_VTAB ENGSPDLIMN_INHOUSE_SC_Compu "" TAB_VERB 2 0 "False" 1 "True" /end COMPU_VTAB
/begin COMPU_METHOD ENGSPDPLSENA_SC_Compu "" TAB_VERB "%6.3" "" COMPU_TAB_REF ENGSPDPLSENA_SC_Compu /end COMPU_METHOD
/begin COMPU_VTAB ENGSPDPLSENA_SC_Compu "" TAB_VERB 2 0 "False" 1 "True" /end COMPU_VTAB
/begin COMPU_METHOD ENGSPDPREDAVL_SC_Compu "" TAB_VERB "%6.3" "" COMPU_TAB_REF ENGSPDPREDAVL_SC_Compu /end COMPU_METHOD
/begin COMPU_VTAB ENGSPDPREDAVL_SC_Compu "" TAB_VERB 2 0 "False" 1 "True" /end COMPU_VTAB
/begin COMPU_METHOD ENGSPD_LIMSTRT_SY_Compu "" TAB_VERB "%6.3" "" COMPU_TAB_REF ENGSPD_LIMSTRT_SY_Compu /end COMPU_METHOD
/begin COMPU_VTAB ENGSPD_LIMSTRT_SY_Compu "" TAB_VERB 2 0 "0" 1 "1" /end COMPU_VTAB
/begin COMPU_METHOD ENGSPD_SWTENA_SY_Compu "" TAB_VERB "%6.3" "" COMPU_TAB_REF ENGSPD_SWTENA_SY_Compu /end COMPU_METHOD
/begin COMPU_VTAB ENGSPD_SWTENA_SY_Compu "" TAB_VERB 2 0 "FALSE" 1 "TRUE" /end COMPU_VTAB
/begin COMPU_METHOD ENGSTREQBYPTCOORN_SC_Compu "" TAB_VERB "%6.3" "" COMPU_TAB_REF ENGSTREQBYPTCOORN_SC_Compu /end COMPU_METHOD
/begin COMPU_VTAB ENGSTREQBYPTCOORN_SC_Compu "" TAB_VERB 2 0 "False" 1 "True" /end COMPU_VTAB
/begin COMPU_METHOD ENGSTRT_FWENGOFF_SC_Compu "" TAB_VERB "%6.3" "" COMPU_TAB_REF ENGSTRT_FWENGOFF_SC_Compu /end COMPU_METHOD
/begin COMPU_VTAB ENGSTRT_FWENGOFF_SC_Compu "" TAB_VERB 2 0 "DISABLED" 1 "ENABLED" /end COMPU_VTAB
/begin COMPU_METHOD ENGSTRT_NEWSYNCNPOSTDRV_SC_Compu "" RAT_FUNC "%6.2" "" COEFFS 0 1 0 0 0 1 /end COMPU_METHOD
/begin COMPU_METHOD ENGSTRT_STRTCOORCUST_SC_Compu "" TAB_VERB "%6.3" "" COMPU_TAB_REF ENGSTRT_STRTCOORCUST_SC_Compu /end COMPU_METHOD
/begin COMPU_VTAB ENGSTRT_STRTCOORCUST_SC_Compu "" TAB_VERB 2 0 "False" 1 "True" /end COMPU_VTAB
/begin COMPU_METHOD ENGSTRT_STRTGDEVIF_SC_Compu "" TAB_VERB "%6.3" "" COMPU_TAB_REF ENGSTRT_STRTGDEVIF_SC_Compu /end COMPU_METHOD
/begin COMPU_VTAB ENGSTRT_STRTGDEVIF_SC_Compu "" TAB_VERB 2 0 "False" 1 "True" /end COMPU_VTAB
/begin COMPU_METHOD ENGSTRT_VAR_SY_Compu "" TAB_VERB "%6.3" "" COMPU_TAB_REF ENGSTRT_VAR_SY_Compu /end COMPU_METHOD
/begin COMPU_VTAB ENGSTRT_VAR_SY_Compu "" TAB_VERB 47 1 "DAI" 3 "VWW" 4 "POR" 5 "AUD" 6 "OPE" 9 "FIA" 11 "BMW" 14 "PSA" 15 "REN" 17 "ALF" 18 "SAB" 19 "VOL" 20 "NIS" 21 "GMU" 22 "FOR" 26 "IMJ" 51 "SEA" 53 "CHR" 54 "JAG" 55 "ROL" 69 "FER" 72 "TOY" 123 "MIT" 147 "HYU" 159 "HON" 160 "MAZ" 183 "CU" 190 "LRG" 204 "VVW" 214 "AVT" 242 "Iveco" 243 "DMC" 248 "SUZ" 267 "SSANGYONG" 270 "KEF" 289 "AMG" 308 "TAT" 319 "MVM" 328 "MM" 385 "UAES" 425 "Polaris" 590 "Scania" 828 "RBCD" 898 "MFTBC" 999 "ALL" 2887 "Nonox" 9454 "Fuso" /end COMPU_VTAB
/begin COMPU_METHOD ENGSTRT_WRMUPFACSTBACTVT_SC_Compu "" TAB_VERB "%6.3" "" COMPU_TAB_REF ENGSTRT_WRMUPFACSTBACTVT_SC_Compu /end COMPU_METHOD
/begin COMPU_VTAB ENGSTRT_WRMUPFACSTBACTVT_SC_Compu "" TAB_VERB 2 0 "False" 1 "True" /end COMPU_VTAB
/begin COMPU_METHOD ENGTMR_VAR_SY_Compu "" TAB_VERB "%6.3" "" COMPU_TAB_REF ENGTMR_VAR_SY_Compu /end COMPU_METHOD
/begin COMPU_VTAB ENGTMR_VAR_SY_Compu "" TAB_VERB 44 1 "DAI" 3 "VWW" 4 "POR" 5 "AUD" 6 "OPE" 9 "FIA" 11 "BMW" 14 "PSA" 15 "REN" 17 "ALF" 18 "SAB" 19 "VOL" 20 "NIS" 21 "GMU" 22 "FOR" 26 "IMJ" 51 "SEA" 53 "CHR" 54 "JAG" 55 "ROL" 69 "FER" 72 "TOY" 123 "MIT" 147 "HYU" 159 "HON" 160 "MAZ" 183 "CU" 190 "LRG" 204 "VVW" 214 "AVT" 242 "Iveco" 243 "DMC" 248 "SUZ" 267 "SSANGYONG" 270 "KEF" 289 "AMG" 308 "TAT" 319 "MVM" 385 "UAES" 590 "Scania" 828 "RBCD" 999 "ALL" 2887 "Nonox" 9454 "Fuso" /end COMPU_VTAB
/begin COMPU_METHOD ENGTRJSTOP_SC_Compu "" RAT_FUNC "%6.2" "" COEFFS 0 1 0 0 0 1 /end COMPU_METHOD
/begin COMPU_METHOD EnrgPrMol_q0p001_COMPU "" RAT_FUNC "%6.5" "J/mol" COEFFS 0 1000 0 0 0 1 /end COMPU_METHOD
/begin COMPU_METHOD ENVP_TYPAVL_SY_Compu "" TAB_VERB "%6.3" "" COMPU_TAB_REF ENVP_TYPAVL_SY_Compu /end COMPU_METHOD
/begin COMPU_VTAB ENVP_TYPAVL_SY_Compu "" TAB_VERB 2 0 "False" 1 "True" /end COMPU_VTAB
/begin COMPU_METHOD ENVT_PHYSRNGCHK_SY_Compu "" TAB_VERB "%6.3" "" COMPU_TAB_REF ENVT_PHYSRNGCHK_SY_Compu /end COMPU_METHOD
/begin COMPU_VTAB ENVT_PHYSRNGCHK_SY_Compu "" TAB_VERB 2 0 "PHYSRNGCHK_DISBL" 1 "PHYSRNGCHK_ENA" /end COMPU_VTAB
/begin COMPU_METHOD ENVT_PLAUSDIAGCSC_SY_Compu "" TAB_VERB "%6.3" "" COMPU_TAB_REF ENVT_PLAUSDIAGCSC_SY_Compu /end COMPU_METHOD
/begin COMPU_VTAB ENVT_PLAUSDIAGCSC_SY_Compu "" TAB_VERB 2 0 "0" 1 "1" /end COMPU_VTAB
/begin COMPU_METHOD ENVT_PLAUSDIAGMBC_SY_Compu "" TAB_VERB "%6.3" "" COMPU_TAB_REF ENVT_PLAUSDIAGMBC_SY_Compu /end COMPU_METHOD
/begin COMPU_VTAB ENVT_PLAUSDIAGMBC_SY_Compu "" TAB_VERB 2 0 "0" 1 "1" /end COMPU_VTAB
/begin COMPU_METHOD ENVT_PLAUSDIAGPRC_SY_Compu "" TAB_VERB "%6.3" "" COMPU_TAB_REF ENVT_PLAUSDIAGPRC_SY_Compu /end COMPU_METHOD
/begin COMPU_VTAB ENVT_PLAUSDIAGPRC_SY_Compu "" TAB_VERB 2 0 "0" 1 "1" /end COMPU_VTAB
/begin COMPU_METHOD ENVT_SWTHWORCAN_SY_Compu "" TAB_VERB "%6.3" "" COMPU_TAB_REF ENVT_SWTHWORCAN_SY_Compu /end COMPU_METHOD
/begin COMPU_VTAB ENVT_SWTHWORCAN_SY_Compu "" TAB_VERB 3 0 "0" 1 "1" 2 "2" /end COMPU_VTAB
/begin COMPU_METHOD ENVT_TCACINTKBNK_SC_Compu "" TAB_VERB "%6.3" "" COMPU_TAB_REF ENVT_TCACINTKBNK_SC_Compu /end COMPU_METHOD
/begin COMPU_VTAB ENVT_TCACINTKBNK_SC_Compu "" TAB_VERB 3 0 "no_bank" 1 "bank_1" 2 "bank_2" /end COMPU_VTAB
/begin COMPU_METHOD ENVT_TCACINTKPOS_SC_Compu "" TAB_VERB "%6.3" "" COMPU_TAB_REF ENVT_TCACINTKPOS_SC_Compu /end COMPU_METHOD
/begin COMPU_VTAB ENVT_TCACINTKPOS_SC_Compu "" TAB_VERB 6 0 "no_position" 1 "position_1" 2 "position_2" 3 "position_3" 4 "position_4" 5 "position_5" /end COMPU_VTAB
/begin COMPU_METHOD ENVT_TMODINTKBNK_SC_Compu "" TAB_VERB "%6.3" "" COMPU_TAB_REF ENVT_TMODINTKBNK_SC_Compu /end COMPU_METHOD
/begin COMPU_VTAB ENVT_TMODINTKBNK_SC_Compu "" TAB_VERB 3 0 "no_bank" 1 "bank_1" 2 "bank_2" /end COMPU_VTAB
/begin COMPU_METHOD ENVT_TMODINTKPOS_SC_Compu "" TAB_VERB "%6.3" "" COMPU_TAB_REF ENVT_TMODINTKPOS_SC_Compu /end COMPU_METHOD
/begin COMPU_VTAB ENVT_TMODINTKPOS_SC_Compu "" TAB_VERB 6 0 "no_position" 1 "position_1" 2 "position_2" 3 "position_3" 4 "position_4" 5 "position_5" /end COMPU_VTAB
/begin COMPU_METHOD ENVT_TPLAUSMOD_SY_Compu "" TAB_VERB "%6.3" "" COMPU_TAB_REF ENVT_TPLAUSMOD_SY_Compu /end COMPU_METHOD
/begin COMPU_VTAB ENVT_TPLAUSMOD_SY_Compu "" TAB_VERB 3 0 "0" 1 "1" 2 "2" /end COMPU_VTAB
/begin COMPU_METHOD ENVT_TREPLMOD_SY_Compu "" TAB_VERB "%6.3" "" COMPU_TAB_REF ENVT_TREPLMOD_SY_Compu /end COMPU_METHOD
/begin COMPU_VTAB ENVT_TREPLMOD_SY_Compu "" TAB_VERB 3 0 "0" 1 "1" 2 "2" /end COMPU_VTAB
/begin COMPU_METHOD ENVT_TSENSADCAVL_SY_Compu "" TAB_VERB "%6.3" "" COMPU_TAB_REF ENVT_TSENSADCAVL_SY_Compu /end COMPU_METHOD
/begin COMPU_VTAB ENVT_TSENSADCAVL_SY_Compu "" TAB_VERB 2 0 "0" 1 "1" /end COMPU_VTAB
/begin COMPU_METHOD ENVT_TSENSCANAVL_SY_Compu "" TAB_VERB "%6.3" "" COMPU_TAB_REF ENVT_TSENSCANAVL_SY_Compu /end COMPU_METHOD
/begin COMPU_VTAB ENVT_TSENSCANAVL_SY_Compu "" TAB_VERB 2 0 "0" 1 "1" /end COMPU_VTAB
/begin COMPU_METHOD ENVT_TSENSMOD_SY_Compu "" TAB_VERB "%6.3" "" COMPU_TAB_REF ENVT_TSENSMOD_SY_Compu /end COMPU_METHOD
/begin COMPU_VTAB ENVT_TSENSMOD_SY_Compu "" TAB_VERB 2 0 "0" 1 "1" /end COMPU_VTAB
/begin COMPU_METHOD ENVT_TYPAVL_SY_Compu "" TAB_VERB "%6.3" "" COMPU_TAB_REF ENVT_TYPAVL_SY_Compu /end COMPU_METHOD
/begin COMPU_VTAB ENVT_TYPAVL_SY_Compu "" TAB_VERB 2 0 "False" 1 "True" /end COMPU_VTAB
/begin COMPU_METHOD EOBD5PLUS_SC_Compu "" TAB_VERB "%6.3" "" COMPU_TAB_REF EOBD5PLUS_SC_Compu /end COMPU_METHOD
/begin COMPU_VTAB EOBD5PLUS_SC_Compu "" TAB_VERB 2 0 "False" 1 "True" /end COMPU_VTAB
/begin COMPU_METHOD EOMACTVNENA_SC_Compu "" TAB_VERB "%6.3" "" COMPU_TAB_REF EOMACTVNENA_SC_Compu /end COMPU_METHOD
/begin COMPU_VTAB EOMACTVNENA_SC_Compu "" TAB_VERB 2 0 "False" 1 "True" /end COMPU_VTAB
/begin COMPU_METHOD EOMCOORNTYP_SC_Compu "" TAB_VERB "%6.3" "" COMPU_TAB_REF EOMCOORNTYP_SC_Compu /end COMPU_METHOD
/begin COMPU_VTAB EOMCOORNTYP_SC_Compu "" TAB_VERB 5 0 "0" 1 "1" 2 "2" 3 "3" 4 "4" /end COMPU_VTAB
/begin COMPU_METHOD EOMGPFLOAD_SC_Compu "" TAB_VERB "%6.3" "" COMPU_TAB_REF EOMGPFLOAD_SC_Compu /end COMPU_METHOD
/begin COMPU_VTAB EOMGPFLOAD_SC_Compu "" TAB_VERB 2 0 "NO_GPF_LOAD_AVAILABLE" 1 "EOM_GPF_LOAD_AVAILABLE" /end COMPU_VTAB
/begin COMPU_METHOD EOMMTRXSTGCFG_SC_Compu "" TAB_VERB "%6.3" "" COMPU_TAB_REF EOMMTRXSTGCFG_SC_Compu /end COMPU_METHOD
/begin COMPU_VTAB EOMMTRXSTGCFG_SC_Compu "" TAB_VERB 2 0 "physical_based_mode_gasoline" 1 "functional_based_mode_gasoline" /end COMPU_VTAB
/begin COMPU_METHOD EOMVLVLFTINMTRX_SC_Compu "" TAB_VERB "%6.3" "" COMPU_TAB_REF EOMVLVLFTINMTRX_SC_Compu /end COMPU_METHOD
/begin COMPU_VTAB EOMVLVLFTINMTRX_SC_Compu "" TAB_VERB 2 0 "NoValveLiftInMatrix" 1 "ValveLiftInMatrix" /end COMPU_VTAB
/begin COMPU_METHOD EPMBCA_FACSEGTIMEACC_CURX_SC_Compu "" RAT_FUNC "%6.2" "" COEFFS 0 1 0 0 0 1 /end COMPU_METHOD
/begin COMPU_METHOD EPMCAS_DIAGSRC2_SC_Compu "" RAT_FUNC "%6.2" "" COEFFS 0 1 0 0 0 1 /end COMPU_METHOD
/begin COMPU_METHOD EPMCAS_FACPLAUS_DSTX_SC_Compu "" RAT_FUNC "%6.2" "" COEFFS 0 1 0 0 0 1 /end COMPU_METHOD
/begin COMPU_METHOD EPMCAS_NUMSEGLEN_SC_Compu "" RAT_FUNC "%6.2" "" COEFFS 0 1 0 0 0 1 /end COMPU_METHOD
/begin COMPU_METHOD EPMCAS_NUMSEG_SC_Compu "" RAT_FUNC "%6.2" "" COEFFS 0 1 0 0 0 1 /end COMPU_METHOD
/begin COMPU_METHOD EPMCAS_OFFSAVRGFILSIZE_SC_Compu "" RAT_FUNC "%6.2" "" COEFFS 0 1 0 0 0 1 /end COMPU_METHOD
/begin COMPU_METHOD EPMCAS_OFFSDIAGDTRENA_SC_Compu "" TAB_VERB "%6.3" "" COMPU_TAB_REF EPMCAS_OFFSDIAGDTRENA_SC_Compu /end COMPU_METHOD
/begin COMPU_VTAB EPMCAS_OFFSDIAGDTRENA_SC_Compu "" TAB_VERB 2 0 "False" 1 "True" /end COMPU_VTAB
/begin COMPU_METHOD EPMCAS_PHINCOR_CURX_SC_Compu "" RAT_FUNC "%6.2" "" COEFFS 0 1 0 0 0 1 /end COMPU_METHOD
/begin COMPU_METHOD EPMCAS_PHITEMPADAPCORSIZEDSTX_SC_Compu "" RAT_FUNC "%6.2" "" COEFFS 0 1 0 0 0 1 /end COMPU_METHOD
/begin COMPU_METHOD EPMCAS_PHITEMPCOR05_DSTX_SC_Compu "" RAT_FUNC "%6.2" "" COEFFS 0 1 0 0 0 1 /end COMPU_METHOD
/begin COMPU_METHOD EPMCAS_PRODCORRNVAL_SC_Compu "" TAB_VERB "%6.3" "" COMPU_TAB_REF EPMCAS_PRODCORRNVAL_SC_Compu /end COMPU_METHOD
/begin COMPU_VTAB EPMCAS_PRODCORRNVAL_SC_Compu "" TAB_VERB 2 0 "OFF" 1 "ON" /end COMPU_VTAB
/begin COMPU_METHOD EPMCAS_REFADPNTSTRENARESP_SC_Compu "" RAT_FUNC "%6.2" "" COEFFS 0 1 0 0 0 1 /end COMPU_METHOD
/begin COMPU_METHOD EPMCAS_REFADPNTSTR_SC_Compu "" TAB_VERB "%6.3" "" COMPU_TAB_REF EPMCAS_REFADPNTSTR_SC_Compu /end COMPU_METHOD
/begin COMPU_VTAB EPMCAS_REFADPNTSTR_SC_Compu "" TAB_VERB 2 0 "False" 1 "True" /end COMPU_VTAB
/begin COMPU_METHOD EPMCAS_SELNDIAGFAILRADPN_SC_Compu "" TAB_VERB "%6.3" "" COMPU_TAB_REF EPMCAS_SELNDIAGFAILRADPN_SC_Compu /end COMPU_METHOD
/begin COMPU_VTAB EPMCAS_SELNDIAGFAILRADPN_SC_Compu "" TAB_VERB 2 0 "DISAD_DIAG_FAILRADPN" 1 "ENAD_DIAG_FAILRADPN" /end COMPU_VTAB
/begin COMPU_METHOD EPMCRS_DGIPLSCORRNACTVD_SC_Compu "" RAT_FUNC "%6.2" "" COEFFS 0 1 0 0 0 1 /end COMPU_METHOD
/begin COMPU_METHOD EPMCRS_DIAGDETAILEXTD_SC_Compu "" TAB_VERB "%6.3" "" COMPU_TAB_REF EPMCRS_DIAGDETAILEXTD_SC_Compu /end COMPU_METHOD
/begin COMPU_VTAB EPMCRS_DIAGDETAILEXTD_SC_Compu "" TAB_VERB 3 0 "DISABLE" 1 "ENABLE_SIGNAL" 2 "ENABLE_NOSIGNAL" /end COMPU_VTAB
/begin COMPU_METHOD EPMCRS_DIAGSRC_SC_Compu "" RAT_FUNC "%6.2" "" COEFFS 0 1 0 0 0 1 /end COMPU_METHOD
/begin COMPU_METHOD EPMCRS_DIAGSYNCLOST_SC_Compu "" TAB_VERB "%6.3" "" COMPU_TAB_REF EPMCRS_DIAGSYNCLOST_SC_Compu /end COMPU_METHOD
/begin COMPU_VTAB EPMCRS_DIAGSYNCLOST_SC_Compu "" TAB_VERB 2 0 "DISABLE_DIAGSYNCLOST" 1 "ENABLE_DIAGSYNCLOST" /end COMPU_VTAB
/begin COMPU_METHOD EPMCRS_ENASIGLVLDIAG_SC_Compu "" TAB_VERB "%6.3" "" COMPU_TAB_REF EPMCRS_ENASIGLVLDIAG_SC_Compu /end COMPU_METHOD
/begin COMPU_VTAB EPMCRS_ENASIGLVLDIAG_SC_Compu "" TAB_VERB 2 0 "False" 1 "True" /end COMPU_VTAB
/begin COMPU_METHOD EPMCRS_MAXAXISPNTSTIPLSCRV_SC_Compu "" RAT_FUNC "%6.2" "" COEFFS 0 1 0 0 0 1 /end COMPU_METHOD
/begin COMPU_METHOD EPMCRS_NRENGSPDSEGPLAUS_SC_Compu "" RAT_FUNC "%6.2" "" COEFFS 0 1 0 0 0 1 /end COMPU_METHOD
/begin COMPU_METHOD EPMCRS_NUMINCOUT_SC_Compu "" RAT_FUNC "%6.2" "" COEFFS 0 1 0 0 0 1 /end COMPU_METHOD
/begin COMPU_METHOD EPMCRS_PLSWIDTHAPPLACTVD_SC_Compu "" TAB_VERB "%6.3" "" COMPU_TAB_REF EPMCRS_PLSWIDTHAPPLACTVD_SC_Compu /end COMPU_METHOD
/begin COMPU_VTAB EPMCRS_PLSWIDTHAPPLACTVD_SC_Compu "" TAB_VERB 2 0 "0" 1 "1" /end COMPU_VTAB
/begin COMPU_METHOD EPMCRS_RESLTOTREV_SC_Compu "" TAB_VERB "%6.3" "" COMPU_TAB_REF EPMCRS_RESLTOTREV_SC_Compu /end COMPU_METHOD
/begin COMPU_VTAB EPMCRS_RESLTOTREV_SC_Compu "" TAB_VERB 3 0 "RESL1000" 1 "RESL100" 2 "RESL10" /end COMPU_VTAB
/begin COMPU_METHOD EPMCRS_REVSTRTCONT_SC_Compu "" TAB_VERB "%6.3" "" COMPU_TAB_REF EPMCRS_REVSTRTCONT_SC_Compu /end COMPU_METHOD
/begin COMPU_VTAB EPMCRS_REVSTRTCONT_SC_Compu "" TAB_VERB 2 0 "False" 1 "True" /end COMPU_VTAB
/begin COMPU_METHOD EPMCRS_TIINCOUTPVBL_SC_Compu "" TAB_VERB "%6.3" "" COMPU_TAB_REF EPMCRS_TIINCOUTPVBL_SC_Compu /end COMPU_METHOD
/begin COMPU_VTAB EPMCRS_TIINCOUTPVBL_SC_Compu "" TAB_VERB 3 1 "TIINC" 2 "TIINCLRES" 3 "TIINC_TIINCLRES" /end COMPU_VTAB
/begin COMPU_METHOD EPMCRS_TIINCOUT_SC_Compu "" TAB_VERB "%6.3" "" COMPU_TAB_REF EPMCRS_TIINCOUT_SC_Compu /end COMPU_METHOD
/begin COMPU_VTAB EPMCRS_TIINCOUT_SC_Compu "" TAB_VERB 2 0 "False" 1 "True" /end COMPU_VTAB
/begin COMPU_METHOD EPMERR_NRERRINFOARY_SC_Compu "" TAB_VERB "%6.3" "" COMPU_TAB_REF EPMERR_NRERRINFOARY_SC_Compu /end COMPU_METHOD
/begin COMPU_VTAB EPMERR_NRERRINFOARY_SC_Compu "" TAB_VERB 3 1 "small block size" 2 "medium block size" 3 "big block size" /end COMPU_VTAB
/begin COMPU_METHOD EPMHWE_RTM_SY_Compu "" TAB_VERB "%6.3" "" COMPU_TAB_REF EPMHWE_RTM_SY_Compu /end COMPU_METHOD
/begin COMPU_VTAB EPMHWE_RTM_SY_Compu "" TAB_VERB 2 0 "NO_RTM" 1 "RTM" /end COMPU_VTAB
/begin COMPU_METHOD EPMHWE_SWTCPU_SY_Compu "" TAB_VERB "%6.3" "" COMPU_TAB_REF EPMHWE_SWTCPU_SY_Compu /end COMPU_METHOD
/begin COMPU_VTAB EPMHWE_SWTCPU_SY_Compu "" TAB_VERB 2 0 "PCP" 1 "CPU" /end COMPU_VTAB
/begin COMPU_METHOD EPMRRS_IGNLOCKRELSIMDT_SC_Compu "" TAB_VERB "%6.3" "" COMPU_TAB_REF EPMRRS_IGNLOCKRELSIMDT_SC_Compu /end COMPU_METHOD
/begin COMPU_VTAB EPMRRS_IGNLOCKRELSIMDT_SC_Compu "" TAB_VERB 2 0 "False" 1 "True" /end COMPU_VTAB
/begin COMPU_METHOD EPMRRS_SY_Compu "" TAB_VERB "%6.3" "" COMPU_TAB_REF EPMRRS_SY_Compu /end COMPU_METHOD
/begin COMPU_VTAB EPMRRS_SY_Compu "" TAB_VERB 3 0 "NO_RRS" 1 "REV" 2 "REV_STOP" /end COMPU_VTAB
/begin COMPU_METHOD EPMRRS_TITEMP_CURX_SC_Compu "" RAT_FUNC "%6.2" "" COEFFS 0 1 0 0 0 1 /end COMPU_METHOD
/begin COMPU_METHOD EPMRVSROTYMETH_SY_Compu "" TAB_VERB "%6.3" "" COMPU_TAB_REF EPMRVSROTYMETH_SY_Compu /end COMPU_METHOD
/begin COMPU_VTAB EPMRVSROTYMETH_SY_Compu "" TAB_VERB 2 0 "TOOTHPERD" 1 "PLSTI" /end COMPU_VTAB
/begin COMPU_METHOD EPMSPD_ENAPSDIAG_SC_Compu "" TAB_VERB "%6.3" "" COMPU_TAB_REF EPMSPD_ENAPSDIAG_SC_Compu /end COMPU_METHOD
/begin COMPU_VTAB EPMSPD_ENAPSDIAG_SC_Compu "" TAB_VERB 2 0 "DIPSDIAG" 1 "ENAPSDIAG" /end COMPU_VTAB
/begin COMPU_METHOD EPMSPD_SIGGENN_SC_Compu "" TAB_VERB "%6.3" "" COMPU_TAB_REF EPMSPD_SIGGENN_SC_Compu /end COMPU_METHOD
/begin COMPU_VTAB EPMSPD_SIGGENN_SC_Compu "" TAB_VERB 5 0 "NO_SIGGENN" 1 "CRS_GENN" 2 "PWM_GENN" 3 "PWMORCRS_GENN" 4 "TWOSIG_GENN" /end COMPU_VTAB
/begin COMPU_METHOD EPMSYN_INJRLS_SC_Compu "" TAB_VERB "%6.3" "" COMPU_TAB_REF EPMSYN_INJRLS_SC_Compu /end COMPU_METHOD
/begin COMPU_VTAB EPMSYN_INJRLS_SC_Compu "" TAB_VERB 2 0 "INJRLS_ALWAYS" 1 "INJRLS_AFTERANGLE" /end COMPU_VTAB
/begin COMPU_METHOD EPMSYN_PHIINCCOR_CURX_SC_Compu "" RAT_FUNC "%6.2" "" COEFFS 0 1 0 0 0 1 /end COMPU_METHOD
/begin COMPU_METHOD EPMTDC_PRODCORRNVAL_SC_Compu "" TAB_VERB "%6.3" "" COMPU_TAB_REF EPMTDC_PRODCORRNVAL_SC_Compu /end COMPU_METHOD
/begin COMPU_VTAB EPMTDC_PRODCORRNVAL_SC_Compu "" TAB_VERB 2 0 "OFF" 1 "ON" /end COMPU_VTAB
/begin COMPU_METHOD EPM_ATS_SY_Compu "" TAB_VERB "%6.3" "" COMPU_TAB_REF EPM_ATS_SY_Compu /end COMPU_METHOD
/begin COMPU_VTAB EPM_ATS_SY_Compu "" TAB_VERB 2 0 "NO_ACCESS" 1 "ACCESS" /end COMPU_VTAB
/begin COMPU_METHOD EPM_CAMSFTSNSRDEACTVN_SC_Compu "" TAB_VERB "%6.3" "" COMPU_TAB_REF EPM_CAMSFTSNSRDEACTVN_SC_Compu /end COMPU_METHOD
/begin COMPU_VTAB EPM_CAMSFTSNSRDEACTVN_SC_Compu "" TAB_VERB 2 0 "CANNOT_DEACTIVATE" 1 "BY_CALIBRATION" /end COMPU_VTAB
/begin COMPU_METHOD EPM_CUSTADP_SC_Compu "" TAB_VERB "%6.3" "" COMPU_TAB_REF EPM_CUSTADP_SC_Compu /end COMPU_METHOD
/begin COMPU_VTAB EPM_CUSTADP_SC_Compu "" TAB_VERB 2 0 "False" 1 "True" /end COMPU_VTAB
/begin COMPU_METHOD EPM_DGIDIRCORRN_SC_Compu "" TAB_VERB "%6.3" "" COMPU_TAB_REF EPM_DGIDIRCORRN_SC_Compu /end COMPU_METHOD
/begin COMPU_VTAB EPM_DGIDIRCORRN_SC_Compu "" TAB_VERB 2 0 "DIRCORRN_OFF" 1 "DIRCORRN_ON" /end COMPU_VTAB
/begin COMPU_METHOD EPM_DGIDIRFRCD_SC_Compu "" TAB_VERB "%6.3" "" COMPU_TAB_REF EPM_DGIDIRFRCD_SC_Compu /end COMPU_METHOD
/begin COMPU_VTAB EPM_DGIDIRFRCD_SC_Compu "" TAB_VERB 2 0 "DIRFRCD_OFF" 1 "DIRFRCD_ON" /end COMPU_VTAB
/begin COMPU_METHOD Fact "" RAT_FUNC "%6.5" "-" COEFFS 0 8192 0 0 0 1 /end COMPU_METHOD
/begin COMPU_METHOD fak_uw_b2 "" RAT_FUNC "%7.6" "-" COEFFS 0 65536 0 0 0 2 /end COMPU_METHOD
/begin COMPU_METHOD nmot_ub_q40 "" RAT_FUNC "%6.1" "1/min" COEFFS 0 1 0 0 0 40 /end COMPU_METHOD
/begin COMPU_METHOD OneToOne "" RAT_FUNC "%6.2" "-" COEFFS 0 1 0 0 0 1 /end COMPU_METHOD
/begin COMPU_METHOD RBPtCel_p_0p002_1 "" RAT_FUNC "%6.4" "MPa" COEFFS 0 1000 0 0 0 2 /end COMPU_METHOD
/begin COMPU_METHOD RBPtCel_p_1p0_1 "" RAT_FUNC "%6.2" "hPa" COEFFS 0 1 0 0 0 1 /end COMPU_METHOD
/begin COMPU_METHOD RBPtCel_t_1p0_3 "" RAT_FUNC "%6.2" "Deg C" COEFFS 0 1 0 0 0 1 /end COMPU_METHOD
/begin COMPU_METHOD rel_sw_b1536 "" RAT_FUNC "%6.4" "%" COEFFS 0 65536 0 0 0 3072 /end COMPU_METHOD
/begin COMPU_METHOD SigQly_COMPU_VERB "" TAB_VERB "%6.3" "" COMPU_TAB_REF SigQly_COMPU_VERB /end COMPU_METHOD
/begin COMPU_VTAB SigQly_COMPU_VERB "" TAB_VERB 16 0 "SIGQLY_NOTCALC" 1 "SIGQLY_INIT" 2 "SIGQLY_OK" 3 "SIGQLY_MODEL" 4 "SIGQLY_REPLACEMENT" 5 "SIGQLY_FROZEN" 6 "SIGQLY_INVALID" 7 "SIGQLY_RESERVED_7" 8 "SIGQLY_RESERVED_8" 9 "SIGQLY_RESERVED_9" 10 "SIGQLY_RESERVED_10" 11 "SIGQLY_RESERVED_11" 12 "SIGQLY_RESERVED_12" 13 "SIGQLY_RESERVED_13" 14 "SIGQLY_RESERVED_14" 15 "SIGQLY_RESERVED_15" /end COMPU_VTAB
/begin COMPU_METHOD t1sxs_uw_q1 "" RAT_FUNC "%6.2" "s" COEFFS 0 1 0 0 0 1 /end COMPU_METHOD
/begin COMPU_METHOD Temp_Cels "" RAT_FUNC "%6.1" "deg C" COEFFS 0 10 2731.4 0 0 1 /end COMPU_METHOD
/begin COMPU_METHOD temp_ub_q0p75_o48 "" RAT_FUNC "%6.2" "Grad C" COEFFS 0 1 48 0 0 0.75 /end COMPU_METHOD
/begin COMPU_METHOD t_q0p01 "" RAT_FUNC "%6.4" "s" COEFFS 0 100 0 0 0 1 /end COMPU_METHOD
/begin COMPU_METHOD t_q0p05 "" RAT_FUNC "%6.4" "s" COEFFS 0 100 0 0 0 5 /end COMPU_METHOD
/begin COMPU_METHOD t_q0p1 "" RAT_FUNC "%6.3" "s" COEFFS 0 10 0 0 0 1 /end COMPU_METHOD
/begin COMPU_METHOD t_q0p2 "" RAT_FUNC "%6.3" "s" COEFFS 0 10 0 0 0 2 /end COMPU_METHOD
/begin COMPU_METHOD t_q10_ms "" RAT_FUNC "%6.1" "ms" COEFFS 0 1 0 0 0 10 /end COMPU_METHOD
/begin COMPU_METHOD Volt_Batt "" RAT_FUNC "%6.1" "mV" COEFFS 0 0.05 0 0 0 1 /end COMPU_METHOD
/begin RECORD_LAYOUT KwWU16 FNC_VALUES 1 UWORD COLUMN_DIR DIRECT /end RECORD_LAYOUT
/begin RECORD_LAYOUT KwWU8 FNC_VALUES 1 UBYTE COLUMN_DIR DIRECT /end RECORD_LAYOUT
/begin RECORD_LAYOUT Kw_Ws16 FNC_VALUES 1 SWORD COLUMN_DIR DIRECT /end RECORD_LAYOUT
/begin RECORD_LAYOUT RB_Curve_U16_U8_Static NO_AXIS_PTS_X 1 UWORD AXIS_PTS_X 2 UWORD INDEX_INCR DIRECT FNC_VALUES 3 UBYTE COLUMN_DIR DIRECT STATIC_RECORD_LAYOUT /end RECORD_LAYOUT
/begin RECORD_LAYOUT RB_Curve_U8_U16_Static NO_AXIS_PTS_X 1 UBYTE AXIS_PTS_X 2 UBYTE INDEX_INCR DIRECT FNC_VALUES 3 UWORD COLUMN_DIR DIRECT STATIC_RECORD_LAYOUT /end RECORD_LAYOUT
/begin RECORD_LAYOUT RB_Val_Ws16 FNC_VALUES 1 SWORD COLUMN_DIR DIRECT /end RECORD_LAYOUT
/begin RECORD_LAYOUT RB_Val_Wu16 FNC_VALUES 1 UWORD COLUMN_DIR DIRECT /end RECORD_LAYOUT
/begin RECORD_LAYOUT RB_Val_Wu8 FNC_VALUES 1 UBYTE COLUMN_DIR DIRECT /end RECORD_LAYOUT
/begin RECORD_LAYOUT Val_Wu16 FNC_VALUES 1 UWORD COLUMN_DIR DIRECT /end RECORD_LAYOUT
/begin RECORD_LAYOUT Val_Wu8 FNC_VALUES 1 UBYTE COLUMN_DIR DIRECT /end RECORD_LAYOUT
/end MODULE
/end PROJECT
