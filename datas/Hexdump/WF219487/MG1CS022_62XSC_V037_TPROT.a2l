ASAP2_VERSION 1 60
/begin PROJECT MG1CS022 "MG1CS022"
/begin HEADER "" VERSION "MG1CS022_62XSC_V037_TPROT" PROJECT_NO MG1CS022 /end HEADER
/begin MODULE DIM ""
/begin MOD_COMMON "" BYTE_ORDER MSB_LAST ALIGNMENT_BYTE 1 ALIGNMENT_WORD 2 ALIGNMENT_LONG 4 ALIGNMENT_INT64 4 ALIGNMENT_FLOAT32_IEEE 4 ALIGNMENT_FLOAT64_IEEE 4 DATA_SIZE 32 /end MOD_COMMON
/begin CHARACTERISTIC EGSDCmn_Cat1B1Empty_I.duUMinOKParl_C "Calculation of the transition condition for switching to lean lambda phase / Minimum sensor voltage gradient for detection of catalyst acceptably empty from oxygen during pre-conditioning phase" VALUE 0x8053E414 RB_Val_Ws16 132.9980 spgg_q0p002029_V_DIV_s -66.50000 66.49797 FORMAT "%8.5" /end CHARACTERISTIC
/begin CHARACTERISTIC EGSDCmn_Cat1B1Empty_I.mO2CatEmptyOKParl_C "Calculation of the transition condition for switching to lean lambda phase / Integrated exhaust gas mass flow for detection if catalyst is sufficiently empty from oxygen during pre-conditioning phase" VALUE 0x8053E418 RB_Val_Wr32 50000.0000 m_q1_mg 0.00 50000.0000 FORMAT "%10.4" EXTENDED_LIMITS -3.40282347E+038 3.40282347E+038 /end CHARACTERISTIC
/begin CHARACTERISTIC EGSDCmn_Cat1B1Empty_I.uCatEmptyOKParl_C "Calculation of the transition condition for switching to lean lambda phase / Minimum sensor voltage for detection of catalyst acceptably empty from oxygen during pre-conditioning phase" VALUE 0x8053E41C RB_Val_Wu16 4.998779 spg_q1p221Em3_V 0.00 4.998779 FORMAT "%8.6" EXTENDED_LIMITS 0.00 79.99878 /end CHARACTERISTIC
/begin CHARACTERISTIC EGSDCmn_dmEnaNegParl_C "Release threshold for negative gradient of exhaust gas mass flow of parallelized exhaust sensor diagnosis" VALUE 0x8053E49C RB_Val_Ws16 6553.500 m_sw_b3276p8 -3276.800 3276.700 FORMAT "%8.3" /end CHARACTERISTIC
/begin CHARACTERISTIC EGSDCmn_dmEnaPosParl_C "Release threshold for positive gradient of exhaust gas mass flow of parallelized exhaust sensor diagnosis" VALUE 0x8053E49E RB_Val_Ws16 6553.500 m_sw_b3276p8 -3276.800 3276.700 FORMAT "%8.3" /end CHARACTERISTIC
/begin CHARACTERISTIC EGSDCmn_dmfRngHiMaxActvParl_T "engine dependent offset for the upper limit of the mass flow of the release condition of the mass flow high range for parallelization" CURVE 0x8053E4A0 RB_Curve_S16_U16_Static 6553.500 m_uw_b6553p5 0.00 6553.500 FORMAT "%8.3"
 /begin AXIS_DESCR STD_AXIS Epm_nEng EngN 6 -16384.00 16383.50 FORMAT "%8.2" DEPOSIT ABSOLUTE /end AXIS_DESCR
/end CHARACTERISTIC
/begin CHARACTERISTIC EGSDCmn_dmfRngHiMinActvParl_C "offset for the lower limit of the mass flow of the release condition of the mass flow high range for parallelization" VALUE 0x8053E4BA RB_Val_Wu16 6553.500 m_uw_b6553p5 0.00 6553.500 FORMAT "%8.3" /end CHARACTERISTIC
/begin CHARACTERISTIC EGSDCmn_dmfRngLoMaxActvParl_T "engine dependent offset for the upper limit of the mass flow of the release condition of the mass flow low range for parallelization" CURVE 0x8053E4BC RB_Curve_S16_U16_Static 6553.500 m_uw_b6553p5 0.00 6553.500 FORMAT "%8.3"
 /begin AXIS_DESCR STD_AXIS Epm_nEng EngN 6 -16384.00 16383.50 FORMAT "%8.2" DEPOSIT ABSOLUTE /end AXIS_DESCR
/end CHARACTERISTIC
/begin CHARACTERISTIC EGSDCmn_dmfRngLoMinActvParl_C "offset for the lower limit of the mass flow of the release condition of the mass flow low range for parallelization" VALUE 0x8053E4D6 RB_Val_Wu16 6553.500 m_uw_b6553p5 0.00 6553.500 FORMAT "%8.3" /end CHARACTERISTIC
/begin CHARACTERISTIC EGSDCmn_dmfRngLoUnderMinParl_C "offset for the lower limit of the mass flow of the release condition of the mass flow low range for parallelization when Diagnosis is Active" VALUE 0x8053E4D8 RB_Val_Wu16 6553.500 m_uw_b6553p5 0.00 6553.500 FORMAT "%8.3" /end CHARACTERISTIC
/begin CHARACTERISTIC EGSDCmn_dnEngMaxParl_C "Delta to lower maximum engine speed boundary" VALUE 0x8053E4DA RB_Val_Wu8 10200. nmot_ub_q40 0.00 10200. FORMAT "%5.0" /end CHARACTERISTIC
/begin CHARACTERISTIC EGSDCmn_dnEngMinParl_C "Delta to raise minimum engine speed boundary" VALUE 0x8053E4DB RB_Val_Wu8 10200. nmot_ub_q40 0.00 10200. FORMAT "%5.0" /end CHARACTERISTIC
/begin CHARACTERISTIC EGSDCmn_dtCat1HomParl_C "Difference temperature for catalyst 1 heated up" VALUE 0x8053E4DC RB_Val_Ws16 6553.500 temp_q0p1 -3276.800 3276.700 FORMAT "%8.3" /end CHARACTERISTIC
/begin CHARACTERISTIC EGSDCmn_dtCat1RngHiMaxParl_C "offset for the upper limit of the catalyst temperature of the release condition of the temperature high range for parallelization ( for Gasoline Fuel)" VALUE 0x8053E4DE RB_Val_Wu16 1535.977 temp_q0p0234 0.00 1535.977 FORMAT "%8.3" /end CHARACTERISTIC
/begin CHARACTERISTIC EGSDCmn_dtCat1RngHiMinParl_C "offset for the lower limit of the catalyst temperature of the release condition of the temperature high range for parallelization ( for Gasoline Fuel)" VALUE 0x8053E4E0 RB_Val_Wu16 1535.977 temp_q0p0234 0.00 1535.977 FORMAT "%8.3" /end CHARACTERISTIC
/begin CHARACTERISTIC EGSDCmn_dtCat1RngLoMaxParl_C "offset for the upper limit of the catalyst temperature of the release condition of the temperature low range for parallelization( for Gasoline Fuel)" VALUE 0x8053E4E2 RB_Val_Wu16 1535.977 temp_q0p0234 0.00 1535.977 FORMAT "%8.3" /end CHARACTERISTIC
/begin CHARACTERISTIC EGSDCmn_dtCat1RngLoMinParl_C "offset for the lower limit of the catalyst temperature of the release condition for parallelization" VALUE 0x8053E4E4 RB_Val_Wu16 1535.977 temp_q0p0234 0.00 1535.977 FORMAT "%8.3" /end CHARACTERISTIC
/begin CHARACTERISTIC EGSDCmn_duCatEmptyMaxParl_C "Maximum acceptable voltage gradient for detection of catalyst is empty of oxygen" VALUE 0x8053E088 RB_Val_Ws16 132.9980 spgg_q0p002029_V_DIV_s -66.50000 66.49797 FORMAT "%8.5" /end CHARACTERISTIC
/begin CHARACTERISTIC EGSDCmn_duCatEmptyMinParl_C "Minimum acceptable voltage gradient for detection of catalyst is empty of oxygen" VALUE 0x8053E08A RB_Val_Ws16 132.9980 spgg_q0p002029_V_DIV_s -66.50000 66.49797 FORMAT "%8.5" /end CHARACTERISTIC
/begin CHARACTERISTIC EGSDCmn_duCatFullMaxParl_C "Maximum acceptable voltage gradient for detection of catalyst is full of oxygen" VALUE 0x8053E08C RB_Val_Ws16 132.9980 spgg_q0p002029_V_DIV_s -66.50000 66.49797 FORMAT "%8.5" /end CHARACTERISTIC
/begin CHARACTERISTIC EGSDCmn_duCatFullMinParl_C "Minimum acceptable voltage gradient for detection of catalyst is full of oxygen" VALUE 0x8053E08E RB_Val_Ws16 132.9980 spgg_q0p002029_V_DIV_s -66.50000 66.49797 FORMAT "%8.5" /end CHARACTERISTIC
/begin CHARACTERISTIC EGSDCmn_facFpcAdpnMaxParl_C "maximal fuel purge adaptation for enable condition" VALUE 0x8053E4E6 RB_Val_Ws16 127.9980 fak_sw_b64 -64.00000 63.99805 FORMAT "%8.5" /end CHARACTERISTIC
/begin CHARACTERISTIC EGSDCmn_facFuByFpcParl_C "maximal relative fuel portion from canister purge for parallelization" VALUE 0x8053E4E8 RB_Val_Wu16 3.999939 fak_uw_b4 0.00 3.999939 FORMAT "%8.6" /end CHARACTERISTIC
/begin CHARACTERISTIC EGSDCmn_facLamCtrlVLamDynParl_C "Controller factor for active dynamic diagnose" VALUE 0x8053E420 RB_Val_Wu8 1.992188 fak_ub_b2 0.00 1.992188 FORMAT "%8.6" /end CHARACTERISTIC
/begin CHARACTERISTIC EGSDCmn_facLamCtrlVParl_C "Factor for lambda controller velocity during parallelization" VALUE 0x8053E421 RB_Val_Wu8 1.992188 fak_ub_b2 0.00 1.992188 FORMAT "%8.6" /end CHARACTERISTIC
/begin CHARACTERISTIC EGSDCmn_facOSCErrTarLean_T "Correction factor of maximum oxygen mass for the timeout activation of the lambda request dependent on oxygen storage capacity of catalyst" CURVE 0x8053E090 RB_Curve_U16_U16 15.99976 fak_uw_b16 0.00 15.99976 FORMAT "%8.5"
 /begin AXIS_DESCR STD_AXIS TWCD_rOSCAvrgPriB1 fak_uw_b16 5 0.00 15.99976 FORMAT "%8.5" DEPOSIT ABSOLUTE /end AXIS_DESCR
/end CHARACTERISTIC
/begin CHARACTERISTIC EGSDCmn_facOSCErrTarRich_T "Correction factor of maximum exhaust gas mass for the timeout activation of the lambda request dependent on oxygen storage capacity of catalyst" CURVE 0x8053E0A6 RB_Curve_U16_U16 15.99976 fak_uw_b16 0.00 15.99976 FORMAT "%8.5"
 /begin AXIS_DESCR STD_AXIS TWCD_rOSCAvrgPriB1 fak_uw_b16 5 0.00 15.99976 FORMAT "%8.5" DEPOSIT ABSOLUTE /end AXIS_DESCR
/end CHARACTERISTIC
/begin CHARACTERISTIC EGSDCmn_facOSCRampDur_T "Correction factor of maximum exhaust gas mass for the end of the lambda ramp dependent on oxygen storage capacity of catalysts" CURVE 0x8053E0BC RB_Curve_U16_U16 15.99976 fak_uw_b16 0.00 15.99976 FORMAT "%8.5"
 /begin AXIS_DESCR STD_AXIS TWCD_rOSCAvrgPriB1 fak_uw_b16 5 0.00 15.99976 FORMAT "%8.5" DEPOSIT ABSOLUTE /end AXIS_DESCR
/end CHARACTERISTIC
/begin CHARACTERISTIC EGSDCmn_facRampParl_C "Gradient of the lambda ramp in ramp-test of range check of sensor voltage" VALUE 0x8053E0D2 RB_Val_Wu16 9.999084 k10ms_uw_b100 0.00 9.999084 FORMAT "%8.6" EXTENDED_LIMITS 0.00 99.99847 /end CHARACTERISTIC
/begin CHARACTERISTIC EGSDCmn_facTiTqResvParl_C "time constant of the torque reserve for parallelization" VALUE 0x8053E422 RB_Val_Wu16 655.34999985 zk10msxs_uw_b655p36 0.01000015 655.36000000 FORMAT "%12.8" EXTENDED_LIMITS 0.010000152590 655.36000000 /end CHARACTERISTIC
/begin CHARACTERISTIC EGSDCmn_flgActvtAbortCntr_C "Counter of aborts since clearing of error memory activated" VALUE 0x8053E4EA RB_Val_Wu8 1.00000000000 B_TRUE 0.00 1.00000000000 FORMAT "%13.11" /end CHARACTERISTIC
/begin CHARACTERISTIC EGSDCmn_flgBypLamMonOkParl_C "Code word to bypass lambda monitoring criterion as enable condition of parallelization" VALUE 0x8053E4EB RB_Val_Wu8 1.00000000000 B_TRUE 0.00 1.00000000000 FORMAT "%13.11" /end CHARACTERISTIC
/begin CHARACTERISTIC EGSDCmn_flgEnaAftIdleIni_C "Activate initializing of idle feature with TRUE" VALUE 0x8053E4EC RB_Val_Wu8 1.00000000000 B_TRUE 0.00 1.00000000000 FORMAT "%13.11" /end CHARACTERISTIC
/begin CHARACTERISTIC EGSDCmn_flgEnaEomParl_C "Enable to use the operation mode request" VALUE 0x8053E424 RB_Val_Wu8 1.00000000000 B_TRUE 0.00 1.00000000000 FORMAT "%13.11" /end CHARACTERISTIC
/begin CHARACTERISTIC EGSDCmn_flgFcoDiDiag_C "Codeword to consider fuel cut off in feature catalyst to cold due to low engine speed." VALUE 0x8053E4ED RB_Val_Wu8 1.00000000000 B_TRUE 0.00 1.00000000000 FORMAT "%13.11" /end CHARACTERISTIC
/begin CHARACTERISTIC EGSDCmn_flgFMixAdpnParl_CW "enabling criterion fuel mix adaption" VALUE 0x8053E4EE RB_Val_Wu8 1.00000000000 B_TRUE 0.00 1.00000000000 FORMAT "%13.11" /end CHARACTERISTIC
/begin CHARACTERISTIC EGSDCmn_flgGearShiftEnaParl_CW "Activation inhibiting parallelization by gear-shift" VALUE 0x8053E4EF RB_Val_Wu8 1.00000000000 B_TRUE 0.00 1.00000000000 FORMAT "%13.11" /end CHARACTERISTIC
/begin CHARACTERISTIC EGSDCmn_flgInjVlvDisblActvParl_C "Injection valve deactivation criteria active" VALUE 0x8053E4F0 RB_Val_Wu8 1.00000000000 B_TRUE 0.00 1.00000000000 FORMAT "%13.11" /end CHARACTERISTIC
/begin CHARACTERISTIC EGSDCmn_flgLamDynSlowCtrlParl_C "Activation of separate controller factor for dynamic diagnosis" VALUE 0x8053E425 RB_Val_Wu8 1.00000000000 B_TRUE 0.00 1.00000000000 FORMAT "%13.11" /end CHARACTERISTIC
/begin CHARACTERISTIC EGSDCmn_flgLamMonCntrParl_C "Lambda stability criterion is bound to the lambda shifting of the parallelized catalyst diagnosis" VALUE 0x8053E4F1 RB_Val_Wu8 1.00000000000 B_TRUE 0.00 1.00000000000 FORMAT "%13.11" /end CHARACTERISTIC
/begin CHARACTERISTIC EGSDCmn_flgLamMonSuppParl_CW "Codebit: Suppressing of abortions by Lambda-Monitoring possible" VALUE 0x8053E4F2 RB_Val_Wu8 1.00000000000 B_TRUE 0.00 1.00000000000 FORMAT "%13.11" /end CHARACTERISTIC
/begin CHARACTERISTIC EGSDCmn_flgOffsDurgShoPreParl_C "Calibration to consider the UEGO Offset Diagnosis before Parallelization during Short Trip" VALUE 0x8053E4F3 RB_Val_Wu8 1.00000000000 B_TRUE 0.00 1.00000000000 FORMAT "%13.11" /end CHARACTERISTIC
/begin CHARACTERISTIC EGSDCmn_flgPurgCtrlParl_C "The purge flow of the fuel purge control is monitored for the release of the parallelization" VALUE 0x8053E4F4 RB_Val_Wu8 1.00000000000 B_TRUE 0.00 1.00000000000 FORMAT "%13.11" /end CHARACTERISTIC
/begin CHARACTERISTIC EGSDCmn_flgSymTranOnly_CW "Codebit: Dynamic Diagnosis for Symmetric Transition Fault Only" VALUE 0x8053E0D4 RB_Val_Wu8 1.00000000000 B_TRUE 0.00 1.00000000000 FORMAT "%13.11" /end CHARACTERISTIC
/begin CHARACTERISTIC EGSDCmn_flgVltgSymc_C "Enabling of symmetrization feature for first downstream sensor by calibration" VALUE 0x8053E0D5 RB_Val_Wu8 1.00000000000 B_TRUE 0.00 1.00000000000 FORMAT "%13.11" /end CHARACTERISTIC
/begin CHARACTERISTIC EGSDCmn_flgVlVLftActvParl_CW "valve lift ienabling criterion s active" VALUE 0x8053E4F5 RB_Val_Wu8 1.00000000000 B_TRUE 0.00 1.00000000000 FORMAT "%13.11" /end CHARACTERISTIC
/begin CHARACTERISTIC EGSDCmn_mCat1EmptyGrdtParl_M "Amount of exhaust gas mass flow before start of recognition of catalyst 1 is empty from oxygen (based on sensor voltage gradient)" MAP 0x8053E0D8 RB_Map_U16U16_R32 50000.0000 m_q1_mg 0.00 50000.0000 FORMAT "%10.4" EXTENDED_LIMITS -3.40282347E+038 3.40282347E+038
 /begin AXIS_DESCR STD_AXIS NO_INPUT_QUANTITY m_q0p1 5 0.00 6553.500 FORMAT "%8.3" DEPOSIT ABSOLUTE /end AXIS_DESCR
 /begin AXIS_DESCR STD_AXIS NO_INPUT_QUANTITY fak_uw_b16 5 0.00 15.99976 FORMAT "%8.5" DEPOSIT ABSOLUTE /end AXIS_DESCR
/end CHARACTERISTIC
/begin CHARACTERISTIC EGSDCmn_mCat1EmptyGrdtPreCdnParl_M "Rich gas mass for the detection if the catalyst is empty of oxygen during pre conditioning phase Cat2" MAP 0x8053E154 RB_Map_U16U16_R32 50000.0000 m_q1_mg 0.00 50000.0000 FORMAT "%10.4" EXTENDED_LIMITS -3.40282347E+038 3.40282347E+038
 /begin AXIS_DESCR STD_AXIS NO_INPUT_QUANTITY m_q0p1 5 0.00 6553.500 FORMAT "%8.3" DEPOSIT ABSOLUTE /end AXIS_DESCR
 /begin AXIS_DESCR STD_AXIS NO_INPUT_QUANTITY fak_uw_b16 5 0.00 15.99976 FORMAT "%8.5" DEPOSIT ABSOLUTE /end AXIS_DESCR
/end CHARACTERISTIC
/begin CHARACTERISTIC EGSDCmn_mCat1FullGrdtParl_M "Amount of exhaust gas mass flow before start of recognition of catalyst 1 is filled with oxygen (based on sensor voltage gradient)" MAP 0x8053E1D0 RB_Map_U16U16_R32 50000.0000 m_q1_mg 0.00 50000.0000 FORMAT "%10.4" EXTENDED_LIMITS -3.40282347E+038 3.40282347E+038
 /begin AXIS_DESCR STD_AXIS NO_INPUT_QUANTITY m_q0p1 5 0.00 6553.500 FORMAT "%8.3" DEPOSIT ABSOLUTE /end AXIS_DESCR
 /begin AXIS_DESCR STD_AXIS NO_INPUT_QUANTITY fak_uw_b16 5 0.00 15.99976 FORMAT "%8.5" DEPOSIT ABSOLUTE /end AXIS_DESCR
/end CHARACTERISTIC
/begin CHARACTERISTIC EGSDCmn_mCat1FullGrdtPreCdnParl_M "Oxygen mass for the detection if catalyst is filled with oxygen during pre-conditioning phase" MAP 0x8053E24C RB_Map_U16U16_R32 50000.0000 m_q1_mg 0.00 50000.0000 FORMAT "%10.4" EXTENDED_LIMITS -3.40282347E+038 3.40282347E+038
 /begin AXIS_DESCR STD_AXIS NO_INPUT_QUANTITY m_q0p1 5 0.00 6553.500 FORMAT "%8.3" DEPOSIT ABSOLUTE /end AXIS_DESCR
 /begin AXIS_DESCR STD_AXIS NO_INPUT_QUANTITY fak_uw_b16 5 0.00 15.99976 FORMAT "%8.5" DEPOSIT ABSOLUTE /end AXIS_DESCR
/end CHARACTERISTIC
/begin CHARACTERISTIC EGSDCmn_mEgCatWarmAftIdleFco_M "Threshold Map for the Debouncing time for Warm Catalyst ( after fuel cut off and idling Condition) based on Vehicle Speed Environment Temperature" MAP 0x8053E4F6 RB_Map_S16S16_U16 65.53500 m_q0p001_kg 0.00 65.53500 FORMAT "%8.5"
 /begin AXIS_DESCR STD_AXIS VehV_v Vel 4 -327.6800 327.6700 FORMAT "%8.4" DEPOSIT ABSOLUTE /end AXIS_DESCR
 /begin AXIS_DESCR STD_AXIS EnvT_t Temp_Cels 4 -3549.940 3003.560 FORMAT "%8.3" DEPOSIT ABSOLUTE /end AXIS_DESCR
/end CHARACTERISTIC
/begin CHARACTERISTIC EGSDCmn_mEgFpcDynDebParl_C "Exhaust gas massflow to debounce the fuel purge dynamic" VALUE 0x8053E52A RB_Val_Wu16 65.53500 m_q0p001_kg 0.00 65.53500 FORMAT "%8.5" /end CHARACTERISTIC
/begin CHARACTERISTIC EGSDCmn_mEgFpcEnaParl_C "minimum integrated air mass flow from canister purge for parallelization" VALUE 0x8053E52C RB_Val_Wu8 11.32 m_ub_q0p0444 0.00 11.32 FORMAT "%5.2" /end CHARACTERISTIC
/begin CHARACTERISTIC EGSDCmn_mEgLamWaitParl_C "amount of exhaust gas mass flow to wait for the system to settle after Lambda instability during diagnosis execution" VALUE 0x8053E2C8 RB_Val_Wu16 65.53500 m_q0p001_kg 0.00 65.53500 FORMAT "%8.5" /end CHARACTERISTIC
/begin CHARACTERISTIC EGSDCmn_mEgLamWaitShtrpParl_C "Exhaust mass debouncing for the lambda stability criteria shorttrip" VALUE 0x8053E2CA RB_Val_Wu16 65.53500 m_q0p001_kg 0.00 65.53500 FORMAT "%8.5" /end CHARACTERISTIC
/begin CHARACTERISTIC EGSDCmn_mEnaDsbcParlB1_C "amount of air mass flow as debouncing condition since fuel mixture for release conditon of parallelization, bank 1" VALUE 0x8053E52E RB_Val_Wu16 65.53500 m_q0p001_kg 0.00 65.53500 FORMAT "%8.5" /end CHARACTERISTIC
/begin CHARACTERISTIC EGSDCmn_mEnaLam1Parl_C "exhaust gas mass for release of lambda = 1 preconditioning phase" VALUE 0x8053E530 RB_Val_Wu16 65.53500 m_q0p001_kg 0.00 65.53500 FORMAT "%8.5" /end CHARACTERISTIC
/begin CHARACTERISTIC EGSDCmn_mEnaSensVldParl_C "Integrated Exhaust mass to debounce sensor readiness for release of parallelization" VALUE 0x8053E532 RB_Val_Wu16 65.53500 m_q0p001_kg 0.00 65.53500 FORMAT "%8.5" /end CHARACTERISTIC
/begin CHARACTERISTIC EGSDCmn_mErrTarLeanParl_C "amount of oxygen mass flow before setting of a target-lean-error-suspicion" VALUE 0x8053E2CC RB_Val_Wr32 50000.0000 m_q1_mg 0.00 50000.0000 FORMAT "%10.4" EXTENDED_LIMITS -3.40282347E+038 3.40282347E+038 /end CHARACTERISTIC
/begin CHARACTERISTIC EGSDCmn_mErrTarRichParl_C "amount of oxygen mass flow before setting of a target-rich-error-suspicion" VALUE 0x8053E2D0 RB_Val_Wr32 50000.0000 m_q1_mg 0.00 50000.0000 FORMAT "%10.4" EXTENDED_LIMITS -3.40282347E+038 3.40282347E+038 /end CHARACTERISTIC
/begin CHARACTERISTIC EGSDCmn_mfEnaRampMaxParl_C "upper limit of the mass flow of the release condition of lambda ramp" VALUE 0x8053E534 RB_Val_Wu16 6553.500 m_q0p1 0.00 6553.500 FORMAT "%8.3" /end CHARACTERISTIC
/begin CHARACTERISTIC EGSDCmn_mfEnaRampMaxTstParl_C "upper limit of the mass flow of the release condition of lambda ramp during short trip" VALUE 0x8053E536 RB_Val_Wu16 6553.500 m_q0p1 0.00 6553.500 FORMAT "%8.3" /end CHARACTERISTIC
/begin CHARACTERISTIC EGSDCmn_mfEnaRampMinParl_C "lower limit of the mass flow of the release condition of lambda ramp" VALUE 0x8053E538 RB_Val_Wu16 6553.500 m_q0p1 0.00 6553.500 FORMAT "%8.3" /end CHARACTERISTIC
/begin CHARACTERISTIC EGSDCmn_mfEnaRampMinTstParl_C "lower limit of the mass flow of the release condition of lambda ramp during short trip" VALUE 0x8053E53A RB_Val_Wu16 6553.500 m_q0p1 0.00 6553.500 FORMAT "%8.3" /end CHARACTERISTIC
/begin CHARACTERISTIC EGSDCmn_mfPurgCtrlThdParl_C "allowed mass flow of the fuel purge for the release of the parallelization" VALUE 0x8053E53C RB_Val_Wu16 25.59961 m_uw_b25p6 0.00 25.59961 FORMAT "%8.5" /end CHARACTERISTIC
/begin CHARACTERISTIC EGSDCmn_mfRngHiMaxParl_T "the upper limit of the mass flow dependent on the engine speed for the release condition of the mass flow high range for parallelization" CURVE 0x8053E53E RB_Curve_S16_U16_Static 6553.500 m_uw_b6553p5 0.00 6553.500 FORMAT "%8.3"
 /begin AXIS_DESCR STD_AXIS Epm_nEng EngN 6 -16384.00 16383.50 FORMAT "%8.2" DEPOSIT ABSOLUTE /end AXIS_DESCR
/end CHARACTERISTIC
/begin CHARACTERISTIC EGSDCmn_mfRngHiMaxTstParl_C "the upper limit of the mass flow of the release condition of the mass flow high range for parallelization" VALUE 0x8053E558 RB_Val_Wu16 6553.500 m_uw_b6553p5 0.00 6553.500 FORMAT "%8.3" /end CHARACTERISTIC
/begin CHARACTERISTIC EGSDCmn_mfRngHiMinParl_C "the lower limit of the mass flow of the release condition of the mass flow high range for parallelization" VALUE 0x8053E55A RB_Val_Wu16 6553.500 m_uw_b6553p5 0.00 6553.500 FORMAT "%8.3" /end CHARACTERISTIC
/begin CHARACTERISTIC EGSDCmn_mfRngHiMinTstParl_C "the lower limit of the mass flow of the release condition of the mass flow high range for parallelization" VALUE 0x8053E55C RB_Val_Wu16 6553.500 m_uw_b6553p5 0.00 6553.500 FORMAT "%8.3" /end CHARACTERISTIC
/begin CHARACTERISTIC EGSDCmn_mfRngLoMaxParl_T "the upper limit of the mass flow dependent on the engine speed for the release condition of the mass flow high range for parallelization" CURVE 0x8053E55E RB_Curve_S16_U16_Static 6553.500 m_uw_b6553p5 0.00 6553.500 FORMAT "%8.3"
 /begin AXIS_DESCR STD_AXIS Epm_nEng EngN 6 -16384.00 16383.50 FORMAT "%8.2" DEPOSIT ABSOLUTE /end AXIS_DESCR
/end CHARACTERISTIC
/begin CHARACTERISTIC EGSDCmn_mfRngLoMaxTstParl_C "the upper limit of the mass flow of the release condition of the mass flow low range for parallelization in short trip" VALUE 0x8053E578 RB_Val_Wu16 6553.500 m_uw_b6553p5 0.00 6553.500 FORMAT "%8.3" /end CHARACTERISTIC
/begin CHARACTERISTIC EGSDCmn_mfRngLoMinParl_C "the lower limit of the mass flow of the release condition of the mass flow high range for parallelization" VALUE 0x8053E57A RB_Val_Wu16 6553.500 m_uw_b6553p5 0.00 6553.500 FORMAT "%8.3" /end CHARACTERISTIC
/begin CHARACTERISTIC EGSDCmn_mfRngLoMinTstParl_C "the lower limit of the mass flow of the release condition of the mass flow high range for parallelization in short trip" VALUE 0x8053E57C RB_Val_Wu16 6553.500 m_uw_b6553p5 0.00 6553.500 FORMAT "%8.3" /end CHARACTERISTIC
/begin CHARACTERISTIC EGSDCmn_mLamStabParl_C "amount of exhaust gas to detect that lambda value is stable during the diagnosis" VALUE 0x8053E2D4 RB_Val_Wu16 65.53500 m_q0p001_kg 0.00 65.53500 FORMAT "%8.5" /end CHARACTERISTIC
/begin CHARACTERISTIC EGSDCmn_mO2IdnAdapnParl_C "Oxygen mass threshold for online adaption" VALUE 0x8053E2D8 RB_Val_Wr32 50000.0000 m_q1_mg 0.00 50000.0000 FORMAT "%10.4" EXTENDED_LIMITS -3.40282347E+038 3.40282347E+038 /end CHARACTERISTIC
/begin CHARACTERISTIC EGSDCmn_mRampDurS2Parl_C "Maximum exhaust gas mass for the end of the lambda ramp" VALUE 0x8053E2DC RB_Val_Wu16 65.53500 m_q0p001_kg 0.00 65.53500 FORMAT "%8.5" /end CHARACTERISTIC
/begin CHARACTERISTIC EGSDCmn_mRichMinPreCdnS2Parl_M "minimum exhaust gas mass for rich lambda request in partial Oxygen Storage Capacity measurement during precondition phase, sensor 2" MAP 0x8053E2E0 RB_Map_U16U16_R32 50000.0000 m_q1_mg 0.00 50000.0000 FORMAT "%10.4" EXTENDED_LIMITS -3.40282347E+038 3.40282347E+038
 /begin AXIS_DESCR STD_AXIS NO_INPUT_QUANTITY m_q0p1 5 0.00 6553.500 FORMAT "%8.3" DEPOSIT ABSOLUTE /end AXIS_DESCR
 /begin AXIS_DESCR STD_AXIS NO_INPUT_QUANTITY fak_uw_b16 5 0.00 15.99976 FORMAT "%8.5" DEPOSIT ABSOLUTE /end AXIS_DESCR
/end CHARACTERISTIC
/begin CHARACTERISTIC EGSDCmn_mRichMinS2Parl_M "minimum exhaust gas mass for rich lambda request in partial Oxygen Storage Capacity measurement during measurement phase, sensor 2" MAP 0x8053E35C RB_Map_U16U16_R32 50000.0000 m_q1_mg 0.00 50000.0000 FORMAT "%10.4" EXTENDED_LIMITS -3.40282347E+038 3.40282347E+038
 /begin AXIS_DESCR STD_AXIS NO_INPUT_QUANTITY m_q0p1 5 0.00 6553.500 FORMAT "%8.3" DEPOSIT ABSOLUTE /end AXIS_DESCR
 /begin AXIS_DESCR STD_AXIS NO_INPUT_QUANTITY fak_uw_b16 5 0.00 15.99976 FORMAT "%8.5" DEPOSIT ABSOLUTE /end AXIS_DESCR
/end CHARACTERISTIC
/begin CHARACTERISTIC EGSDCmn_mSeg1EnaEgParl_T "exhaust gas mass for release of diagnosis since engine start" CURVE 0x8053E57E RB_Curve_S16_U16_Static 65.53500 m_q0p001_kg 0.00 65.53500 FORMAT "%8.5"
 /begin AXIS_DESCR STD_AXIS CEngDsT_tStrtFrst Temp_Cels 7 -3549.940 3003.560 FORMAT "%8.3" DEPOSIT ABSOLUTE /end AXIS_DESCR
/end CHARACTERISTIC
/begin CHARACTERISTIC EGSDCmn_nEngIdle_C "Engine speed, below which feature catalyst to cold due to low engine speed is activated." VALUE 0x8053E59C RB_Val_Ws16 32767.50 EngN -16384.00 16383.50 FORMAT "%8.2" /end CHARACTERISTIC
/begin CHARACTERISTIC EGSDCmn_nEngMaxParl_C "upper limit of engine speed for parallelization" VALUE 0x8053E59E RB_Val_Wu8 10200. nmot_ub_q40 0.00 10200. FORMAT "%5.0" /end CHARACTERISTIC
/begin CHARACTERISTIC EGSDCmn_nEngMaxTstParl_C "maximal set value of engine speed for operation point for parallelization in shorttrip" VALUE 0x8053E59F RB_Val_Wu8 10200. nmot_ub_q40 0.00 10200. FORMAT "%5.0" /end CHARACTERISTIC
/begin CHARACTERISTIC EGSDCmn_nEngMinParl_C "lower limit of engine speed for parallelization" VALUE 0x8053E5A0 RB_Val_Wu8 10200. nmot_ub_q40 0.00 10200. FORMAT "%5.0" /end CHARACTERISTIC
/begin CHARACTERISTIC EGSDCmn_nEngMinTstParl_C "minimal engine speed for operation point for parallelization in shorttrip" VALUE 0x8053E5A1 RB_Val_Wu8 10200. nmot_ub_q40 0.00 10200. FORMAT "%5.0" /end CHARACTERISTIC
/begin CHARACTERISTIC EGSDCmn_nrLamMonOKEFParl_C "Threshold number of abortions to suppress Lambda-Monitoring" VALUE 0x8053E5A2 RB_Val_Wu8 255.0 dez 0.00 255.0 FORMAT "%5.1" /end CHARACTERISTIC
/begin CHARACTERISTIC EGSDCmn_nrMaxIdnAdpnEnd_C "Number of maximum separate lambda changes for the adaptation for the lambda system" VALUE 0x8053E3D8 RB_Val_Wu8 255.0 OneToOne 0.00 255.0 FORMAT "%5.1" /end CHARACTERISTIC
/begin CHARACTERISTIC EGSDCmn_nrUGrdtParl_C "distance between voltage points for gradient calculation of sensor voltage lambda sensor downstream catalyst" VALUE 0x8053E3D9 RB_Val_Wu8 255.0 dez 0.00 255.0 FORMAT "%5.1" /end CHARACTERISTIC
/begin CHARACTERISTIC EGSDCmn_PEnvMinParl_C "Minimal Environmental pressure to enable Parallelization" VALUE 0x8053E5A4 RB_Val_Ws16 65535.00 p_q1 -32768.00 32767.00 FORMAT "%8.2" /end CHARACTERISTIC
/begin CHARACTERISTIC EGSDCmn_ratLamEnaMaxParl_C "maximum lambda prior to parallelization" VALUE 0x8053E5A6 RB_Val_Wu16 15.99976 fak_uw_b16 0.00 15.99976 FORMAT "%8.5" /end CHARACTERISTIC
/begin CHARACTERISTIC EGSDCmn_ratLamEnaMinParl_C "minimum lambda prior to parallelization" VALUE 0x8053E5A8 RB_Val_Wu16 15.99976 fak_uw_b16 0.00 15.99976 FORMAT "%8.5" /end CHARACTERISTIC
/begin CHARACTERISTIC EGSDCmn_ratLamIdnLeanParl_C "Lean Lambda setpoint request for online identification for Dynamic adaptation purpose only" VALUE 0x8053E3DA RB_Val_Wu16 15.99976 fak_uw_b16 0.00 15.99976 FORMAT "%8.5" /end CHARACTERISTIC
/begin CHARACTERISTIC EGSDCmn_ratLamIdnRichParl_C "Rich Lambda setpoint request for online identification for Dynamic adaptation purpose only" VALUE 0x8053E3DC RB_Val_Wu16 15.99976 fak_uw_b16 0.00 15.99976 FORMAT "%8.5" /end CHARACTERISTIC
/begin CHARACTERISTIC EGSDCmn_ratLamLeanEgInflParl_C "Threshold for detection of a lean lambda request with exhaust gas influence." VALUE 0x8053E5AA RB_Val_Wu16 15.99976 fak_uw_b16 0.00 15.99976 FORMAT "%8.5" /end CHARACTERISTIC
/begin CHARACTERISTIC EGSDCmn_ratLamLeanParl_C "Lean lambda setpoint request for parallelization" VALUE 0x8053E3DE RB_Val_Wu16 15.99976 fak_uw_b16 0.00 15.99976 FORMAT "%8.5" /end CHARACTERISTIC
/begin CHARACTERISTIC EGSDCmn_ratLamLessLeanMonParl_C "range of tolerance towards lambda 1 between set value and actual value of lambda during lambda shifting in lean direction" VALUE 0x8053E3E0 RB_Val_Wu16 15.99976 fak_uw_b16 0.00 15.99976 FORMAT "%8.5" /end CHARACTERISTIC
/begin CHARACTERISTIC EGSDCmn_ratLamLessRichMonParl_C "range of tolerance towards lambda 1 between set value and actual value of lambda during lambda shifting in rich direction" VALUE 0x8053E3E2 RB_Val_Wu16 15.99976 fak_uw_b16 0.00 15.99976 FORMAT "%8.5" /end CHARACTERISTIC
/begin CHARACTERISTIC EGSDCmn_ratLamMoreLeanMonParl_C "range of tolerance towards lean between setpoint value and actual value of lambda during lambda shifting in lean direction" VALUE 0x8053E3E4 RB_Val_Wu16 15.99976 fak_uw_b16 0.00 15.99976 FORMAT "%8.5" /end CHARACTERISTIC
/begin CHARACTERISTIC EGSDCmn_ratLamMoreRichMonParl_C "range of tolerance towards rich between set value and actual value of lambda during lambda shifting in rich direction" VALUE 0x8053E3E6 RB_Val_Wu16 15.99976 fak_uw_b16 0.00 15.99976 FORMAT "%8.5" /end CHARACTERISTIC
/begin CHARACTERISTIC EGSDCmn_ratLamRampLeanParl_C "lambda limit in direction lean of ramp test for range check" VALUE 0x8053E3E8 RB_Val_Wu16 15.99976 fak_uw_b16 0.00 15.99976 FORMAT "%8.5" /end CHARACTERISTIC
/begin CHARACTERISTIC EGSDCmn_ratLamRampRichParl_C "lambda limit in direction rich of ramp test for range check" VALUE 0x8053E3EA RB_Val_Wu16 15.99976 fak_uw_b16 0.00 15.99976 FORMAT "%8.5" /end CHARACTERISTIC
/begin CHARACTERISTIC EGSDCmn_ratLamRichEgInflParl_C "Threshold for detection of a rich lambda request with exhaust gas influence." VALUE 0x8053E5AC RB_Val_Wu16 15.99976 fak_uw_b16 0.00 15.99976 FORMAT "%8.5" /end CHARACTERISTIC
/begin CHARACTERISTIC EGSDCmn_ratLamRichParl_C "requested rich lambda for parallelization during check" VALUE 0x8053E3EC RB_Val_Wu16 15.99976 fak_uw_b16 0.00 15.99976 FORMAT "%8.5" /end CHARACTERISTIC
/begin CHARACTERISTIC EGSDCmn_ratLoadMinParl_Crv "min. threshold of relative load as enable condition" CURVE 0x8053E5AE RB_Curve_U8_U16_Static 1535.977 rel_q0p0234 0.00 1535.977 FORMAT "%8.3"
 /begin AXIS_DESCR STD_AXIS Epm_nEngLRes EngN_LRes 10 0.00 10200. FORMAT "%5.0" DEPOSIT ABSOLUTE /end AXIS_DESCR
/end CHARACTERISTIC
/begin CHARACTERISTIC EGSDCmn_ratLoadMinTstParl_T "min. threshold of relative load as enable condition during Short Trip" CURVE 0x8053E5CE RB_Curve_U8_U16_Static 1535.977 rel_q0p0234 0.00 1535.977 FORMAT "%8.3"
 /begin AXIS_DESCR STD_AXIS Epm_nEngLRes EngN_LRes 6 0.00 10200. FORMAT "%5.0" DEPOSIT ABSOLUTE /end AXIS_DESCR
/end CHARACTERISTIC
/begin CHARACTERISTIC EGSDCmn_rLamMaxDiffParl_C "Mixture difference to bypass actual mixture check after mixture steps" VALUE 0x8053E5E2 RB_Val_Wu16 15.99976 fak_uw_b16 0.00 15.99976 FORMAT "%8.5" /end CHARACTERISTIC
/begin CHARACTERISTIC EGSDCmn_stEomParl_C "Requested engine operation mode of the active exhaust gas sensor and catalyst diagnosis (parallelization)" VALUE 0x8053E428 RB_Val_Wu32 4294967295.00 OneToOne 0.00 4294967295.00 FORMAT "%13.2" /end CHARACTERISTIC
/begin CHARACTERISTIC EGSDCmn_stEomPrioParl_C "Requested engine operation mode priority of the active exhaust gas sensor and catalyst diagnosis (parallelization)" VALUE 0x8053E42C RB_Val_Wu8 255.0 OneToOne 0.00 255.0 FORMAT "%5.1" /end CHARACTERISTIC
/begin CHARACTERISTIC EGSDCmn_stEomPrioShtrpParl_C "Operation mode priority for parallelization in shorttrip" VALUE 0x8053E42D RB_Val_Wu8 255.0 OneToOne 0.00 255.0 FORMAT "%5.1" /end CHARACTERISTIC
/begin CHARACTERISTIC EGSDCmn_stEomShtrpParl_C "Operation mode for parallelization in shorttrip" VALUE 0x8053E430 RB_Val_Wu32 4294967295.00 OneToOne 0.00 4294967295.00 FORMAT "%13.2" /end CHARACTERISTIC
/begin CHARACTERISTIC EGSDCmn_stEomStgParl_C "Requested engine operation mode stage of the active exhaust gas sensor and catalyst diagnosis (parallelization)" VALUE 0x8053E434 RB_Val_Wu16 65535.00 OneToOne 0.00 65535.00 FORMAT "%8.2" /end CHARACTERISTIC
/begin CHARACTERISTIC EGSDCmn_stEomStgShtrpParl_C "Operation mode stage for parallelization in shorttrip" VALUE 0x8053E436 RB_Val_Wu16 65535.00 OneToOne 0.00 65535.00 FORMAT "%8.2" /end CHARACTERISTIC
/begin CHARACTERISTIC EGSDCmn_StOperModRelsShtrp_I.OperMod2Idx_M "Operation mode selection for parallelization in shorttrip / Mapping-Table for the conversion of the operation-mode-information in an other format" MAP 0x8053E43E RB_Map_U8U8_U8 255.0 OneToOne 0.00 255.0 FORMAT "%5.1"
 /begin AXIS_DESCR STD_AXIS NO_INPUT_QUANTITY CoEOM_idxOperModCfgd_VERB 4 0.00 3.00000000000 FORMAT "%13.11" DEPOSIT ABSOLUTE /end AXIS_DESCR
 /begin AXIS_DESCR STD_AXIS NO_INPUT_QUANTITY CoEOM_idxOperModStgTot_VERB 8 0.00 15.0000000000 FORMAT "%13.10" DEPOSIT ABSOLUTE /end AXIS_DESCR
/end CHARACTERISTIC
/begin CHARACTERISTIC EGSDCmn_StOperModRels_I.OperMod2Idx_M "Query of the operation mode / Mapping-Table for the conversion of the operation-mode-information in an other format" MAP 0x8053E46C RB_Map_U8U8_U8 255.0 OneToOne 0.00 255.0 FORMAT "%5.1"
 /begin AXIS_DESCR STD_AXIS NO_INPUT_QUANTITY CoEOM_idxOperModCfgd_VERB 4 0.00 3.00000000000 FORMAT "%13.11" DEPOSIT ABSOLUTE /end AXIS_DESCR
 /begin AXIS_DESCR STD_AXIS NO_INPUT_QUANTITY CoEOM_idxOperModStgTot_VERB 8 0.00 15.0000000000 FORMAT "%13.10" DEPOSIT ABSOLUTE /end AXIS_DESCR
/end CHARACTERISTIC
/begin CHARACTERISTIC EGSDCmn_tAmbMinParl_C "Minimum ambient temperature for activation of parallelization" VALUE 0x8053E5E4 RB_Val_Wu8 191.3 temp_ub_q0p75_o48 -48.0 143.3 FORMAT "%5.1" /end CHARACTERISTIC
/begin CHARACTERISTIC EGSDCmn_tCat1RngHiMaxParl_C "the upper limit of the catalyst temperature of the release condition of the temperature high range for parallelization" VALUE 0x8053E5E6 RB_Val_Wu16 1535.977 temp_q0p0234_o273 -273.150 1262.827 FORMAT "%8.3" /end CHARACTERISTIC
/begin CHARACTERISTIC EGSDCmn_tCat1RngHiMaxTstParl_C "the upper limit of the catalyst temperature of the release condition of the temperature high range for parallelization in short trip" VALUE 0x8053E5E8 RB_Val_Wu16 1535.977 temp_q0p0234_o273 -273.150 1262.827 FORMAT "%8.3" /end CHARACTERISTIC
/begin CHARACTERISTIC EGSDCmn_tCat1RngHiMinParl_C "the lower limit of the catalyst temperature of the release condition of the temperature high range for parallelization" VALUE 0x8053E5EA RB_Val_Wu16 1535.977 temp_q0p0234_o273 -273.150 1262.827 FORMAT "%8.3" /end CHARACTERISTIC
/begin CHARACTERISTIC EGSDCmn_tCat1RngHiMinTstParl_C "the lower limit of the catalyst temperature of the release condition of the temperature high range for parallelization in short trip" VALUE 0x8053E5EC RB_Val_Wu16 1535.977 temp_q0p0234_o273 -273.150 1262.827 FORMAT "%8.3" /end CHARACTERISTIC
/begin CHARACTERISTIC EGSDCmn_tCat1RngLoMaxParl_C "the upper limit of the catalyst temperature of the release condition of the temperature low range for parallelization" VALUE 0x8053E5EE RB_Val_Wu16 1535.977 temp_q0p0234_o273 -273.150 1262.827 FORMAT "%8.3" /end CHARACTERISTIC
/begin CHARACTERISTIC EGSDCmn_tCat1RngLoMaxTstParl_C "the upper limit of the catalyst temperature of the release condition of the temperature low range for parallelization in shorttrip" VALUE 0x8053E5F0 RB_Val_Wu16 1535.977 temp_q0p0234_o273 -273.150 1262.827 FORMAT "%8.3" /end CHARACTERISTIC
/begin CHARACTERISTIC EGSDCmn_tCat1RngLoMinParl_C "the lower limit of the catalyst temperature of the release condition of the temperature low range for parallelization" VALUE 0x8053E5F2 RB_Val_Wu16 1535.977 temp_q0p0234_o273 -273.150 1262.827 FORMAT "%8.3" /end CHARACTERISTIC
/begin CHARACTERISTIC EGSDCmn_tCat1RngLoMinTstParl_C "the lower limit of the catalyst temperature of the release condition of the temperature low range for parallelization in short trip" VALUE 0x8053E5F4 RB_Val_Wu16 1535.977 temp_q0p0234_o273 -273.150 1262.827 FORMAT "%8.3" /end CHARACTERISTIC
/begin CHARACTERISTIC EGSDCmn_tCatMaxGrdtParl_C "Maximum of temperature change at parallelization" VALUE 0x8053E5F6 RB_Val_Ws16 1535.977 temp_q0p0234 -768.0000 767.9766 FORMAT "%8.4" /end CHARACTERISTIC
/begin CHARACTERISTIC EGSDCmn_tCatMaxGrdtTstParl_C "Maximum of temperature change at parallelization in short trip" VALUE 0x8053E5F8 RB_Val_Ws16 1535.977 temp_q0p0234 -768.0000 767.9766 FORMAT "%8.4" /end CHARACTERISTIC
/begin CHARACTERISTIC EGSDCmn_tCatMinGrdtParl_C "min. tolerable temperature dynamic (gradient) to release parallel diagnosis" VALUE 0x8053E5FA RB_Val_Ws16 1535.977 temp_q0p0234 -768.0000 767.9766 FORMAT "%8.4" /end CHARACTERISTIC
/begin CHARACTERISTIC EGSDCmn_tCatMinGrdtTstParl_C "min. tolerable temperature dynamic (gradient) to release parallel diagnosis, during short trip" VALUE 0x8053E5FC RB_Val_Ws16 1535.977 temp_q0p0234 -768.0000 767.9766 FORMAT "%8.4" /end CHARACTERISTIC
/begin CHARACTERISTIC EGSDCmn_tCatMinParl_C "min-temperature for catalyst cooling down detection" VALUE 0x8053E5FE RB_Val_Ws16 6553.500 Temp_Cels -3549.940 3003.560 FORMAT "%8.3" /end CHARACTERISTIC
/begin CHARACTERISTIC EGSDCmn_tEngMinParl_C "minimum coolant temperature at engine output for enable condition" VALUE 0x8053E600 RB_Val_Ws16 6553.500 Temp_Cels -3549.940 3003.560 FORMAT "%8.3" /end CHARACTERISTIC
/begin CHARACTERISTIC EGSDCmn_tiCatMinOffParl_C "inhibit time for catalyst cooling down detection" VALUE 0x8053E602 RB_Val_Wu16 6553.500 t_q0p1 0.00 6553.500 FORMAT "%8.3" /end CHARACTERISTIC
/begin CHARACTERISTIC EGSDCmn_tiCatMinOnParl_C "duration of heating up for catalyst cooling down detection" VALUE 0x8053E604 RB_Val_Wu16 6553.500 t_q0p1 0.00 6553.500 FORMAT "%8.3" /end CHARACTERISTIC
/begin CHARACTERISTIC EGSDCmn_tiDebInjVlvDisblParl_C "Debouncing time for the inhibit of the physical enable conditions of the parallelization because of the injection valve deactivation" VALUE 0x8053E606 RB_Val_Wu16 655.3500 t_q0p01 0.00 655.3500 FORMAT "%8.4" /end CHARACTERISTIC
/begin CHARACTERISTIC EGSDCmn_tiDebInjVlvEnaParl_C "Debouncing time for the inhibit of the physical enable conditions of the parallelization because of the injection valve deactivation" VALUE 0x8053E608 RB_Val_Wu16 180.0000 t_q0p01 0.00 180.0000 FORMAT "%8.4" EXTENDED_LIMITS 0.00 655.3500 /end CHARACTERISTIC
/begin CHARACTERISTIC EGSDCmn_tiDebSigndLamMonParl_CUR "Debounce for deviation of current value" CURVE 0x8053E60A RB_Curve_S16_U16_Static 99.99847 k10ms_uw_b100 0.00 99.99847 FORMAT "%8.5"
 /begin AXIS_DESCR STD_AXIS NO_INPUT_QUANTITY fak_q0p000244 6 -8.000000 7.999756 FORMAT "%8.6" DEPOSIT ABSOLUTE /end AXIS_DESCR
/end CHARACTERISTIC
/begin CHARACTERISTIC EGSDCmn_tiEnaCatTGrdtParl_C "low pass filter time constant for main catalyst temperature of parallelization" VALUE 0x8053E624 RB_Val_Wu16 6553.4999985 zk100msxs_uw_b6553p6 0.1000015 6553.6000000 FORMAT "%12.7" EXTENDED_LIMITS 0.10000152590 6553.6000000 /end CHARACTERISTIC
/begin CHARACTERISTIC EGSDCmn_tiEnaMflowParl_C "time constant of the filtering of the mass flow for release condition of parallelization" VALUE 0x8053E626 RB_Val_Wu8 25.50 t_q0p1 0.00 25.50 FORMAT "%5.2" /end CHARACTERISTIC
/begin CHARACTERISTIC EGSDCmn_tiFilLamCtrlVParl_C "Filter time constant for controller factor" VALUE 0x8053E438 RB_Val_Wu8 25.4996 zk100msxs_ub_b25p6 0.1004 25.6000 FORMAT "%7.4" EXTENDED_LIMITS 0.100392 25.6000 /end CHARACTERISTIC
/begin CHARACTERISTIC EGSDCmn_tiFltMflowParl_C "low pass filter time constant for air mass flow for building of mass flow gradient" VALUE 0x8053E628 RB_Val_Wu16 655.34999985 zk10msxs_uw_b655 0.01000015 655.36000000 FORMAT "%12.8" EXTENDED_LIMITS 0.010000152590 655.36000000 /end CHARACTERISTIC
/begin CHARACTERISTIC EGSDCmn_tiGearShiftParl_C "Debouncing time for condition gear shift disabled" VALUE 0x8053E62A RB_Val_Wu8 25.50 t_q0p1 0.00 25.50 FORMAT "%5.2" /end CHARACTERISTIC
/begin CHARACTERISTIC EGSDCmn_tiIdleMax_C "Acceptable time with low engine speed (idle, StartStop, sailing etc.), until parallelization is disabled." VALUE 0x8053E62C RB_Val_Wu16 6553.500 t_q0p1 0.00 6553.500 FORMAT "%8.3" /end CHARACTERISTIC
/begin CHARACTERISTIC EGSDCmn_tiLamMonParl_C "Tolerance time for detection if lambda is stable during diagnosis execution" VALUE 0x8053E3EE RB_Val_Wu8 2.550 t_q0p01 0.00 2.550 FORMAT "%5.3" /end CHARACTERISTIC
/begin CHARACTERISTIC EGSDCmn_tiNEngOvrIdle_C "Debounce time: engine speed may exceed EGSDCmn_nEngIdle_C" VALUE 0x8053E62E RB_Val_Wu16 6553.500 t_q0p1 0.00 6553.500 FORMAT "%8.3" /end CHARACTERISTIC
/begin CHARACTERISTIC EGSDCmn_tiRngLoUnderMinParl_C "time duration for EGSDCmn_dmfRngLoUnderMinParl_C consideration when the Mass flow is in Low range for parallelization (when Diagnosis is Active )" VALUE 0x8053E630 RB_Val_Wu8 25.50 t_q0p1 0.00 25.50 FORMAT "%5.2" /end CHARACTERISTIC
/begin CHARACTERISTIC EGSDCmn_tiS1DynWrstCaseParl_C "Worst case sensor 1 dynamic time which is assumed during Lambda stability check" VALUE 0x8053E3F0 RB_Val_Wu16 655.3500 t_q0p01 0.00 655.3500 FORMAT "%8.4" /end CHARACTERISTIC
/begin CHARACTERISTIC EGSDCmn_tiS2LtrDynWpaParl_C "Worst part acceptable dynamic time for the downstream sensor, lean to rich" VALUE 0x8053E3F2 RB_Val_Wu16 655.3500 t_q0p01 0.00 655.3500 FORMAT "%8.4" /end CHARACTERISTIC
/begin CHARACTERISTIC EGSDCmn_tiS2RtlDynWpaParl_C "Worst part acceptable dynamic time for the downstream sensor, rich to lean" VALUE 0x8053E3F4 RB_Val_Wu16 655.3500 t_q0p01 0.00 655.3500 FORMAT "%8.4" /end CHARACTERISTIC
/begin CHARACTERISTIC EGSDCmn_tiUCatFullParl_C "Waiting time for detection of catalyst is filled with oxygen (based on sensor voltage)" VALUE 0x8053E3F6 RB_Val_Wu16 655.3500 t_q0p01 0.00 655.3500 FORMAT "%8.4" /end CHARACTERISTIC
/begin CHARACTERISTIC EGSDCmn_tiUS2LtrParl_C "time for sensor dynamic lean-rich for IUMPR simulation" VALUE 0x8053E3F8 RB_Val_Wu16 655.3500 t_q0p01 0.00 655.3500 FORMAT "%8.4" /end CHARACTERISTIC
/begin CHARACTERISTIC EGSDCmn_tiUS2RtlParl_C "time for sensor dynamic rich-lean for IUMPR simulation" VALUE 0x8053E3FA RB_Val_Wu16 655.3500 t_q0p01 0.00 655.3500 FORMAT "%8.4" /end CHARACTERISTIC
/begin CHARACTERISTIC EGSDCmn_tiVirtLamStabParl_C "assumed time for reaching the lambda stability criterion in the IUMPR of the upstream lambda sensor" VALUE 0x8053E3FC RB_Val_Wu16 655.3500 t_q0p01 0.00 655.3500 FORMAT "%8.4" /end CHARACTERISTIC
/begin CHARACTERISTIC EGSDCmn_tMinCatRelsParl_C "Minimum temperature catalyst 1 must exceed during heat up process in order to release diagnosis" VALUE 0x8053E632 RB_Val_Wu16 1535.977 temp_q0p0234_o273 -273.150 1262.827 FORMAT "%8.3" /end CHARACTERISTIC
/begin CHARACTERISTIC EGSDCmn_tqResvParl_C "requested torque reserve for parallelization" VALUE 0x8053E43A RB_Val_Ws16 6553.400 trq_q0p1 -3276.700 3276.700 FORMAT "%8.3" EXTENDED_LIMITS -3276.800 3276.700 /end CHARACTERISTIC
/begin CHARACTERISTIC EGSDCmn_tqResvTstParl_C "requested torque reserve for parallelization in short trip" VALUE 0x8053E43C RB_Val_Ws16 6553.400 trq_q0p1 -3276.700 3276.700 FORMAT "%8.3" EXTENDED_LIMITS -3276.800 3276.700 /end CHARACTERISTIC
/begin CHARACTERISTIC EGSDCmn_tS2EnaSensParl_C "minimum exhaust gas temperature at sensor 2 for parallelization" VALUE 0x8053E634 RB_Val_Wu16 1535.977 temp_q0p0234_o273 -273.150 1262.827 FORMAT "%8.3" /end CHARACTERISTIC
/begin CHARACTERISTIC EGSDCmn_tS2EnaSensTstParl_C "minimum exhaust gas temperature at sensor 2 for parallelization in short trip" VALUE 0x8053E636 RB_Val_Wu16 1535.977 temp_q0p0234_o273 -273.150 1262.827 FORMAT "%8.3" /end CHARACTERISTIC
/begin CHARACTERISTIC EGSDCmn_uCatEmptyGrdtParl_C "Minimum sensor voltage for detection of catalyst is empty of oxygen (based on sensor voltage gradient)" VALUE 0x8053E3FE RB_Val_Wu16 4.998779 spg_q1p221Em3_V 0.00 4.998779 FORMAT "%8.6" EXTENDED_LIMITS 0.00 79.99878 /end CHARACTERISTIC
/begin CHARACTERISTIC EGSDCmn_uCatEmptyGrdtPreCdnParl_C "voltage threshold for the catalyst is empty of oxygen during precondition" VALUE 0x8053E400 RB_Val_Wu16 4.998779 spg_q1p221Em3_V 0.00 4.998779 FORMAT "%8.6" EXTENDED_LIMITS 0.00 79.99878 /end CHARACTERISTIC
/begin CHARACTERISTIC EGSDCmn_uCatEmptyParl_C "Minimum voltage for detection of catalyst is empty of oxygen (based on sensor voltage)" VALUE 0x8053E402 RB_Val_Wu16 4.998779 spg_q1p221Em3_V 0.00 4.998779 FORMAT "%8.6" EXTENDED_LIMITS 0.00 79.99878 /end CHARACTERISTIC
/begin CHARACTERISTIC EGSDCmn_uCatFullGrdtParl_C "Maximum sensor voltage for detection of catalyst is filled with oxygen (based on sensor voltage gradient)" VALUE 0x8053E404 RB_Val_Wu16 4.998779 spg_q1p221Em3_V 0.00 4.998779 FORMAT "%8.6" EXTENDED_LIMITS 0.00 79.99878 /end CHARACTERISTIC
/begin CHARACTERISTIC EGSDCmn_uCatFullGrdtPreCdnParl_C "voltage threshold for the catalyst is full of oxygen" VALUE 0x8053E406 RB_Val_Wu16 4.998779 spg_q1p221Em3_V 0.00 4.998779 FORMAT "%8.6" EXTENDED_LIMITS 0.00 79.99878 /end CHARACTERISTIC
/begin CHARACTERISTIC EGSDCmn_uCatFullParl_C "Maximum sensor voltage for detection of catalyst is filled with oxygen (based on sensor voltage)" VALUE 0x8053E408 RB_Val_Wu16 4.998779 spg_q1p221Em3_V 0.00 4.998779 FORMAT "%8.6" EXTENDED_LIMITS 0.00 79.99878 /end CHARACTERISTIC
/begin CHARACTERISTIC EGSDCmn_uEnaLoEnghParl_C "maximum sensor voltage to enable a delay Lean to Rich check of downstream sensor" VALUE 0x8053E40A RB_Val_Wu16 4.998779 spg_q1p221Em3_V 0.00 4.998779 FORMAT "%8.6" EXTENDED_LIMITS 0.00 79.99878 /end CHARACTERISTIC
/begin CHARACTERISTIC EGSDCmn_uHiEnaParl_C "Rich Lambda threshold for the binary voltage of the parallelized sensors" VALUE 0x8053E40C RB_Val_Wu16 4.998779 spg_q1p221Em3_V 0.00 4.998779 FORMAT "%8.6" EXTENDED_LIMITS 0.00 79.99878 /end CHARACTERISTIC
/begin CHARACTERISTIC EGSDCmn_vVehSpdMinParl_C "minimal vehicle speed for parallelization" VALUE 0x8053E638 RB_Val_Ws16 655.3500 Vel -327.6800 327.6700 FORMAT "%8.4" /end CHARACTERISTIC
/begin MEASUREMENT EGSDCmn_CatCoolOffParlB1TONV_I.outbit "TurnOnDelay: catalyst is cooling down / return value" UBYTE B_TRUE 1 100 0.00 1.00000000000 BIT_MASK 0x1 FORMAT "%13.11" ECU_ADDRESS 0x60007322 /end MEASUREMENT
/begin MEASUREMENT EGSDCmn_CatCoolOffParlB1TONV_I.time "TurnOnDelay: catalyst is cooling down / expired delay time" UWORD t_q0p1 1 100 0.00 6553.500 FORMAT "%8.3" ECU_ADDRESS 0x60007324 /end MEASUREMENT
/begin MEASUREMENT EGSDCmn_CatWrmUpParlB1TONV_I.outbit "TurnOnDelay: catalyst is warming up / return value" UBYTE B_TRUE 1 100 0.00 1.00000000000 BIT_MASK 0x1 FORMAT "%13.11" ECU_ADDRESS 0x6000731E /end MEASUREMENT
/begin MEASUREMENT EGSDCmn_CatWrmUpParlB1TONV_I.time "TurnOnDelay: catalyst is warming up / expired delay time" UWORD t_q0p1 1 100 0.00 6553.500 FORMAT "%8.3" ECU_ADDRESS 0x60007320 /end MEASUREMENT
/begin MEASUREMENT EGSDCmn_cntrB1AbortParlLamMon "Abort counter of parallelization due to Lambda monitoring condition (since clearing of error memory)" UWORD dez 1 100 0.00 65535.00 FORMAT "%8.2" ECU_ADDRESS 0x60008CAC /end MEASUREMENT
/begin MEASUREMENT EGSDCmn_cntrB1AbortParlLamMonNV "Abort counter of parallelization due to Lambda monitoring condition (since clearing of error memory)" UWORD dez 1 100 0.00 65535.00 FORMAT "%8.2" ECU_ADDRESS 0x60039144 /end MEASUREMENT
/begin MEASUREMENT EGSDCmn_cntrB1AbortParlNEng "Abort counter of parallelization due to engine speed (since clearing of error memory)" UWORD dez 1 100 0.00 65535.00 FORMAT "%8.2" ECU_ADDRESS 0x60008CAA /end MEASUREMENT
/begin MEASUREMENT EGSDCmn_cntrB1AbortParlNEngNV "Abort counter of parallelization due to engine speed (since clearing of error memory)" UWORD dez 1 100 0.00 65535.00 FORMAT "%8.2" ECU_ADDRESS 0x60039142 /end MEASUREMENT
/begin MEASUREMENT EGSDCmn_cntrB1AbortParlNV "Abort counter of parallelization with exhaust gas relevant lambda shift (since clearing of error memory)" UWORD dez 1 100 0.00 65535.00 FORMAT "%8.2" ECU_ADDRESS 0x60039140 /end MEASUREMENT
/begin MEASUREMENT EGSDCmn_cntrB1AbortParlRelLd "Abort counter of parallelization due to relative load (since clearing of error memory)" UWORD dez 1 100 0.00 65535.00 FORMAT "%8.2" ECU_ADDRESS 0x60008CA8 /end MEASUREMENT
/begin MEASUREMENT EGSDCmn_cntrB1AbortParlRelLdNV "Abort counter of parallelization due to relative load (since clearing of error memory)" UWORD dez 1 100 0.00 65535.00 FORMAT "%8.2" ECU_ADDRESS 0x6003913E /end MEASUREMENT
/begin MEASUREMENT EGSDCmn_cntrB1AbortParlV "Abort counter of parallelization due to vehicle speed (since clearing of error memory)" UWORD dez 1 100 0.00 65535.00 FORMAT "%8.2" ECU_ADDRESS 0x60008CA6 /end MEASUREMENT
/begin MEASUREMENT EGSDCmn_cntrB1AbortParlVNV "Abort counter of parallelization due to vehicle speed (since clearing of error memory)" UWORD dez 1 100 0.00 65535.00 FORMAT "%8.2" ECU_ADDRESS 0x6003913C /end MEASUREMENT
/begin MEASUREMENT EGSDCmn_cntrB1AbortSumParl "Abort counter of parallelization with exhaust gas relevant lambda shift (since clearing of error memory)" UWORD dez 1 100 0.00 65535.00 FORMAT "%8.2" ECU_ADDRESS 0x60008CA4 /end MEASUREMENT
/begin MEASUREMENT EGSDCmn_cntrB1StrtParlNV "Counter for starts of parallelization with influence on emissions (since clearing of error memory)" UWORD dez 1 100 0.00 65535.00 FORMAT "%8.2" ECU_ADDRESS 0x6003913A /end MEASUREMENT
/begin MEASUREMENT EGSDCmn_cntrB1StrtSumParl "Counter for starts of parallelization with influence on emissions (since clearing of error memory)" UWORD dez 1 100 0.00 65535.00 FORMAT "%8.2" ECU_ADDRESS 0x60008CA2 /end MEASUREMENT
/begin MEASUREMENT EGSDCmn_cntrSeg1B1AbortParlHiRng "Abort counter of parallelization due to Exhaust gas mass flow or catalyst Temperature outside of High Range (since clearing of error memory)" UWORD dez 1 100 0.00 65535.00 FORMAT "%8.2" ECU_ADDRESS 0x60008CA0 /end MEASUREMENT
/begin MEASUREMENT EGSDCmn_cntrSeg1B1AbortParlHiRngNV "Abort counter of parallelization due to Exhaust gas mass flow or catalyst Temperature outside of High Range (since clearing of error memory)" UWORD dez 1 100 0.00 65535.00 FORMAT "%8.2" ECU_ADDRESS 0x60039138 /end MEASUREMENT
/begin MEASUREMENT EGSDCmn_cntrSeg1B1AbortParlLoRng "Abort counter of parallelization due to Exhaust gas mass flow or catalyst Temperature outside of Low Range (since clearing of error memory)" UWORD dez 1 100 0.00 65535.00 FORMAT "%8.2" ECU_ADDRESS 0x60008C9E /end MEASUREMENT
/begin MEASUREMENT EGSDCmn_cntrSeg1B1AbortParlLoRngNV "Abort counter of parallelization due to Exhaust gas mass flow or catalyst Temperature outside of Low Range (since clearing of error memory)" UWORD dez 1 100 0.00 65535.00 FORMAT "%8.2" ECU_ADDRESS 0x60039136 /end MEASUREMENT
/begin MEASUREMENT EGSDCmn_cntrSeg1B1AbortParlMFlowGrdt "Abort counter of parallelization due to Exhaust gas mass flow gradient (since clearing of error memory)" UWORD dez 1 100 0.00 65535.00 FORMAT "%8.2" ECU_ADDRESS 0x60008C9C /end MEASUREMENT
/begin MEASUREMENT EGSDCmn_cntrSeg1B1AbortParlMFlowGrdtNV "Abort counter of parallelization due to Exhaust gas mass flow gradient (since clearing of error memory)" UWORD dez 1 100 0.00 65535.00 FORMAT "%8.2" ECU_ADDRESS 0x60039134 /end MEASUREMENT
/begin MEASUREMENT EGSDCmn_cntrSeg1B1AbortParlTGrdt "Abort counter of parallelization due to Catalyst temperature gradient (since clearing of error memory)" UWORD dez 1 100 0.00 65535.00 FORMAT "%8.2" ECU_ADDRESS 0x60008C9A /end MEASUREMENT
/begin MEASUREMENT EGSDCmn_cntrSeg1B1AbortParlTGrdtNV "Abort counter of parallelization due to Catalyst temperature gradient (since clearing of error memory)" UWORD dez 1 100 0.00 65535.00 FORMAT "%8.2" ECU_ADDRESS 0x60039132 /end MEASUREMENT
/begin MEASUREMENT EGSDCmn_CpvEB_I.buffer "Rising or falling edge of canister purge / EdgeBi.buffer" UBYTE B_TRUE 1 100 0.00 1.00000000000 BIT_MASK 0x1 FORMAT "%13.11" ECU_ADDRESS 0x6000731C /end MEASUREMENT
/begin MEASUREMENT EGSDCmn_CpvEB_I.oldSignal "Rising or falling edge of canister purge / EdgeBi.odlSignal" UBYTE B_TRUE 1 100 0.00 1.00000000000 BIT_MASK 0x1 FORMAT "%13.11" ECU_ADDRESS 0x6000731D /end MEASUREMENT
/begin MEASUREMENT EGSDCmn_ctReIni100msCoorrParlEna "ReIni counter" UBYTE OneToOne 1 100 0.00 255.0 FORMAT "%5.1" ECU_ADDRESS 0x6000B210 /end MEASUREMENT
/begin MEASUREMENT EGSDCmn_ctReIni10msCoorrParlEna "ReIni counter" UBYTE OneToOne 1 100 0.00 255.0 FORMAT "%5.1" ECU_ADDRESS 0x6000B211 /end MEASUREMENT
/begin MEASUREMENT EGSDCmn_dmfEgCat1InpParlB1 "Change rate of exhaust gas mass flow input into catalyst 1, bank 1" SWORD m_sw_b3276p8 1 100 -3276.800 3276.700 FORMAT "%8.3" ECU_ADDRESS 0x60013E84 /end MEASUREMENT
/begin MEASUREMENT EGSDCmn_EnaAftIdleFcoFF_I.status "Flip FLop Instance indicating the Status of Engine in Idling and Fuel Cut off Condition for Parallelization / current value of RS-FF" UBYTE B_TRUE 1 100 0.00 1.00000000000 BIT_MASK 0x1 FORMAT "%13.11" ECU_ADDRESS 0x6000B20F /end MEASUREMENT
/begin MEASUREMENT EGSDCmn_EnaCatTGrdtParlB1LT_I.memory "filtered catalyst temperature for calculation of the temperature gradient, bank 1 / current lowpass value" ULONG temp_q3p57Em7_om273 1 100 -273.15000000 1262.84999964 FORMAT "%13.8" ECU_ADDRESS 0x60002D54 /end MEASUREMENT
/begin MEASUREMENT EGSDCmn_EomDmd_I.stOperMod "Engine operation mode request of the active exhaust gas sensor and catalyst diagnosis (parallelization) / Priority-element of the operation mode structure" ULONG OneToOne 1 100 0.00 4294967295.00 FORMAT "%13.2" ECU_ADDRESS 0x70003050 /end MEASUREMENT
/begin MEASUREMENT EGSDCmn_EomDmd_I.stOperModPrio "Engine operation mode request of the active exhaust gas sensor and catalyst diagnosis (parallelization) / Stage-element of the operation mode structure" UBYTE OneToOne 1 100 0.00 255.0 FORMAT "%5.1" ECU_ADDRESS 0x70003054 /end MEASUREMENT
/begin MEASUREMENT EGSDCmn_EomDmd_I.stOperModStg "Engine operation mode request of the active exhaust gas sensor and catalyst diagnosis (parallelization) / Operation-mode element of the operation mode structure" UWORD OneToOne 1 100 0.00 65535.00 FORMAT "%8.2" ECU_ADDRESS 0x70003056 /end MEASUREMENT
/begin MEASUREMENT EGSDCmn_facLamActMonParlB1IK_I.memory "Debouncing for actual mixture deviations, bank 1 / current integrator value" ULONG fak_q2p3283Em10 1 100 0.00 0.999999999767 FORMAT "%14.12" ECU_ADDRESS 0x60012580 /end MEASUREMENT
/begin MEASUREMENT EGSDCmn_facLamCtrlVParlB1 "Controller factor during active parallelization" UBYTE fak_ub_b2 1 100 0.00 1.992188 FORMAT "%8.6" ECU_ADDRESS 0x6000EFB5 /end MEASUREMENT
/begin MEASUREMENT EGSDCmn_facLamCtrlVParlB1LT_I.memory "factor filtering / current lowpass value" UWORD fak_uw_b2 1 100 0.00 1.999969 FORMAT "%8.6" ECU_ADDRESS 0x6000732C /end MEASUREMENT
/begin MEASUREMENT EGSDCmn_flgActvHiRngSeg1B1 "Exhaust gas mass flow and catalyst temperature have been in high enabling range once" UBYTE B_TRUE 1 100 0.00 1.00000000000 BIT_MASK 0x1 FORMAT "%13.11" ECU_ADDRESS 0x70000A51 /end MEASUREMENT
/begin MEASUREMENT EGSDCmn_flgActvLoRngSeg1B1 "Exhaust gas mass flow and catalyst temperature have been in low enabling range once" UBYTE B_TRUE 1 100 0.00 1.00000000000 BIT_MASK 0x1 FORMAT "%13.11" ECU_ADDRESS 0x70000A50 /end MEASUREMENT
/begin MEASUREMENT EGSDCmn_flgB1AbortParlEF_I.buffer "- / memory to detect falling edge" UBYTE B_TRUE 1 100 0.00 1.00000000000 BIT_MASK 0x1 FORMAT "%13.11" ECU_ADDRESS 0x6000730E /end MEASUREMENT
/begin MEASUREMENT EGSDCmn_flgB1AbortParlEF_I.oldSignal "- / memory to detect falling edge" UBYTE B_TRUE 1 100 0.00 1.00000000000 BIT_MASK 0x1 FORMAT "%13.11" ECU_ADDRESS 0x6000730F /end MEASUREMENT
/begin MEASUREMENT EGSDCmn_flgB1EgInflParlFF_I.status "- / current value of RS-FF" UBYTE B_TRUE 1 100 0.00 1.00000000000 BIT_MASK 0x1 FORMAT "%13.11" ECU_ADDRESS 0x6000B208 /end MEASUREMENT
/begin MEASUREMENT EGSDCmn_flgB1ShtrpSyncEnaParl "Bank 1 enabled for lambda synchronization during short trip" UBYTE B_TRUE 1 100 0.00 1.00000000000 BIT_MASK 0x1 FORMAT "%13.11" ECU_ADDRESS 0x70000331 /end MEASUREMENT
/begin MEASUREMENT EGSDCmn_flgB1StartParlER_I.buffer "- / rising edge detected" UBYTE B_TRUE 1 100 0.00 1.00000000000 BIT_MASK 0x1 FORMAT "%13.11" ECU_ADDRESS 0x6000730C /end MEASUREMENT
/begin MEASUREMENT EGSDCmn_flgB1StartParlER_I.oldSignal "- / flag rising edge" UBYTE B_TRUE 1 100 0.00 1.00000000000 BIT_MASK 0x1 FORMAT "%13.11" ECU_ADDRESS 0x6000730D /end MEASUREMENT
/begin MEASUREMENT EGSDCmn_flgCat1B1EnaTHomParl "Catalyst is homogeneously heated for execution of parallel exhaust gas components diagnosis" UBYTE B_TRUE 1 100 0.00 1.00000000000 BIT_MASK 0x1 FORMAT "%13.11" ECU_ADDRESS 0x70000330 /end MEASUREMENT
/begin MEASUREMENT EGSDCmn_flgCat1B1EnaTMinParl "catalyst is not cooled off" UBYTE B_TRUE 1 100 0.00 1.00000000000 BIT_MASK 0x1 FORMAT "%13.11" ECU_ADDRESS 0x7000032F /end MEASUREMENT
/begin MEASUREMENT EGSDCmn_flgCat1B1EnaTParl "temperature gradient of cataylst is stable, bank 1" UBYTE B_TRUE 1 100 0.00 1.00000000000 BIT_MASK 0x1 FORMAT "%13.11" ECU_ADDRESS 0x70000A4A /end MEASUREMENT
/begin MEASUREMENT EGSDCmn_flgCat1B1EnaTRngHiParl "catalyst temperature is within the high range release zone, catalyst 1, bank 1" UBYTE B_TRUE 1 100 0.00 1.00000000000 BIT_MASK 0x1 FORMAT "%13.11" ECU_ADDRESS 0x70000A49 /end MEASUREMENT
/begin MEASUREMENT EGSDCmn_flgCat1B1EnaTRngLoParl "catalyst temperature is within the low range release zone, catalyst 1, bank 1" UBYTE B_TRUE 1 100 0.00 1.00000000000 BIT_MASK 0x1 FORMAT "%13.11" ECU_ADDRESS 0x70000A48 /end MEASUREMENT
/begin MEASUREMENT EGSDCmn_flgCatWarmAftIdleER_I.buffer "Trigger for keep catalyst warm / rising edge detected" UBYTE B_TRUE 1 100 0.00 1.00000000000 BIT_MASK 0x1 FORMAT "%13.11" ECU_ADDRESS 0x6000730A /end MEASUREMENT
/begin MEASUREMENT EGSDCmn_flgCatWarmAftIdleER_I.oldSignal "Trigger for keep catalyst warm / flag rising edge" UBYTE B_TRUE 1 100 0.00 1.00000000000 BIT_MASK 0x1 FORMAT "%13.11" ECU_ADDRESS 0x6000730B /end MEASUREMENT
/begin MEASUREMENT EGSDCmn_flgCatWarmAftIdleFco "Flag Indicating the Warm Catalyst Behaviour after the idling or Fuel Cut off condition." UBYTE B_TRUE 1 100 0.00 1.00000000000 BIT_MASK 0x1 FORMAT "%13.11" ECU_ADDRESS 0x7000032E /end MEASUREMENT
/begin MEASUREMENT EGSDCmn_flgCOEOMPsblParlB1 "customer specific operation mode request is possible, bank 1" UBYTE B_TRUE 1 100 0.00 1.00000000000 BIT_MASK 0x1 FORMAT "%13.11" ECU_ADDRESS 0x70000A4C /end MEASUREMENT
/begin MEASUREMENT EGSDCmn_flgCOEOMRelsParlB1 "customer specific operation mode request is released, bank 1" UBYTE B_TRUE 1 100 0.00 1.00000000000 BIT_MASK 0x1 FORMAT "%13.11" ECU_ADDRESS 0x70000A4B /end MEASUREMENT
/begin MEASUREMENT EGSDCmn_flgDSMClrParlEnaB1 "DSMClear is requested, bank 1" UBYTE B_TRUE 1 100 0.00 1.00000000000 BIT_MASK 0x1 FORMAT "%13.11" ECU_ADDRESS 0x70000A40 /end MEASUREMENT
/begin MEASUREMENT EGSDCmn_flgDynStepLtrB1ER_I.buffer "Step in lean-rich direction detected / rising edge detected" UBYTE B_TRUE 1 100 0.00 1.00000000000 BIT_MASK 0x1 FORMAT "%13.11" ECU_ADDRESS 0x6000732A /end MEASUREMENT
/begin MEASUREMENT EGSDCmn_flgDynStepLtrB1ER_I.oldSignal "Step in lean-rich direction detected / flag rising edge" UBYTE B_TRUE 1 100 0.00 1.00000000000 BIT_MASK 0x1 FORMAT "%13.11" ECU_ADDRESS 0x6000732B /end MEASUREMENT
/begin MEASUREMENT EGSDCmn_flgDynStepRtlB1ER_I.buffer "Step in rich-lean direction detected / rising edge detected" UBYTE B_TRUE 1 100 0.00 1.00000000000 BIT_MASK 0x1 FORMAT "%13.11" ECU_ADDRESS 0x60007328 /end MEASUREMENT
/begin MEASUREMENT EGSDCmn_flgDynStepRtlB1ER_I.oldSignal "Step in rich-lean direction detected / flag rising edge" UBYTE B_TRUE 1 100 0.00 1.00000000000 BIT_MASK 0x1 FORMAT "%13.11" ECU_ADDRESS 0x60007329 /end MEASUREMENT
/begin MEASUREMENT EGSDCmn_flgEnaEnvCndParl "The enviroment conditions (air pressure, temperature) for the parallelized diagnoses" UBYTE B_TRUE 1 100 0.00 1.00000000000 BIT_MASK 0x1 FORMAT "%13.11" ECU_ADDRESS 0x7000032D /end MEASUREMENT
/begin MEASUREMENT EGSDCmn_flgEnaEthParl "only relevant for FlexFuel-System: release condition of diagnosis regarding ethanol and ethanol sensor" UBYTE B_TRUE 1 100 0.00 1.00000000000 BIT_MASK 0x1 FORMAT "%13.11" ECU_ADDRESS 0x70000A3F /end MEASUREMENT
/begin MEASUREMENT EGSDCmn_flgEnaFuMixAdpnParl "fuel mixture criteria satisfied" UBYTE B_TRUE 1 100 0.00 1.00000000000 BIT_MASK 0x1 FORMAT "%13.11" ECU_ADDRESS 0x7000032C /end MEASUREMENT
/begin MEASUREMENT EGSDCmn_flgEnaGearShiftParl "gear criteria satisfied" UBYTE B_TRUE 1 100 0.00 1.00000000000 BIT_MASK 0x1 FORMAT "%13.11" ECU_ADDRESS 0x7000032B /end MEASUREMENT
/begin MEASUREMENT EGSDCmn_flgEnaGlbParl "Condition: Global enable conditions for parallielzation fulfilled" UBYTE B_TRUE 1 100 0.00 1.00000000000 BIT_MASK 0x1 FORMAT "%13.11" ECU_ADDRESS 0x7000032A /end MEASUREMENT
/begin MEASUREMENT EGSDCmn_flgEnaGlbPrtlParl "Project independent general enable conditions for the parallelized diagnoses" UBYTE B_TRUE 1 100 0.00 1.00000000000 BIT_MASK 0x1 FORMAT "%13.11" ECU_ADDRESS 0x70000329 /end MEASUREMENT
/begin MEASUREMENT EGSDCmn_flgEnaHiRngSeg1B1 "Enabling condition Exhaust gas mass flow and Catalyst temperature in high range" UBYTE B_TRUE 1 100 0.00 1.00000000000 BIT_MASK 0x1 FORMAT "%13.11" ECU_ADDRESS 0x70000A3E /end MEASUREMENT
/begin MEASUREMENT EGSDCmn_flgEnaLoRngSeg1B1 "Enabling condition Exhaust gas mass flow and Catalyst temperature in low range" UBYTE B_TRUE 1 100 0.00 1.00000000000 BIT_MASK 0x1 FORMAT "%13.11" ECU_ADDRESS 0x70000A3D /end MEASUREMENT
/begin MEASUREMENT EGSDCmn_flgEnaMsTParlB1 "Bank 1 indication flag represents the desired Mass flow and Temperature conditions for Physical release for parallisation." UBYTE B_TRUE 1 100 0.00 1.00000000000 BIT_MASK 0x1 FORMAT "%13.11" ECU_ADDRESS 0x70000328 /end MEASUREMENT
/begin MEASUREMENT EGSDCmn_flgEnaRelLoadParl "Enable condition of the relative air mass for parallelized diagnoses" UBYTE B_TRUE 1 100 0.00 1.00000000000 BIT_MASK 0x1 FORMAT "%13.11" ECU_ADDRESS 0x70000A3C /end MEASUREMENT
/begin MEASUREMENT EGSDCmn_flgEnaVehVParl "Condition: vehicle speed criiterion fulfilled" UBYTE B_TRUE 1 100 0.00 1.00000000000 BIT_MASK 0x1 FORMAT "%13.11" ECU_ADDRESS 0x70000A3B /end MEASUREMENT
/begin MEASUREMENT EGSDCmn_flgEnvtlDiPID41Parl "Condition: Parallelization inhibited by environmental conditions. PID41 Disabled" UBYTE B_TRUE 1 100 0.00 1.00000000000 BIT_MASK 0x1 FORMAT "%13.11" ECU_ADDRESS 0x70000A3A /end MEASUREMENT
/begin MEASUREMENT EGSDCmn_flgFpcAdpdParl "Fuel purge adaption is sufficient for parallelization" UBYTE B_TRUE 1 100 0.00 1.00000000000 BIT_MASK 0x1 FORMAT "%13.11" ECU_ADDRESS 0x70000327 /end MEASUREMENT
/begin MEASUREMENT EGSDCmn_flgFpcDynDebParl "The activation or deactivation of the fuel purge control is debounced for the release of the parallelization" UBYTE B_TRUE 1 100 0.00 1.00000000000 BIT_MASK 0x1 FORMAT "%13.11" ECU_ADDRESS 0x70000326 /end MEASUREMENT
/begin MEASUREMENT EGSDCmn_flgFpcOKParl "relative fuel portion from canister purge for parallelization is within the high range of release zone" UBYTE B_TRUE 1 100 0.00 1.00000000000 BIT_MASK 0x1 FORMAT "%13.11" ECU_ADDRESS 0x70000325 /end MEASUREMENT
/begin MEASUREMENT EGSDCmn_flgGearShiftParlTONV_I.outbit "TurnOnDelay: Activation inhibiting parallelization by gear-shift / return value" UBYTE B_TRUE 1 100 0.00 1.00000000000 BIT_MASK 0x1 FORMAT "%13.11" ECU_ADDRESS 0x60007308 /end MEASUREMENT
/begin MEASUREMENT EGSDCmn_flgGearShiftParlTONV_I.time "TurnOnDelay: Activation inhibiting parallelization by gear-shift / expired delay time" UBYTE t_q0p1 1 100 0.00 25.50 FORMAT "%5.2" ECU_ADDRESS 0x60007309 /end MEASUREMENT
/begin MEASUREMENT EGSDCmn_flgInhbRdyParlB1 "Inhibition of the parallelized diagnoses" UBYTE B_TRUE 1 100 0.00 1.00000000000 BIT_MASK 0x1 FORMAT "%13.11" ECU_ADDRESS 0x70000324 /end MEASUREMENT
/begin MEASUREMENT EGSDCmn_flgInjVlvEnaParlB1 "Release condition for the parallelization with injection valve deactivation" UBYTE B_TRUE 1 100 0.00 1.00000000000 BIT_MASK 0x1 FORMAT "%13.11" ECU_ADDRESS 0x70000323 /end MEASUREMENT
/begin MEASUREMENT EGSDCmn_flgLamActvParlB1ER_I.buffer "Lambda request is active / rising edge detected" UBYTE B_TRUE 1 100 0.00 1.00000000000 BIT_MASK 0x1 FORMAT "%13.11" ECU_ADDRESS 0x60007306 /end MEASUREMENT
/begin MEASUREMENT EGSDCmn_flgLamActvParlB1ER_I.oldSignal "Lambda request is active / flag rising edge" UBYTE B_TRUE 1 100 0.00 1.00000000000 BIT_MASK 0x1 FORMAT "%13.11" ECU_ADDRESS 0x60007307 /end MEASUREMENT
/begin MEASUREMENT EGSDCmn_flgLamMonOkParlB1 "lambda monitoring criterion, if lamba actual value follows the lambda set value, is fulfilled, bank 1" UBYTE B_TRUE 1 100 0.00 1.00000000000 BIT_MASK 0x1 FORMAT "%13.11" ECU_ADDRESS 0x70000A36 /end MEASUREMENT
/begin MEASUREMENT EGSDCmn_flgLamMonSuppParlB1 "Condition: Suppress abortions by Lambda-Monitoring bank 1" UBYTE B_TRUE 1 100 0.00 1.00000000000 BIT_MASK 0x1 FORMAT "%13.11" ECU_ADDRESS 0x70000A35 /end MEASUREMENT
/begin MEASUREMENT EGSDCmn_flgLamPriEnaParlB1 "Lambda set point before starting the parallelization stable for enough time" UBYTE B_TRUE 1 100 0.00 1.00000000000 BIT_MASK 0x1 FORMAT "%13.11" ECU_ADDRESS 0x70000A34 /end MEASUREMENT
/begin MEASUREMENT EGSDCmn_flgLamReldParlB1 "Lambda condition released" UBYTE B_TRUE 1 100 0.00 1.00000000000 BIT_MASK 0x1 FORMAT "%13.11" ECU_ADDRESS 0x70000A33 /end MEASUREMENT
/begin MEASUREMENT EGSDCmn_flgMfEgEnaRampParl "Release mass flow criterion for lambda ramp" UBYTE B_TRUE 1 100 0.00 1.00000000000 BIT_MASK 0x1 FORMAT "%13.11" ECU_ADDRESS 0x70000322 /end MEASUREMENT
/begin MEASUREMENT EGSDCmn_flgmPurgCtrlOkParl "Mass of purge control fuel portion is below threshold" UBYTE B_TRUE 1 100 0.00 1.00000000000 BIT_MASK 0x1 FORMAT "%13.11" ECU_ADDRESS 0x70000321 /end MEASUREMENT
/begin MEASUREMENT EGSDCmn_flgNarrowRngSeg1B1 "Apply narrowed release range (e.g. for engine speed, exhaust gas mass flow,...)" UBYTE B_TRUE 1 100 0.00 1.00000000000 BIT_MASK 0x1 FORMAT "%13.11" ECU_ADDRESS 0x70000320 /end MEASUREMENT
/begin MEASUREMENT EGSDCmn_flgNEngInRngParl "Engine speed is in allowed range for parallelization" UBYTE B_TRUE 1 100 0.00 1.00000000000 BIT_MASK 0x1 FORMAT "%13.11" ECU_ADDRESS 0x70000A31 /end MEASUREMENT
/begin MEASUREMENT EGSDCmn_flgOperModDmdActv "Requested operation mode active" UBYTE B_TRUE 1 100 0.00 1.00000000000 BIT_MASK 0x1 FORMAT "%13.11" ECU_ADDRESS 0x70000332 /end MEASUREMENT
/begin MEASUREMENT EGSDCmn_flgOperPntActvParl "parallelization is by current operation point active" UBYTE B_TRUE 1 100 0.00 1.00000000000 BIT_MASK 0x1 FORMAT "%13.11" ECU_ADDRESS 0x70000A30 /end MEASUREMENT
/begin MEASUREMENT EGSDCmn_flgRdyB1Parl "parallelization is ready to run, request for permissions from Diagnostic System Manager (DSM)" UBYTE B_TRUE 1 100 0.00 1.00000000000 BIT_MASK 0x1 FORMAT "%13.11" ECU_ADDRESS 0x70000A2E /end MEASUREMENT
/begin MEASUREMENT EGSDCmn_flgReqEomParl "engine operation mode request active" UBYTE B_TRUE 1 100 0.00 1.00000000000 BIT_MASK 0x1 FORMAT "%13.11" ECU_ADDRESS 0x70000A2D /end MEASUREMENT
/begin MEASUREMENT EGSDCmn_flgS1B1OffsDneParl "Offset checked for Parallelization release" UBYTE B_TRUE 1 100 0.00 1.00000000000 BIT_MASK 0x1 FORMAT "%13.11" ECU_ADDRESS 0x70000A2A /end MEASUREMENT
/begin MEASUREMENT EGSDCmn_flgSeg1B1ActvRqrdParl "Status, if measurements for parallelized exhaust gas components diagnosis are required" UBYTE B_TRUE 1 100 0.00 1.00000000000 BIT_MASK 0x1 FORMAT "%13.11" ECU_ADDRESS 0x70000A1D /end MEASUREMENT
/begin MEASUREMENT EGSDCmn_flgSeg1B1EnaEgParl "the integrated exhaust gas mass flow or heating quantity since engine start is over a threshold" UBYTE B_TRUE 1 100 0.00 1.00000000000 BIT_MASK 0x1 FORMAT "%13.11" ECU_ADDRESS 0x70000A1C /end MEASUREMENT
/begin MEASUREMENT EGSDCmn_flgSeg1B1EnaHeatUp "Lambda sensors for parallization are heated up" UBYTE B_TRUE 1 100 0.00 1.00000000000 BIT_MASK 0x1 FORMAT "%13.11" ECU_ADDRESS 0x7000031F /end MEASUREMENT
/begin MEASUREMENT EGSDCmn_flgSeg1B1EnaMfGrdtTONV_I.outbit "Enable condition of parallelized diagnosises: exhaust gas mass flow gradient / return value" UBYTE B_TRUE 1 100 0.00 1.00000000000 BIT_MASK 0x1 FORMAT "%13.11" ECU_ADDRESS 0x60007304 /end MEASUREMENT
/begin MEASUREMENT EGSDCmn_flgSeg1B1EnaMfGrdtTONV_I.time "Enable condition of parallelized diagnosises: exhaust gas mass flow gradient / expired delay time" UBYTE t_q0p1 1 100 0.00 25.50 FORMAT "%5.2" ECU_ADDRESS 0x60007305 /end MEASUREMENT
/begin MEASUREMENT EGSDCmn_flgSeg1B1EnaMfRngHiParl "Exhaust gas mass flow is within the high range release zone, catalyst 1, bank 1" UBYTE B_TRUE 1 100 0.00 1.00000000000 BIT_MASK 0x1 FORMAT "%13.11" ECU_ADDRESS 0x7000031E /end MEASUREMENT
/begin MEASUREMENT EGSDCmn_flgSeg1B1EnaMfRngLoParl "Exhaust gas mass flow is within the low range zone, catalyst 1, bank 1" UBYTE B_TRUE 1 100 0.00 1.00000000000 BIT_MASK 0x1 FORMAT "%13.11" ECU_ADDRESS 0x7000031D /end MEASUREMENT
/begin MEASUREMENT EGSDCmn_flgSeg1B1EnaParl "Enabling conditions for parallelization are fulfilled" UBYTE B_TRUE 1 100 0.00 1.00000000000 BIT_MASK 0x1 FORMAT "%13.11" ECU_ADDRESS 0x70000A1B /end MEASUREMENT
/begin MEASUREMENT EGSDCmn_flgSeg1B1EnaVldParl "Sensor is ready to operate, mass flow debounced, segment 1, bank 1" UBYTE B_TRUE 1 100 0.00 1.00000000000 BIT_MASK 0x1 FORMAT "%13.11" ECU_ADDRESS 0x70000A1A /end MEASUREMENT
/begin MEASUREMENT EGSDCmn_flgSeg1B1MeasRqrdParl "Status of required measurements for parallelization, segment 1, bank 1" UBYTE B_TRUE 1 100 0.00 1.00000000000 BIT_MASK 0x1 FORMAT "%13.11" ECU_ADDRESS 0x70000A19 /end MEASUREMENT
/begin MEASUREMENT EGSDCmn_flgSeg1B1PhyEnaParl "physical release condition for parallelization are fulfilled" UBYTE B_TRUE 1 100 0.00 1.00000000000 BIT_MASK 0x1 FORMAT "%13.11" ECU_ADDRESS 0x70000A18 /end MEASUREMENT
/begin MEASUREMENT EGSDCmn_flgSeg1B1QPFaildParl "Quickpass is failed based on current measurements in parallelization, segment 1, bank 1" UBYTE B_TRUE 1 100 0.00 1.00000000000 BIT_MASK 0x1 FORMAT "%13.11" ECU_ADDRESS 0x70000A17 /end MEASUREMENT
/begin MEASUREMENT EGSDCmn_flgSeg1B1RampEnaParl "physical release condition for lambda ramp are fulfilled" UBYTE B_TRUE 1 100 0.00 1.00000000000 BIT_MASK 0x1 FORMAT "%13.11" ECU_ADDRESS 0x70000A16 /end MEASUREMENT
/begin MEASUREMENT EGSDCmn_flgSeg1B1RdyParl "parallelization is ready to run, request for permissions from Diagnostic System Manager (DSM), segment 1, bank 1" UBYTE B_TRUE 1 100 0.00 1.00000000000 BIT_MASK 0x1 FORMAT "%13.11" ECU_ADDRESS 0x70000A15 /end MEASUREMENT
/begin MEASUREMENT EGSDCmn_flgSeg1B1ReldFinalParl "flag indicating the diagnosis activeness, sensor 1, bank1." UBYTE B_TRUE 1 100 0.00 1.00000000000 BIT_MASK 0x1 FORMAT "%13.11" ECU_ADDRESS 0x70000A14 /end MEASUREMENT
/begin MEASUREMENT EGSDCmn_flgSeg1B1ReldParl "parallelization is released by Diagnostic System Manager (DSM), segment 1, bank 1" UBYTE B_TRUE 1 100 0.00 1.00000000000 BIT_MASK 0x1 FORMAT "%13.11" ECU_ADDRESS 0x70000A13 /end MEASUREMENT
/begin MEASUREMENT EGSDCmn_flgSeg1B1VirtActvRqrdParl "Status, if measurements for virtual parallelized exhaust gas components diagnosis are required" UBYTE B_TRUE 1 100 0.00 1.00000000000 BIT_MASK 0x1 FORMAT "%13.11" ECU_ADDRESS 0x70000A12 /end MEASUREMENT
/begin MEASUREMENT EGSDCmn_flgSeg1B1VirtEnaParl "Enabling conditions for virtual diagnosis" UBYTE B_TRUE 1 100 0.00 1.00000000000 BIT_MASK 0x1 FORMAT "%13.11" ECU_ADDRESS 0x7000031C /end MEASUREMENT
/begin MEASUREMENT EGSDCmn_flgSeg1B1VirtMeasRqrdParl "Status of required virtual measurements for parallelization, segment 1, bank 1" UBYTE B_TRUE 1 100 0.00 1.00000000000 BIT_MASK 0x1 FORMAT "%13.11" ECU_ADDRESS 0x70000A11 /end MEASUREMENT
/begin MEASUREMENT EGSDCmn_flgSeg1B1VirtReldFinalParl "parallelization is released for virtual simulation including release from Diagnostic System Manager (DSM), segment 1, bank 1" UBYTE B_TRUE 1 100 0.00 1.00000000000 BIT_MASK 0x1 FORMAT "%13.11" ECU_ADDRESS 0x70000A10 /end MEASUREMENT
/begin MEASUREMENT EGSDCmn_flgSeg1B1VirtReldParl "parallelization is released for IUMPR simulation, segment 1, bank 1" UBYTE B_TRUE 1 100 0.00 1.00000000000 BIT_MASK 0x1 FORMAT "%13.11" ECU_ADDRESS 0x70000A0F /end MEASUREMENT
/begin MEASUREMENT EGSDCmn_flgStrtEndParlB1 "engine start is ended for catalyst cooling down detection" UBYTE B_TRUE 1 100 0.00 1.00000000000 BIT_MASK 0x1 FORMAT "%13.11" ECU_ADDRESS 0x7000031B /end MEASUREMENT
/begin MEASUREMENT EGSDCmn_flgTarLeanSuspcParlB1 "Target Lean error suspicion, request lean ramp, bank 1" UBYTE B_TRUE 1 100 0.00 1.00000000000 BIT_MASK 0x1 FORMAT "%13.11" ECU_ADDRESS 0x70000A0D /end MEASUREMENT
/begin MEASUREMENT EGSDCmn_flgTarRichSuspcParlB1 "Target Rich error suspicion, request rich ramp, bank 1" UBYTE B_TRUE 1 100 0.00 1.00000000000 BIT_MASK 0x1 FORMAT "%13.11" ECU_ADDRESS 0x70000A0C /end MEASUREMENT
/begin MEASUREMENT EGSDCmn_flgTarSuspcB1 "Target error suspicion" UBYTE B_TRUE 1 100 0.00 1.00000000000 BIT_MASK 0x1 FORMAT "%13.11" ECU_ADDRESS 0x70000A0B /end MEASUREMENT
/begin MEASUREMENT EGSDCmn_flgTarSuspcVirtParlB1 "Virtual Target error suspicion" UBYTE B_TRUE 1 100 0.00 1.00000000000 BIT_MASK 0x1 FORMAT "%13.11" ECU_ADDRESS 0x70000A0A /end MEASUREMENT
/begin MEASUREMENT EGSDCmn_flgTiIdleExcdd "Allowed time of engine in idle or fuel cut off reached" UBYTE B_TRUE 1 100 0.00 1.00000000000 BIT_MASK 0x1 FORMAT "%13.11" ECU_ADDRESS 0x7000031A /end MEASUREMENT
/begin MEASUREMENT EGSDCmn_flgVirtCOEOMRelsParlB1 "Virtual customer specific operation mode request is released, bank 1" UBYTE B_TRUE 1 100 0.00 1.00000000000 BIT_MASK 0x1 FORMAT "%13.11" ECU_ADDRESS 0x70000A09 /end MEASUREMENT
/begin MEASUREMENT EGSDCmn_flgVirtRdyB1Parl "Virtual enable conditions ready" UBYTE B_TRUE 1 100 0.00 1.00000000000 BIT_MASK 0x1 FORMAT "%13.11" ECU_ADDRESS 0x70000319 /end MEASUREMENT
/begin MEASUREMENT EGSDCmn_flgVirtReqEomParl "Request of the virtual engine operation mode" UBYTE B_TRUE 1 100 0.00 1.00000000000 BIT_MASK 0x1 FORMAT "%13.11" ECU_ADDRESS 0x70000A08 /end MEASUREMENT
/begin MEASUREMENT EGSDCmn_flgVlvLftActvParlB1 "Flag which indicates the actual and requested valve lift status are same for Bank 1." UBYTE B_TRUE 1 100 0.00 1.00000000000 BIT_MASK 0x1 FORMAT "%13.11" ECU_ADDRESS 0x70000A07 /end MEASUREMENT
/begin MEASUREMENT EGSDCmn_InjVlvDisblParlB1TONV_I.outbit "Injection valve deactivation condition active / return value" UBYTE B_TRUE 1 100 0.00 1.00000000000 BIT_MASK 0x1 FORMAT "%13.11" ECU_ADDRESS 0x60007318 /end MEASUREMENT
/begin MEASUREMENT EGSDCmn_InjVlvDisblParlB1TONV_I.time "Injection valve deactivation condition active / expired delay time" UWORD t_q0p01 1 100 0.00 655.3500 FORMAT "%8.4" ECU_ADDRESS 0x6000731A /end MEASUREMENT
/begin MEASUREMENT EGSDCmn_InjVlvEnaParlB1TOFFV_I.outbit "Injection valve deactivation condition inactive / Output Bit" UBYTE B_TRUE 1 100 0.00 1.00000000000 BIT_MASK 0x1 FORMAT "%13.11" ECU_ADDRESS 0x60007314 /end MEASUREMENT
/begin MEASUREMENT EGSDCmn_InjVlvEnaParlB1TOFFV_I.time "Injection valve deactivation condition inactive / Occured Time" UWORD t_q0p01 1 100 0.00 655.3500 FORMAT "%8.4" ECU_ADDRESS 0x60007316 /end MEASUREMENT
/begin MEASUREMENT EGSDCmn_InjVlvParlB1FF_I.status "Injection valve deactivation condition released / current value of RS-FF" UBYTE B_TRUE 1 100 0.00 1.00000000000 BIT_MASK 0x1 FORMAT "%13.11" ECU_ADDRESS 0x600140A9 /end MEASUREMENT
/begin MEASUREMENT EGSDCmn_LamDynActvParlB1FF_I.status "Dynamic diagnoses active / current value of RS-FF" UBYTE B_TRUE 1 100 0.00 1.00000000000 BIT_MASK 0x1 FORMAT "%13.11" ECU_ADDRESS 0x6000B212 /end MEASUREMENT
/begin MEASUREMENT EGSDCmn_LamMonOKB1EF_I.buffer "Edge Falling: Lambda monitoring fulfilled bank 1 / memory to detect falling edge" UBYTE B_TRUE 1 100 0.00 1.00000000000 BIT_MASK 0x1 FORMAT "%13.11" ECU_ADDRESS 0x60007312 /end MEASUREMENT
/begin MEASUREMENT EGSDCmn_LamMonOKB1EF_I.oldSignal "Edge Falling: Lambda monitoring fulfilled bank 1 / memory to detect falling edge" UBYTE B_TRUE 1 100 0.00 1.00000000000 BIT_MASK 0x1 FORMAT "%13.11" ECU_ADDRESS 0x60007313 /end MEASUREMENT
/begin MEASUREMENT EGSDCmn_LamMonOKEFParlB1CTR_I.counter "Counter abortions by Lambda-Monitoring bank 1 / current counter value" UBYTE dez 1 100 0.00 255.0 FORMAT "%5.1" ECU_ADDRESS 0x6000B20E /end MEASUREMENT
/begin MEASUREMENT EGSDCmn_LamReqOKB1TONV_I.outbit "Turn on Delay, lambda request is in lambda released, bank 1 / return value" UBYTE B_TRUE 1 100 0.00 1.00000000000 BIT_MASK 0x1 FORMAT "%13.11" ECU_ADDRESS 0x60007310 /end MEASUREMENT
/begin MEASUREMENT EGSDCmn_LamReqOKB1TONV_I.time "Turn on Delay, lambda request is in lambda released, bank 1 / expired delay time" UBYTE t_q0p01 1 100 0.00 2.550 FORMAT "%5.3" ECU_ADDRESS 0x60007311 /end MEASUREMENT
/begin MEASUREMENT EGSDCmn_mEgCatWarmAftIdleFcoIK_I.memory "Mass Flow Integrator Instance indicating the Debouncing time for Warm Catalyst ( after fuel cut off and idling Condition) based on Vehicle Speed Environment Temperature / current integrator value" ULONG m_q1p5259Em8_kg 1 100 0.00 65.5359999847 FORMAT "%13.10" ECU_ADDRESS 0x60002D50 /end MEASUREMENT
/begin MEASUREMENT EGSDCmn_mEgEnaFpcParlIK_I.memory "Exhaust gas mass to debounce after opening or closing canister purge valve / current integrator value" ULONG m_q1p5259Em8_kg 1 100 0.00 65.5359999847 FORMAT "%13.10" ECU_ADDRESS 0x60002D4C /end MEASUREMENT
/begin MEASUREMENT EGSDCmn_mEgEnaOpDecelParlB1IK_I.memory "amount of exhaust gas mass flow since the operation point and catalyst temperature are in the release window, bank 1 / current integrator value" ULONG m_q1p5259Em8_kg 1 100 0.00 65.5359999847 FORMAT "%13.10" ECU_ADDRESS 0x60002D48 /end MEASUREMENT
/begin MEASUREMENT EGSDCmn_mEgSeg1EnaParlB1IK_I.memory "integrated exhaust gas mass flow to release of parallelization of segment 1, bank 1 / current integrator value" ULONG m_q1p5259Em8_kg 1 100 0.00 65.5359999847 FORMAT "%13.10" ECU_ADDRESS 0x60002D44 /end MEASUREMENT
/begin MEASUREMENT EGSDCmn_mfEgFilCat1ParlB1LT_I.memory "Low Pass filter for exhaust gas mass flow, used for gradient calculation / current lowpass value" ULONG m_q1p526Em6_g 1 100 0.00 6553.59999847 FORMAT "%13.8" ECU_ADDRESS 0x5000168C /end MEASUREMENT
/begin MEASUREMENT EGSDCmn_mfUnderRngLoMinParlDetB1SW_I.timeCounter "Time for EGSDCmn_dmfRngLoUnderMinParl_C consideration, bank 1 / expired time since start" UBYTE t_q0p1 1 100 0.00 25.50 FORMAT "%5.2" ECU_ADDRESS 0x6000B207 /end MEASUREMENT
/begin MEASUREMENT EGSDCmn_mLamEnaParlB1IK_I.memory "Exhaust gasm ass integrator to ensure Lambda set point before starting the parallelization stable for enough time / current integrator value" ULONG m_q1p5259Em8_kg 1 100 0.00 65.5359999847 FORMAT "%13.10" ECU_ADDRESS 0x50001688 /end MEASUREMENT
/begin MEASUREMENT EGSDCmn_mSeg1B1SensVldParlIK_I.memory "mass flow debouncing since sensors are ready to operate / current integrator value" ULONG m_q1p5259Em8_kg 1 100 0.00 65.5359999847 FORMAT "%13.10" ECU_ADDRESS 0x60002D40 /end MEASUREMENT
/begin MEASUREMENT EGSDCmn_nEngOvrIdleTOFFV_I.outbit "Debouncing of the engine speed condition for reset of the stop watch / Output Bit" UBYTE B_TRUE 1 100 0.00 1.00000000000 BIT_MASK 0x1 FORMAT "%13.11" ECU_ADDRESS 0x500054AE /end MEASUREMENT
/begin MEASUREMENT EGSDCmn_nEngOvrIdleTOFFV_I.time "Debouncing of the engine speed condition for reset of the stop watch / Occured Time" UWORD t_q0p1 1 100 0.00 6553.500 FORMAT "%8.3" ECU_ADDRESS 0x500054B0 /end MEASUREMENT
/begin MEASUREMENT EGSDCmn_rLamDeltaMonParlB1 "Lambda deviation vs. setpoint bank 1" SWORD fak_q0p000244 1 100 -8.000000 7.999756 FORMAT "%8.6" ECU_ADDRESS 0x6001332C /end MEASUREMENT
/begin MEASUREMENT EGSDCmn_S2B1VirtTarLeanOffsParl_I.ratLamRampLeanParl "Virtual lambda shifting for IUMPR simulation of range check of lean target sensor voltage with Lambda Offset, bank 1 / Lean Lambda request setpoint during ramping" UWORD fak_uw_b16 1 100 0.00 15.99976 FORMAT "%8.5" ECU_ADDRESS 0x500015D8 /end MEASUREMENT
/begin MEASUREMENT EGSDCmn_S2B1VirtTarLeanOffsParl_I.ratLamRampRichParl "Virtual lambda shifting for IUMPR simulation of range check of lean target sensor voltage with Lambda Offset, bank 1 / Rich Lambda request setpoint during ramping" UWORD fak_uw_b16 1 100 0.00 15.99976 FORMAT "%8.5" ECU_ADDRESS 0x500015DA /end MEASUREMENT
/begin MEASUREMENT EGSDCmn_S2B1VirtTarLeanOffsParl_I.ratLamReq "Virtual lambda shifting for IUMPR simulation of range check of lean target sensor voltage with Lambda Offset, bank 1 / Requested Lambda value" UWORD fak_uw_b16 1 100 0.00 15.99976 FORMAT "%8.5" ECU_ADDRESS 0x500015DC /end MEASUREMENT
/begin MEASUREMENT EGSDCmn_S2B1VirtTarLeanOffsParl_I.sm "Virtual lambda shifting for IUMPR simulation of range check of lean target sensor voltage with Lambda Offset, bank 1 / State number" UBYTE EGSDCmn_VirtTarPlausParl_sm_VERB 1 100 0.00 5.00000000000 FORMAT "%13.11" ECU_ADDRESS 0x500015DE /end MEASUREMENT
/begin MEASUREMENT EGSDCmn_S2B1VirtTarLeanOffsParl_I.stLamGenr "Virtual lambda shifting for IUMPR simulation of range check of lean target sensor voltage with Lambda Offset, bank 1 / State number" UBYTE dez 1 100 0.00 255.0 FORMAT "%5.1" ECU_ADDRESS 0x500015DF /end MEASUREMENT
/begin MEASUREMENT EGSDCmn_S2B1VirtTarLeanOffsParl_I.tiGasRt "Virtual lambda shifting for IUMPR simulation of range check of lean target sensor voltage with Lambda Offset, bank 1 / gas propagation time till first Lambda sensor" UWORD t_q0p1 1 100 0.00 6553.500 FORMAT "%8.3" ECU_ADDRESS 0x500015E0 /end MEASUREMENT
/begin MEASUREMENT EGSDCmn_S2B1VirtTarLeanOffsParl_I.tiLamDynLtr "Virtual lambda shifting for IUMPR simulation of range check of lean target sensor voltage with Lambda Offset, bank 1 / Dynamic time lambda signal of upstream sensor 1 Lean-Rich" UWORD t_q0p1 1 100 0.00 6553.500 FORMAT "%8.3" ECU_ADDRESS 0x500015E2 /end MEASUREMENT
/begin MEASUREMENT EGSDCmn_S2B1VirtTarLeanOffsParl_I.tiLamDynRtl "Virtual lambda shifting for IUMPR simulation of range check of lean target sensor voltage with Lambda Offset, bank 1 / Dynamic time lambda signal of upstream sensor 1 Rich-Lean" UWORD t_q0p1 1 100 0.00 6553.500 FORMAT "%8.3" ECU_ADDRESS 0x500015E4 /end MEASUREMENT
/begin MEASUREMENT EGSDCmn_S2B1VirtTarLeanOffsParl_I.tiUDynLtr "Virtual lambda shifting for IUMPR simulation of range check of lean target sensor voltage with Lambda Offset, bank 1 / Dynamic reaction time of downstream sensor, Lean-Rich" UWORD t_q0p1 1 100 0.00 6553.500 FORMAT "%8.3" ECU_ADDRESS 0x500015E6 /end MEASUREMENT
/begin MEASUREMENT EGSDCmn_S2B1VirtTarLeanOffsParl_I.tiUDynRtl "Virtual lambda shifting for IUMPR simulation of range check of lean target sensor voltage with Lambda Offset, bank 1 / Dynamic reaction time of downstream sensor, Rich-Lean" UWORD t_q0p1 1 100 0.00 6553.500 FORMAT "%8.3" ECU_ADDRESS 0x500015E8 /end MEASUREMENT
/begin MEASUREMENT EGSDCmn_S2B1VirtTarLeanOffsParl_I.EnaReldEF_I.buffer "Virtual lambda shifting for IUMPR simulation of range check of lean target sensor voltage with Lambda Offset, bank 1 / EdgeFalling: loss of enable condition / memory to detect falling edge" UBYTE B_TRUE 1 100 0.00 1.00000000000 BIT_MASK 0x1 FORMAT "%13.11" ECU_ADDRESS 0x500015EA /end MEASUREMENT
/begin MEASUREMENT EGSDCmn_S2B1VirtTarLeanOffsParl_I.EnaReldEF_I.oldSignal "Virtual lambda shifting for IUMPR simulation of range check of lean target sensor voltage with Lambda Offset, bank 1 / EdgeFalling: loss of enable condition / memory to detect falling edge" UBYTE B_TRUE 1 100 0.00 1.00000000000 BIT_MASK 0x1 FORMAT "%13.11" ECU_ADDRESS 0x500015EB /end MEASUREMENT
/begin MEASUREMENT EGSDCmn_S2B1VirtTarLeanOffsParl_I.LamRampIKL_I.memory "Virtual lambda shifting for IUMPR simulation of range check of lean target sensor voltage with Lambda Offset, bank 1 / Integrator to create a ramp shaped lambda request / Current Integrator value" ULONG fak_q3p72529Em9 1 100 0.00 15.9999999963 FORMAT "%13.10" ECU_ADDRESS 0x500015EC /end MEASUREMENT
/begin MEASUREMENT EGSDCmn_S2B1VirtTarLeanOffsParl_I.RampEndLimIK_I.memory "Virtual lambda shifting for IUMPR simulation of range check of lean target sensor voltage with Lambda Offset, bank 1 / Integrator for calculation of amount of exhaust mass during ramp-test / current integrator value" ULONG m_q1p5259Em8_kg 1 100 0.00 65.5359999847 FORMAT "%13.10" ECU_ADDRESS 0x500015F0 /end MEASUREMENT
/begin MEASUREMENT EGSDCmn_S2B1VirtTarLeanOffsParl_I.mO2EnaCatFullGrdtIK_I.memory "Virtual lambda shifting for IUMPR simulation of range check of lean target sensor voltage with Lambda Offset, bank 1 / Integrator for oxygen gas mass flow for detection if catalyst is filled with oxygen / current integrator value" FLOAT32_IEEE m_q1_mg 1 100 -1.0000E+037 1.0000E+037 FORMAT "%10.4" ECU_ADDRESS 0x500015F4 /end MEASUREMENT
/begin MEASUREMENT EGSDCmn_S2B1VirtTarLeanOffsParl_I.mO2VirtEnaCatEmptyIK_I.memory "Virtual lambda shifting for IUMPR simulation of range check of lean target sensor voltage with Lambda Offset, bank 1 / Integrator for rich gas mass flow for detection if catalyst is emtpied from oxygen / current integrator value" FLOAT32_IEEE m_q1_mg 1 100 -1.0000E+037 1.0000E+037 FORMAT "%10.4" ECU_ADDRESS 0x500015F8 /end MEASUREMENT
/begin MEASUREMENT EGSDCmn_S2B1VirtTarLeanOffsParl_I.tiDynWpaRampTONVNM_I.outbit "Virtual lambda shifting for IUMPR simulation of range check of lean target sensor voltage with Lambda Offset, bank 1 / Simulation of a sensor dynamics which corresponds to worst performing acceptable / return value" UBYTE B_TRUE 1 100 0.00 1.00000000000 BIT_MASK 0x1 FORMAT "%13.11" ECU_ADDRESS 0x500015FC /end MEASUREMENT
/begin MEASUREMENT EGSDCmn_S2B1VirtTarLeanOffsParl_I.tiDynWpaRampTONVNM_I.time "Virtual lambda shifting for IUMPR simulation of range check of lean target sensor voltage with Lambda Offset, bank 1 / Simulation of a sensor dynamics which corresponds to worst performing acceptable / expired delay time" UWORD t_q0p1 1 100 0.00 6553.500 FORMAT "%8.3" ECU_ADDRESS 0x500015FE /end MEASUREMENT
/begin MEASUREMENT EGSDCmn_S2B1VirtTarLeanOffsParl_I.tiLamDynTONV_I.outbit "Virtual lambda shifting for IUMPR simulation of range check of lean target sensor voltage with Lambda Offset, bank 1 / simulation time for sensor dynamic of upstream sensor 1 / return value" UBYTE B_TRUE 1 100 0.00 1.00000000000 BIT_MASK 0x1 FORMAT "%13.11" ECU_ADDRESS 0x50001600 /end MEASUREMENT
/begin MEASUREMENT EGSDCmn_S2B1VirtTarLeanOffsParl_I.tiLamDynTONV_I.time "Virtual lambda shifting for IUMPR simulation of range check of lean target sensor voltage with Lambda Offset, bank 1 / simulation time for sensor dynamic of upstream sensor 1 / expired delay time" UWORD t_q0p1 1 100 0.00 6553.500 FORMAT "%8.3" ECU_ADDRESS 0x50001602 /end MEASUREMENT
/begin MEASUREMENT EGSDCmn_S2B1VirtTarLeanOffsParl_I.tiUDynTONV_I.outbit "Virtual lambda shifting for IUMPR simulation of range check of lean target sensor voltage with Lambda Offset, bank 1 / simulation time for sensor dynamic of downstream sensor / return value" UBYTE B_TRUE 1 100 0.00 1.00000000000 BIT_MASK 0x1 FORMAT "%13.11" ECU_ADDRESS 0x50001604 /end MEASUREMENT
/begin MEASUREMENT EGSDCmn_S2B1VirtTarLeanOffsParl_I.tiUDynTONV_I.time "Virtual lambda shifting for IUMPR simulation of range check of lean target sensor voltage with Lambda Offset, bank 1 / simulation time for sensor dynamic of downstream sensor / expired delay time" UWORD t_q0p1 1 100 0.00 6553.500 FORMAT "%8.3" ECU_ADDRESS 0x50001606 /end MEASUREMENT
/begin MEASUREMENT EGSDCmn_S2B1VirtTarLeanParl_I.flgCatEmptyTOut "Virtual lambda shifting for IUMPR simulation of range check of lean target sensor voltage / Time out while checking if catalyst is empty from oxygen" UBYTE B_TRUE 1 100 0.00 1.00000000000 BIT_MASK 0x1 FORMAT "%13.11" ECU_ADDRESS 0x60002E3C /end MEASUREMENT
/begin MEASUREMENT EGSDCmn_S2B1VirtTarLeanParl_I.flgCatFullTOut "Virtual lambda shifting for IUMPR simulation of range check of lean target sensor voltage / Time out while checking if catalyst is filled with oxygen" UBYTE B_TRUE 1 100 0.00 1.00000000000 BIT_MASK 0x1 FORMAT "%13.11" ECU_ADDRESS 0x60002E3D /end MEASUREMENT
/begin MEASUREMENT EGSDCmn_S2B1VirtTarLeanParl_I.flgReld "Virtual lambda shifting for IUMPR simulation of range check of lean target sensor voltage / lambda shifting is released" UBYTE B_TRUE 1 100 0.00 1.00000000000 BIT_MASK 0x1 FORMAT "%13.11" ECU_ADDRESS 0x60002E3E /end MEASUREMENT
/begin MEASUREMENT EGSDCmn_S2B1VirtTarLeanParl_I.flgTarLeanRes "Virtual lambda shifting for IUMPR simulation of range check of lean target sensor voltage / check of lean sensor voltage, result is available" UBYTE B_TRUE 1 100 0.00 1.00000000000 BIT_MASK 0x1 FORMAT "%13.11" ECU_ADDRESS 0x60002E3F /end MEASUREMENT
/begin MEASUREMENT EGSDCmn_S2B1VirtTarLeanParl_I.flgTarRich "Virtual lambda shifting for IUMPR simulation of range check of lean target sensor voltage / Target Rich check is activated" UBYTE B_TRUE 1 100 0.00 1.00000000000 BIT_MASK 0x1 FORMAT "%13.11" ECU_ADDRESS 0x60002E40 /end MEASUREMENT
/begin MEASUREMENT EGSDCmn_S2B1VirtTarLeanParl_I.flgTarRichRes "Virtual lambda shifting for IUMPR simulation of range check of lean target sensor voltage / check of rich sensor voltage, result is available" UBYTE B_TRUE 1 100 0.00 1.00000000000 BIT_MASK 0x1 FORMAT "%13.11" ECU_ADDRESS 0x60002E41 /end MEASUREMENT
/begin MEASUREMENT EGSDCmn_S2B1VirtTarLeanParl_I.flgUHiEnaParl "Virtual lambda shifting for IUMPR simulation of range check of lean target sensor voltage / Sensor voltage downstream is high" UBYTE B_TRUE 1 100 0.00 1.00000000000 BIT_MASK 0x1 FORMAT "%13.11" ECU_ADDRESS 0x60002E42 /end MEASUREMENT
/begin MEASUREMENT EGSDCmn_S2B1VirtTarLeanParl_I.mOSC "Virtual lambda shifting for IUMPR simulation of range check of lean target sensor voltage / Assumed oxygen storage capacity for first catalyst" FLOAT32_IEEE m_q1_mg 1 100 0.00 50000.0000 FORMAT "%10.4" ECU_ADDRESS 0x60002E44 /end MEASUREMENT
/begin MEASUREMENT EGSDCmn_S2B1VirtTarLeanParl_I.mRSC "Virtual lambda shifting for IUMPR simulation of range check of lean target sensor voltage / Assumed rich gas storage capacity for first catalyst" FLOAT32_IEEE m_q1_mg 1 100 0.00 50000.0000 FORMAT "%10.4" ECU_ADDRESS 0x60002E48 /end MEASUREMENT
/begin MEASUREMENT EGSDCmn_S2B1VirtTarLeanParl_I.mRampDurParl "Virtual lambda shifting for IUMPR simulation of range check of lean target sensor voltage / Needed amount of exhaust mass during ramp-test" UWORD m_q0p001_kg 1 100 0.00 65.53500 FORMAT "%8.5" ECU_ADDRESS 0x60002E4C /end MEASUREMENT
/begin MEASUREMENT EGSDCmn_S2B1VirtTarLeanParl_I.mfEg "Virtual lambda shifting for IUMPR simulation of range check of lean target sensor voltage / Exhaust gas mass flow" UWORD m_q0p1 1 100 0.00 6553.500 FORMAT "%8.3" ECU_ADDRESS 0x60002E4E /end MEASUREMENT
/begin MEASUREMENT EGSDCmn_S2B1VirtTarLeanParl_I.mfVirtO2 "Virtual lambda shifting for IUMPR simulation of range check of lean target sensor voltage / Oxygen mass flow in catalyst 1, corrected by maximum possible mixture deviation in a fault free system" FLOAT32_IEEE mgrad_q1_mgdivs 1 100 0.00 50000.0000 FORMAT "%10.4" ECU_ADDRESS 0x60002E50 /end MEASUREMENT
/begin MEASUREMENT EGSDCmn_S2B1VirtTarLeanParl_I.mfVirtRich "Virtual lambda shifting for IUMPR simulation of range check of lean target sensor voltage / Rich Gas mass flow in catalyst 1, corrected by maximum possible mixture deviation in a fault free system" FLOAT32_IEEE mgrad_q1_mgdivs 1 100 0.00 50000.0000 FORMAT "%10.4" ECU_ADDRESS 0x60002E54 /end MEASUREMENT
/begin MEASUREMENT EGSDCmn_S2B1VirtTarLeanParl_I.ratLamRampLeanParl "Virtual lambda shifting for IUMPR simulation of range check of lean target sensor voltage / Lean Lambda request setpoint during ramping" UWORD fak_uw_b16 1 100 0.00 15.99976 FORMAT "%8.5" ECU_ADDRESS 0x60002E58 /end MEASUREMENT
/begin MEASUREMENT EGSDCmn_S2B1VirtTarLeanParl_I.ratLamRampRichParl "Virtual lambda shifting for IUMPR simulation of range check of lean target sensor voltage / Rich Lambda request setpoint during ramping" UWORD fak_uw_b16 1 100 0.00 15.99976 FORMAT "%8.5" ECU_ADDRESS 0x60002E5A /end MEASUREMENT
/begin MEASUREMENT EGSDCmn_S2B1VirtTarLeanParl_I.ratLamReq "Virtual lambda shifting for IUMPR simulation of range check of lean target sensor voltage / Requested Lambda value" UWORD fak_uw_b16 1 100 0.00 15.99976 FORMAT "%8.5" ECU_ADDRESS 0x60002E5C /end MEASUREMENT
/begin MEASUREMENT EGSDCmn_S2B1VirtTarLeanParl_I.sm "Virtual lambda shifting for IUMPR simulation of range check of lean target sensor voltage / State number" UBYTE EGSDCmn_VirtTarPlausParl_sm_VERB 1 100 0.00 5.00000000000 FORMAT "%13.11" ECU_ADDRESS 0x60002E5E /end MEASUREMENT
/begin MEASUREMENT EGSDCmn_S2B1VirtTarLeanParl_I.stLamGenr "Virtual lambda shifting for IUMPR simulation of range check of lean target sensor voltage / State number" UBYTE dez 1 100 0.00 255.0 FORMAT "%5.1" ECU_ADDRESS 0x60002E5F /end MEASUREMENT
/begin MEASUREMENT EGSDCmn_S2B1VirtTarLeanParl_I.tiGasRt "Virtual lambda shifting for IUMPR simulation of range check of lean target sensor voltage / gas propagation time till first Lambda sensor" UWORD t_q0p1 1 100 0.00 6553.500 FORMAT "%8.3" ECU_ADDRESS 0x60002E60 /end MEASUREMENT
/begin MEASUREMENT EGSDCmn_S2B1VirtTarLeanParl_I.tiLamDynLtr "Virtual lambda shifting for IUMPR simulation of range check of lean target sensor voltage / Dynamic time lambda signal of upstream sensor 1 Lean-Rich" UWORD t_q0p1 1 100 0.00 6553.500 FORMAT "%8.3" ECU_ADDRESS 0x60002E62 /end MEASUREMENT
/begin MEASUREMENT EGSDCmn_S2B1VirtTarLeanParl_I.tiLamDynRtl "Virtual lambda shifting for IUMPR simulation of range check of lean target sensor voltage / Dynamic time lambda signal of upstream sensor 1 Rich-Lean" UWORD t_q0p1 1 100 0.00 6553.500 FORMAT "%8.3" ECU_ADDRESS 0x60002E64 /end MEASUREMENT
/begin MEASUREMENT EGSDCmn_S2B1VirtTarLeanParl_I.tiUDynLtr "Virtual lambda shifting for IUMPR simulation of range check of lean target sensor voltage / Dynamic reaction time of downstream sensor, Lean-Rich" UWORD t_q0p1 1 100 0.00 6553.500 FORMAT "%8.3" ECU_ADDRESS 0x60002E66 /end MEASUREMENT
/begin MEASUREMENT EGSDCmn_S2B1VirtTarLeanParl_I.tiUDynRtl "Virtual lambda shifting for IUMPR simulation of range check of lean target sensor voltage / Dynamic reaction time of downstream sensor, Rich-Lean" UWORD t_q0p1 1 100 0.00 6553.500 FORMAT "%8.3" ECU_ADDRESS 0x60002E68 /end MEASUREMENT
/begin MEASUREMENT EGSDCmn_S2B1VirtTarLeanParl_I.EnaReldEF_I.buffer "Virtual lambda shifting for IUMPR simulation of range check of lean target sensor voltage / EdgeFalling: loss of enable condition / memory to detect falling edge" UBYTE B_TRUE 1 100 0.00 1.00000000000 BIT_MASK 0x1 FORMAT "%13.11" ECU_ADDRESS 0x60002E6A /end MEASUREMENT
/begin MEASUREMENT EGSDCmn_S2B1VirtTarLeanParl_I.EnaReldEF_I.oldSignal "Virtual lambda shifting for IUMPR simulation of range check of lean target sensor voltage / EdgeFalling: loss of enable condition / memory to detect falling edge" UBYTE B_TRUE 1 100 0.00 1.00000000000 BIT_MASK 0x1 FORMAT "%13.11" ECU_ADDRESS 0x60002E6B /end MEASUREMENT
/begin MEASUREMENT EGSDCmn_S2B1VirtTarLeanParl_I.LamRampIKL_I.memory "Virtual lambda shifting for IUMPR simulation of range check of lean target sensor voltage / Integrator to create a ramp shaped lambda request / Current Integrator value" ULONG fak_q3p72529Em9 1 100 0.00 15.9999999963 FORMAT "%13.10" ECU_ADDRESS 0x60002E6C /end MEASUREMENT
/begin MEASUREMENT EGSDCmn_S2B1VirtTarLeanParl_I.RampEndLimIK_I.memory "Virtual lambda shifting for IUMPR simulation of range check of lean target sensor voltage / Integrator for calculation of amount of exhaust mass during ramp-test / current integrator value" ULONG m_q1p5259Em8_kg 1 100 0.00 65.5359999847 FORMAT "%13.10" ECU_ADDRESS 0x60002E70 /end MEASUREMENT
/begin MEASUREMENT EGSDCmn_S2B1VirtTarLeanParl_I.mO2EnaCatFullGrdtIK_I.memory "Virtual lambda shifting for IUMPR simulation of range check of lean target sensor voltage / Integrator for oxygen gas mass flow for detection if catalyst is filled with oxygen / current integrator value" FLOAT32_IEEE m_q1_mg 1 100 -1.0000E+037 1.0000E+037 FORMAT "%10.4" ECU_ADDRESS 0x60002E74 /end MEASUREMENT
/begin MEASUREMENT EGSDCmn_S2B1VirtTarLeanParl_I.mO2VirtEnaCatEmptyIK_I.memory "Virtual lambda shifting for IUMPR simulation of range check of lean target sensor voltage / Integrator for rich gas mass flow for detection if catalyst is emtpied from oxygen / current integrator value" FLOAT32_IEEE m_q1_mg 1 100 -1.0000E+037 1.0000E+037 FORMAT "%10.4" ECU_ADDRESS 0x60002E78 /end MEASUREMENT
/begin MEASUREMENT EGSDCmn_S2B1VirtTarLeanParl_I.tiDynWpaRampTONVNM_I.outbit "Virtual lambda shifting for IUMPR simulation of range check of lean target sensor voltage / Simulation of a sensor dynamics which corresponds to worst performing acceptable / return value" UBYTE B_TRUE 1 100 0.00 1.00000000000 BIT_MASK 0x1 FORMAT "%13.11" ECU_ADDRESS 0x60002E7C /end MEASUREMENT
/begin MEASUREMENT EGSDCmn_S2B1VirtTarLeanParl_I.tiDynWpaRampTONVNM_I.time "Virtual lambda shifting for IUMPR simulation of range check of lean target sensor voltage / Simulation of a sensor dynamics which corresponds to worst performing acceptable / expired delay time" UWORD t_q0p1 1 100 0.00 6553.500 FORMAT "%8.3" ECU_ADDRESS 0x60002E7E /end MEASUREMENT
/begin MEASUREMENT EGSDCmn_S2B1VirtTarLeanParl_I.tiLamDynTONV_I.outbit "Virtual lambda shifting for IUMPR simulation of range check of lean target sensor voltage / simulation time for sensor dynamic of upstream sensor 1 / return value" UBYTE B_TRUE 1 100 0.00 1.00000000000 BIT_MASK 0x1 FORMAT "%13.11" ECU_ADDRESS 0x60002E80 /end MEASUREMENT
/begin MEASUREMENT EGSDCmn_S2B1VirtTarLeanParl_I.tiLamDynTONV_I.time "Virtual lambda shifting for IUMPR simulation of range check of lean target sensor voltage / simulation time for sensor dynamic of upstream sensor 1 / expired delay time" UWORD t_q0p1 1 100 0.00 6553.500 FORMAT "%8.3" ECU_ADDRESS 0x60002E82 /end MEASUREMENT
/begin MEASUREMENT EGSDCmn_S2B1VirtTarLeanParl_I.tiUDynTONV_I.outbit "Virtual lambda shifting for IUMPR simulation of range check of lean target sensor voltage / simulation time for sensor dynamic of downstream sensor / return value" UBYTE B_TRUE 1 100 0.00 1.00000000000 BIT_MASK 0x1 FORMAT "%13.11" ECU_ADDRESS 0x60002E84 /end MEASUREMENT
/begin MEASUREMENT EGSDCmn_S2B1VirtTarLeanParl_I.tiUDynTONV_I.time "Virtual lambda shifting for IUMPR simulation of range check of lean target sensor voltage / simulation time for sensor dynamic of downstream sensor / expired delay time" UWORD t_q0p1 1 100 0.00 6553.500 FORMAT "%8.3" ECU_ADDRESS 0x60002E86 /end MEASUREMENT
/begin MEASUREMENT EGSDCmn_S2B1VirtTarRichOffsParl_I.flgCatEmptyTOut "Virtual lambda shifting for IUMPR simulation of range check of rich target sensor voltage with Lambda Offset, bank 1 / Time out while checking if catalyst is empty from oxygen" UBYTE B_TRUE 1 100 0.00 1.00000000000 BIT_MASK 0x1 FORMAT "%13.11" ECU_ADDRESS 0x50001608 /end MEASUREMENT
/begin MEASUREMENT EGSDCmn_S2B1VirtTarRichOffsParl_I.flgCatFullTOut "Virtual lambda shifting for IUMPR simulation of range check of rich target sensor voltage with Lambda Offset, bank 1 / Time out while checking if catalyst is filled with oxygen" UBYTE B_TRUE 1 100 0.00 1.00000000000 BIT_MASK 0x1 FORMAT "%13.11" ECU_ADDRESS 0x50001609 /end MEASUREMENT
/begin MEASUREMENT EGSDCmn_S2B1VirtTarRichOffsParl_I.flgReld "Virtual lambda shifting for IUMPR simulation of range check of rich target sensor voltage with Lambda Offset, bank 1 / lambda shifting is released" UBYTE B_TRUE 1 100 0.00 1.00000000000 BIT_MASK 0x1 FORMAT "%13.11" ECU_ADDRESS 0x5000160A /end MEASUREMENT
/begin MEASUREMENT EGSDCmn_S2B1VirtTarRichOffsParl_I.flgTarLeanRes "Virtual lambda shifting for IUMPR simulation of range check of rich target sensor voltage with Lambda Offset, bank 1 / check of lean sensor voltage, result is available" UBYTE B_TRUE 1 100 0.00 1.00000000000 BIT_MASK 0x1 FORMAT "%13.11" ECU_ADDRESS 0x5000160B /end MEASUREMENT
/begin MEASUREMENT EGSDCmn_S2B1VirtTarRichOffsParl_I.flgTarRich "Virtual lambda shifting for IUMPR simulation of range check of rich target sensor voltage with Lambda Offset, bank 1 / Target Rich check is activated" UBYTE B_TRUE 1 100 0.00 1.00000000000 BIT_MASK 0x1 FORMAT "%13.11" ECU_ADDRESS 0x5000160C /end MEASUREMENT
/begin MEASUREMENT EGSDCmn_S2B1VirtTarRichOffsParl_I.flgTarRichRes "Virtual lambda shifting for IUMPR simulation of range check of rich target sensor voltage with Lambda Offset, bank 1 / check of rich sensor voltage, result is available" UBYTE B_TRUE 1 100 0.00 1.00000000000 BIT_MASK 0x1 FORMAT "%13.11" ECU_ADDRESS 0x5000160D /end MEASUREMENT
/begin MEASUREMENT EGSDCmn_S2B1VirtTarRichOffsParl_I.flgUHiEnaParl "Virtual lambda shifting for IUMPR simulation of range check of rich target sensor voltage with Lambda Offset, bank 1 / Sensor voltage downstream is high" UBYTE B_TRUE 1 100 0.00 1.00000000000 BIT_MASK 0x1 FORMAT "%13.11" ECU_ADDRESS 0x5000160E /end MEASUREMENT
/begin MEASUREMENT EGSDCmn_S2B1VirtTarRichOffsParl_I.mOSC "Virtual lambda shifting for IUMPR simulation of range check of rich target sensor voltage with Lambda Offset, bank 1 / Assumed oxygen storage capacity for first catalyst" FLOAT32_IEEE m_q1_mg 1 100 0.00 50000.0000 FORMAT "%10.4" ECU_ADDRESS 0x50001610 /end MEASUREMENT
/begin MEASUREMENT EGSDCmn_S2B1VirtTarRichOffsParl_I.mRSC "Virtual lambda shifting for IUMPR simulation of range check of rich target sensor voltage with Lambda Offset, bank 1 / Assumed rich gas storage capacity for first catalyst" FLOAT32_IEEE m_q1_mg 1 100 0.00 50000.0000 FORMAT "%10.4" ECU_ADDRESS 0x50001614 /end MEASUREMENT
/begin MEASUREMENT EGSDCmn_S2B1VirtTarRichOffsParl_I.mRampDurParl "Virtual lambda shifting for IUMPR simulation of range check of rich target sensor voltage with Lambda Offset, bank 1 / Needed amount of exhaust mass during ramp-test" UWORD m_q0p001_kg 1 100 0.00 65.53500 FORMAT "%8.5" ECU_ADDRESS 0x50001618 /end MEASUREMENT
/begin MEASUREMENT EGSDCmn_S2B1VirtTarRichOffsParl_I.mfEg "Virtual lambda shifting for IUMPR simulation of range check of rich target sensor voltage with Lambda Offset, bank 1 / Exhaust gas mass flow" UWORD m_q0p1 1 100 0.00 6553.500 FORMAT "%8.3" ECU_ADDRESS 0x5000161A /end MEASUREMENT
/begin MEASUREMENT EGSDCmn_S2B1VirtTarRichOffsParl_I.mfVirtO2 "Virtual lambda shifting for IUMPR simulation of range check of rich target sensor voltage with Lambda Offset, bank 1 / Oxygen mass flow in catalyst 1, corrected by maximum possible mixture deviation in a fault free system" FLOAT32_IEEE mgrad_q1_mgdivs 1 100 0.00 50000.0000 FORMAT "%10.4" ECU_ADDRESS 0x5000161C /end MEASUREMENT
/begin MEASUREMENT EGSDCmn_S2B1VirtTarRichOffsParl_I.mfVirtRich "Virtual lambda shifting for IUMPR simulation of range check of rich target sensor voltage with Lambda Offset, bank 1 / Rich Gas mass flow in catalyst 1, corrected by maximum possible mixture deviation in a fault free system" FLOAT32_IEEE mgrad_q1_mgdivs 1 100 0.00 50000.0000 FORMAT "%10.4" ECU_ADDRESS 0x50001620 /end MEASUREMENT
/begin MEASUREMENT EGSDCmn_S2B1VirtTarRichOffsParl_I.ratLamRampLeanParl "Virtual lambda shifting for IUMPR simulation of range check of rich target sensor voltage with Lambda Offset, bank 1 / Lean Lambda request setpoint during ramping" UWORD fak_uw_b16 1 100 0.00 15.99976 FORMAT "%8.5" ECU_ADDRESS 0x50001624 /end MEASUREMENT
/begin MEASUREMENT EGSDCmn_S2B1VirtTarRichOffsParl_I.ratLamRampRichParl "Virtual lambda shifting for IUMPR simulation of range check of rich target sensor voltage with Lambda Offset, bank 1 / Rich Lambda request setpoint during ramping" UWORD fak_uw_b16 1 100 0.00 15.99976 FORMAT "%8.5" ECU_ADDRESS 0x50001626 /end MEASUREMENT
/begin MEASUREMENT EGSDCmn_S2B1VirtTarRichOffsParl_I.ratLamReq "Virtual lambda shifting for IUMPR simulation of range check of rich target sensor voltage with Lambda Offset, bank 1 / Requested Lambda value" UWORD fak_uw_b16 1 100 0.00 15.99976 FORMAT "%8.5" ECU_ADDRESS 0x50001628 /end MEASUREMENT
/begin MEASUREMENT EGSDCmn_S2B1VirtTarRichOffsParl_I.sm "Virtual lambda shifting for IUMPR simulation of range check of rich target sensor voltage with Lambda Offset, bank 1 / State number" UBYTE EGSDCmn_VirtTarPlausParl_sm_VERB 1 100 0.00 5.00000000000 FORMAT "%13.11" ECU_ADDRESS 0x5000162A /end MEASUREMENT
/begin MEASUREMENT EGSDCmn_S2B1VirtTarRichOffsParl_I.stLamGenr "Virtual lambda shifting for IUMPR simulation of range check of rich target sensor voltage with Lambda Offset, bank 1 / State number" UBYTE dez 1 100 0.00 255.0 FORMAT "%5.1" ECU_ADDRESS 0x5000162B /end MEASUREMENT
/begin MEASUREMENT EGSDCmn_S2B1VirtTarRichOffsParl_I.tiGasRt "Virtual lambda shifting for IUMPR simulation of range check of rich target sensor voltage with Lambda Offset, bank 1 / gas propagation time till first Lambda sensor" UWORD t_q0p1 1 100 0.00 6553.500 FORMAT "%8.3" ECU_ADDRESS 0x5000162C /end MEASUREMENT
/begin MEASUREMENT EGSDCmn_S2B1VirtTarRichOffsParl_I.tiLamDynLtr "Virtual lambda shifting for IUMPR simulation of range check of rich target sensor voltage with Lambda Offset, bank 1 / Dynamic time lambda signal of upstream sensor 1 Lean-Rich" UWORD t_q0p1 1 100 0.00 6553.500 FORMAT "%8.3" ECU_ADDRESS 0x5000162E /end MEASUREMENT
/begin MEASUREMENT EGSDCmn_S2B1VirtTarRichOffsParl_I.tiLamDynRtl "Virtual lambda shifting for IUMPR simulation of range check of rich target sensor voltage with Lambda Offset, bank 1 / Dynamic time lambda signal of upstream sensor 1 Rich-Lean" UWORD t_q0p1 1 100 0.00 6553.500 FORMAT "%8.3" ECU_ADDRESS 0x50001630 /end MEASUREMENT
/begin MEASUREMENT EGSDCmn_S2B1VirtTarRichOffsParl_I.tiUDynLtr "Virtual lambda shifting for IUMPR simulation of range check of rich target sensor voltage with Lambda Offset, bank 1 / Dynamic reaction time of downstream sensor, Lean-Rich" UWORD t_q0p1 1 100 0.00 6553.500 FORMAT "%8.3" ECU_ADDRESS 0x50001632 /end MEASUREMENT
/begin MEASUREMENT EGSDCmn_S2B1VirtTarRichOffsParl_I.tiUDynRtl "Virtual lambda shifting for IUMPR simulation of range check of rich target sensor voltage with Lambda Offset, bank 1 / Dynamic reaction time of downstream sensor, Rich-Lean" UWORD t_q0p1 1 100 0.00 6553.500 FORMAT "%8.3" ECU_ADDRESS 0x50001634 /end MEASUREMENT
/begin MEASUREMENT EGSDCmn_S2B1VirtTarRichOffsParl_I.EnaReldEF_I.buffer "Virtual lambda shifting for IUMPR simulation of range check of rich target sensor voltage with Lambda Offset, bank 1 / EdgeFalling: loss of enable condition / memory to detect falling edge" UBYTE B_TRUE 1 100 0.00 1.00000000000 BIT_MASK 0x1 FORMAT "%13.11" ECU_ADDRESS 0x50001636 /end MEASUREMENT
/begin MEASUREMENT EGSDCmn_S2B1VirtTarRichOffsParl_I.EnaReldEF_I.oldSignal "Virtual lambda shifting for IUMPR simulation of range check of rich target sensor voltage with Lambda Offset, bank 1 / EdgeFalling: loss of enable condition / memory to detect falling edge" UBYTE B_TRUE 1 100 0.00 1.00000000000 BIT_MASK 0x1 FORMAT "%13.11" ECU_ADDRESS 0x50001637 /end MEASUREMENT
/begin MEASUREMENT EGSDCmn_S2B1VirtTarRichOffsParl_I.LamRampIKL_I.memory "Virtual lambda shifting for IUMPR simulation of range check of rich target sensor voltage with Lambda Offset, bank 1 / Integrator to create a ramp shaped lambda request / Current Integrator value" ULONG fak_q3p72529Em9 1 100 0.00 15.9999999963 FORMAT "%13.10" ECU_ADDRESS 0x50001638 /end MEASUREMENT
/begin MEASUREMENT EGSDCmn_S2B1VirtTarRichOffsParl_I.RampEndLimIK_I.memory "Virtual lambda shifting for IUMPR simulation of range check of rich target sensor voltage with Lambda Offset, bank 1 / Integrator for calculation of amount of exhaust mass during ramp-test / current integrator value" ULONG m_q1p5259Em8_kg 1 100 0.00 65.5359999847 FORMAT "%13.10" ECU_ADDRESS 0x5000163C /end MEASUREMENT
/begin MEASUREMENT EGSDCmn_S2B1VirtTarRichOffsParl_I.mO2EnaCatFullGrdtIK_I.memory "Virtual lambda shifting for IUMPR simulation of range check of rich target sensor voltage with Lambda Offset, bank 1 / Integrator for oxygen gas mass flow for detection if catalyst is filled with oxygen / current integrator value" FLOAT32_IEEE m_q1_mg 1 100 -1.0000E+037 1.0000E+037 FORMAT "%10.4" ECU_ADDRESS 0x50001640 /end MEASUREMENT
/begin MEASUREMENT EGSDCmn_S2B1VirtTarRichOffsParl_I.mO2VirtEnaCatEmptyIK_I.memory "Virtual lambda shifting for IUMPR simulation of range check of rich target sensor voltage with Lambda Offset, bank 1 / Integrator for rich gas mass flow for detection if catalyst is emtpied from oxygen / current integrator value" FLOAT32_IEEE m_q1_mg 1 100 -1.0000E+037 1.0000E+037 FORMAT "%10.4" ECU_ADDRESS 0x50001644 /end MEASUREMENT
/begin MEASUREMENT EGSDCmn_S2B1VirtTarRichOffsParl_I.tiDynWpaRampTONVNM_I.outbit "Virtual lambda shifting for IUMPR simulation of range check of rich target sensor voltage with Lambda Offset, bank 1 / Simulation of a sensor dynamics which corresponds to worst performing acceptable / return value" UBYTE B_TRUE 1 100 0.00 1.00000000000 BIT_MASK 0x1 FORMAT "%13.11" ECU_ADDRESS 0x50001648 /end MEASUREMENT
/begin MEASUREMENT EGSDCmn_S2B1VirtTarRichOffsParl_I.tiDynWpaRampTONVNM_I.time "Virtual lambda shifting for IUMPR simulation of range check of rich target sensor voltage with Lambda Offset, bank 1 / Simulation of a sensor dynamics which corresponds to worst performing acceptable / expired delay time" UWORD t_q0p1 1 100 0.00 6553.500 FORMAT "%8.3" ECU_ADDRESS 0x5000164A /end MEASUREMENT
/begin MEASUREMENT EGSDCmn_S2B1VirtTarRichOffsParl_I.tiLamDynTONV_I.outbit "Virtual lambda shifting for IUMPR simulation of range check of rich target sensor voltage with Lambda Offset, bank 1 / simulation time for sensor dynamic of upstream sensor 1 / return value" UBYTE B_TRUE 1 100 0.00 1.00000000000 BIT_MASK 0x1 FORMAT "%13.11" ECU_ADDRESS 0x5000164C /end MEASUREMENT
/begin MEASUREMENT EGSDCmn_S2B1VirtTarRichOffsParl_I.tiLamDynTONV_I.time "Virtual lambda shifting for IUMPR simulation of range check of rich target sensor voltage with Lambda Offset, bank 1 / simulation time for sensor dynamic of upstream sensor 1 / expired delay time" UWORD t_q0p1 1 100 0.00 6553.500 FORMAT "%8.3" ECU_ADDRESS 0x5000164E /end MEASUREMENT
/begin MEASUREMENT EGSDCmn_S2B1VirtTarRichOffsParl_I.tiUDynTONV_I.outbit "Virtual lambda shifting for IUMPR simulation of range check of rich target sensor voltage with Lambda Offset, bank 1 / simulation time for sensor dynamic of downstream sensor / return value" UBYTE B_TRUE 1 100 0.00 1.00000000000 BIT_MASK 0x1 FORMAT "%13.11" ECU_ADDRESS 0x50001650 /end MEASUREMENT
/begin MEASUREMENT EGSDCmn_S2B1VirtTarRichOffsParl_I.tiUDynTONV_I.time "Virtual lambda shifting for IUMPR simulation of range check of rich target sensor voltage with Lambda Offset, bank 1 / simulation time for sensor dynamic of downstream sensor / expired delay time" UWORD t_q0p1 1 100 0.00 6553.500 FORMAT "%8.3" ECU_ADDRESS 0x50001652 /end MEASUREMENT
/begin MEASUREMENT EGSDCmn_S2B1VirtTarRichParl_I.flgCatEmptyTOut "Virtual lambda shifting for IUMPR simulation of range check of rich target sensor voltage / Time out while checking if catalyst is empty from oxygen" UBYTE B_TRUE 1 100 0.00 1.00000000000 BIT_MASK 0x1 FORMAT "%13.11" ECU_ADDRESS 0x60002DF0 /end MEASUREMENT
/begin MEASUREMENT EGSDCmn_S2B1VirtTarRichParl_I.flgCatFullTOut "Virtual lambda shifting for IUMPR simulation of range check of rich target sensor voltage / Time out while checking if catalyst is filled with oxygen" UBYTE B_TRUE 1 100 0.00 1.00000000000 BIT_MASK 0x1 FORMAT "%13.11" ECU_ADDRESS 0x60002DF1 /end MEASUREMENT
/begin MEASUREMENT EGSDCmn_S2B1VirtTarRichParl_I.flgReld "Virtual lambda shifting for IUMPR simulation of range check of rich target sensor voltage / lambda shifting is released" UBYTE B_TRUE 1 100 0.00 1.00000000000 BIT_MASK 0x1 FORMAT "%13.11" ECU_ADDRESS 0x60002DF2 /end MEASUREMENT
/begin MEASUREMENT EGSDCmn_S2B1VirtTarRichParl_I.flgTarLeanRes "Virtual lambda shifting for IUMPR simulation of range check of rich target sensor voltage / check of lean sensor voltage, result is available" UBYTE B_TRUE 1 100 0.00 1.00000000000 BIT_MASK 0x1 FORMAT "%13.11" ECU_ADDRESS 0x60002DF3 /end MEASUREMENT
/begin MEASUREMENT EGSDCmn_S2B1VirtTarRichParl_I.flgTarRich "Virtual lambda shifting for IUMPR simulation of range check of rich target sensor voltage / Target Rich check is activated" UBYTE B_TRUE 1 100 0.00 1.00000000000 BIT_MASK 0x1 FORMAT "%13.11" ECU_ADDRESS 0x60002DF4 /end MEASUREMENT
/begin MEASUREMENT EGSDCmn_S2B1VirtTarRichParl_I.flgTarRichRes "Virtual lambda shifting for IUMPR simulation of range check of rich target sensor voltage / check of rich sensor voltage, result is available" UBYTE B_TRUE 1 100 0.00 1.00000000000 BIT_MASK 0x1 FORMAT "%13.11" ECU_ADDRESS 0x60002DF5 /end MEASUREMENT
/begin MEASUREMENT EGSDCmn_S2B1VirtTarRichParl_I.flgUHiEnaParl "Virtual lambda shifting for IUMPR simulation of range check of rich target sensor voltage / Sensor voltage downstream is high" UBYTE B_TRUE 1 100 0.00 1.00000000000 BIT_MASK 0x1 FORMAT "%13.11" ECU_ADDRESS 0x60002DF6 /end MEASUREMENT
/begin MEASUREMENT EGSDCmn_S2B1VirtTarRichParl_I.mOSC "Virtual lambda shifting for IUMPR simulation of range check of rich target sensor voltage / Assumed oxygen storage capacity for first catalyst" FLOAT32_IEEE m_q1_mg 1 100 0.00 50000.0000 FORMAT "%10.4" ECU_ADDRESS 0x60002DF8 /end MEASUREMENT
/begin MEASUREMENT EGSDCmn_S2B1VirtTarRichParl_I.mRSC "Virtual lambda shifting for IUMPR simulation of range check of rich target sensor voltage / Assumed rich gas storage capacity for first catalyst" FLOAT32_IEEE m_q1_mg 1 100 0.00 50000.0000 FORMAT "%10.4" ECU_ADDRESS 0x60002DFC /end MEASUREMENT
/begin MEASUREMENT EGSDCmn_S2B1VirtTarRichParl_I.mRampDurParl "Virtual lambda shifting for IUMPR simulation of range check of rich target sensor voltage / Needed amount of exhaust mass during ramp-test" UWORD m_q0p001_kg 1 100 0.00 65.53500 FORMAT "%8.5" ECU_ADDRESS 0x60002E00 /end MEASUREMENT
/begin MEASUREMENT EGSDCmn_S2B1VirtTarRichParl_I.mfEg "Virtual lambda shifting for IUMPR simulation of range check of rich target sensor voltage / Exhaust gas mass flow" UWORD m_q0p1 1 100 0.00 6553.500 FORMAT "%8.3" ECU_ADDRESS 0x60002E02 /end MEASUREMENT
/begin MEASUREMENT EGSDCmn_S2B1VirtTarRichParl_I.mfVirtO2 "Virtual lambda shifting for IUMPR simulation of range check of rich target sensor voltage / Oxygen mass flow in catalyst 1, corrected by maximum possible mixture deviation in a fault free system" FLOAT32_IEEE mgrad_q1_mgdivs 1 100 0.00 50000.0000 FORMAT "%10.4" ECU_ADDRESS 0x60002E04 /end MEASUREMENT
/begin MEASUREMENT EGSDCmn_S2B1VirtTarRichParl_I.mfVirtRich "Virtual lambda shifting for IUMPR simulation of range check of rich target sensor voltage / Rich Gas mass flow in catalyst 1, corrected by maximum possible mixture deviation in a fault free system" FLOAT32_IEEE mgrad_q1_mgdivs 1 100 0.00 50000.0000 FORMAT "%10.4" ECU_ADDRESS 0x60002E08 /end MEASUREMENT
/begin MEASUREMENT EGSDCmn_S2B1VirtTarRichParl_I.ratLamRampLeanParl "Virtual lambda shifting for IUMPR simulation of range check of rich target sensor voltage / Lean Lambda request setpoint during ramping" UWORD fak_uw_b16 1 100 0.00 15.99976 FORMAT "%8.5" ECU_ADDRESS 0x60002E0C /end MEASUREMENT
/begin MEASUREMENT EGSDCmn_S2B1VirtTarRichParl_I.ratLamRampRichParl "Virtual lambda shifting for IUMPR simulation of range check of rich target sensor voltage / Rich Lambda request setpoint during ramping" UWORD fak_uw_b16 1 100 0.00 15.99976 FORMAT "%8.5" ECU_ADDRESS 0x60002E0E /end MEASUREMENT
/begin MEASUREMENT EGSDCmn_S2B1VirtTarRichParl_I.ratLamReq "Virtual lambda shifting for IUMPR simulation of range check of rich target sensor voltage / Requested Lambda value" UWORD fak_uw_b16 1 100 0.00 15.99976 FORMAT "%8.5" ECU_ADDRESS 0x60002E10 /end MEASUREMENT
/begin MEASUREMENT EGSDCmn_S2B1VirtTarRichParl_I.sm "Virtual lambda shifting for IUMPR simulation of range check of rich target sensor voltage / State number" UBYTE EGSDCmn_VirtTarPlausParl_sm_VERB 1 100 0.00 5.00000000000 FORMAT "%13.11" ECU_ADDRESS 0x60002E12 /end MEASUREMENT
/begin MEASUREMENT EGSDCmn_S2B1VirtTarRichParl_I.stLamGenr "Virtual lambda shifting for IUMPR simulation of range check of rich target sensor voltage / State number" UBYTE dez 1 100 0.00 255.0 FORMAT "%5.1" ECU_ADDRESS 0x60002E13 /end MEASUREMENT
/begin MEASUREMENT EGSDCmn_S2B1VirtTarRichParl_I.tiGasRt "Virtual lambda shifting for IUMPR simulation of range check of rich target sensor voltage / gas propagation time till first Lambda sensor" UWORD t_q0p1 1 100 0.00 6553.500 FORMAT "%8.3" ECU_ADDRESS 0x60002E14 /end MEASUREMENT
/begin MEASUREMENT EGSDCmn_S2B1VirtTarRichParl_I.tiLamDynLtr "Virtual lambda shifting for IUMPR simulation of range check of rich target sensor voltage / Dynamic time lambda signal of upstream sensor 1 Lean-Rich" UWORD t_q0p1 1 100 0.00 6553.500 FORMAT "%8.3" ECU_ADDRESS 0x60002E16 /end MEASUREMENT
/begin MEASUREMENT EGSDCmn_S2B1VirtTarRichParl_I.tiLamDynRtl "Virtual lambda shifting for IUMPR simulation of range check of rich target sensor voltage / Dynamic time lambda signal of upstream sensor 1 Rich-Lean" UWORD t_q0p1 1 100 0.00 6553.500 FORMAT "%8.3" ECU_ADDRESS 0x60002E18 /end MEASUREMENT
/begin MEASUREMENT EGSDCmn_S2B1VirtTarRichParl_I.tiUDynLtr "Virtual lambda shifting for IUMPR simulation of range check of rich target sensor voltage / Dynamic reaction time of downstream sensor, Lean-Rich" UWORD t_q0p1 1 100 0.00 6553.500 FORMAT "%8.3" ECU_ADDRESS 0x60002E1A /end MEASUREMENT
/begin MEASUREMENT EGSDCmn_S2B1VirtTarRichParl_I.tiUDynRtl "Virtual lambda shifting for IUMPR simulation of range check of rich target sensor voltage / Dynamic reaction time of downstream sensor, Rich-Lean" UWORD t_q0p1 1 100 0.00 6553.500 FORMAT "%8.3" ECU_ADDRESS 0x60002E1C /end MEASUREMENT
/begin MEASUREMENT EGSDCmn_S2B1VirtTarRichParl_I.EnaReldEF_I.buffer "Virtual lambda shifting for IUMPR simulation of range check of rich target sensor voltage / EdgeFalling: loss of enable condition / memory to detect falling edge" UBYTE B_TRUE 1 100 0.00 1.00000000000 BIT_MASK 0x1 FORMAT "%13.11" ECU_ADDRESS 0x60002E1E /end MEASUREMENT
/begin MEASUREMENT EGSDCmn_S2B1VirtTarRichParl_I.EnaReldEF_I.oldSignal "Virtual lambda shifting for IUMPR simulation of range check of rich target sensor voltage / EdgeFalling: loss of enable condition / memory to detect falling edge" UBYTE B_TRUE 1 100 0.00 1.00000000000 BIT_MASK 0x1 FORMAT "%13.11" ECU_ADDRESS 0x60002E1F /end MEASUREMENT
/begin MEASUREMENT EGSDCmn_S2B1VirtTarRichParl_I.LamRampIKL_I.memory "Virtual lambda shifting for IUMPR simulation of range check of rich target sensor voltage / Integrator to create a ramp shaped lambda request / Current Integrator value" ULONG fak_q3p72529Em9 1 100 0.00 15.9999999963 FORMAT "%13.10" ECU_ADDRESS 0x60002E20 /end MEASUREMENT
/begin MEASUREMENT EGSDCmn_S2B1VirtTarRichParl_I.RampEndLimIK_I.memory "Virtual lambda shifting for IUMPR simulation of range check of rich target sensor voltage / Integrator for calculation of amount of exhaust mass during ramp-test / current integrator value" ULONG m_q1p5259Em8_kg 1 100 0.00 65.5359999847 FORMAT "%13.10" ECU_ADDRESS 0x60002E24 /end MEASUREMENT
/begin MEASUREMENT EGSDCmn_S2B1VirtTarRichParl_I.mO2EnaCatFullGrdtIK_I.memory "Virtual lambda shifting for IUMPR simulation of range check of rich target sensor voltage / Integrator for oxygen gas mass flow for detection if catalyst is filled with oxygen / current integrator value" FLOAT32_IEEE m_q1_mg 1 100 -1.0000E+037 1.0000E+037 FORMAT "%10.4" ECU_ADDRESS 0x60002E28 /end MEASUREMENT
/begin MEASUREMENT EGSDCmn_S2B1VirtTarRichParl_I.mO2VirtEnaCatEmptyIK_I.memory "Virtual lambda shifting for IUMPR simulation of range check of rich target sensor voltage / Integrator for rich gas mass flow for detection if catalyst is emtpied from oxygen / current integrator value" FLOAT32_IEEE m_q1_mg 1 100 -1.0000E+037 1.0000E+037 FORMAT "%10.4" ECU_ADDRESS 0x60002E2C /end MEASUREMENT
/begin MEASUREMENT EGSDCmn_S2B1VirtTarRichParl_I.tiDynWpaRampTONVNM_I.outbit "Virtual lambda shifting for IUMPR simulation of range check of rich target sensor voltage / Simulation of a sensor dynamics which corresponds to worst performing acceptable / return value" UBYTE B_TRUE 1 100 0.00 1.00000000000 BIT_MASK 0x1 FORMAT "%13.11" ECU_ADDRESS 0x60002E30 /end MEASUREMENT
/begin MEASUREMENT EGSDCmn_S2B1VirtTarRichParl_I.tiDynWpaRampTONVNM_I.time "Virtual lambda shifting for IUMPR simulation of range check of rich target sensor voltage / Simulation of a sensor dynamics which corresponds to worst performing acceptable / expired delay time" UWORD t_q0p1 1 100 0.00 6553.500 FORMAT "%8.3" ECU_ADDRESS 0x60002E32 /end MEASUREMENT
/begin MEASUREMENT EGSDCmn_S2B1VirtTarRichParl_I.tiLamDynTONV_I.outbit "Virtual lambda shifting for IUMPR simulation of range check of rich target sensor voltage / simulation time for sensor dynamic of upstream sensor 1 / return value" UBYTE B_TRUE 1 100 0.00 1.00000000000 BIT_MASK 0x1 FORMAT "%13.11" ECU_ADDRESS 0x60002E34 /end MEASUREMENT
/begin MEASUREMENT EGSDCmn_S2B1VirtTarRichParl_I.tiLamDynTONV_I.time "Virtual lambda shifting for IUMPR simulation of range check of rich target sensor voltage / simulation time for sensor dynamic of upstream sensor 1 / expired delay time" UWORD t_q0p1 1 100 0.00 6553.500 FORMAT "%8.3" ECU_ADDRESS 0x60002E36 /end MEASUREMENT
/begin MEASUREMENT EGSDCmn_S2B1VirtTarRichParl_I.tiUDynTONV_I.outbit "Virtual lambda shifting for IUMPR simulation of range check of rich target sensor voltage / simulation time for sensor dynamic of downstream sensor / return value" UBYTE B_TRUE 1 100 0.00 1.00000000000 BIT_MASK 0x1 FORMAT "%13.11" ECU_ADDRESS 0x60002E38 /end MEASUREMENT
/begin MEASUREMENT EGSDCmn_S2B1VirtTarRichParl_I.tiUDynTONV_I.time "Virtual lambda shifting for IUMPR simulation of range check of rich target sensor voltage / simulation time for sensor dynamic of downstream sensor / expired delay time" UWORD t_q0p1 1 100 0.00 6553.500 FORMAT "%8.3" ECU_ADDRESS 0x60002E3A /end MEASUREMENT
/begin MEASUREMENT EGSDCmn_S2B1VirtUDlyParl_I.flgCatEmpty "state machine of virtual lambda shifting for IUMPR simulation of measurement of delay time of sensor voltage from coordinator function of parallelization, bank 1 / Check if catalyst is empty from oxygen" UBYTE B_TRUE 1 100 0.00 1.00000000000 BIT_MASK 0x1 FORMAT "%13.11" ECU_ADDRESS 0x60002DA4 /end MEASUREMENT
/begin MEASUREMENT EGSDCmn_S2B1VirtUDlyParl_I.flgCatFull "state machine of virtual lambda shifting for IUMPR simulation of measurement of delay time of sensor voltage from coordinator function of parallelization, bank 1 / Check if catalyst is filled with oxygen" UBYTE B_TRUE 1 100 0.00 1.00000000000 BIT_MASK 0x1 FORMAT "%13.11" ECU_ADDRESS 0x60002DA5 /end MEASUREMENT
/begin MEASUREMENT EGSDCmn_S2B1VirtUDlyParl_I.flgDynTripDneVirt "state machine of virtual lambda shifting for IUMPR simulation of measurement of delay time of sensor voltage from coordinator function of parallelization, bank 1 / Virtuell dynamic check for the upstream sensor" UBYTE B_TRUE 1 100 0.00 1.00000000000 BIT_MASK 0x1 FORMAT "%13.11" ECU_ADDRESS 0x60002DA6 /end MEASUREMENT
/begin MEASUREMENT EGSDCmn_S2B1VirtUDlyParl_I.flgIdnAdpnEnd "state machine of virtual lambda shifting for IUMPR simulation of measurement of delay time of sensor voltage from coordinator function of parallelization, bank 1 / Status of Online adaption" UBYTE B_TRUE 1 100 0.00 1.00000000000 BIT_MASK 0x1 FORMAT "%13.11" ECU_ADDRESS 0x60002DA7 /end MEASUREMENT
/begin MEASUREMENT EGSDCmn_S2B1VirtUDlyParl_I.flgIdnAdpnLean "state machine of virtual lambda shifting for IUMPR simulation of measurement of delay time of sensor voltage from coordinator function of parallelization, bank 1 / Status of Online adaptionfor lean lambda" UBYTE B_TRUE 1 100 0.00 1.00000000000 BIT_MASK 0x1 FORMAT "%13.11" ECU_ADDRESS 0x60002DA8 /end MEASUREMENT
/begin MEASUREMENT EGSDCmn_S2B1VirtUDlyParl_I.flgIdnAdpnRich "state machine of virtual lambda shifting for IUMPR simulation of measurement of delay time of sensor voltage from coordinator function of parallelization, bank 1 / Status of Online adaptionfor rich lambda" UBYTE B_TRUE 1 100 0.00 1.00000000000 BIT_MASK 0x1 FORMAT "%13.11" ECU_ADDRESS 0x60002DA9 /end MEASUREMENT
/begin MEASUREMENT EGSDCmn_S2B1VirtUDlyParl_I.flgReld "state machine of virtual lambda shifting for IUMPR simulation of measurement of delay time of sensor voltage from coordinator function of parallelization, bank 1 / lambda shifting is released" UBYTE B_TRUE 1 100 0.00 1.00000000000 BIT_MASK 0x1 FORMAT "%13.11" ECU_ADDRESS 0x60002DAA /end MEASUREMENT
/begin MEASUREMENT EGSDCmn_S2B1VirtUDlyParl_I.flgUHiEnaParl "state machine of virtual lambda shifting for IUMPR simulation of measurement of delay time of sensor voltage from coordinator function of parallelization, bank 1 / Sensor voltage downstream is high" UBYTE B_TRUE 1 100 0.00 1.00000000000 BIT_MASK 0x1 FORMAT "%13.11" ECU_ADDRESS 0x60002DAB /end MEASUREMENT
/begin MEASUREMENT EGSDCmn_S2B1VirtUDlyParl_I.flgUMid "state machine of virtual lambda shifting for IUMPR simulation of measurement of delay time of sensor voltage from coordinator function of parallelization, bank 1 / sensor voltage in medium range (two stage preconditioning required)" UBYTE B_TRUE 1 100 0.00 1.00000000000 BIT_MASK 0x1 FORMAT "%13.11" ECU_ADDRESS 0x60002DAC /end MEASUREMENT
/begin MEASUREMENT EGSDCmn_S2B1VirtUDlyParl_I.flgVirtLamDyn "state machine of virtual lambda shifting for IUMPR simulation of measurement of delay time of sensor voltage from coordinator function of parallelization, bank 1 / Activation of IUMPR simulation for UEGO dynamic diagnosis" UBYTE B_TRUE 1 100 0.00 1.00000000000 BIT_MASK 0x1 FORMAT "%13.11" ECU_ADDRESS 0x60002DAD /end MEASUREMENT
/begin MEASUREMENT EGSDCmn_S2B1VirtUDlyParl_I.mOSC "state machine of virtual lambda shifting for IUMPR simulation of measurement of delay time of sensor voltage from coordinator function of parallelization, bank 1 / Assumed oxygen storage capacity for first catalyst" FLOAT32_IEEE m_q1_mg 1 100 0.00 50000.0000 FORMAT "%10.4" ECU_ADDRESS 0x60002DB0 /end MEASUREMENT
/begin MEASUREMENT EGSDCmn_S2B1VirtUDlyParl_I.mRSC "state machine of virtual lambda shifting for IUMPR simulation of measurement of delay time of sensor voltage from coordinator function of parallelization, bank 1 / Assumed rich gas storage capacity for first catalyst" FLOAT32_IEEE m_q1_mg 1 100 0.00 50000.0000 FORMAT "%10.4" ECU_ADDRESS 0x60002DB4 /end MEASUREMENT
/begin MEASUREMENT EGSDCmn_S2B1VirtUDlyParl_I.mfVirtO2 "state machine of virtual lambda shifting for IUMPR simulation of measurement of delay time of sensor voltage from coordinator function of parallelization, bank 1 / Oxygen mass flow in catalyst 1, corrected by maximum possible mixture deviation in a fault free system" FLOAT32_IEEE mgrad_q1_mgdivs 1 100 0.00 50000.0000 FORMAT "%10.4" ECU_ADDRESS 0x60002DB8 /end MEASUREMENT
/begin MEASUREMENT EGSDCmn_S2B1VirtUDlyParl_I.mfVirtRich "state machine of virtual lambda shifting for IUMPR simulation of measurement of delay time of sensor voltage from coordinator function of parallelization, bank 1 / Rich Gas mass flow in catalyst 1, corrected by maximum possible mixture deviation in a fault free system" FLOAT32_IEEE mgrad_q1_mgdivs 1 100 0.00 50000.0000 FORMAT "%10.4" ECU_ADDRESS 0x60002DBC /end MEASUREMENT
/begin MEASUREMENT EGSDCmn_S2B1VirtUDlyParl_I.sm "state machine of virtual lambda shifting for IUMPR simulation of measurement of delay time of sensor voltage from coordinator function of parallelization, bank 1 / State number" UBYTE EGSDCmn_VirtLamGenrParl_sm_VERB 1 100 0.00 7.00000000000 FORMAT "%13.11" ECU_ADDRESS 0x60002DC0 /end MEASUREMENT
/begin MEASUREMENT EGSDCmn_S2B1VirtUDlyParl_I.stLamGenr "state machine of virtual lambda shifting for IUMPR simulation of measurement of delay time of sensor voltage from coordinator function of parallelization, bank 1 / State number" UBYTE dez 1 100 0.00 255.0 FORMAT "%5.1" ECU_ADDRESS 0x60002DC1 /end MEASUREMENT
/begin MEASUREMENT EGSDCmn_S2B1VirtUDlyParl_I.tiGas "state machine of virtual lambda shifting for IUMPR simulation of measurement of delay time of sensor voltage from coordinator function of parallelization, bank 1 / gas propagation time till first Lambda sensor" UWORD t_q0p1 1 100 0.00 6553.500 FORMAT "%8.3" ECU_ADDRESS 0x60002DC2 /end MEASUREMENT
/begin MEASUREMENT EGSDCmn_S2B1VirtUDlyParl_I.tiLamDynLtr "state machine of virtual lambda shifting for IUMPR simulation of measurement of delay time of sensor voltage from coordinator function of parallelization, bank 1 / Dynamic time lambda signal of upstream sensor 1 Lean-Rich" UWORD t_q0p1 1 100 0.00 6553.500 FORMAT "%8.3" ECU_ADDRESS 0x60002DC4 /end MEASUREMENT
/begin MEASUREMENT EGSDCmn_S2B1VirtUDlyParl_I.tiLamDynRtl "state machine of virtual lambda shifting for IUMPR simulation of measurement of delay time of sensor voltage from coordinator function of parallelization, bank 1 / Dynamic time lambda signal of upstream sensor 1 Rich-Lean" UWORD t_q0p1 1 100 0.00 6553.500 FORMAT "%8.3" ECU_ADDRESS 0x60002DC6 /end MEASUREMENT
/begin MEASUREMENT EGSDCmn_S2B1VirtUDlyParl_I.tiUDynLtr "state machine of virtual lambda shifting for IUMPR simulation of measurement of delay time of sensor voltage from coordinator function of parallelization, bank 1 / Dynamic reaction time of downstream sensor, Lean-Rich" UWORD t_q0p1 1 100 0.00 6553.500 FORMAT "%8.3" ECU_ADDRESS 0x60002DC8 /end MEASUREMENT
/begin MEASUREMENT EGSDCmn_S2B1VirtUDlyParl_I.tiUDynRtl "state machine of virtual lambda shifting for IUMPR simulation of measurement of delay time of sensor voltage from coordinator function of parallelization, bank 1 / Dynamic reaction time of downstream sensor, Rich-Lean" UWORD t_q0p1 1 100 0.00 6553.500 FORMAT "%8.3" ECU_ADDRESS 0x60002DCA /end MEASUREMENT
/begin MEASUREMENT EGSDCmn_S2B1VirtUDlyParl_I.u "state machine of virtual lambda shifting for IUMPR simulation of measurement of delay time of sensor voltage from coordinator function of parallelization, bank 1 / Sensor voltage of downstream sensor" UWORD spg_q1p221Em3_V 1 100 0.00 4.998779 FORMAT "%8.6" ECU_ADDRESS 0x60002DCC /end MEASUREMENT
/begin MEASUREMENT EGSDCmn_S2B1VirtUDlyParl_I.EnaReldEF_I.buffer "state machine of virtual lambda shifting for IUMPR simulation of measurement of delay time of sensor voltage from coordinator function of parallelization, bank 1 / EdgeFalling: loss of enable condition / memory to detect falling edge" UBYTE B_TRUE 1 100 0.00 1.00000000000 BIT_MASK 0x1 FORMAT "%13.11" ECU_ADDRESS 0x60002DCE /end MEASUREMENT
/begin MEASUREMENT EGSDCmn_S2B1VirtUDlyParl_I.EnaReldEF_I.oldSignal "state machine of virtual lambda shifting for IUMPR simulation of measurement of delay time of sensor voltage from coordinator function of parallelization, bank 1 / EdgeFalling: loss of enable condition / memory to detect falling edge" UBYTE B_TRUE 1 100 0.00 1.00000000000 BIT_MASK 0x1 FORMAT "%13.11" ECU_ADDRESS 0x60002DCF /end MEASUREMENT
/begin MEASUREMENT EGSDCmn_S2B1VirtUDlyParl_I.IdnAdpnCTR_I.counter "state machine of virtual lambda shifting for IUMPR simulation of measurement of delay time of sensor voltage from coordinator function of parallelization, bank 1 / Counter for lambda jumps for online adaption purposes / current counter value" UWORD dez 1 100 0.00 65535.00 FORMAT "%8.2" ECU_ADDRESS 0x60002DD0 /end MEASUREMENT
/begin MEASUREMENT EGSDCmn_S2B1VirtUDlyParl_I.flgLeanLamStabTONV_I.outbit "state machine of virtual lambda shifting for IUMPR simulation of measurement of delay time of sensor voltage from coordinator function of parallelization, bank 1 / Waiting time for lean lambda stability criterion / return value" UBYTE B_TRUE 1 100 0.00 1.00000000000 BIT_MASK 0x1 FORMAT "%13.11" ECU_ADDRESS 0x60002DD2 /end MEASUREMENT
/begin MEASUREMENT EGSDCmn_S2B1VirtUDlyParl_I.flgLeanLamStabTONV_I.time "state machine of virtual lambda shifting for IUMPR simulation of measurement of delay time of sensor voltage from coordinator function of parallelization, bank 1 / Waiting time for lean lambda stability criterion / expired delay time" UWORD t_q0p1 1 100 0.00 6553.500 FORMAT "%8.3" ECU_ADDRESS 0x60002DD4 /end MEASUREMENT
/begin MEASUREMENT EGSDCmn_S2B1VirtUDlyParl_I.flgRichLamStabTONV_I.outbit "state machine of virtual lambda shifting for IUMPR simulation of measurement of delay time of sensor voltage from coordinator function of parallelization, bank 1 / Waiting time for rich lambda stability criterion / return value" UBYTE B_TRUE 1 100 0.00 1.00000000000 BIT_MASK 0x1 FORMAT "%13.11" ECU_ADDRESS 0x60002DD6 /end MEASUREMENT
/begin MEASUREMENT EGSDCmn_S2B1VirtUDlyParl_I.flgRichLamStabTONV_I.time "state machine of virtual lambda shifting for IUMPR simulation of measurement of delay time of sensor voltage from coordinator function of parallelization, bank 1 / Waiting time for rich lambda stability criterion / expired delay time" UWORD t_q0p1 1 100 0.00 6553.500 FORMAT "%8.3" ECU_ADDRESS 0x60002DD8 /end MEASUREMENT
/begin MEASUREMENT EGSDCmn_S2B1VirtUDlyParl_I.mO2EnaCatFullGrdtIK_I.memory "state machine of virtual lambda shifting for IUMPR simulation of measurement of delay time of sensor voltage from coordinator function of parallelization, bank 1 / Integrator for oxygen gas mass flow for detection if catalyst is filled with oxygen / current integrator value" FLOAT32_IEEE m_q1_mg 1 100 -1.0000E+037 1.0000E+037 FORMAT "%10.4" ECU_ADDRESS 0x60002DDC /end MEASUREMENT
/begin MEASUREMENT EGSDCmn_S2B1VirtUDlyParl_I.mO2IdnAdpnIKL_I.memory "state machine of virtual lambda shifting for IUMPR simulation of measurement of delay time of sensor voltage from coordinator function of parallelization, bank 1 / Integrator for oxygen or rich gas mass flow for lambda jumps for online adaption purposes / Current Integrator value" FLOAT32_IEEE m_q1_mg 1 100 -1.0000E+037 1.0000E+037 FORMAT "%10.4" ECU_ADDRESS 0x60002DE0 /end MEASUREMENT
/begin MEASUREMENT EGSDCmn_S2B1VirtUDlyParl_I.mO2VirtEnaCatEmptyIK_I.memory "state machine of virtual lambda shifting for IUMPR simulation of measurement of delay time of sensor voltage from coordinator function of parallelization, bank 1 / Integrator for rich gas mass flow for detection if catalyst is emtpied from oxygen / current integrator value" FLOAT32_IEEE m_q1_mg 1 100 -1.0000E+037 1.0000E+037 FORMAT "%10.4" ECU_ADDRESS 0x60002DE4 /end MEASUREMENT
/begin MEASUREMENT EGSDCmn_S2B1VirtUDlyParl_I.tiGasRtlTONV_I.outbit "state machine of virtual lambda shifting for IUMPR simulation of measurement of delay time of sensor voltage from coordinator function of parallelization, bank 1 / Simulation of gas propagation till first Lambda sensor / return value" UBYTE B_TRUE 1 100 0.00 1.00000000000 BIT_MASK 0x1 FORMAT "%13.11" ECU_ADDRESS 0x60002DE8 /end MEASUREMENT
/begin MEASUREMENT EGSDCmn_S2B1VirtUDlyParl_I.tiGasRtlTONV_I.time "state machine of virtual lambda shifting for IUMPR simulation of measurement of delay time of sensor voltage from coordinator function of parallelization, bank 1 / Simulation of gas propagation till first Lambda sensor / expired delay time" UWORD t_q0p1 1 100 0.00 6553.500 FORMAT "%8.3" ECU_ADDRESS 0x60002DEA /end MEASUREMENT
/begin MEASUREMENT EGSDCmn_S2B1VirtUDlyParl_I.tiUDynTONV_I.outbit "state machine of virtual lambda shifting for IUMPR simulation of measurement of delay time of sensor voltage from coordinator function of parallelization, bank 1 / simulation time for sensor dynamic of downstream sensor / return value" UBYTE B_TRUE 1 100 0.00 1.00000000000 BIT_MASK 0x1 FORMAT "%13.11" ECU_ADDRESS 0x60002DEC /end MEASUREMENT
/begin MEASUREMENT EGSDCmn_S2B1VirtUDlyParl_I.tiUDynTONV_I.time "state machine of virtual lambda shifting for IUMPR simulation of measurement of delay time of sensor voltage from coordinator function of parallelization, bank 1 / simulation time for sensor dynamic of downstream sensor / expired delay time" UWORD t_q0p1 1 100 0.00 6553.500 FORMAT "%8.3" ECU_ADDRESS 0x60002DEE /end MEASUREMENT
/begin MEASUREMENT EGSDCmn_S2B1VirtUTranParl_I.flgCatEmpty "state machine of virtual lambda shifting for IUMPR simulation of measurement of transition time of sensor voltage from coordinator function of parallelization, bank 1 / Check if catalyst is empty from oxygen" UBYTE B_TRUE 1 100 0.00 1.00000000000 BIT_MASK 0x1 FORMAT "%13.11" ECU_ADDRESS 0x60002D58 /end MEASUREMENT
/begin MEASUREMENT EGSDCmn_S2B1VirtUTranParl_I.flgCatFull "state machine of virtual lambda shifting for IUMPR simulation of measurement of transition time of sensor voltage from coordinator function of parallelization, bank 1 / Check if catalyst is filled with oxygen" UBYTE B_TRUE 1 100 0.00 1.00000000000 BIT_MASK 0x1 FORMAT "%13.11" ECU_ADDRESS 0x60002D59 /end MEASUREMENT
/begin MEASUREMENT EGSDCmn_S2B1VirtUTranParl_I.flgDynTripDneVirt "state machine of virtual lambda shifting for IUMPR simulation of measurement of transition time of sensor voltage from coordinator function of parallelization, bank 1 / Virtuell dynamic check for the upstream sensor" UBYTE B_TRUE 1 100 0.00 1.00000000000 BIT_MASK 0x1 FORMAT "%13.11" ECU_ADDRESS 0x60002D5A /end MEASUREMENT
/begin MEASUREMENT EGSDCmn_S2B1VirtUTranParl_I.flgIdnAdpnEnd "state machine of virtual lambda shifting for IUMPR simulation of measurement of transition time of sensor voltage from coordinator function of parallelization, bank 1 / Status of Online adaption" UBYTE B_TRUE 1 100 0.00 1.00000000000 BIT_MASK 0x1 FORMAT "%13.11" ECU_ADDRESS 0x60002D5B /end MEASUREMENT
/begin MEASUREMENT EGSDCmn_S2B1VirtUTranParl_I.flgIdnAdpnLean "state machine of virtual lambda shifting for IUMPR simulation of measurement of transition time of sensor voltage from coordinator function of parallelization, bank 1 / Status of Online adaptionfor lean lambda" UBYTE B_TRUE 1 100 0.00 1.00000000000 BIT_MASK 0x1 FORMAT "%13.11" ECU_ADDRESS 0x60002D5C /end MEASUREMENT
/begin MEASUREMENT EGSDCmn_S2B1VirtUTranParl_I.flgIdnAdpnRich "state machine of virtual lambda shifting for IUMPR simulation of measurement of transition time of sensor voltage from coordinator function of parallelization, bank 1 / Status of Online adaptionfor rich lambda" UBYTE B_TRUE 1 100 0.00 1.00000000000 BIT_MASK 0x1 FORMAT "%13.11" ECU_ADDRESS 0x60002D5D /end MEASUREMENT
/begin MEASUREMENT EGSDCmn_S2B1VirtUTranParl_I.flgReld "state machine of virtual lambda shifting for IUMPR simulation of measurement of transition time of sensor voltage from coordinator function of parallelization, bank 1 / lambda shifting is released" UBYTE B_TRUE 1 100 0.00 1.00000000000 BIT_MASK 0x1 FORMAT "%13.11" ECU_ADDRESS 0x60002D5E /end MEASUREMENT
/begin MEASUREMENT EGSDCmn_S2B1VirtUTranParl_I.flgUHiEnaParl "state machine of virtual lambda shifting for IUMPR simulation of measurement of transition time of sensor voltage from coordinator function of parallelization, bank 1 / Sensor voltage downstream is high" UBYTE B_TRUE 1 100 0.00 1.00000000000 BIT_MASK 0x1 FORMAT "%13.11" ECU_ADDRESS 0x60002D5F /end MEASUREMENT
/begin MEASUREMENT EGSDCmn_S2B1VirtUTranParl_I.flgUMid "state machine of virtual lambda shifting for IUMPR simulation of measurement of transition time of sensor voltage from coordinator function of parallelization, bank 1 / sensor voltage in medium range (two stage preconditioning required)" UBYTE B_TRUE 1 100 0.00 1.00000000000 BIT_MASK 0x1 FORMAT "%13.11" ECU_ADDRESS 0x60002D60 /end MEASUREMENT
/begin MEASUREMENT EGSDCmn_S2B1VirtUTranParl_I.flgVirtLamDyn "state machine of virtual lambda shifting for IUMPR simulation of measurement of transition time of sensor voltage from coordinator function of parallelization, bank 1 / Activation of IUMPR simulation for UEGO dynamic diagnosis" UBYTE B_TRUE 1 100 0.00 1.00000000000 BIT_MASK 0x1 FORMAT "%13.11" ECU_ADDRESS 0x60002D61 /end MEASUREMENT
/begin MEASUREMENT EGSDCmn_S2B1VirtUTranParl_I.mOSC "state machine of virtual lambda shifting for IUMPR simulation of measurement of transition time of sensor voltage from coordinator function of parallelization, bank 1 / Assumed oxygen storage capacity for first catalyst" FLOAT32_IEEE m_q1_mg 1 100 0.00 50000.0000 FORMAT "%10.4" ECU_ADDRESS 0x60002D64 /end MEASUREMENT
/begin MEASUREMENT EGSDCmn_S2B1VirtUTranParl_I.mRSC "state machine of virtual lambda shifting for IUMPR simulation of measurement of transition time of sensor voltage from coordinator function of parallelization, bank 1 / Assumed rich gas storage capacity for first catalyst" FLOAT32_IEEE m_q1_mg 1 100 0.00 50000.0000 FORMAT "%10.4" ECU_ADDRESS 0x60002D68 /end MEASUREMENT
/begin MEASUREMENT EGSDCmn_S2B1VirtUTranParl_I.mfVirtO2 "state machine of virtual lambda shifting for IUMPR simulation of measurement of transition time of sensor voltage from coordinator function of parallelization, bank 1 / Oxygen mass flow in catalyst 1, corrected by maximum possible mixture deviation in a fault free system" FLOAT32_IEEE mgrad_q1_mgdivs 1 100 0.00 50000.0000 FORMAT "%10.4" ECU_ADDRESS 0x60002D6C /end MEASUREMENT
/begin MEASUREMENT EGSDCmn_S2B1VirtUTranParl_I.mfVirtRich "state machine of virtual lambda shifting for IUMPR simulation of measurement of transition time of sensor voltage from coordinator function of parallelization, bank 1 / Rich Gas mass flow in catalyst 1, corrected by maximum possible mixture deviation in a fault free system" FLOAT32_IEEE mgrad_q1_mgdivs 1 100 0.00 50000.0000 FORMAT "%10.4" ECU_ADDRESS 0x60002D70 /end MEASUREMENT
/begin MEASUREMENT EGSDCmn_S2B1VirtUTranParl_I.sm "state machine of virtual lambda shifting for IUMPR simulation of measurement of transition time of sensor voltage from coordinator function of parallelization, bank 1 / State number" UBYTE EGSDCmn_VirtLamGenrParl_sm_VERB 1 100 0.00 7.00000000000 FORMAT "%13.11" ECU_ADDRESS 0x60002D74 /end MEASUREMENT
/begin MEASUREMENT EGSDCmn_S2B1VirtUTranParl_I.stLamGenr "state machine of virtual lambda shifting for IUMPR simulation of measurement of transition time of sensor voltage from coordinator function of parallelization, bank 1 / State number" UBYTE dez 1 100 0.00 255.0 FORMAT "%5.1" ECU_ADDRESS 0x60002D75 /end MEASUREMENT
/begin MEASUREMENT EGSDCmn_S2B1VirtUTranParl_I.tiGas "state machine of virtual lambda shifting for IUMPR simulation of measurement of transition time of sensor voltage from coordinator function of parallelization, bank 1 / gas propagation time till first Lambda sensor" UWORD t_q0p1 1 100 0.00 6553.500 FORMAT "%8.3" ECU_ADDRESS 0x60002D76 /end MEASUREMENT
/begin MEASUREMENT EGSDCmn_S2B1VirtUTranParl_I.tiLamDynLtr "state machine of virtual lambda shifting for IUMPR simulation of measurement of transition time of sensor voltage from coordinator function of parallelization, bank 1 / Dynamic time lambda signal of upstream sensor 1 Lean-Rich" UWORD t_q0p1 1 100 0.00 6553.500 FORMAT "%8.3" ECU_ADDRESS 0x60002D78 /end MEASUREMENT
/begin MEASUREMENT EGSDCmn_S2B1VirtUTranParl_I.tiLamDynRtl "state machine of virtual lambda shifting for IUMPR simulation of measurement of transition time of sensor voltage from coordinator function of parallelization, bank 1 / Dynamic time lambda signal of upstream sensor 1 Rich-Lean" UWORD t_q0p1 1 100 0.00 6553.500 FORMAT "%8.3" ECU_ADDRESS 0x60002D7A /end MEASUREMENT
/begin MEASUREMENT EGSDCmn_S2B1VirtUTranParl_I.tiUDynLtr "state machine of virtual lambda shifting for IUMPR simulation of measurement of transition time of sensor voltage from coordinator function of parallelization, bank 1 / Dynamic reaction time of downstream sensor, Lean-Rich" UWORD t_q0p1 1 100 0.00 6553.500 FORMAT "%8.3" ECU_ADDRESS 0x60002D7C /end MEASUREMENT
/begin MEASUREMENT EGSDCmn_S2B1VirtUTranParl_I.tiUDynRtl "state machine of virtual lambda shifting for IUMPR simulation of measurement of transition time of sensor voltage from coordinator function of parallelization, bank 1 / Dynamic reaction time of downstream sensor, Rich-Lean" UWORD t_q0p1 1 100 0.00 6553.500 FORMAT "%8.3" ECU_ADDRESS 0x60002D7E /end MEASUREMENT
/begin MEASUREMENT EGSDCmn_S2B1VirtUTranParl_I.u "state machine of virtual lambda shifting for IUMPR simulation of measurement of transition time of sensor voltage from coordinator function of parallelization, bank 1 / Sensor voltage of downstream sensor" UWORD spg_q1p221Em3_V 1 100 0.00 4.998779 FORMAT "%8.6" ECU_ADDRESS 0x60002D80 /end MEASUREMENT
/begin MEASUREMENT EGSDCmn_S2B1VirtUTranParl_I.EnaReldEF_I.buffer "state machine of virtual lambda shifting for IUMPR simulation of measurement of transition time of sensor voltage from coordinator function of parallelization, bank 1 / EdgeFalling: loss of enable condition / memory to detect falling edge" UBYTE B_TRUE 1 100 0.00 1.00000000000 BIT_MASK 0x1 FORMAT "%13.11" ECU_ADDRESS 0x60002D82 /end MEASUREMENT
/begin MEASUREMENT EGSDCmn_S2B1VirtUTranParl_I.EnaReldEF_I.oldSignal "state machine of virtual lambda shifting for IUMPR simulation of measurement of transition time of sensor voltage from coordinator function of parallelization, bank 1 / EdgeFalling: loss of enable condition / memory to detect falling edge" UBYTE B_TRUE 1 100 0.00 1.00000000000 BIT_MASK 0x1 FORMAT "%13.11" ECU_ADDRESS 0x60002D83 /end MEASUREMENT
/begin MEASUREMENT EGSDCmn_S2B1VirtUTranParl_I.IdnAdpnCTR_I.counter "state machine of virtual lambda shifting for IUMPR simulation of measurement of transition time of sensor voltage from coordinator function of parallelization, bank 1 / Counter for lambda jumps for online adaption purposes / current counter value" UWORD dez 1 100 0.00 65535.00 FORMAT "%8.2" ECU_ADDRESS 0x60002D84 /end MEASUREMENT
/begin MEASUREMENT EGSDCmn_S2B1VirtUTranParl_I.flgLeanLamStabTONV_I.outbit "state machine of virtual lambda shifting for IUMPR simulation of measurement of transition time of sensor voltage from coordinator function of parallelization, bank 1 / Waiting time for lean lambda stability criterion / return value" UBYTE B_TRUE 1 100 0.00 1.00000000000 BIT_MASK 0x1 FORMAT "%13.11" ECU_ADDRESS 0x60002D86 /end MEASUREMENT
/begin MEASUREMENT EGSDCmn_S2B1VirtUTranParl_I.flgLeanLamStabTONV_I.time "state machine of virtual lambda shifting for IUMPR simulation of measurement of transition time of sensor voltage from coordinator function of parallelization, bank 1 / Waiting time for lean lambda stability criterion / expired delay time" UWORD t_q0p1 1 100 0.00 6553.500 FORMAT "%8.3" ECU_ADDRESS 0x60002D88 /end MEASUREMENT
/begin MEASUREMENT EGSDCmn_S2B1VirtUTranParl_I.flgRichLamStabTONV_I.outbit "state machine of virtual lambda shifting for IUMPR simulation of measurement of transition time of sensor voltage from coordinator function of parallelization, bank 1 / Waiting time for rich lambda stability criterion / return value" UBYTE B_TRUE 1 100 0.00 1.00000000000 BIT_MASK 0x1 FORMAT "%13.11" ECU_ADDRESS 0x60002D8A /end MEASUREMENT
/begin MEASUREMENT EGSDCmn_S2B1VirtUTranParl_I.flgRichLamStabTONV_I.time "state machine of virtual lambda shifting for IUMPR simulation of measurement of transition time of sensor voltage from coordinator function of parallelization, bank 1 / Waiting time for rich lambda stability criterion / expired delay time" UWORD t_q0p1 1 100 0.00 6553.500 FORMAT "%8.3" ECU_ADDRESS 0x60002D8C /end MEASUREMENT
/begin MEASUREMENT EGSDCmn_S2B1VirtUTranParl_I.mO2EnaCatFullGrdtIK_I.memory "state machine of virtual lambda shifting for IUMPR simulation of measurement of transition time of sensor voltage from coordinator function of parallelization, bank 1 / Integrator for oxygen gas mass flow for detection if catalyst is filled with oxygen / current integrator value" FLOAT32_IEEE m_q1_mg 1 100 -1.0000E+037 1.0000E+037 FORMAT "%10.4" ECU_ADDRESS 0x60002D90 /end MEASUREMENT
/begin MEASUREMENT EGSDCmn_S2B1VirtUTranParl_I.mO2IdnAdpnIKL_I.memory "state machine of virtual lambda shifting for IUMPR simulation of measurement of transition time of sensor voltage from coordinator function of parallelization, bank 1 / Integrator for oxygen or rich gas mass flow for lambda jumps for online adaption purposes / Current Integrator value" FLOAT32_IEEE m_q1_mg 1 100 -1.0000E+037 1.0000E+037 FORMAT "%10.4" ECU_ADDRESS 0x60002D94 /end MEASUREMENT
/begin MEASUREMENT EGSDCmn_S2B1VirtUTranParl_I.mO2VirtEnaCatEmptyIK_I.memory "state machine of virtual lambda shifting for IUMPR simulation of measurement of transition time of sensor voltage from coordinator function of parallelization, bank 1 / Integrator for rich gas mass flow for detection if catalyst is emtpied from oxygen / current integrator value" FLOAT32_IEEE m_q1_mg 1 100 -1.0000E+037 1.0000E+037 FORMAT "%10.4" ECU_ADDRESS 0x60002D98 /end MEASUREMENT
/begin MEASUREMENT EGSDCmn_S2B1VirtUTranParl_I.tiGasRtlTONV_I.outbit "state machine of virtual lambda shifting for IUMPR simulation of measurement of transition time of sensor voltage from coordinator function of parallelization, bank 1 / Simulation of gas propagation till first Lambda sensor / return value" UBYTE B_TRUE 1 100 0.00 1.00000000000 BIT_MASK 0x1 FORMAT "%13.11" ECU_ADDRESS 0x60002D9C /end MEASUREMENT
/begin MEASUREMENT EGSDCmn_S2B1VirtUTranParl_I.tiGasRtlTONV_I.time "state machine of virtual lambda shifting for IUMPR simulation of measurement of transition time of sensor voltage from coordinator function of parallelization, bank 1 / Simulation of gas propagation till first Lambda sensor / expired delay time" UWORD t_q0p1 1 100 0.00 6553.500 FORMAT "%8.3" ECU_ADDRESS 0x60002D9E /end MEASUREMENT
/begin MEASUREMENT EGSDCmn_S2B1VirtUTranParl_I.tiUDynTONV_I.outbit "state machine of virtual lambda shifting for IUMPR simulation of measurement of transition time of sensor voltage from coordinator function of parallelization, bank 1 / simulation time for sensor dynamic of downstream sensor / return value" UBYTE B_TRUE 1 100 0.00 1.00000000000 BIT_MASK 0x1 FORMAT "%13.11" ECU_ADDRESS 0x60002DA0 /end MEASUREMENT
/begin MEASUREMENT EGSDCmn_S2B1VirtUTranParl_I.tiUDynTONV_I.time "state machine of virtual lambda shifting for IUMPR simulation of measurement of transition time of sensor voltage from coordinator function of parallelization, bank 1 / simulation time for sensor dynamic of downstream sensor / expired delay time" UWORD t_q0p1 1 100 0.00 6553.500 FORMAT "%8.3" ECU_ADDRESS 0x60002DA2 /end MEASUREMENT
/begin MEASUREMENT EGSDCmn_Seg1B1EnaLamCdnFF_I.status "Flipflop: lambda is in range in advance of parallelization, segment 1, bank 1 / current value of RS-FF" UBYTE B_TRUE 1 100 0.00 1.00000000000 BIT_MASK 0x1 FORMAT "%13.11" ECU_ADDRESS 0x6000B20D /end MEASUREMENT
/begin MEASUREMENT EGSDCmn_Seg1B1EnaRngMfHiParl_I.flgEnaRng "Massflow range check / Range check successfull" UBYTE B_TRUE 1 100 0.00 1.00000000000 BIT_MASK 0x1 FORMAT "%13.11" ECU_ADDRESS 0x6000B20C /end MEASUREMENT
/begin MEASUREMENT EGSDCmn_Seg1B1EnaRngMfLoParl_I.flgEnaRng "Massflow range check / Range check successfull" UBYTE B_TRUE 1 100 0.00 1.00000000000 BIT_MASK 0x1 FORMAT "%13.11" ECU_ADDRESS 0x6000B20B /end MEASUREMENT
/begin MEASUREMENT EGSDCmn_Seg1B1EnaRngTHiParl_I.flgEnaRng "Temperature range check / Range check successfull" UBYTE B_TRUE 1 100 0.00 1.00000000000 BIT_MASK 0x1 FORMAT "%13.11" ECU_ADDRESS 0x6000B20A /end MEASUREMENT
/begin MEASUREMENT EGSDCmn_Seg1B1EnaRngTLoParl_I.flgEnaRng "Temperature range check / Range check successfull" UBYTE B_TRUE 1 100 0.00 1.00000000000 BIT_MASK 0x1 FORMAT "%13.11" ECU_ADDRESS 0x6000B209 /end MEASUREMENT
/begin MEASUREMENT EGSDCmn_Seg1B1LamRampLeanVirtParl_I.flgLamReq "Class instance: virtual lean lambda ramp / lambda request is active" UBYTE B_TRUE 1 100 0.00 1.00000000000 BIT_MASK 0x1 FORMAT "%13.11" ECU_ADDRESS 0x50001654 /end MEASUREMENT
/begin MEASUREMENT EGSDCmn_Seg1B1LamRampLeanVirtParl_I.flgLeanRampEnd "Class instance: virtual lean lambda ramp / lean lambda ramp is expired" UBYTE B_TRUE 1 100 0.00 1.00000000000 BIT_MASK 0x1 FORMAT "%13.11" ECU_ADDRESS 0x50001655 /end MEASUREMENT
/begin MEASUREMENT EGSDCmn_Seg1B1LamRampLeanVirtParl_I.flgRampDurEnd "Class instance: virtual lean lambda ramp / lambda ramp is expired" UBYTE B_TRUE 1 100 0.00 1.00000000000 BIT_MASK 0x1 FORMAT "%13.11" ECU_ADDRESS 0x50001656 /end MEASUREMENT
/begin MEASUREMENT EGSDCmn_Seg1B1LamRampLeanVirtParl_I.flgRichRampEnd "Class instance: virtual lean lambda ramp / rich lambda ramp is expired" UBYTE B_TRUE 1 100 0.00 1.00000000000 BIT_MASK 0x1 FORMAT "%13.11" ECU_ADDRESS 0x50001657 /end MEASUREMENT
/begin MEASUREMENT EGSDCmn_Seg1B1LamRampLeanVirtParl_I.mRampEndLim "Class instance: virtual lean lambda ramp / Oxygen intgeral during lambda ramp" UWORD m_q0p001_kg 1 100 0.00 65.53500 FORMAT "%8.5" ECU_ADDRESS 0x50001658 /end MEASUREMENT
/begin MEASUREMENT EGSDCmn_Seg1B1LamRampLeanVirtParl_I.ratLamReq "Class instance: virtual lean lambda ramp / requested lambda" UWORD fak_uw_b16 1 100 0.00 15.99976 FORMAT "%8.5" ECU_ADDRESS 0x5000165A /end MEASUREMENT
/begin MEASUREMENT EGSDCmn_Seg1B1LamRampLeanVirtParl_I.tiObsvrTOut "Class instance: virtual lean lambda ramp / measured time until timeout flag is set" UWORD t_q0p01 1 100 0.00 655.3500 FORMAT "%8.4" ECU_ADDRESS 0x5000165C /end MEASUREMENT
/begin MEASUREMENT EGSDCmn_Seg1B1LamRampLeanVirtParl_I.DynErrRampTONVNM_I.time "Class instance: virtual lean lambda ramp / simulation time for sensor dynamic to calculation for ramp duration / Delay Time" UWORD t_q0p01 1 100 0.00 655.3500 FORMAT "%8.4" ECU_ADDRESS 0x5000165E /end MEASUREMENT
/begin MEASUREMENT EGSDCmn_Seg1B1LamRampLeanVirtParl_I.LamRampIKL_I.memory "Class instance: virtual lean lambda ramp / lambda ramp / Current Integrator value" ULONG fak_q3p72529Em9 1 100 0.00 15.9999999963 FORMAT "%13.10" ECU_ADDRESS 0x50001660 /end MEASUREMENT
/begin MEASUREMENT EGSDCmn_Seg1B1LamRampLeanVirtParl_I.RampEndLimIK_I.memory "Class instance: virtual lean lambda ramp / integrated exhaust gas mass flow during lambda rampe / current integrator value" ULONG m_q1p5259Em8_kg 1 100 0.00 65.5359999847 FORMAT "%13.10" ECU_ADDRESS 0x50001664 /end MEASUREMENT
/begin MEASUREMENT EGSDCmn_Seg1B1LamRampLeanVirtParl_I.tiObsvrTOutSW_I.timeCounter "Class instance: virtual lean lambda ramp / measurement of the time until timeout flag is set / expired time since start" UWORD t_q0p01 1 100 0.00 655.3500 FORMAT "%8.4" ECU_ADDRESS 0x50001668 /end MEASUREMENT
/begin MEASUREMENT EGSDCmn_Seg1B1LamRampParl_I.flgLamReq "Class instance: lambda ramp / lambda request is active" UBYTE B_TRUE 1 100 0.00 1.00000000000 BIT_MASK 0x1 FORMAT "%13.11" ECU_ADDRESS 0x60012568 /end MEASUREMENT
/begin MEASUREMENT EGSDCmn_Seg1B1LamRampParl_I.flgLeanRampEnd "Class instance: lambda ramp / lean lambda ramp is expired" UBYTE B_TRUE 1 100 0.00 1.00000000000 BIT_MASK 0x1 FORMAT "%13.11" ECU_ADDRESS 0x60012569 /end MEASUREMENT
/begin MEASUREMENT EGSDCmn_Seg1B1LamRampParl_I.flgRampDurEnd "Class instance: lambda ramp / lambda ramp is expired" UBYTE B_TRUE 1 100 0.00 1.00000000000 BIT_MASK 0x1 FORMAT "%13.11" ECU_ADDRESS 0x6001256A /end MEASUREMENT
/begin MEASUREMENT EGSDCmn_Seg1B1LamRampParl_I.flgRichRampEnd "Class instance: lambda ramp / rich lambda ramp is expired" UBYTE B_TRUE 1 100 0.00 1.00000000000 BIT_MASK 0x1 FORMAT "%13.11" ECU_ADDRESS 0x6001256B /end MEASUREMENT
/begin MEASUREMENT EGSDCmn_Seg1B1LamRampParl_I.mRampEndLim "Class instance: lambda ramp / Oxygen intgeral during lambda ramp" UWORD m_q0p001_kg 1 100 0.00 65.53500 FORMAT "%8.5" ECU_ADDRESS 0x6001256C /end MEASUREMENT
/begin MEASUREMENT EGSDCmn_Seg1B1LamRampParl_I.ratLamReq "Class instance: lambda ramp / requested lambda" UWORD fak_uw_b16 1 100 0.00 15.99976 FORMAT "%8.5" ECU_ADDRESS 0x6001256E /end MEASUREMENT
/begin MEASUREMENT EGSDCmn_Seg1B1LamRampParl_I.tiObsvrTOut "Class instance: lambda ramp / measured time until timeout flag is set" UWORD t_q0p01 1 100 0.00 655.3500 FORMAT "%8.4" ECU_ADDRESS 0x60012570 /end MEASUREMENT
/begin MEASUREMENT EGSDCmn_Seg1B1LamRampParl_I.DynErrRampTONVNM_I.time "Class instance: lambda ramp / simulation time for sensor dynamic to calculation for ramp duration / Delay Time" UWORD t_q0p01 1 100 0.00 655.3500 FORMAT "%8.4" ECU_ADDRESS 0x60012572 /end MEASUREMENT
/begin MEASUREMENT EGSDCmn_Seg1B1LamRampParl_I.LamRampIKL_I.memory "Class instance: lambda ramp / lambda ramp / Current Integrator value" ULONG fak_q3p72529Em9 1 100 0.00 15.9999999963 FORMAT "%13.10" ECU_ADDRESS 0x60012574 /end MEASUREMENT
/begin MEASUREMENT EGSDCmn_Seg1B1LamRampParl_I.RampEndLimIK_I.memory "Class instance: lambda ramp / integrated exhaust gas mass flow during lambda rampe / current integrator value" ULONG m_q1p5259Em8_kg 1 100 0.00 65.5359999847 FORMAT "%13.10" ECU_ADDRESS 0x60012578 /end MEASUREMENT
/begin MEASUREMENT EGSDCmn_Seg1B1LamRampParl_I.tiObsvrTOutSW_I.timeCounter "Class instance: lambda ramp / measurement of the time until timeout flag is set / expired time since start" UWORD t_q0p01 1 100 0.00 655.3500 FORMAT "%8.4" ECU_ADDRESS 0x6001257C /end MEASUREMENT
/begin MEASUREMENT EGSDCmn_Seg1B1LamRampRichVirtParl_I.flgLamReq "Class instance: virtual rich lambda ramp / lambda request is active" UBYTE B_TRUE 1 100 0.00 1.00000000000 BIT_MASK 0x1 FORMAT "%13.11" ECU_ADDRESS 0x5000166C /end MEASUREMENT
/begin MEASUREMENT EGSDCmn_Seg1B1LamRampRichVirtParl_I.flgLeanRampEnd "Class instance: virtual rich lambda ramp / lean lambda ramp is expired" UBYTE B_TRUE 1 100 0.00 1.00000000000 BIT_MASK 0x1 FORMAT "%13.11" ECU_ADDRESS 0x5000166D /end MEASUREMENT
/begin MEASUREMENT EGSDCmn_Seg1B1LamRampRichVirtParl_I.flgRampDurEnd "Class instance: virtual rich lambda ramp / lambda ramp is expired" UBYTE B_TRUE 1 100 0.00 1.00000000000 BIT_MASK 0x1 FORMAT "%13.11" ECU_ADDRESS 0x5000166E /end MEASUREMENT
/begin MEASUREMENT EGSDCmn_Seg1B1LamRampRichVirtParl_I.flgRichRampEnd "Class instance: virtual rich lambda ramp / rich lambda ramp is expired" UBYTE B_TRUE 1 100 0.00 1.00000000000 BIT_MASK 0x1 FORMAT "%13.11" ECU_ADDRESS 0x5000166F /end MEASUREMENT
/begin MEASUREMENT EGSDCmn_Seg1B1LamRampRichVirtParl_I.mRampEndLim "Class instance: virtual rich lambda ramp / Oxygen intgeral during lambda ramp" UWORD m_q0p001_kg 1 100 0.00 65.53500 FORMAT "%8.5" ECU_ADDRESS 0x50001670 /end MEASUREMENT
/begin MEASUREMENT EGSDCmn_Seg1B1LamRampRichVirtParl_I.ratLamReq "Class instance: virtual rich lambda ramp / requested lambda" UWORD fak_uw_b16 1 100 0.00 15.99976 FORMAT "%8.5" ECU_ADDRESS 0x50001672 /end MEASUREMENT
/begin MEASUREMENT EGSDCmn_Seg1B1LamRampRichVirtParl_I.tiObsvrTOut "Class instance: virtual rich lambda ramp / measured time until timeout flag is set" UWORD t_q0p01 1 100 0.00 655.3500 FORMAT "%8.4" ECU_ADDRESS 0x50001674 /end MEASUREMENT
/begin MEASUREMENT EGSDCmn_Seg1B1LamRampRichVirtParl_I.DynErrRampTONVNM_I.time "Class instance: virtual rich lambda ramp / simulation time for sensor dynamic to calculation for ramp duration / Delay Time" UWORD t_q0p01 1 100 0.00 655.3500 FORMAT "%8.4" ECU_ADDRESS 0x50001676 /end MEASUREMENT
/begin MEASUREMENT EGSDCmn_Seg1B1LamRampRichVirtParl_I.LamRampIKL_I.memory "Class instance: virtual rich lambda ramp / lambda ramp / Current Integrator value" ULONG fak_q3p72529Em9 1 100 0.00 15.9999999963 FORMAT "%13.10" ECU_ADDRESS 0x50001678 /end MEASUREMENT
/begin MEASUREMENT EGSDCmn_Seg1B1LamRampRichVirtParl_I.RampEndLimIK_I.memory "Class instance: virtual rich lambda ramp / integrated exhaust gas mass flow during lambda rampe / current integrator value" ULONG m_q1p5259Em8_kg 1 100 0.00 65.5359999847 FORMAT "%13.10" ECU_ADDRESS 0x5000167C /end MEASUREMENT
/begin MEASUREMENT EGSDCmn_Seg1B1LamRampRichVirtParl_I.tiObsvrTOutSW_I.timeCounter "Class instance: virtual rich lambda ramp / measurement of the time until timeout flag is set / expired time since start" UWORD t_q0p01 1 100 0.00 655.3500 FORMAT "%8.4" ECU_ADDRESS 0x50001680 /end MEASUREMENT
/begin MEASUREMENT EGSDCmn_stEnaGlbPrtlParl "Statusbitword of all project unspecific enable conditions" UWORD OneToOne 1 100 0.00 65535.00 FORMAT "%8.2" ECU_ADDRESS 0x60007326 /end MEASUREMENT
/begin MEASUREMENT EGSDCmn_TarChkS2B1_I.flgTarLeanOK "Target check diagnosis / lean voltage reached" UBYTE B_TRUE 1 100 0.00 1.00000000000 BIT_MASK 0x1 FORMAT "%13.11" ECU_ADDRESS 0x500054A6 /end MEASUREMENT
/begin MEASUREMENT EGSDCmn_TarChkS2B1_I.flgTarRichOK "Target check diagnosis / Target sensor voltage in rich is reached" UBYTE B_TRUE 1 100 0.00 1.00000000000 BIT_MASK 0x1 FORMAT "%13.11" ECU_ADDRESS 0x500054A7 /end MEASUREMENT
/begin MEASUREMENT EGSDCmn_TarChkS2B1_I.stLamGenrParlOld "Target check diagnosis / Status of lambda shifting of parallelization (old value)" UBYTE dez 1 100 0.00 255.0 FORMAT "%5.1" ECU_ADDRESS 0x500054A8 /end MEASUREMENT
/begin MEASUREMENT EGSDCmn_TarChkS2B1_I.uCatEmptyMax "Target check diagnosis / highest reached sensor voltage" UWORD spg_q1p221Em3_V 1 100 0.00 4.998779 FORMAT "%8.6" ECU_ADDRESS 0x500054AA /end MEASUREMENT
/begin MEASUREMENT EGSDCmn_TarChkS2B1_I.uCatFullMin "Target check diagnosis / lowest reached sensor voltage" UWORD spg_q1p221Em3_V 1 100 0.00 4.998779 FORMAT "%8.6" ECU_ADDRESS 0x500054AC /end MEASUREMENT
/begin MEASUREMENT EGSDCmn_tGrdtParlB1 "Temperature gradient of catalyst 1, bank 1" SWORD temp_q0p0234 1 100 -768.0000 767.9766 FORMAT "%8.4" ECU_ADDRESS 0x6001332E /end MEASUREMENT
/begin MEASUREMENT EGSDCmn_tiEngIdleSW_I.timeCounter "Stop watch to detect time of engine in idle or fuel cut off / expired time since start" UWORD t_q0p1 1 100 0.00 6553.500 FORMAT "%8.3" ECU_ADDRESS 0x60007302 /end MEASUREMENT
/begin MEASUREMENT EGSDCmn_tiGasRtB1 "gas runtime" UWORD t_q0p1 1 100 0.00 6553.500 FORMAT "%8.3" ECU_ADDRESS 0x6000733A /end MEASUREMENT
/begin MEASUREMENT EGSDCmn_tiLamDynLtrParlB1 "Dynamic time of the first sensor lean to rich" UWORD t_q0p1 1 100 0.00 6553.500 FORMAT "%8.3" ECU_ADDRESS 0x60007338 /end MEASUREMENT
/begin MEASUREMENT EGSDCmn_tiLamDynRtlParlB1 "Dynamic time of the first sensor rich to lean" UWORD t_q0p1 1 100 0.00 6553.500 FORMAT "%8.3" ECU_ADDRESS 0x60007336 /end MEASUREMENT
/begin MEASUREMENT EGSDCmn_tiUS2DynLtrEvlnParlB1 "Dynamic time of the second sensor lean to rich" UWORD t_q0p1 1 100 0.00 6553.500 FORMAT "%8.3" ECU_ADDRESS 0x60007334 /end MEASUREMENT
/begin MEASUREMENT EGSDCmn_tiUS2DynRtlEvlnParlB1 "Dynamic time of the second sensor rich to lean" UWORD t_q0p1 1 100 0.00 6553.500 FORMAT "%8.3" ECU_ADDRESS 0x60007332 /end MEASUREMENT
/begin MEASUREMENT EGSDCmn_tMinCatRelsParlB1FF_I.status "Part of heat up condition: temperature of catalyst has reached min threashold. / current value of RS-FF" UBYTE B_TRUE 1 100 0.00 1.00000000000 BIT_MASK 0x1 FORMAT "%13.11" ECU_ADDRESS 0x6000B206 /end MEASUREMENT
/begin MEASUREMENT EGSDCmn_tqResvParl "torque reserve during parallelization" SWORD trq_q0p1 1 100 -3276.800 3276.700 FORMAT "%8.3" ECU_ADDRESS 0x60013E8C /end MEASUREMENT
/begin MEASUREMENT EGSDCmn_TqResvParlITL_I.memory "Integrator of torque reserve during parallelization / current integrator value" SLONG md_q1p526Em6 1 100 -3276.80000000 3276.79999847 FORMAT "%13.8" ECU_ADDRESS 0x50001684 /end MEASUREMENT
/begin MEASUREMENT EGSDCmn_uCatEmptyGrdtParl "voltage threshold for the catalyst is empty of oxygen" UWORD spg_q1p221Em3_V 1 100 0.00 4.998779 FORMAT "%8.6" ECU_ADDRESS 0x60008C86 /end MEASUREMENT
/begin MEASUREMENT EGSDCmn_uCatEmptyGrdtPreCdnParl "voltage threshold for the catalyst is empty of oxygen" UWORD spg_q1p221Em3_V 1 100 0.00 4.998779 FORMAT "%8.6" ECU_ADDRESS 0x60008C84 /end MEASUREMENT
/begin MEASUREMENT EGSDCmn_uCatEmptyParl "voltage threshold for the catalyst is empty of oxygen" UWORD spg_q1p221Em3_V 1 100 0.00 4.998779 FORMAT "%8.6" ECU_ADDRESS 0x60008C82 /end MEASUREMENT
/begin MEASUREMENT EGSDCmn_uCatFullGrdtParl "voltage threshold for the catalyst is full of oxygen" UWORD spg_q1p221Em3_V 1 100 0.00 4.998779 FORMAT "%8.6" ECU_ADDRESS 0x60008C80 /end MEASUREMENT
/begin MEASUREMENT EGSDCmn_uCatFullGrdtPreCdnParl "voltage threshold for the catalyst is full of oxygen" UWORD spg_q1p221Em3_V 1 100 0.00 4.998779 FORMAT "%8.6" ECU_ADDRESS 0x60008C7E /end MEASUREMENT
/begin MEASUREMENT EGSDCmn_uCatFullParl "voltage threshold for the catalyst is full of oxygen" UWORD spg_q1p221Em3_V 1 100 0.00 4.998779 FORMAT "%8.6" ECU_ADDRESS 0x60008C7C /end MEASUREMENT
/begin MEASUREMENT EGSDCmn_uS2B1Grdt_I.duSnsr "Calculation of the binary voltage gradient / voltage gradient" SWORD spgg_q0p002029_V_DIV_s 1 100 -66.50000 66.49797 FORMAT "%8.5" ECU_ADDRESS 0x500054B2 /end MEASUREMENT
/begin MEASUREMENT EGSDCmn_uS2B1Grdt_I.idxInp "Calculation of the binary voltage gradient / Index" UBYTE dez 1 100 0.00 10.00 FORMAT "%5.2" ECU_ADDRESS 0x500054B4 /end MEASUREMENT
/begin MEASUREMENT EGSDCmn_uS2B1Grdt_I.idxOutp "Calculation of the binary voltage gradient / Index" UBYTE dez 1 100 0.00 10.00 FORMAT "%5.2" ECU_ADDRESS 0x500054B5 /end MEASUREMENT
/begin MEASUREMENT EGSDCmn_uS2B1Grdt_I.uOld_a "Calculation of the binary voltage gradient / old voltage value" UWORD spg_q1p221Em3_V 1 100 0.00 4.998779 FORMAT "%8.6" ARRAY_SIZE 11 ECU_ADDRESS 0x500054B6 /end MEASUREMENT
/begin MEASUREMENT EGSDCmn_uS2B1Grdt_I.FrzRiTOFFVNM_I.time "Calculation of the binary voltage gradient / Entprellung / delay time" UBYTE t_q0p01 1 100 0.00 2.550 FORMAT "%5.3" ECU_ADDRESS 0x500054CC /end MEASUREMENT
/begin MEASUREMENT EGSDCmn_uS2B1Parl "filtered (and symmetrized, if required) sensor voltage of sensor 2, bank 1" UWORD spg_q1p221Em3_V 1 100 0.00 4.998779 FORMAT "%8.6" ECU_ADDRESS 0x6000733C /end MEASUREMENT
/begin MEASUREMENT EGSDCmn_VirtEomDmd_I.stOperMod "Virtual Engine operation mode request of the active exhaust gas sensor and catalyst diagnosis (parallelization) / Priority-element of the operation mode structure" ULONG OneToOne 1 100 0.00 4294967295.00 FORMAT "%13.2" ECU_ADDRESS 0x70003048 /end MEASUREMENT
/begin MEASUREMENT EGSDCmn_VirtEomDmd_I.stOperModPrio "Virtual Engine operation mode request of the active exhaust gas sensor and catalyst diagnosis (parallelization) / Stage-element of the operation mode structure" UBYTE OneToOne 1 100 0.00 255.0 FORMAT "%5.1" ECU_ADDRESS 0x7000304C /end MEASUREMENT
/begin MEASUREMENT EGSDCmn_VirtEomDmd_I.stOperModStg "Virtual Engine operation mode request of the active exhaust gas sensor and catalyst diagnosis (parallelization) / Operation-mode element of the operation mode structure" UWORD OneToOne 1 100 0.00 65535.00 FORMAT "%8.2" ECU_ADDRESS 0x7000304E /end MEASUREMENT
/begin FUNCTION EGSDCmn_CoorrParl "1.62.0    Coordinator of parallelization of active exhaust gas sensor dynamic diagnosis and catalyst diagnosis"
 /begin DEF_CHARACTERISTIC EGSDCmn_Cat1B1Empty_I.duUMinOKParl_C EGSDCmn_Cat1B1Empty_I.mO2CatEmptyOKParl_C EGSDCmn_Cat1B1Empty_I.uCatEmptyOKParl_C EGSDCmn_duCatEmptyMaxParl_C EGSDCmn_duCatEmptyMinParl_C EGSDCmn_duCatFullMaxParl_C EGSDCmn_duCatFullMinParl_C EGSDCmn_facOSCErrTarLean_T EGSDCmn_facOSCErrTarRich_T EGSDCmn_facOSCRampDur_T EGSDCmn_facRampParl_C EGSDCmn_flgSymTranOnly_CW EGSDCmn_flgVltgSymc_C EGSDCmn_mCat1EmptyGrdtParl_M EGSDCmn_mCat1EmptyGrdtPreCdnParl_M EGSDCmn_mCat1FullGrdtParl_M EGSDCmn_mCat1FullGrdtPreCdnParl_M EGSDCmn_mEgLamWaitParl_C EGSDCmn_mEgLamWaitShtrpParl_C EGSDCmn_mErrTarLeanParl_C EGSDCmn_mErrTarRichParl_C EGSDCmn_mLamStabParl_C EGSDCmn_mO2IdnAdapnParl_C EGSDCmn_mRampDurS2Parl_C EGSDCmn_mRichMinPreCdnS2Parl_M EGSDCmn_mRichMinS2Parl_M EGSDCmn_nrMaxIdnAdpnEnd_C EGSDCmn_nrUGrdtParl_C EGSDCmn_ratLamIdnLeanParl_C EGSDCmn_ratLamIdnRichParl_C EGSDCmn_ratLamLeanParl_C EGSDCmn_ratLamLessLeanMonParl_C EGSDCmn_ratLamLessRichMonParl_C EGSDCmn_ratLamMoreLeanMonParl_C EGSDCmn_ratLamMoreRichMonParl_C EGSDCmn_ratLamRampLeanParl_C EGSDCmn_ratLamRampRichParl_C EGSDCmn_ratLamRichParl_C EGSDCmn_tiLamMonParl_C EGSDCmn_tiS1DynWrstCaseParl_C EGSDCmn_tiS2LtrDynWpaParl_C EGSDCmn_tiS2RtlDynWpaParl_C EGSDCmn_tiUCatFullParl_C EGSDCmn_tiUS2LtrParl_C EGSDCmn_tiUS2RtlParl_C EGSDCmn_tiVirtLamStabParl_C EGSDCmn_uCatEmptyGrdtParl_C EGSDCmn_uCatEmptyGrdtPreCdnParl_C EGSDCmn_uCatEmptyParl_C EGSDCmn_uCatFullGrdtParl_C EGSDCmn_uCatFullGrdtPreCdnParl_C EGSDCmn_uCatFullParl_C EGSDCmn_uEnaLoEnghParl_C EGSDCmn_uHiEnaParl_C /end DEF_CHARACTERISTIC
 /begin LOC_MEASUREMENT EGSDCmn_S2B1VirtTarLeanOffsParl_I.ratLamRampLeanParl EGSDCmn_S2B1VirtTarLeanOffsParl_I.ratLamRampRichParl EGSDCmn_S2B1VirtTarLeanOffsParl_I.ratLamReq EGSDCmn_S2B1VirtTarLeanOffsParl_I.sm EGSDCmn_S2B1VirtTarLeanOffsParl_I.stLamGenr EGSDCmn_S2B1VirtTarLeanOffsParl_I.tiGasRt EGSDCmn_S2B1VirtTarLeanOffsParl_I.tiLamDynLtr EGSDCmn_S2B1VirtTarLeanOffsParl_I.tiLamDynRtl EGSDCmn_S2B1VirtTarLeanOffsParl_I.tiUDynLtr EGSDCmn_S2B1VirtTarLeanOffsParl_I.tiUDynRtl EGSDCmn_S2B1VirtTarLeanOffsParl_I.EnaReldEF_I.buffer EGSDCmn_S2B1VirtTarLeanOffsParl_I.EnaReldEF_I.oldSignal EGSDCmn_S2B1VirtTarLeanOffsParl_I.LamRampIKL_I.memory EGSDCmn_S2B1VirtTarLeanOffsParl_I.RampEndLimIK_I.memory EGSDCmn_S2B1VirtTarLeanOffsParl_I.mO2EnaCatFullGrdtIK_I.memory EGSDCmn_S2B1VirtTarLeanOffsParl_I.mO2VirtEnaCatEmptyIK_I.memory EGSDCmn_S2B1VirtTarLeanOffsParl_I.tiDynWpaRampTONVNM_I.outbit EGSDCmn_S2B1VirtTarLeanOffsParl_I.tiDynWpaRampTONVNM_I.time EGSDCmn_S2B1VirtTarLeanOffsParl_I.tiLamDynTONV_I.outbit EGSDCmn_S2B1VirtTarLeanOffsParl_I.tiLamDynTONV_I.time EGSDCmn_S2B1VirtTarLeanOffsParl_I.tiUDynTONV_I.outbit EGSDCmn_S2B1VirtTarLeanOffsParl_I.tiUDynTONV_I.time EGSDCmn_S2B1VirtTarLeanParl_I.flgCatEmptyTOut EGSDCmn_S2B1VirtTarLeanParl_I.flgCatFullTOut EGSDCmn_S2B1VirtTarLeanParl_I.flgReld EGSDCmn_S2B1VirtTarLeanParl_I.flgTarLeanRes EGSDCmn_S2B1VirtTarLeanParl_I.flgTarRich EGSDCmn_S2B1VirtTarLeanParl_I.flgTarRichRes EGSDCmn_S2B1VirtTarLeanParl_I.flgUHiEnaParl EGSDCmn_S2B1VirtTarLeanParl_I.mOSC EGSDCmn_S2B1VirtTarLeanParl_I.mRSC EGSDCmn_S2B1VirtTarLeanParl_I.mRampDurParl EGSDCmn_S2B1VirtTarLeanParl_I.mfEg EGSDCmn_S2B1VirtTarLeanParl_I.mfVirtO2 EGSDCmn_S2B1VirtTarLeanParl_I.mfVirtRich EGSDCmn_S2B1VirtTarLeanParl_I.ratLamRampLeanParl EGSDCmn_S2B1VirtTarLeanParl_I.ratLamRampRichParl EGSDCmn_S2B1VirtTarLeanParl_I.ratLamReq EGSDCmn_S2B1VirtTarLeanParl_I.sm EGSDCmn_S2B1VirtTarLeanParl_I.stLamGenr EGSDCmn_S2B1VirtTarLeanParl_I.tiGasRt EGSDCmn_S2B1VirtTarLeanParl_I.tiLamDynLtr EGSDCmn_S2B1VirtTarLeanParl_I.tiLamDynRtl EGSDCmn_S2B1VirtTarLeanParl_I.tiUDynLtr EGSDCmn_S2B1VirtTarLeanParl_I.tiUDynRtl EGSDCmn_S2B1VirtTarLeanParl_I.EnaReldEF_I.buffer EGSDCmn_S2B1VirtTarLeanParl_I.EnaReldEF_I.oldSignal EGSDCmn_S2B1VirtTarLeanParl_I.LamRampIKL_I.memory EGSDCmn_S2B1VirtTarLeanParl_I.RampEndLimIK_I.memory EGSDCmn_S2B1VirtTarLeanParl_I.mO2EnaCatFullGrdtIK_I.memory EGSDCmn_S2B1VirtTarLeanParl_I.mO2VirtEnaCatEmptyIK_I.memory EGSDCmn_S2B1VirtTarLeanParl_I.tiDynWpaRampTONVNM_I.outbit EGSDCmn_S2B1VirtTarLeanParl_I.tiDynWpaRampTONVNM_I.time EGSDCmn_S2B1VirtTarLeanParl_I.tiLamDynTONV_I.outbit EGSDCmn_S2B1VirtTarLeanParl_I.tiLamDynTONV_I.time EGSDCmn_S2B1VirtTarLeanParl_I.tiUDynTONV_I.outbit EGSDCmn_S2B1VirtTarLeanParl_I.tiUDynTONV_I.time EGSDCmn_S2B1VirtTarRichOffsParl_I.flgCatEmptyTOut EGSDCmn_S2B1VirtTarRichOffsParl_I.flgCatFullTOut EGSDCmn_S2B1VirtTarRichOffsParl_I.flgReld EGSDCmn_S2B1VirtTarRichOffsParl_I.flgTarLeanRes EGSDCmn_S2B1VirtTarRichOffsParl_I.flgTarRich EGSDCmn_S2B1VirtTarRichOffsParl_I.flgTarRichRes EGSDCmn_S2B1VirtTarRichOffsParl_I.flgUHiEnaParl EGSDCmn_S2B1VirtTarRichOffsParl_I.mOSC EGSDCmn_S2B1VirtTarRichOffsParl_I.mRSC EGSDCmn_S2B1VirtTarRichOffsParl_I.mRampDurParl EGSDCmn_S2B1VirtTarRichOffsParl_I.mfEg EGSDCmn_S2B1VirtTarRichOffsParl_I.mfVirtO2 EGSDCmn_S2B1VirtTarRichOffsParl_I.mfVirtRich EGSDCmn_S2B1VirtTarRichOffsParl_I.ratLamRampLeanParl EGSDCmn_S2B1VirtTarRichOffsParl_I.ratLamRampRichParl EGSDCmn_S2B1VirtTarRichOffsParl_I.ratLamReq EGSDCmn_S2B1VirtTarRichOffsParl_I.sm EGSDCmn_S2B1VirtTarRichOffsParl_I.stLamGenr EGSDCmn_S2B1VirtTarRichOffsParl_I.tiGasRt EGSDCmn_S2B1VirtTarRichOffsParl_I.tiLamDynLtr EGSDCmn_S2B1VirtTarRichOffsParl_I.tiLamDynRtl EGSDCmn_S2B1VirtTarRichOffsParl_I.tiUDynLtr EGSDCmn_S2B1VirtTarRichOffsParl_I.tiUDynRtl EGSDCmn_S2B1VirtTarRichOffsParl_I.EnaReldEF_I.buffer EGSDCmn_S2B1VirtTarRichOffsParl_I.EnaReldEF_I.oldSignal EGSDCmn_S2B1VirtTarRichOffsParl_I.LamRampIKL_I.memory EGSDCmn_S2B1VirtTarRichOffsParl_I.RampEndLimIK_I.memory EGSDCmn_S2B1VirtTarRichOffsParl_I.mO2EnaCatFullGrdtIK_I.memory EGSDCmn_S2B1VirtTarRichOffsParl_I.mO2VirtEnaCatEmptyIK_I.memory EGSDCmn_S2B1VirtTarRichOffsParl_I.tiDynWpaRampTONVNM_I.outbit EGSDCmn_S2B1VirtTarRichOffsParl_I.tiDynWpaRampTONVNM_I.time EGSDCmn_S2B1VirtTarRichOffsParl_I.tiLamDynTONV_I.outbit EGSDCmn_S2B1VirtTarRichOffsParl_I.tiLamDynTONV_I.time EGSDCmn_S2B1VirtTarRichOffsParl_I.tiUDynTONV_I.outbit EGSDCmn_S2B1VirtTarRichOffsParl_I.tiUDynTONV_I.time EGSDCmn_S2B1VirtTarRichParl_I.flgCatEmptyTOut EGSDCmn_S2B1VirtTarRichParl_I.flgCatFullTOut EGSDCmn_S2B1VirtTarRichParl_I.flgReld EGSDCmn_S2B1VirtTarRichParl_I.flgTarLeanRes EGSDCmn_S2B1VirtTarRichParl_I.flgTarRich EGSDCmn_S2B1VirtTarRichParl_I.flgTarRichRes EGSDCmn_S2B1VirtTarRichParl_I.flgUHiEnaParl EGSDCmn_S2B1VirtTarRichParl_I.mOSC EGSDCmn_S2B1VirtTarRichParl_I.mRSC EGSDCmn_S2B1VirtTarRichParl_I.mRampDurParl EGSDCmn_S2B1VirtTarRichParl_I.mfEg EGSDCmn_S2B1VirtTarRichParl_I.mfVirtO2 EGSDCmn_S2B1VirtTarRichParl_I.mfVirtRich EGSDCmn_S2B1VirtTarRichParl_I.ratLamRampLeanParl EGSDCmn_S2B1VirtTarRichParl_I.ratLamRampRichParl EGSDCmn_S2B1VirtTarRichParl_I.ratLamReq EGSDCmn_S2B1VirtTarRichParl_I.sm EGSDCmn_S2B1VirtTarRichParl_I.stLamGenr EGSDCmn_S2B1VirtTarRichParl_I.tiGasRt EGSDCmn_S2B1VirtTarRichParl_I.tiLamDynLtr EGSDCmn_S2B1VirtTarRichParl_I.tiLamDynRtl EGSDCmn_S2B1VirtTarRichParl_I.tiUDynLtr EGSDCmn_S2B1VirtTarRichParl_I.tiUDynRtl EGSDCmn_S2B1VirtTarRichParl_I.EnaReldEF_I.buffer EGSDCmn_S2B1VirtTarRichParl_I.EnaReldEF_I.oldSignal EGSDCmn_S2B1VirtTarRichParl_I.LamRampIKL_I.memory EGSDCmn_S2B1VirtTarRichParl_I.RampEndLimIK_I.memory EGSDCmn_S2B1VirtTarRichParl_I.mO2EnaCatFullGrdtIK_I.memory EGSDCmn_S2B1VirtTarRichParl_I.mO2VirtEnaCatEmptyIK_I.memory EGSDCmn_S2B1VirtTarRichParl_I.tiDynWpaRampTONVNM_I.outbit EGSDCmn_S2B1VirtTarRichParl_I.tiDynWpaRampTONVNM_I.time EGSDCmn_S2B1VirtTarRichParl_I.tiLamDynTONV_I.outbit EGSDCmn_S2B1VirtTarRichParl_I.tiLamDynTONV_I.time EGSDCmn_S2B1VirtTarRichParl_I.tiUDynTONV_I.outbit EGSDCmn_S2B1VirtTarRichParl_I.tiUDynTONV_I.time EGSDCmn_S2B1VirtUDlyParl_I.flgCatEmpty EGSDCmn_S2B1VirtUDlyParl_I.flgCatFull EGSDCmn_S2B1VirtUDlyParl_I.flgDynTripDneVirt EGSDCmn_S2B1VirtUDlyParl_I.flgIdnAdpnEnd EGSDCmn_S2B1VirtUDlyParl_I.flgIdnAdpnLean EGSDCmn_S2B1VirtUDlyParl_I.flgIdnAdpnRich EGSDCmn_S2B1VirtUDlyParl_I.flgReld EGSDCmn_S2B1VirtUDlyParl_I.flgUHiEnaParl EGSDCmn_S2B1VirtUDlyParl_I.flgUMid EGSDCmn_S2B1VirtUDlyParl_I.flgVirtLamDyn EGSDCmn_S2B1VirtUDlyParl_I.mOSC EGSDCmn_S2B1VirtUDlyParl_I.mRSC EGSDCmn_S2B1VirtUDlyParl_I.mfVirtO2 EGSDCmn_S2B1VirtUDlyParl_I.mfVirtRich EGSDCmn_S2B1VirtUDlyParl_I.sm EGSDCmn_S2B1VirtUDlyParl_I.stLamGenr EGSDCmn_S2B1VirtUDlyParl_I.tiGas EGSDCmn_S2B1VirtUDlyParl_I.tiLamDynLtr EGSDCmn_S2B1VirtUDlyParl_I.tiLamDynRtl EGSDCmn_S2B1VirtUDlyParl_I.tiUDynLtr EGSDCmn_S2B1VirtUDlyParl_I.tiUDynRtl EGSDCmn_S2B1VirtUDlyParl_I.u EGSDCmn_S2B1VirtUDlyParl_I.EnaReldEF_I.buffer EGSDCmn_S2B1VirtUDlyParl_I.EnaReldEF_I.oldSignal EGSDCmn_S2B1VirtUDlyParl_I.IdnAdpnCTR_I.counter EGSDCmn_S2B1VirtUDlyParl_I.flgLeanLamStabTONV_I.outbit EGSDCmn_S2B1VirtUDlyParl_I.flgLeanLamStabTONV_I.time EGSDCmn_S2B1VirtUDlyParl_I.flgRichLamStabTONV_I.outbit EGSDCmn_S2B1VirtUDlyParl_I.flgRichLamStabTONV_I.time EGSDCmn_S2B1VirtUDlyParl_I.mO2EnaCatFullGrdtIK_I.memory EGSDCmn_S2B1VirtUDlyParl_I.mO2IdnAdpnIKL_I.memory EGSDCmn_S2B1VirtUDlyParl_I.mO2VirtEnaCatEmptyIK_I.memory EGSDCmn_S2B1VirtUDlyParl_I.tiGasRtlTONV_I.outbit EGSDCmn_S2B1VirtUDlyParl_I.tiGasRtlTONV_I.time EGSDCmn_S2B1VirtUDlyParl_I.tiUDynTONV_I.outbit EGSDCmn_S2B1VirtUDlyParl_I.tiUDynTONV_I.time EGSDCmn_S2B1VirtUTranParl_I.flgCatEmpty EGSDCmn_S2B1VirtUTranParl_I.flgCatFull EGSDCmn_S2B1VirtUTranParl_I.flgDynTripDneVirt EGSDCmn_S2B1VirtUTranParl_I.flgIdnAdpnEnd EGSDCmn_S2B1VirtUTranParl_I.flgIdnAdpnLean EGSDCmn_S2B1VirtUTranParl_I.flgIdnAdpnRich EGSDCmn_S2B1VirtUTranParl_I.flgReld EGSDCmn_S2B1VirtUTranParl_I.flgUHiEnaParl EGSDCmn_S2B1VirtUTranParl_I.flgUMid EGSDCmn_S2B1VirtUTranParl_I.flgVirtLamDyn EGSDCmn_S2B1VirtUTranParl_I.mOSC EGSDCmn_S2B1VirtUTranParl_I.mRSC EGSDCmn_S2B1VirtUTranParl_I.mfVirtO2 EGSDCmn_S2B1VirtUTranParl_I.mfVirtRich EGSDCmn_S2B1VirtUTranParl_I.sm EGSDCmn_S2B1VirtUTranParl_I.stLamGenr EGSDCmn_S2B1VirtUTranParl_I.tiGas EGSDCmn_S2B1VirtUTranParl_I.tiLamDynLtr EGSDCmn_S2B1VirtUTranParl_I.tiLamDynRtl EGSDCmn_S2B1VirtUTranParl_I.tiUDynLtr EGSDCmn_S2B1VirtUTranParl_I.tiUDynRtl EGSDCmn_S2B1VirtUTranParl_I.u EGSDCmn_S2B1VirtUTranParl_I.EnaReldEF_I.buffer EGSDCmn_S2B1VirtUTranParl_I.EnaReldEF_I.oldSignal EGSDCmn_S2B1VirtUTranParl_I.IdnAdpnCTR_I.counter EGSDCmn_S2B1VirtUTranParl_I.flgLeanLamStabTONV_I.outbit EGSDCmn_S2B1VirtUTranParl_I.flgLeanLamStabTONV_I.time EGSDCmn_S2B1VirtUTranParl_I.flgRichLamStabTONV_I.outbit EGSDCmn_S2B1VirtUTranParl_I.flgRichLamStabTONV_I.time EGSDCmn_S2B1VirtUTranParl_I.mO2EnaCatFullGrdtIK_I.memory EGSDCmn_S2B1VirtUTranParl_I.mO2IdnAdpnIKL_I.memory EGSDCmn_S2B1VirtUTranParl_I.mO2VirtEnaCatEmptyIK_I.memory EGSDCmn_S2B1VirtUTranParl_I.tiGasRtlTONV_I.outbit EGSDCmn_S2B1VirtUTranParl_I.tiGasRtlTONV_I.time EGSDCmn_S2B1VirtUTranParl_I.tiUDynTONV_I.outbit EGSDCmn_S2B1VirtUTranParl_I.tiUDynTONV_I.time EGSDCmn_Seg1B1LamRampLeanVirtParl_I.flgLamReq EGSDCmn_Seg1B1LamRampLeanVirtParl_I.flgLeanRampEnd EGSDCmn_Seg1B1LamRampLeanVirtParl_I.flgRampDurEnd EGSDCmn_Seg1B1LamRampLeanVirtParl_I.flgRichRampEnd EGSDCmn_Seg1B1LamRampLeanVirtParl_I.mRampEndLim EGSDCmn_Seg1B1LamRampLeanVirtParl_I.ratLamReq EGSDCmn_Seg1B1LamRampLeanVirtParl_I.tiObsvrTOut EGSDCmn_Seg1B1LamRampLeanVirtParl_I.DynErrRampTONVNM_I.time EGSDCmn_Seg1B1LamRampLeanVirtParl_I.LamRampIKL_I.memory EGSDCmn_Seg1B1LamRampLeanVirtParl_I.RampEndLimIK_I.memory EGSDCmn_Seg1B1LamRampLeanVirtParl_I.tiObsvrTOutSW_I.timeCounter EGSDCmn_Seg1B1LamRampParl_I.flgLamReq EGSDCmn_Seg1B1LamRampParl_I.flgLeanRampEnd EGSDCmn_Seg1B1LamRampParl_I.flgRampDurEnd EGSDCmn_Seg1B1LamRampParl_I.flgRichRampEnd EGSDCmn_Seg1B1LamRampParl_I.mRampEndLim EGSDCmn_Seg1B1LamRampParl_I.ratLamReq EGSDCmn_Seg1B1LamRampParl_I.tiObsvrTOut EGSDCmn_Seg1B1LamRampParl_I.DynErrRampTONVNM_I.time EGSDCmn_Seg1B1LamRampParl_I.LamRampIKL_I.memory EGSDCmn_Seg1B1LamRampParl_I.RampEndLimIK_I.memory EGSDCmn_Seg1B1LamRampParl_I.tiObsvrTOutSW_I.timeCounter EGSDCmn_Seg1B1LamRampRichVirtParl_I.flgLamReq EGSDCmn_Seg1B1LamRampRichVirtParl_I.flgLeanRampEnd EGSDCmn_Seg1B1LamRampRichVirtParl_I.flgRampDurEnd EGSDCmn_Seg1B1LamRampRichVirtParl_I.flgRichRampEnd EGSDCmn_Seg1B1LamRampRichVirtParl_I.mRampEndLim EGSDCmn_Seg1B1LamRampRichVirtParl_I.ratLamReq EGSDCmn_Seg1B1LamRampRichVirtParl_I.tiObsvrTOut EGSDCmn_Seg1B1LamRampRichVirtParl_I.DynErrRampTONVNM_I.time EGSDCmn_Seg1B1LamRampRichVirtParl_I.LamRampIKL_I.memory EGSDCmn_Seg1B1LamRampRichVirtParl_I.RampEndLimIK_I.memory EGSDCmn_Seg1B1LamRampRichVirtParl_I.tiObsvrTOutSW_I.timeCounter EGSDCmn_TarChkS2B1_I.flgTarLeanOK EGSDCmn_TarChkS2B1_I.flgTarRichOK EGSDCmn_TarChkS2B1_I.stLamGenrParlOld EGSDCmn_TarChkS2B1_I.uCatEmptyMax EGSDCmn_TarChkS2B1_I.uCatFullMin EGSDCmn_tiGasRtB1 EGSDCmn_tiLamDynLtrParlB1 EGSDCmn_tiLamDynRtlParlB1 EGSDCmn_tiUS2DynLtrEvlnParlB1 EGSDCmn_tiUS2DynRtlEvlnParlB1 EGSDCmn_uCatEmptyGrdtParl EGSDCmn_uCatEmptyGrdtPreCdnParl EGSDCmn_uCatEmptyParl EGSDCmn_uCatFullGrdtParl EGSDCmn_uCatFullGrdtPreCdnParl EGSDCmn_uCatFullParl EGSDCmn_uS2B1Grdt_I.duSnsr EGSDCmn_uS2B1Grdt_I.idxInp EGSDCmn_uS2B1Grdt_I.idxOutp EGSDCmn_uS2B1Grdt_I.uOld_a EGSDCmn_uS2B1Grdt_I.FrzRiTOFFVNM_I.time EGSDCmn_uS2B1Parl /end LOC_MEASUREMENT
 FUNCTION_VERSION "1.62.0" /end FUNCTION
/begin FUNCTION EGSDCmn_CoorrParlAssc "1.11.0    assistance measures for coordinator of parallelization of sensor dynamic diagnosis and catalyst diagnosis"
 /begin DEF_CHARACTERISTIC EGSDCmn_facLamCtrlVLamDynParl_C EGSDCmn_facLamCtrlVParl_C EGSDCmn_facTiTqResvParl_C EGSDCmn_flgEnaEomParl_C EGSDCmn_flgLamDynSlowCtrlParl_C EGSDCmn_stEomParl_C EGSDCmn_stEomPrioParl_C EGSDCmn_stEomPrioShtrpParl_C EGSDCmn_stEomShtrpParl_C EGSDCmn_stEomStgParl_C EGSDCmn_stEomStgShtrpParl_C EGSDCmn_StOperModRelsShtrp_I.OperMod2Idx_M EGSDCmn_StOperModRels_I.OperMod2Idx_M EGSDCmn_tiFilLamCtrlVParl_C EGSDCmn_tqResvParl_C EGSDCmn_tqResvTstParl_C /end DEF_CHARACTERISTIC
 /begin IN_MEASUREMENT CoEOM_flgEGSDCmnVirtDmdActv CoEOM_stEomActvTmng EGSDCmn_flgLamReqParlB1 EGSDCmn_flgSeg1B1ReldParl EGSDCmn_flgSeg1B1VirtReldParl EGSDCmn_flgShtrpParl EGSDCmn_stLamGenrParlB1 EGSDO2_flgDynErrSuspcS1B1 EGSDO2_flgDynStepLtrB1 EGSDO2_flgDynStepRtlB1 EGSDO2_flgStepLtrEvlnS1B1 EGSDO2_flgStepRtlEvlnS1B1 EGSDU_flgS2B1QPFaildDynEvln EngStrt_bStrtEnd TWCD_flgOSCQPFaildPriB1 /end IN_MEASUREMENT
 /begin OUT_MEASUREMENT EGSDCmn_EomDmd_I.stOperMod EGSDCmn_EomDmd_I.stOperModPrio EGSDCmn_EomDmd_I.stOperModStg EGSDCmn_facLamCtrlVParlB1 EGSDCmn_flgCOEOMPsblParlB1 EGSDCmn_flgCOEOMRelsParlB1 EGSDCmn_flgOperPntActvParl EGSDCmn_flgReqEomParl EGSDCmn_flgSeg1B1QPFaildParl EGSDCmn_flgVirtCOEOMRelsParlB1 EGSDCmn_flgVirtReqEomParl EGSDCmn_tqResvParl EGSDCmn_VirtEomDmd_I.stOperMod EGSDCmn_VirtEomDmd_I.stOperModPrio EGSDCmn_VirtEomDmd_I.stOperModStg /end OUT_MEASUREMENT
 /begin LOC_MEASUREMENT EGSDCmn_facLamCtrlVParlB1LT_I.memory EGSDCmn_flgDynStepLtrB1ER_I.buffer EGSDCmn_flgDynStepLtrB1ER_I.oldSignal EGSDCmn_flgDynStepRtlB1ER_I.buffer EGSDCmn_flgDynStepRtlB1ER_I.oldSignal EGSDCmn_flgOperModDmdActv EGSDCmn_LamDynActvParlB1FF_I.status EGSDCmn_TqResvParlITL_I.memory /end LOC_MEASUREMENT
 FUNCTION_VERSION "1.11.0" /end FUNCTION
/begin FUNCTION EGSDCmn_CoorrParlEna "1.38.0    Enable condition for coordinator of parallelization of active exhaust gas sensor dynamic diagnosis and catalyst diagnosis"
 /begin DEF_CHARACTERISTIC EGSDCmn_dmEnaNegParl_C EGSDCmn_dmEnaPosParl_C EGSDCmn_dmfRngHiMaxActvParl_T EGSDCmn_dmfRngHiMinActvParl_C EGSDCmn_dmfRngLoMaxActvParl_T EGSDCmn_dmfRngLoMinActvParl_C EGSDCmn_dmfRngLoUnderMinParl_C EGSDCmn_dnEngMaxParl_C EGSDCmn_dnEngMinParl_C EGSDCmn_dtCat1HomParl_C EGSDCmn_dtCat1RngHiMaxParl_C EGSDCmn_dtCat1RngHiMinParl_C EGSDCmn_dtCat1RngLoMaxParl_C EGSDCmn_dtCat1RngLoMinParl_C EGSDCmn_facFpcAdpnMaxParl_C EGSDCmn_facFuByFpcParl_C EGSDCmn_flgActvtAbortCntr_C EGSDCmn_flgBypLamMonOkParl_C EGSDCmn_flgEnaAftIdleIni_C EGSDCmn_flgFcoDiDiag_C EGSDCmn_flgFMixAdpnParl_CW EGSDCmn_flgGearShiftEnaParl_CW EGSDCmn_flgInjVlvDisblActvParl_C EGSDCmn_flgLamMonCntrParl_C EGSDCmn_flgLamMonSuppParl_CW EGSDCmn_flgOffsDurgShoPreParl_C EGSDCmn_flgPurgCtrlParl_C EGSDCmn_flgVlVLftActvParl_CW EGSDCmn_mEgCatWarmAftIdleFco_M EGSDCmn_mEgFpcDynDebParl_C EGSDCmn_mEgFpcEnaParl_C EGSDCmn_mEnaDsbcParlB1_C EGSDCmn_mEnaLam1Parl_C EGSDCmn_mEnaSensVldParl_C EGSDCmn_mfEnaRampMaxParl_C EGSDCmn_mfEnaRampMaxTstParl_C EGSDCmn_mfEnaRampMinParl_C EGSDCmn_mfEnaRampMinTstParl_C EGSDCmn_mfPurgCtrlThdParl_C EGSDCmn_mfRngHiMaxParl_T EGSDCmn_mfRngHiMaxTstParl_C EGSDCmn_mfRngHiMinParl_C EGSDCmn_mfRngHiMinTstParl_C EGSDCmn_mfRngLoMaxParl_T EGSDCmn_mfRngLoMaxTstParl_C EGSDCmn_mfRngLoMinParl_C EGSDCmn_mfRngLoMinTstParl_C EGSDCmn_mSeg1EnaEgParl_T EGSDCmn_nEngIdle_C EGSDCmn_nEngMaxParl_C EGSDCmn_nEngMaxTstParl_C EGSDCmn_nEngMinParl_C EGSDCmn_nEngMinTstParl_C EGSDCmn_nrLamMonOKEFParl_C EGSDCmn_PEnvMinParl_C EGSDCmn_ratLamEnaMaxParl_C EGSDCmn_ratLamEnaMinParl_C EGSDCmn_ratLamLeanEgInflParl_C EGSDCmn_ratLamRichEgInflParl_C EGSDCmn_ratLoadMinParl_Crv EGSDCmn_ratLoadMinTstParl_T EGSDCmn_rLamMaxDiffParl_C EGSDCmn_tAmbMinParl_C EGSDCmn_tCat1RngHiMaxParl_C EGSDCmn_tCat1RngHiMaxTstParl_C EGSDCmn_tCat1RngHiMinParl_C EGSDCmn_tCat1RngHiMinTstParl_C EGSDCmn_tCat1RngLoMaxParl_C EGSDCmn_tCat1RngLoMaxTstParl_C EGSDCmn_tCat1RngLoMinParl_C EGSDCmn_tCat1RngLoMinTstParl_C EGSDCmn_tCatMaxGrdtParl_C EGSDCmn_tCatMaxGrdtTstParl_C EGSDCmn_tCatMinGrdtParl_C EGSDCmn_tCatMinGrdtTstParl_C EGSDCmn_tCatMinParl_C EGSDCmn_tEngMinParl_C EGSDCmn_tiCatMinOffParl_C EGSDCmn_tiCatMinOnParl_C EGSDCmn_tiDebInjVlvDisblParl_C EGSDCmn_tiDebInjVlvEnaParl_C EGSDCmn_tiDebSigndLamMonParl_CUR EGSDCmn_tiEnaCatTGrdtParl_C EGSDCmn_tiEnaMflowParl_C EGSDCmn_tiFltMflowParl_C EGSDCmn_tiGearShiftParl_C EGSDCmn_tiIdleMax_C EGSDCmn_tiNEngOvrIdle_C EGSDCmn_tiRngLoUnderMinParl_C EGSDCmn_tMinCatRelsParl_C EGSDCmn_tS2EnaSensParl_C EGSDCmn_tS2EnaSensTstParl_C EGSDCmn_vVehSpdMinParl_C /end DEF_CHARACTERISTIC
 /begin REF_CHARACTERISTIC EGSDO2_flgIdnDurgParl_CW EGSDO2_flgLamOffsFastPreParl_CW EGSDO2_flgSeqDyn_C /end REF_CHARACTERISTIC
 /begin IN_MEASUREMENT B_bevab_msg B_ethhte_msg B_frmax_msg B_frmin_msg B_gaenres_msg B_gsch_msg B_ten_msg B_te_msg B_vhegs_msg B_vheg_msg CEngDsT_t CEngDsT_tStrtFrst Eep_EnvRamInvld EGSDCmn_flgB1LamNotStabParl EGSDCmn_flgCOEOMPsblParlB1 EGSDCmn_flgCOEOMRelsParlB1 EGSDCmn_flgInhbProdModParl EGSDCmn_flgLamReqParlB1 EGSDCmn_flgProdModParl EGSDCmn_flgS1B1O2PlausResVirtParl EGSDCmn_flgS1B1VldParl EGSDCmn_flgS2B1TarLeanErrParl EGSDCmn_flgS2B1TarLeanResVirtOffsParl EGSDCmn_flgS2B1TarRichErrParl EGSDCmn_flgS2B1TarRichResVirtOffsParl EGSDCmn_flgS2B1VldParl EGSDCmn_flgShtrpParl EGSDCmn_flgVirtCOEOMRelsParlB1 EGSDCmn_mfEgCat1B1Parl EGSDCmn_tCat1B1MaxParl EGSDCmn_tCat1B1MinParl EGSDCmn_tCat1B1Parl EGSDCmn_tS2B1SensParl EGSDO2_flgDebHealOffsFastS1B1 EGSDO2_flgDynLtrTripDneS1B1 EGSDO2_flgDynLtrTripDneVirtS1B1 EGSDO2_flgDynRtlTripDneS1B1 EGSDO2_flgDynRtlTripDneVirtS1B1 EGSDO2_flgLamPlausFltMaxS1B1 EGSDO2_flgLamPlausFltMinS1B1 EGSDO2_flgLamPlausFltVirtS1B1 EGSDO2_flgLamPlausInhbParlS1B1 EGSDO2_flgQlyDeFltSuspcB1 EGSDU_flgS2B1TarLeanResEvln EGSDU_flgS2B1TarLeanResVirtEvln EGSDU_flgS2B1TarRichResEvln EGSDU_flgS2B1TarRichResVirtEvln EGSDU_flgS2B1TripLtrDlyEvln EGSDU_flgS2B1TripLtrTranEvln EGSDU_flgS2B1TripRtlDlyEvln EGSDU_flgS2B1TripRtlTranEvln EGSDU_flgS2B1TripVirtLtrDlyEvln EGSDU_flgS2B1TripVirtLtrTranEvln EGSDU_flgS2B1TripVirtRtlDlyEvln EGSDU_flgS2B1TripVirtRtlTranEvln EngStrt_bFrstStrtEnd EngStrt_bStrtEnd EnvT_t Epm_nEng Epm_nEngLRes ftead_w_msg imsteini_msg InjSys_ratFuM LamCtrl_ratLamSpS1B1 lamsbg_w_msg lamsons_w_msg lamssok_w_msg lamzak_w_msg mste_w_msg PEnv_p PthSet_bOvrRun rkte_w_msg rl_w_msg SyC_ctPostDrvLeave SyC_stSub TWCD_flgMeasFinshdTripB1 TWCD_flgMeasFinshdVirtTripB1 VehV_v zlamko_msg /end IN_MEASUREMENT
 /begin OUT_MEASUREMENT EGSDCmn_cntrB1AbortParlLamMon EGSDCmn_cntrB1AbortParlNEng EGSDCmn_cntrB1AbortParlRelLd EGSDCmn_cntrB1AbortParlV EGSDCmn_cntrB1AbortSumParl EGSDCmn_cntrB1StrtSumParl EGSDCmn_cntrSeg1B1AbortParlHiRng EGSDCmn_cntrSeg1B1AbortParlLoRng EGSDCmn_cntrSeg1B1AbortParlMFlowGrdt EGSDCmn_cntrSeg1B1AbortParlTGrdt EGSDCmn_flgCat1B1EnaTRngHiParl EGSDCmn_flgCat1B1EnaTRngLoParl EGSDCmn_flgEnaEthParl EGSDCmn_flgEnvtlDiPID41Parl EGSDCmn_flgLamMonOkParlB1 EGSDCmn_flgS1B1OffsDneParl EGSDCmn_flgSeg1B1ActvRqrdParl EGSDCmn_flgSeg1B1EnaEgParl EGSDCmn_flgSeg1B1EnaParl EGSDCmn_flgSeg1B1EnaVldParl EGSDCmn_flgSeg1B1MeasRqrdParl EGSDCmn_flgSeg1B1PhyEnaParl EGSDCmn_flgSeg1B1RampEnaParl EGSDCmn_flgSeg1B1RdyParl EGSDCmn_flgSeg1B1ReldFinalParl EGSDCmn_flgSeg1B1ReldParl EGSDCmn_flgSeg1B1VirtActvRqrdParl EGSDCmn_flgSeg1B1VirtMeasRqrdParl EGSDCmn_flgSeg1B1VirtReldFinalParl EGSDCmn_flgSeg1B1VirtReldParl EGSDCmn_flgTarLeanSuspcParlB1 EGSDCmn_flgTarRichSuspcParlB1 EGSDCmn_flgTarSuspcB1 EGSDCmn_flgTarSuspcVirtParlB1 /end OUT_MEASUREMENT
 /begin LOC_MEASUREMENT EGSDCmn_CatCoolOffParlB1TONV_I.outbit EGSDCmn_CatCoolOffParlB1TONV_I.time EGSDCmn_CatWrmUpParlB1TONV_I.outbit EGSDCmn_CatWrmUpParlB1TONV_I.time EGSDCmn_cntrB1AbortParlLamMonNV EGSDCmn_cntrB1AbortParlNEngNV EGSDCmn_cntrB1AbortParlNV EGSDCmn_cntrB1AbortParlRelLdNV EGSDCmn_cntrB1AbortParlVNV EGSDCmn_cntrB1StrtParlNV EGSDCmn_cntrSeg1B1AbortParlHiRngNV EGSDCmn_cntrSeg1B1AbortParlLoRngNV EGSDCmn_cntrSeg1B1AbortParlMFlowGrdtNV EGSDCmn_cntrSeg1B1AbortParlTGrdtNV EGSDCmn_CpvEB_I.buffer EGSDCmn_CpvEB_I.oldSignal EGSDCmn_ctReIni100msCoorrParlEna EGSDCmn_ctReIni10msCoorrParlEna EGSDCmn_dmfEgCat1InpParlB1 EGSDCmn_EnaAftIdleFcoFF_I.status EGSDCmn_EnaCatTGrdtParlB1LT_I.memory EGSDCmn_facLamActMonParlB1IK_I.memory EGSDCmn_flgActvHiRngSeg1B1 EGSDCmn_flgActvLoRngSeg1B1 EGSDCmn_flgB1AbortParlEF_I.buffer EGSDCmn_flgB1AbortParlEF_I.oldSignal EGSDCmn_flgB1EgInflParlFF_I.status EGSDCmn_flgB1ShtrpSyncEnaParl EGSDCmn_flgB1StartParlER_I.buffer EGSDCmn_flgB1StartParlER_I.oldSignal EGSDCmn_flgCat1B1EnaTHomParl EGSDCmn_flgCat1B1EnaTMinParl EGSDCmn_flgCat1B1EnaTParl EGSDCmn_flgCatWarmAftIdleER_I.buffer EGSDCmn_flgCatWarmAftIdleER_I.oldSignal EGSDCmn_flgCatWarmAftIdleFco EGSDCmn_flgDSMClrParlEnaB1 EGSDCmn_flgEnaEnvCndParl EGSDCmn_flgEnaFuMixAdpnParl EGSDCmn_flgEnaGearShiftParl EGSDCmn_flgEnaGlbParl EGSDCmn_flgEnaGlbPrtlParl EGSDCmn_flgEnaHiRngSeg1B1 EGSDCmn_flgEnaLoRngSeg1B1 EGSDCmn_flgEnaMsTParlB1 EGSDCmn_flgEnaRelLoadParl EGSDCmn_flgEnaVehVParl EGSDCmn_flgFpcAdpdParl EGSDCmn_flgFpcDynDebParl EGSDCmn_flgFpcOKParl EGSDCmn_flgGearShiftParlTONV_I.outbit EGSDCmn_flgGearShiftParlTONV_I.time EGSDCmn_flgInhbRdyParlB1 EGSDCmn_flgInjVlvEnaParlB1 EGSDCmn_flgLamActvParlB1ER_I.buffer EGSDCmn_flgLamActvParlB1ER_I.oldSignal EGSDCmn_flgLamMonSuppParlB1 EGSDCmn_flgLamPriEnaParlB1 EGSDCmn_flgLamReldParlB1 EGSDCmn_flgMfEgEnaRampParl EGSDCmn_flgmPurgCtrlOkParl EGSDCmn_flgNarrowRngSeg1B1 EGSDCmn_flgNEngInRngParl EGSDCmn_flgRdyB1Parl EGSDCmn_flgSeg1B1EnaHeatUp EGSDCmn_flgSeg1B1EnaMfGrdtTONV_I.outbit EGSDCmn_flgSeg1B1EnaMfGrdtTONV_I.time EGSDCmn_flgSeg1B1EnaMfRngHiParl EGSDCmn_flgSeg1B1EnaMfRngLoParl EGSDCmn_flgSeg1B1VirtEnaParl EGSDCmn_flgStrtEndParlB1 EGSDCmn_flgTiIdleExcdd EGSDCmn_flgVirtRdyB1Parl EGSDCmn_flgVlvLftActvParlB1 EGSDCmn_InjVlvDisblParlB1TONV_I.outbit EGSDCmn_InjVlvDisblParlB1TONV_I.time EGSDCmn_InjVlvEnaParlB1TOFFV_I.outbit EGSDCmn_InjVlvEnaParlB1TOFFV_I.time EGSDCmn_InjVlvParlB1FF_I.status EGSDCmn_LamMonOKB1EF_I.buffer EGSDCmn_LamMonOKB1EF_I.oldSignal EGSDCmn_LamMonOKEFParlB1CTR_I.counter EGSDCmn_LamReqOKB1TONV_I.outbit EGSDCmn_LamReqOKB1TONV_I.time EGSDCmn_mEgCatWarmAftIdleFcoIK_I.memory EGSDCmn_mEgEnaFpcParlIK_I.memory EGSDCmn_mEgEnaOpDecelParlB1IK_I.memory EGSDCmn_mEgSeg1EnaParlB1IK_I.memory EGSDCmn_mfEgFilCat1ParlB1LT_I.memory EGSDCmn_mfUnderRngLoMinParlDetB1SW_I.timeCounter EGSDCmn_mLamEnaParlB1IK_I.memory EGSDCmn_mSeg1B1SensVldParlIK_I.memory EGSDCmn_nEngOvrIdleTOFFV_I.outbit EGSDCmn_nEngOvrIdleTOFFV_I.time EGSDCmn_rLamDeltaMonParlB1 EGSDCmn_Seg1B1EnaLamCdnFF_I.status EGSDCmn_Seg1B1EnaRngMfHiParl_I.flgEnaRng EGSDCmn_Seg1B1EnaRngMfLoParl_I.flgEnaRng EGSDCmn_Seg1B1EnaRngTHiParl_I.flgEnaRng EGSDCmn_Seg1B1EnaRngTLoParl_I.flgEnaRng EGSDCmn_stEnaGlbPrtlParl EGSDCmn_tGrdtParlB1 EGSDCmn_tiEngIdleSW_I.timeCounter EGSDCmn_tMinCatRelsParlB1FF_I.status /end LOC_MEASUREMENT
 FUNCTION_VERSION "1.38.0" /end FUNCTION
/begin COMPU_METHOD B_TRUE "" TAB_VERB "%6.3" "" COMPU_TAB_REF B_TRUE /end COMPU_METHOD
/begin COMPU_VTAB B_TRUE "" TAB_VERB 2 0 "FALSE" 1 "TRUE" /end COMPU_VTAB
/begin COMPU_METHOD CoEOM_idxOperModCfgd_VERB "" TAB_VERB "%6.3" "-" COMPU_TAB_REF CoEOM_idxOperModCfgd_VERB /end COMPU_METHOD
/begin COMPU_VTAB CoEOM_idxOperModCfgd_VERB "" TAB_VERB 4 0 "Base" 1 "WarmUp" 2 "CatHtg" 3 "Start" /end COMPU_VTAB
/begin COMPU_METHOD CoEOM_idxOperModStgTot_VERB "" TAB_VERB "%6.3" "-" COMPU_TAB_REF CoEOM_idxOperModStgTot_VERB /end COMPU_METHOD
/begin COMPU_VTAB CoEOM_idxOperModStgTot_VERB "" TAB_VERB 16 0 "HOM-SNGL_FullLft" 1 "HOM_FullLft" 2 "HSP_FullLft" 3 "HSPIC_FullLft" 4 "HOM-SNGL_EIVC" 5 "HOM_EIVC" 6 "HSP_EIVC" 7 "HSPIC_EIVC" 8 "Stage 8" 9 "Stage 9" 10 "Stage 10" 11 "Stage 11" 12 "Stage 12" 13 "Stage 13" 14 "Stage 14" 15 "Stage 15" /end COMPU_VTAB
/begin COMPU_METHOD dez "" RAT_FUNC "%6.2" "" COEFFS 0 1 0 0 0 1 /end COMPU_METHOD
/begin COMPU_METHOD EGSDCmn_VirtLamGenrParl_sm_VERB "" TAB_VERB "%6.3" "" COMPU_TAB_REF EGSDCmn_VirtLamGenrParl_sm_VERB /end COMPU_METHOD
/begin COMPU_VTAB EGSDCmn_VirtLamGenrParl_sm_VERB "" TAB_VERB 8 0 "_0_InactiveV" 1 "_1_InpCatEmptyCdngV" 2 "_2_InpCatFullCdngV" 3 "_3_TarCatFullV" 4 "_4_TarCatEmptyV" 5 "_6_LamRichV" 6 "_7_LamLeanV" 7 "_99_hintergrundV" /end COMPU_VTAB
/begin COMPU_METHOD EGSDCmn_VirtTarPlausParl_sm_VERB "" TAB_VERB "%6.3" "" COMPU_TAB_REF EGSDCmn_VirtTarPlausParl_sm_VERB /end COMPU_METHOD
/begin COMPU_VTAB EGSDCmn_VirtTarPlausParl_sm_VERB "" TAB_VERB 6 0 "_0_Inactive_V" 1 "_1_InpCatEmptyCdng_V" 2 "_2_InpCatFullCdng_V" 3 "_3_TarCatFull_V" 4 "_4_TarCatEmpty_V" 5 "_99_hintergrund_V" /end COMPU_VTAB
/begin COMPU_METHOD EngN "" RAT_FUNC "%6.3" "rpm" COEFFS 0 2 0 0 0 1 /end COMPU_METHOD
/begin COMPU_METHOD EngN_LRes "" RAT_FUNC "%6.1" "rpm" COEFFS 0 0.025 0 0 0 1 /end COMPU_METHOD
/begin COMPU_METHOD fak_q0p000244 "" RAT_FUNC "%6.5" "-" COEFFS 0 65536 0 0 0 16 /end COMPU_METHOD
/begin COMPU_METHOD fak_q2p3283Em10 "" RAT_FUNC "%12.11" "-" COEFFS 0 4294967296 0 0 0 1 /end COMPU_METHOD
/begin COMPU_METHOD fak_q3p72529Em9 "" RAT_FUNC "%11.10" "" COEFFS 0 268435456 0 0 0 1 /end COMPU_METHOD
/begin COMPU_METHOD fak_sw_b64 "" RAT_FUNC "%6.4" "-" COEFFS 0 65536 0 0 0 128 /end COMPU_METHOD
/begin COMPU_METHOD fak_ub_b2 "" RAT_FUNC "%8.5" "-" COEFFS 0 256 0 0 0 2 /end COMPU_METHOD
/begin COMPU_METHOD fak_uw_b16 "" RAT_FUNC "%6.5" "-" COEFFS 0 65536 0 0 0 16 /end COMPU_METHOD
/begin COMPU_METHOD fak_uw_b2 "" RAT_FUNC "%7.6" "-" COEFFS 0 65536 0 0 0 2 /end COMPU_METHOD
/begin COMPU_METHOD fak_uw_b4 "" RAT_FUNC "%7.6" "-" COEFFS 0 65536 0 0 0 4 /end COMPU_METHOD
/begin COMPU_METHOD FFV_SY_Compu "" TAB_VERB "%6.3" "" COMPU_TAB_REF FFV_SY_Compu /end COMPU_METHOD
/begin COMPU_VTAB FFV_SY_Compu "" TAB_VERB 2 0 "False" 1 "True" /end COMPU_VTAB
/begin COMPU_METHOD FILININENDINTV_SC_Compu "" TAB_VERB "%6.3" "" COMPU_TAB_REF FILININENDINTV_SC_Compu /end COMPU_METHOD
/begin COMPU_VTAB FILININENDINTV_SC_Compu "" TAB_VERB 2 0 "False" 1 "True" /end COMPU_VTAB
/begin COMPU_METHOD FILLGDETRMTWNFLOW_SC_Compu "" TAB_VERB "%6.3" "" COMPU_TAB_REF FILLGDETRMTWNFLOW_SC_Compu /end COMPU_METHOD
/begin COMPU_VTAB FILLGDETRMTWNFLOW_SC_Compu "" TAB_VERB 2 0 "False" 1 "True" /end COMPU_VTAB
/begin COMPU_METHOD FlConsum_l "" RAT_FUNC "%6.5" "l" COEFFS 0 1000 0 0 0 1 /end COMPU_METHOD
/begin COMPU_METHOD FlConsum_l_s "" RAT_FUNC "%8.7" "l/s" COEFFS 0 360000 0 0 0 1 /end COMPU_METHOD
/begin COMPU_METHOD FlConsum_ul "" RAT_FUNC "%6.2" "ul" COEFFS 0 1 0 0 0 1 /end COMPU_METHOD
/begin COMPU_METHOD FlConsum_ul_1 "" RAT_FUNC "%6.5" "ul" COEFFS 0 1000 0 0 0 1 /end COMPU_METHOD
/begin COMPU_METHOD FlConsum_ul_High_COMPU "" RAT_FUNC "%6.1" "ul" COEFFS 0 0.05 0 0 0 1 /end COMPU_METHOD
/begin COMPU_METHOD k10ms_uw_b100 "" RAT_FUNC "%6.4" "1/s" COEFFS 0 65536 0 0 0 100 /end COMPU_METHOD
/begin COMPU_METHOD md_q1p526Em6 "" RAT_FUNC "%8.7" "Nm" COEFFS 0 65536 0 0 0 0.1 /end COMPU_METHOD
/begin COMPU_METHOD mgrad_q1_mgdivs "" RAT_FUNC "%6.2" "mg/s" COEFFS 0 1 0 0 0 1 /end COMPU_METHOD
/begin COMPU_METHOD m_q0p001_kg "" RAT_FUNC "%6.5" "kg" COEFFS 0 1000 0 0 0 1 /end COMPU_METHOD
/begin COMPU_METHOD m_q0p1 "" RAT_FUNC "%6.3" "kg/h" COEFFS 0 10 0 0 0 1 /end COMPU_METHOD
/begin COMPU_METHOD m_q1p5259Em8_kg "" RAT_FUNC "%10.9" "kg" COEFFS 0 65536000 0 0 0 1 /end COMPU_METHOD
/begin COMPU_METHOD m_q1p526Em6_g "" RAT_FUNC "%8.7" "g" COEFFS 0 655360 0 0 0 1 /end COMPU_METHOD
/begin COMPU_METHOD m_q1_mg "" RAT_FUNC "%6.2" "mg" COEFFS 0 1 0 0 0 1 /end COMPU_METHOD
/begin COMPU_METHOD m_sw_b3276p8 "" RAT_FUNC "%6.3" "kg/h" COEFFS 0 1 0 0 0 0.1 /end COMPU_METHOD
/begin COMPU_METHOD m_ub_q0p0444 "" RAT_FUNC "%6.4" "g" COEFFS 0 1 0 0 0 0.0444 /end COMPU_METHOD
/begin COMPU_METHOD m_uw_b25p6 "" RAT_FUNC "%6.5" "kg/h" COEFFS 0 65536 0 0 0 25.6 /end COMPU_METHOD
/begin COMPU_METHOD m_uw_b6553p5 "" RAT_FUNC "%6.3" "kg/h" COEFFS 0 1 0 0 0 0.1 /end COMPU_METHOD
/begin COMPU_METHOD nmot_ub_q40 "" RAT_FUNC "%6.1" "1/min" COEFFS 0 1 0 0 0 40 /end COMPU_METHOD
/begin COMPU_METHOD OneToOne "" RAT_FUNC "%6.2" "-" COEFFS 0 1 0 0 0 1 /end COMPU_METHOD
/begin COMPU_METHOD p_q1 "" RAT_FUNC "%6.2" "hPa" COEFFS 0 1 0 0 0 1 /end COMPU_METHOD
/begin COMPU_METHOD rel_q0p0234 "" RAT_FUNC "%6.4" "%" COEFFS 0 128 0 0 0 3 /end COMPU_METHOD
/begin COMPU_METHOD spgg_q0p002029_V_DIV_s "" RAT_FUNC "%6.4" "V/s" COEFFS 0 65536 0 0 0 133 /end COMPU_METHOD
/begin COMPU_METHOD spg_q1p221Em3_V "" RAT_FUNC "%6.4" "V" COEFFS 0 65536 0 0 0 80 /end COMPU_METHOD
/begin COMPU_METHOD Temp_Cels "" RAT_FUNC "%6.1" "deg C" COEFFS 0 10 2731.4 0 0 1 /end COMPU_METHOD
/begin COMPU_METHOD temp_q0p0234 "" RAT_FUNC "%6.4" "K" COEFFS 0 256 0 0 0 6 /end COMPU_METHOD
/begin COMPU_METHOD temp_q0p0234_o273 "" RAT_FUNC "%6.1" "Grad C" COEFFS 0 1 273.15 0 0 0.0234375 /end COMPU_METHOD
/begin COMPU_METHOD temp_q0p1 "" RAT_FUNC "%6.3" "Grad C" COEFFS 0 10 0 0 0 1 /end COMPU_METHOD
/begin COMPU_METHOD temp_q3p57Em7_om273 "" RAT_FUNC "%6.1" "Grad C" COEFFS 0 8388608 2291348275.2 0 0 3 /end COMPU_METHOD
/begin COMPU_METHOD temp_ub_q0p75_o48 "" RAT_FUNC "%6.2" "Grad C" COEFFS 0 1 48 0 0 0.75 /end COMPU_METHOD
/begin COMPU_METHOD trq_q0p1 "" RAT_FUNC "%6.3" "Nm" COEFFS 0 10 0 0 0 1 /end COMPU_METHOD
/begin COMPU_METHOD t_q0p01 "" RAT_FUNC "%6.4" "s" COEFFS 0 100 0 0 0 1 /end COMPU_METHOD
/begin COMPU_METHOD t_q0p1 "" RAT_FUNC "%6.3" "s" COEFFS 0 10 0 0 0 1 /end COMPU_METHOD
/begin COMPU_METHOD Vel "" RAT_FUNC "%6.4" "km/h" COEFFS 0 100 0 0 0 1 /end COMPU_METHOD
/begin COMPU_METHOD zk100msxs_ub_b25p6 "" RAT_FUNC "%6.3" "s" COEFFS 0 0 256 0 10 0 /end COMPU_METHOD
/begin COMPU_METHOD zk100msxs_uw_b6553p6 "" RAT_FUNC "%6.1" "s" COEFFS 0 0 65536 0 10 0 /end COMPU_METHOD
/begin COMPU_METHOD zk10msxs_uw_b655 "" RAT_FUNC "%6.2" "s" COEFFS 0 0 65536 0 100 0 /end COMPU_METHOD
/begin COMPU_METHOD zk10msxs_uw_b655p36 "" RAT_FUNC "%6.2" "s" COEFFS 0 0 65536 0 100 0 /end COMPU_METHOD
/begin RECORD_LAYOUT RB_Curve_S16_U16_Static NO_AXIS_PTS_X 1 SWORD AXIS_PTS_X 2 SWORD INDEX_INCR DIRECT FNC_VALUES 3 UWORD COLUMN_DIR DIRECT STATIC_RECORD_LAYOUT /end RECORD_LAYOUT
/begin RECORD_LAYOUT RB_Curve_U16_U16 NO_AXIS_PTS_X 1 UWORD AXIS_PTS_X 2 UWORD INDEX_INCR DIRECT FNC_VALUES 3 UWORD COLUMN_DIR DIRECT /end RECORD_LAYOUT
/begin RECORD_LAYOUT RB_Curve_U8_U16_Static NO_AXIS_PTS_X 1 UBYTE AXIS_PTS_X 2 UBYTE INDEX_INCR DIRECT FNC_VALUES 3 UWORD COLUMN_DIR DIRECT STATIC_RECORD_LAYOUT /end RECORD_LAYOUT
/begin RECORD_LAYOUT RB_Map_S16S16_U16 NO_AXIS_PTS_X 1 SWORD NO_AXIS_PTS_Y 2 SWORD AXIS_PTS_X 3 SWORD INDEX_INCR DIRECT AXIS_PTS_Y 4 SWORD INDEX_INCR DIRECT FNC_VALUES 5 UWORD COLUMN_DIR DIRECT /end RECORD_LAYOUT
/begin RECORD_LAYOUT RB_Map_U16U16_R32 NO_AXIS_PTS_X 1 UWORD NO_AXIS_PTS_Y 2 UWORD AXIS_PTS_X 3 UWORD INDEX_INCR DIRECT AXIS_PTS_Y 4 UWORD INDEX_INCR DIRECT FNC_VALUES 5 FLOAT32_IEEE COLUMN_DIR DIRECT /end RECORD_LAYOUT
/begin RECORD_LAYOUT RB_Map_U8U8_U8 NO_AXIS_PTS_X 1 UBYTE NO_AXIS_PTS_Y 2 UBYTE AXIS_PTS_X 3 UBYTE INDEX_INCR DIRECT AXIS_PTS_Y 4 UBYTE INDEX_INCR DIRECT FNC_VALUES 5 UBYTE COLUMN_DIR DIRECT /end RECORD_LAYOUT
/begin RECORD_LAYOUT RB_Val_Wr32 FNC_VALUES 1 FLOAT32_IEEE COLUMN_DIR DIRECT /end RECORD_LAYOUT
/begin RECORD_LAYOUT RB_Val_Ws16 FNC_VALUES 1 SWORD COLUMN_DIR DIRECT /end RECORD_LAYOUT
/begin RECORD_LAYOUT RB_Val_Wu16 FNC_VALUES 1 UWORD COLUMN_DIR DIRECT /end RECORD_LAYOUT
/begin RECORD_LAYOUT RB_Val_Wu32 FNC_VALUES 1 ULONG COLUMN_DIR DIRECT /end RECORD_LAYOUT
/begin RECORD_LAYOUT RB_Val_Wu8 FNC_VALUES 1 UBYTE COLUMN_DIR DIRECT /end RECORD_LAYOUT
/end MODULE
/end PROJECT
