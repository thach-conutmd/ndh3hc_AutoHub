ASAP2_VERSION 1 60
/begin PROJECT MG1CS022 "MG1CS022"
/begin HEADER "" VERSION "MG1CS022_62XSC_V037_TPROT" PROJECT_NO MG1CS022 /end HEADER
/begin MODULE DIM ""
/begin MOD_COMMON "" BYTE_ORDER MSB_LAST ALIGNMENT_BYTE 1 ALIGNMENT_WORD 2 ALIGNMENT_LONG 4 ALIGNMENT_INT64 4 ALIGNMENT_FLOAT32_IEEE 4 ALIGNMENT_FLOAT64_IEEE 4 DATA_SIZE 32 /end MOD_COMMON
/begin CHARACTERISTIC DINH_FId.DFC_AAVEmax_CA "inhibitable FIds / FIds to be inhibited by inhibit source DFC_AAVEmax" VAL_BLK 0x804D9A94 ValA_Wu16 968.000000000 DINH_FIdVerb 0.00 968.000000000 FORMAT "%13.9" NUMBER 59 /end CHARACTERISTIC
/begin CHARACTERISTIC DINH_FId.DFC_AAVEmin_CA "inhibitable FIds / FIds to be inhibited by inhibit source DFC_AAVEmin" VAL_BLK 0x804D9B0A ValA_Wu16 968.000000000 DINH_FIdVerb 0.00 968.000000000 FORMAT "%13.9" NUMBER 60 /end CHARACTERISTIC
/begin CHARACTERISTIC DINH_FId.DFC_AAVEsig_CA "inhibitable FIds / FIds to be inhibited by inhibit source DFC_AAVEsig" VAL_BLK 0x804D9B82 ValA_Wu16 968.000000000 DINH_FIdVerb 0.00 968.000000000 FORMAT "%13.9" NUMBER 59 /end CHARACTERISTIC
/begin CHARACTERISTIC DINH_FId.DFC_AltIOACGFailr_CA "inhibitable FIds / FIds to be inhibited by inhibit source DFC_AltIOACGFailr" VAL_BLK 0x804D9BF8 ValA_Wu16 968.000000000 DINH_FIdVerb 0.00 968.000000000 FORMAT "%13.9" NUMBER 65 /end CHARACTERISTIC
/begin CHARACTERISTIC DINH_FId.DFC_AltIOACGHiVltg_CA "inhibitable FIds / FIds to be inhibited by inhibit source DFC_AltIOACGHiVltg" VAL_BLK 0x804D9C7A ValA_Wu16 968.000000000 DINH_FIdVerb 0.00 968.000000000 FORMAT "%13.9" NUMBER 65 /end CHARACTERISTIC
/begin CHARACTERISTIC DINH_FId.DFC_AltIOACGLoVltg_CA "inhibitable FIds / FIds to be inhibited by inhibit source DFC_AltIOACGLoVltg" VAL_BLK 0x804D9CFC ValA_Wu16 968.000000000 DINH_FIdVerb 0.00 968.000000000 FORMAT "%13.9" NUMBER 65 /end CHARACTERISTIC
/begin CHARACTERISTIC DINH_FId.DFC_AltIOACGTHi_CA "inhibitable FIds / FIds to be inhibited by inhibit source DFC_AltIOACGTHi" VAL_BLK 0x804D9D7E ValA_Wu16 968.000000000 DINH_FIdVerb 0.00 968.000000000 FORMAT "%13.9" NUMBER 59 /end CHARACTERISTIC
/begin CHARACTERISTIC DINH_FId.DFC_AltIODConnACG_CA "inhibitable FIds / FIds to be inhibited by inhibit source DFC_AltIODConnACG" VAL_BLK 0x804D9DF4 ValA_Wu16 968.000000000 DINH_FIdVerb 0.00 968.000000000 FORMAT "%13.9" NUMBER 65 /end CHARACTERISTIC
/begin CHARACTERISTIC DINH_FId.DFC_BGOELWAF_CA "inhibitable FIds / FIds to be inhibited by inhibit source DFC_BGOELWAF" VAL_BLK 0x804D9E76 ValA_Wu16 968.000000000 DINH_FIdVerb 0.00 968.000000000 FORMAT "%13.9" NUMBER 50 /end CHARACTERISTIC
/begin CHARACTERISTIC DINH_FId.DFC_BattUHiFailr_CA "inhibitable FIds / FIds to be inhibited by inhibit source DFC_BattUHiFailr" VAL_BLK 0x804D9EDA ValA_Wu16 968.000000000 DINH_FIdVerb 0.00 968.000000000 FORMAT "%13.9" NUMBER 51 /end CHARACTERISTIC
/begin CHARACTERISTIC DINH_FId.DFC_BattULoFailr_CA "inhibitable FIds / FIds to be inhibited by inhibit source DFC_BattULoFailr" VAL_BLK 0x804D9F40 ValA_Wu16 968.000000000 DINH_FIdVerb 0.00 968.000000000 FORMAT "%13.9" NUMBER 51 /end CHARACTERISTIC
/begin CHARACTERISTIC DINH_FId.DFC_BrkBstPDriftHiErr_CA "inhibitable FIds / FIds to be inhibited by inhibit source DFC_BrkBstPDriftHiErr" VAL_BLK 0x804D9FA6 ValA_Wu16 968.000000000 DINH_FIdVerb 0.00 968.000000000 FORMAT "%13.9" NUMBER 55 /end CHARACTERISTIC
/begin CHARACTERISTIC DINH_FId.DFC_BrkBstPDriftLoErr_CA "inhibitable FIds / FIds to be inhibited by inhibit source DFC_BrkBstPDriftLoErr" VAL_BLK 0x804DA014 ValA_Wu16 968.000000000 DINH_FIdVerb 0.00 968.000000000 FORMAT "%13.9" NUMBER 55 /end CHARACTERISTIC
/begin CHARACTERISTIC DINH_FId.DFC_BrkBstPSnsrStuck_CA "inhibitable FIds / FIds to be inhibited by inhibit source DFC_BrkBstPSnsrStuck" VAL_BLK 0x804DA082 ValA_Wu16 968.000000000 DINH_FIdVerb 0.00 968.000000000 FORMAT "%13.9" NUMBER 56 /end CHARACTERISTIC
/begin CHARACTERISTIC DINH_FId.DFC_BrkMnSwtContOn_CA "inhibitable FIds / FIds to be inhibited by inhibit source DFC_BrkMnSwtContOn" VAL_BLK 0x804DA0F2 ValA_Wu16 968.000000000 DINH_FIdVerb 0.00 968.000000000 FORMAT "%13.9" NUMBER 55 /end CHARACTERISTIC
/begin CHARACTERISTIC DINH_FId.DFC_BrkMnSwtNotStp_CA "inhibitable FIds / FIds to be inhibited by inhibit source DFC_BrkMnSwtNotStp" VAL_BLK 0x804DA160 ValA_Wu16 968.000000000 DINH_FIdVerb 0.00 968.000000000 FORMAT "%13.9" NUMBER 55 /end CHARACTERISTIC
/begin CHARACTERISTIC DINH_FId.DFC_BrkNpl_CA "inhibitable FIds / FIds to be inhibited by inhibit source DFC_BrkNpl" VAL_BLK 0x804DA1CE ValA_Wu16 968.000000000 DINH_FIdVerb 0.00 968.000000000 FORMAT "%13.9" NUMBER 54 /end CHARACTERISTIC
/begin CHARACTERISTIC DINH_FId.DFC_BrkRdntSwtContOn_CA "inhibitable FIds / FIds to be inhibited by inhibit source DFC_BrkRdntSwtContOn" VAL_BLK 0x804DA23A ValA_Wu16 968.000000000 DINH_FIdVerb 0.00 968.000000000 FORMAT "%13.9" NUMBER 55 /end CHARACTERISTIC
/begin CHARACTERISTIC DINH_FId.DFC_BrkRdntSwtNotStp_CA "inhibitable FIds / FIds to be inhibited by inhibit source DFC_BrkRdntSwtNotStp" VAL_BLK 0x804DA2A8 ValA_Wu16 968.000000000 DINH_FIdVerb 0.00 968.000000000 FORMAT "%13.9" NUMBER 55 /end CHARACTERISTIC
/begin CHARACTERISTIC DINH_FId.DFC_Clth3ONStuck_CA "inhibitable FIds / FIds to be inhibited by inhibit source DFC_Clth3ONStuck" VAL_BLK 0x804DA316 ValA_Wu16 968.000000000 DINH_FIdVerb 0.00 968.000000000 FORMAT "%13.9" NUMBER 63 /end CHARACTERISTIC
/begin CHARACTERISTIC DINH_FId.DFC_Clth4OFFStuck_CA "inhibitable FIds / FIds to be inhibited by inhibit source DFC_Clth4OFFStuck" VAL_BLK 0x804DA394 ValA_Wu16 968.000000000 DINH_FIdVerb 0.00 968.000000000 FORMAT "%13.9" NUMBER 59 /end CHARACTERISTIC
/begin CHARACTERISTIC DINH_FId.DFC_ClthOFFStuck_CA "inhibitable FIds / FIds to be inhibited by inhibit source DFC_ClthOFFStuck" VAL_BLK 0x804DA40A ValA_Wu16 968.000000000 DINH_FIdVerb 0.00 968.000000000 FORMAT "%13.9" NUMBER 60 /end CHARACTERISTIC
/begin CHARACTERISTIC DINH_FId.DFC_ClthONStuck_CA "inhibitable FIds / FIds to be inhibited by inhibit source DFC_ClthONStuck" VAL_BLK 0x804DA482 ValA_Wu16 968.000000000 DINH_FIdVerb 0.00 968.000000000 FORMAT "%13.9" NUMBER 60 /end CHARACTERISTIC
/begin CHARACTERISTIC DINH_FId.DFC_ClthStkFailInfo_CA "inhibitable FIds / FIds to be inhibited by inhibit source DFC_ClthStkFailInfo" VAL_BLK 0x804DA4FA ValA_Wu16 968.000000000 DINH_FIdVerb 0.00 968.000000000 FORMAT "%13.9" NUMBER 68 /end CHARACTERISTIC
/begin CHARACTERISTIC DINH_FId.DFC_ComACFailInfo_CA "inhibitable FIds / FIds to be inhibited by inhibit source DFC_ComACFailInfo" VAL_BLK 0x804DA582 ValA_Wu16 968.000000000 DINH_FIdVerb 0.00 968.000000000 FORMAT "%13.9" NUMBER 53 /end CHARACTERISTIC
/begin CHARACTERISTIC DINH_FId.DFC_ComATFTValErr_CA "inhibitable FIds / FIds to be inhibited by inhibit source DFC_ComATFTValErr" VAL_BLK 0x804DA5EC ValA_Wu16 968.000000000 DINH_FIdVerb 0.00 968.000000000 FORMAT "%13.9" NUMBER 50 /end CHARACTERISTIC
/begin CHARACTERISTIC DINH_FId.DFC_ComATMILReq_CA "inhibitable FIds / FIds to be inhibited by inhibit source DFC_ComATMILReq" VAL_BLK 0x804DA650 ValA_Wu16 968.000000000 DINH_FIdVerb 0.00 968.000000000 FORMAT "%13.9" NUMBER 50 /end CHARACTERISTIC
/begin CHARACTERISTIC DINH_FId.DFC_ComAYCAChksum_CA "inhibitable FIds / FIds to be inhibited by inhibit source DFC_ComAYCAChksum" VAL_BLK 0x804DA6B4 ValA_Wu16 968.000000000 DINH_FIdVerb 0.00 968.000000000 FORMAT "%13.9" NUMBER 67 /end CHARACTERISTIC
/begin CHARACTERISTIC DINH_FId.DFC_ComAYCARingCnt_CA "inhibitable FIds / FIds to be inhibited by inhibit source DFC_ComAYCARingCnt" VAL_BLK 0x804DA73A ValA_Wu16 968.000000000 DINH_FIdVerb 0.00 968.000000000 FORMAT "%13.9" NUMBER 67 /end CHARACTERISTIC
/begin CHARACTERISTIC DINH_FId.DFC_ComAYCATOut_CA "inhibitable FIds / FIds to be inhibited by inhibit source DFC_ComAYCATOut" VAL_BLK 0x804DA7C0 ValA_Wu16 968.000000000 DINH_FIdVerb 0.00 968.000000000 FORMAT "%13.9" NUMBER 67 /end CHARACTERISTIC
/begin CHARACTERISTIC DINH_FId.DFC_ComAYCDChkSum_CA "inhibitable FIds / FIds to be inhibited by inhibit source DFC_ComAYCDChkSum" VAL_BLK 0x804DA846 ValA_Wu16 968.000000000 DINH_FIdVerb 0.00 968.000000000 FORMAT "%13.9" NUMBER 66 /end CHARACTERISTIC
/begin CHARACTERISTIC DINH_FId.DFC_ComAYCDTOut_CA "inhibitable FIds / FIds to be inhibited by inhibit source DFC_ComAYCDTOut" VAL_BLK 0x804DA8CA ValA_Wu16 968.000000000 DINH_FIdVerb 0.00 968.000000000 FORMAT "%13.9" NUMBER 66 /end CHARACTERISTIC
/begin CHARACTERISTIC DINH_FId.DFC_ComAYCFChksum_CA "inhibitable FIds / FIds to be inhibited by inhibit source DFC_ComAYCFChksum" VAL_BLK 0x804DA94E ValA_Wu16 968.000000000 DINH_FIdVerb 0.00 968.000000000 FORMAT "%13.9" NUMBER 69 /end CHARACTERISTIC
/begin CHARACTERISTIC DINH_FId.DFC_ComAYCFRingCnt_CA "inhibitable FIds / FIds to be inhibited by inhibit source DFC_ComAYCFRingCnt" VAL_BLK 0x804DA9D8 ValA_Wu16 968.000000000 DINH_FIdVerb 0.00 968.000000000 FORMAT "%13.9" NUMBER 69 /end CHARACTERISTIC
/begin CHARACTERISTIC DINH_FId.DFC_ComAYCFTOut_CA "inhibitable FIds / FIds to be inhibited by inhibit source DFC_ComAYCFTOut" VAL_BLK 0x804DAA62 ValA_Wu16 968.000000000 DINH_FIdVerb 0.00 968.000000000 FORMAT "%13.9" NUMBER 69 /end CHARACTERISTIC
/begin CHARACTERISTIC DINH_FId.DFC_ComAYCGChksum_CA "inhibitable FIds / FIds to be inhibited by inhibit source DFC_ComAYCGChksum" VAL_BLK 0x804DAAEC ValA_Wu16 968.000000000 DINH_FIdVerb 0.00 968.000000000 FORMAT "%13.9" NUMBER 64 /end CHARACTERISTIC
/begin CHARACTERISTIC DINH_FId.DFC_ComAYCGRingCnt_CA "inhibitable FIds / FIds to be inhibited by inhibit source DFC_ComAYCGRingCnt" VAL_BLK 0x804DAB6C ValA_Wu16 968.000000000 DINH_FIdVerb 0.00 968.000000000 FORMAT "%13.9" NUMBER 64 /end CHARACTERISTIC
/begin CHARACTERISTIC DINH_FId.DFC_ComAYCGTOut_CA "inhibitable FIds / FIds to be inhibited by inhibit source DFC_ComAYCGTOut" VAL_BLK 0x804DABEC ValA_Wu16 968.000000000 DINH_FIdVerb 0.00 968.000000000 FORMAT "%13.9" NUMBER 64 /end CHARACTERISTIC
/begin CHARACTERISTIC DINH_FId.DFC_ComAYCIChkSum_CA "inhibitable FIds / FIds to be inhibited by inhibit source DFC_ComAYCIChkSum" VAL_BLK 0x804DAC6C ValA_Wu16 968.000000000 DINH_FIdVerb 0.00 968.000000000 FORMAT "%13.9" NUMBER 58 /end CHARACTERISTIC
/begin CHARACTERISTIC DINH_FId.DFC_ComAYCIRingCnt_CA "inhibitable FIds / FIds to be inhibited by inhibit source DFC_ComAYCIRingCnt" VAL_BLK 0x804DACE0 ValA_Wu16 968.000000000 DINH_FIdVerb 0.00 968.000000000 FORMAT "%13.9" NUMBER 58 /end CHARACTERISTIC
/begin CHARACTERISTIC DINH_FId.DFC_ComAYCITOut_CA "inhibitable FIds / FIds to be inhibited by inhibit source DFC_ComAYCITOut" VAL_BLK 0x804DAD54 ValA_Wu16 968.000000000 DINH_FIdVerb 0.00 968.000000000 FORMAT "%13.9" NUMBER 58 /end CHARACTERISTIC
/begin CHARACTERISTIC DINH_FId.DFC_ComBCM1ChkSum_CA "inhibitable FIds / FIds to be inhibited by inhibit source DFC_ComBCM1ChkSum" VAL_BLK 0x804DADC8 ValA_Wu16 968.000000000 DINH_FIdVerb 0.00 968.000000000 FORMAT "%13.9" NUMBER 55 /end CHARACTERISTIC
/begin CHARACTERISTIC DINH_FId.DFC_ComBCM1RingCnt_CA "inhibitable FIds / FIds to be inhibited by inhibit source DFC_ComBCM1RingCnt" VAL_BLK 0x804DAE36 ValA_Wu16 968.000000000 DINH_FIdVerb 0.00 968.000000000 FORMAT "%13.9" NUMBER 55 /end CHARACTERISTIC
/begin CHARACTERISTIC DINH_FId.DFC_ComBCM1TOut_CA "inhibitable FIds / FIds to be inhibited by inhibit source DFC_ComBCM1TOut" VAL_BLK 0x804DAEA4 ValA_Wu16 968.000000000 DINH_FIdVerb 0.00 968.000000000 FORMAT "%13.9" NUMBER 55 /end CHARACTERISTIC
/begin CHARACTERISTIC DINH_FId.DFC_ComCANABusOffErr_CA "inhibitable FIds / FIds to be inhibited by inhibit source DFC_ComCANABusOffErr" VAL_BLK 0x804DAF12 ValA_Wu16 968.000000000 DINH_FIdVerb 0.00 968.000000000 FORMAT "%13.9" NUMBER 201 /end CHARACTERISTIC
/begin CHARACTERISTIC DINH_FId.DFC_ComCANBBusOffErr_CA "inhibitable FIds / FIds to be inhibited by inhibit source DFC_ComCANBBusOffErr" VAL_BLK 0x804DB0A4 ValA_Wu16 968.000000000 DINH_FIdVerb 0.00 968.000000000 FORMAT "%13.9" NUMBER 200 /end CHARACTERISTIC
/begin CHARACTERISTIC DINH_FId.DFC_ComCANCBusOffErr_CA "inhibitable FIds / FIds to be inhibited by inhibit source DFC_ComCANCBusOffErr" VAL_BLK 0x804DB234 ValA_Wu16 968.000000000 DINH_FIdVerb 0.00 968.000000000 FORMAT "%13.9" NUMBER 200 /end CHARACTERISTIC
/begin CHARACTERISTIC DINH_FId.DFC_ComCGW1ChkSum_CA "inhibitable FIds / FIds to be inhibited by inhibit source DFC_ComCGW1ChkSum" VAL_BLK 0x804DB3C4 ValA_Wu16 968.000000000 DINH_FIdVerb 0.00 968.000000000 FORMAT "%13.9" NUMBER 53 /end CHARACTERISTIC
/begin CHARACTERISTIC DINH_FId.DFC_ComCGW1RingCnt_CA "inhibitable FIds / FIds to be inhibited by inhibit source DFC_ComCGW1RingCnt" VAL_BLK 0x804DB42E ValA_Wu16 968.000000000 DINH_FIdVerb 0.00 968.000000000 FORMAT "%13.9" NUMBER 53 /end CHARACTERISTIC
/begin CHARACTERISTIC DINH_FId.DFC_ComCGW1TOut_CA "inhibitable FIds / FIds to be inhibited by inhibit source DFC_ComCGW1TOut" VAL_BLK 0x804DB498 ValA_Wu16 968.000000000 DINH_FIdVerb 0.00 968.000000000 FORMAT "%13.9" NUMBER 53 /end CHARACTERISTIC
/begin CHARACTERISTIC DINH_FId.DFC_ComConvBoostErr_CA "inhibitable FIds / FIds to be inhibited by inhibit source DFC_ComConvBoostErr" VAL_BLK 0x804DB502 ValA_Wu16 968.000000000 DINH_FIdVerb 0.00 968.000000000 FORMAT "%13.9" NUMBER 51 /end CHARACTERISTIC
/begin CHARACTERISTIC DINH_FId.DFC_ComConvSlipErr_CA "inhibitable FIds / FIds to be inhibited by inhibit source DFC_ComConvSlipErr" VAL_BLK 0x804DB568 ValA_Wu16 968.000000000 DINH_FIdVerb 0.00 968.000000000 FORMAT "%13.9" NUMBER 51 /end CHARACTERISTIC
/begin CHARACTERISTIC DINH_FId.DFC_ComDCDCPrfmncErr_CA "inhibitable FIds / FIds to be inhibited by inhibit source DFC_ComDCDCPrfmncErr" VAL_BLK 0x804DB5CE ValA_Wu16 968.000000000 DINH_FIdVerb 0.00 968.000000000 FORMAT "%13.9" NUMBER 57 /end CHARACTERISTIC
/begin CHARACTERISTIC DINH_FId.DFC_ComDCDCTempWarn_CA "inhibitable FIds / FIds to be inhibited by inhibit source DFC_ComDCDCTempWarn" VAL_BLK 0x804DB640 ValA_Wu16 968.000000000 DINH_FIdVerb 0.00 968.000000000 FORMAT "%13.9" NUMBER 54 /end CHARACTERISTIC
/begin CHARACTERISTIC DINH_FId.DFC_ComEAT10Chksum_CA "inhibitable FIds / FIds to be inhibited by inhibit source DFC_ComEAT10Chksum" VAL_BLK 0x804DB6AC ValA_Wu16 968.000000000 DINH_FIdVerb 0.00 968.000000000 FORMAT "%13.9" NUMBER 60 /end CHARACTERISTIC
/begin CHARACTERISTIC DINH_FId.DFC_ComEAT10RingCnt_CA "inhibitable FIds / FIds to be inhibited by inhibit source DFC_ComEAT10RingCnt" VAL_BLK 0x804DB724 ValA_Wu16 968.000000000 DINH_FIdVerb 0.00 968.000000000 FORMAT "%13.9" NUMBER 60 /end CHARACTERISTIC
/begin CHARACTERISTIC DINH_FId.DFC_ComEAT10TOut_CA "inhibitable FIds / FIds to be inhibited by inhibit source DFC_ComEAT10TOut" VAL_BLK 0x804DB79C ValA_Wu16 968.000000000 DINH_FIdVerb 0.00 968.000000000 FORMAT "%13.9" NUMBER 60 /end CHARACTERISTIC
/begin CHARACTERISTIC DINH_FId.DFC_ComEAT11ChkSum_CA "inhibitable FIds / FIds to be inhibited by inhibit source DFC_ComEAT11ChkSum" VAL_BLK 0x804DB814 ValA_Wu16 968.000000000 DINH_FIdVerb 0.00 968.000000000 FORMAT "%13.9" NUMBER 53 /end CHARACTERISTIC
/begin CHARACTERISTIC DINH_FId.DFC_ComEAT11RingCnt_CA "inhibitable FIds / FIds to be inhibited by inhibit source DFC_ComEAT11RingCnt" VAL_BLK 0x804DB87E ValA_Wu16 968.000000000 DINH_FIdVerb 0.00 968.000000000 FORMAT "%13.9" NUMBER 53 /end CHARACTERISTIC
/begin CHARACTERISTIC DINH_FId.DFC_ComEAT11TOut_CA "inhibitable FIds / FIds to be inhibited by inhibit source DFC_ComEAT11TOut" VAL_BLK 0x804DB8E8 ValA_Wu16 968.000000000 DINH_FIdVerb 0.00 968.000000000 FORMAT "%13.9" NUMBER 53 /end CHARACTERISTIC
/begin CHARACTERISTIC DINH_FId.DFC_ComEAT12ChkSum_CA "inhibitable FIds / FIds to be inhibited by inhibit source DFC_ComEAT12ChkSum" VAL_BLK 0x804DB952 ValA_Wu16 968.000000000 DINH_FIdVerb 0.00 968.000000000 FORMAT "%13.9" NUMBER 53 /end CHARACTERISTIC
/begin CHARACTERISTIC DINH_FId.DFC_ComEAT12RingCnt_CA "inhibitable FIds / FIds to be inhibited by inhibit source DFC_ComEAT12RingCnt" VAL_BLK 0x804DB9BC ValA_Wu16 968.000000000 DINH_FIdVerb 0.00 968.000000000 FORMAT "%13.9" NUMBER 53 /end CHARACTERISTIC
/begin CHARACTERISTIC DINH_FId.DFC_ComEAT12TOut_CA "inhibitable FIds / FIds to be inhibited by inhibit source DFC_ComEAT12TOut" VAL_BLK 0x804DBA26 ValA_Wu16 968.000000000 DINH_FIdVerb 0.00 968.000000000 FORMAT "%13.9" NUMBER 53 /end CHARACTERISTIC
/begin CHARACTERISTIC DINH_FId.DFC_ComEAT13ChkSum_CA "inhibitable FIds / FIds to be inhibited by inhibit source DFC_ComEAT13ChkSum" VAL_BLK 0x804DBA90 ValA_Wu16 968.000000000 DINH_FIdVerb 0.00 968.000000000 FORMAT "%13.9" NUMBER 57 /end CHARACTERISTIC
/begin CHARACTERISTIC DINH_FId.DFC_ComEAT13RingCnt_CA "inhibitable FIds / FIds to be inhibited by inhibit source DFC_ComEAT13RingCnt" VAL_BLK 0x804DBB02 ValA_Wu16 968.000000000 DINH_FIdVerb 0.00 968.000000000 FORMAT "%13.9" NUMBER 57 /end CHARACTERISTIC
/begin CHARACTERISTIC DINH_FId.DFC_ComEAT13TOut_CA "inhibitable FIds / FIds to be inhibited by inhibit source DFC_ComEAT13TOut" VAL_BLK 0x804DBB74 ValA_Wu16 968.000000000 DINH_FIdVerb 0.00 968.000000000 FORMAT "%13.9" NUMBER 57 /end CHARACTERISTIC
/begin CHARACTERISTIC DINH_FId.DFC_ComEAT1Chksum_CA "inhibitable FIds / FIds to be inhibited by inhibit source DFC_ComEAT1Chksum" VAL_BLK 0x804DBBE6 ValA_Wu16 968.000000000 DINH_FIdVerb 0.00 968.000000000 FORMAT "%13.9" NUMBER 57 /end CHARACTERISTIC
/begin CHARACTERISTIC DINH_FId.DFC_ComEAT1RingCnt_CA "inhibitable FIds / FIds to be inhibited by inhibit source DFC_ComEAT1RingCnt" VAL_BLK 0x804DBC58 ValA_Wu16 968.000000000 DINH_FIdVerb 0.00 968.000000000 FORMAT "%13.9" NUMBER 57 /end CHARACTERISTIC
/begin CHARACTERISTIC DINH_FId.DFC_ComEAT1TOut_CA "inhibitable FIds / FIds to be inhibited by inhibit source DFC_ComEAT1TOut" VAL_BLK 0x804DBCCA ValA_Wu16 968.000000000 DINH_FIdVerb 0.00 968.000000000 FORMAT "%13.9" NUMBER 57 /end CHARACTERISTIC
/begin CHARACTERISTIC DINH_FId.DFC_ComEAT2ChkSum_CA "inhibitable FIds / FIds to be inhibited by inhibit source DFC_ComEAT2ChkSum" VAL_BLK 0x804DBD3C ValA_Wu16 968.000000000 DINH_FIdVerb 0.00 968.000000000 FORMAT "%13.9" NUMBER 58 /end CHARACTERISTIC
/begin CHARACTERISTIC DINH_FId.DFC_ComEAT2RingCnt_CA "inhibitable FIds / FIds to be inhibited by inhibit source DFC_ComEAT2RingCnt" VAL_BLK 0x804DBDB0 ValA_Wu16 968.000000000 DINH_FIdVerb 0.00 968.000000000 FORMAT "%13.9" NUMBER 58 /end CHARACTERISTIC
/begin CHARACTERISTIC DINH_FId.DFC_ComEAT2TOut_CA "inhibitable FIds / FIds to be inhibited by inhibit source DFC_ComEAT2TOut" VAL_BLK 0x804DBE24 ValA_Wu16 968.000000000 DINH_FIdVerb 0.00 968.000000000 FORMAT "%13.9" NUMBER 58 /end CHARACTERISTIC
/begin CHARACTERISTIC DINH_FId.DFC_ComEAT4ChkSum_CA "inhibitable FIds / FIds to be inhibited by inhibit source DFC_ComEAT4ChkSum" VAL_BLK 0x804DBE98 ValA_Wu16 968.000000000 DINH_FIdVerb 0.00 968.000000000 FORMAT "%13.9" NUMBER 58 /end CHARACTERISTIC
/begin CHARACTERISTIC DINH_FId.DFC_ComEAT4RingCnt_CA "inhibitable FIds / FIds to be inhibited by inhibit source DFC_ComEAT4RingCnt" VAL_BLK 0x804DBF0C ValA_Wu16 968.000000000 DINH_FIdVerb 0.00 968.000000000 FORMAT "%13.9" NUMBER 58 /end CHARACTERISTIC
/begin CHARACTERISTIC DINH_FId.DFC_ComEAT4TOut_CA "inhibitable FIds / FIds to be inhibited by inhibit source DFC_ComEAT4TOut" VAL_BLK 0x804DBF80 ValA_Wu16 968.000000000 DINH_FIdVerb 0.00 968.000000000 FORMAT "%13.9" NUMBER 58 /end CHARACTERISTIC
/begin CHARACTERISTIC DINH_FId.DFC_ComEAT6Chksum_CA "inhibitable FIds / FIds to be inhibited by inhibit source DFC_ComEAT6Chksum" VAL_BLK 0x804DBFF4 ValA_Wu16 968.000000000 DINH_FIdVerb 0.00 968.000000000 FORMAT "%13.9" NUMBER 59 /end CHARACTERISTIC
/begin CHARACTERISTIC DINH_FId.DFC_ComEAT6RingCnt_CA "inhibitable FIds / FIds to be inhibited by inhibit source DFC_ComEAT6RingCnt" VAL_BLK 0x804DC06A ValA_Wu16 968.000000000 DINH_FIdVerb 0.00 968.000000000 FORMAT "%13.9" NUMBER 59 /end CHARACTERISTIC
/begin CHARACTERISTIC DINH_FId.DFC_ComEAT6TOut_CA "inhibitable FIds / FIds to be inhibited by inhibit source DFC_ComEAT6TOut" VAL_BLK 0x804DC0E0 ValA_Wu16 968.000000000 DINH_FIdVerb 0.00 968.000000000 FORMAT "%13.9" NUMBER 59 /end CHARACTERISTIC
/begin CHARACTERISTIC DINH_FId.DFC_ComEAT7Chksum_CA "inhibitable FIds / FIds to be inhibited by inhibit source DFC_ComEAT7Chksum" VAL_BLK 0x804DC156 ValA_Wu16 968.000000000 DINH_FIdVerb 0.00 968.000000000 FORMAT "%13.9" NUMBER 58 /end CHARACTERISTIC
/begin CHARACTERISTIC DINH_FId.DFC_ComEAT7RingCnt_CA "inhibitable FIds / FIds to be inhibited by inhibit source DFC_ComEAT7RingCnt" VAL_BLK 0x804DC1CA ValA_Wu16 968.000000000 DINH_FIdVerb 0.00 968.000000000 FORMAT "%13.9" NUMBER 58 /end CHARACTERISTIC
/begin CHARACTERISTIC DINH_FId.DFC_ComEAT7TOut_CA "inhibitable FIds / FIds to be inhibited by inhibit source DFC_ComEAT7TOut" VAL_BLK 0x804DC23E ValA_Wu16 968.000000000 DINH_FIdVerb 0.00 968.000000000 FORMAT "%13.9" NUMBER 58 /end CHARACTERISTIC
/begin CHARACTERISTIC DINH_FId.DFC_ComEAT8Chksum_CA "inhibitable FIds / FIds to be inhibited by inhibit source DFC_ComEAT8Chksum" VAL_BLK 0x804DC2B2 ValA_Wu16 968.000000000 DINH_FIdVerb 0.00 968.000000000 FORMAT "%13.9" NUMBER 59 /end CHARACTERISTIC
/begin CHARACTERISTIC DINH_FId.DFC_ComEAT8RingCnt_CA "inhibitable FIds / FIds to be inhibited by inhibit source DFC_ComEAT8RingCnt" VAL_BLK 0x804DC328 ValA_Wu16 968.000000000 DINH_FIdVerb 0.00 968.000000000 FORMAT "%13.9" NUMBER 59 /end CHARACTERISTIC
/begin CHARACTERISTIC DINH_FId.DFC_ComEAT8TOut_CA "inhibitable FIds / FIds to be inhibited by inhibit source DFC_ComEAT8TOut" VAL_BLK 0x804DC39E ValA_Wu16 968.000000000 DINH_FIdVerb 0.00 968.000000000 FORMAT "%13.9" NUMBER 59 /end CHARACTERISTIC
/begin CHARACTERISTIC DINH_FId.DFC_ComEATAChksum_CA "inhibitable FIds / FIds to be inhibited by inhibit source DFC_ComEATAChksum" VAL_BLK 0x804DC414 ValA_Wu16 968.000000000 DINH_FIdVerb 0.00 968.000000000 FORMAT "%13.9" NUMBER 59 /end CHARACTERISTIC
/begin CHARACTERISTIC DINH_FId.DFC_ComEATARingCnt_CA "inhibitable FIds / FIds to be inhibited by inhibit source DFC_ComEATARingCnt" VAL_BLK 0x804DC48A ValA_Wu16 968.000000000 DINH_FIdVerb 0.00 968.000000000 FORMAT "%13.9" NUMBER 59 /end CHARACTERISTIC
/begin CHARACTERISTIC DINH_FId.DFC_ComEATATOut_CA "inhibitable FIds / FIds to be inhibited by inhibit source DFC_ComEATATOut" VAL_BLK 0x804DC500 ValA_Wu16 968.000000000 DINH_FIdVerb 0.00 968.000000000 FORMAT "%13.9" NUMBER 59 /end CHARACTERISTIC
/begin CHARACTERISTIC DINH_FId.DFC_ComEATBChkSum_CA "inhibitable FIds / FIds to be inhibited by inhibit source DFC_ComEATBChkSum" VAL_BLK 0x804DC576 ValA_Wu16 968.000000000 DINH_FIdVerb 0.00 968.000000000 FORMAT "%13.9" NUMBER 65 /end CHARACTERISTIC
/begin CHARACTERISTIC DINH_FId.DFC_ComEATBRingCnt_CA "inhibitable FIds / FIds to be inhibited by inhibit source DFC_ComEATBRingCnt" VAL_BLK 0x804DC5F8 ValA_Wu16 968.000000000 DINH_FIdVerb 0.00 968.000000000 FORMAT "%13.9" NUMBER 65 /end CHARACTERISTIC
/begin CHARACTERISTIC DINH_FId.DFC_ComEATBTOut_CA "inhibitable FIds / FIds to be inhibited by inhibit source DFC_ComEATBTOut" VAL_BLK 0x804DC67A ValA_Wu16 968.000000000 DINH_FIdVerb 0.00 968.000000000 FORMAT "%13.9" NUMBER 65 /end CHARACTERISTIC
/begin CHARACTERISTIC DINH_FId.DFC_ComEATCChksum_CA "inhibitable FIds / FIds to be inhibited by inhibit source DFC_ComEATCChksum" VAL_BLK 0x804DC6FC ValA_Wu16 968.000000000 DINH_FIdVerb 0.00 968.000000000 FORMAT "%13.9" NUMBER 52 /end CHARACTERISTIC
/begin CHARACTERISTIC DINH_FId.DFC_ComEATCRingCnt_CA "inhibitable FIds / FIds to be inhibited by inhibit source DFC_ComEATCRingCnt" VAL_BLK 0x804DC764 ValA_Wu16 968.000000000 DINH_FIdVerb 0.00 968.000000000 FORMAT "%13.9" NUMBER 52 /end CHARACTERISTIC
/begin CHARACTERISTIC DINH_FId.DFC_ComEATCTOut_CA "inhibitable FIds / FIds to be inhibited by inhibit source DFC_ComEATCTOut" VAL_BLK 0x804DC7CC ValA_Wu16 968.000000000 DINH_FIdVerb 0.00 968.000000000 FORMAT "%13.9" NUMBER 52 /end CHARACTERISTIC
/begin CHARACTERISTIC DINH_FId.DFC_ComEPBBChkSum_CA "inhibitable FIds / FIds to be inhibited by inhibit source DFC_ComEPBBChkSum" VAL_BLK 0x804DC834 ValA_Wu16 968.000000000 DINH_FIdVerb 0.00 968.000000000 FORMAT "%13.9" NUMBER 53 /end CHARACTERISTIC
/begin CHARACTERISTIC DINH_FId.DFC_ComEPBBRingCnt_CA "inhibitable FIds / FIds to be inhibited by inhibit source DFC_ComEPBBRingCnt" VAL_BLK 0x804DC89E ValA_Wu16 968.000000000 DINH_FIdVerb 0.00 968.000000000 FORMAT "%13.9" NUMBER 53 /end CHARACTERISTIC
/begin CHARACTERISTIC DINH_FId.DFC_ComEPBBTOut_CA "inhibitable FIds / FIds to be inhibited by inhibit source DFC_ComEPBBTOut" VAL_BLK 0x804DC908 ValA_Wu16 968.000000000 DINH_FIdVerb 0.00 968.000000000 FORMAT "%13.9" NUMBER 53 /end CHARACTERISTIC
/begin CHARACTERISTIC DINH_FId.DFC_ComEPBChksum_CA "inhibitable FIds / FIds to be inhibited by inhibit source DFC_ComEPBChksum" VAL_BLK 0x804DC972 ValA_Wu16 968.000000000 DINH_FIdVerb 0.00 968.000000000 FORMAT "%13.9" NUMBER 65 /end CHARACTERISTIC
/begin CHARACTERISTIC DINH_FId.DFC_ComEPBTOut_CA "inhibitable FIds / FIds to be inhibited by inhibit source DFC_ComEPBTOut" VAL_BLK 0x804DC9F4 ValA_Wu16 968.000000000 DINH_FIdVerb 0.00 968.000000000 FORMAT "%13.9" NUMBER 65 /end CHARACTERISTIC
/begin CHARACTERISTIC DINH_FId.DFC_ComEPBctRing_CA "inhibitable FIds / FIds to be inhibited by inhibit source DFC_ComEPBctRing" VAL_BLK 0x804DCA76 ValA_Wu16 968.000000000 DINH_FIdVerb 0.00 968.000000000 FORMAT "%13.9" NUMBER 65 /end CHARACTERISTIC
/begin CHARACTERISTIC DINH_FId.DFC_ComEPS1Chksum_CA "inhibitable FIds / FIds to be inhibited by inhibit source DFC_ComEPS1Chksum" VAL_BLK 0x804DCAF8 ValA_Wu16 968.000000000 DINH_FIdVerb 0.00 968.000000000 FORMAT "%13.9" NUMBER 59 /end CHARACTERISTIC
/begin CHARACTERISTIC DINH_FId.DFC_ComEPS1RingCnt_CA "inhibitable FIds / FIds to be inhibited by inhibit source DFC_ComEPS1RingCnt" VAL_BLK 0x804DCB6E ValA_Wu16 968.000000000 DINH_FIdVerb 0.00 968.000000000 FORMAT "%13.9" NUMBER 59 /end CHARACTERISTIC
/begin CHARACTERISTIC DINH_FId.DFC_ComEPS1TOut_CA "inhibitable FIds / FIds to be inhibited by inhibit source DFC_ComEPS1TOut" VAL_BLK 0x804DCBE4 ValA_Wu16 968.000000000 DINH_FIdVerb 0.00 968.000000000 FORMAT "%13.9" NUMBER 59 /end CHARACTERISTIC
/begin CHARACTERISTIC DINH_FId.DFC_ComEngCanRxErr_CA "inhibitable FIds / FIds to be inhibited by inhibit source DFC_ComEngCanRxErr" VAL_BLK 0x804DCC5A ValA_Wu16 968.000000000 DINH_FIdVerb 0.00 968.000000000 FORMAT "%13.9" NUMBER 53 /end CHARACTERISTIC
/begin CHARACTERISTIC DINH_FId.DFC_ComGrvySnsrErr_CA "inhibitable FIds / FIds to be inhibited by inhibit source DFC_ComGrvySnsrErr" VAL_BLK 0x804DCCC4 ValA_Wu16 968.000000000 DINH_FIdVerb 0.00 968.000000000 FORMAT "%13.9" NUMBER 50 /end CHARACTERISTIC
/begin CHARACTERISTIC DINH_FId.DFC_ComGwIMG1ChkSum_CA "inhibitable FIds / FIds to be inhibited by inhibit source DFC_ComGwIMG1ChkSum" VAL_BLK 0x804DCD28 ValA_Wu16 968.000000000 DINH_FIdVerb 0.00 968.000000000 FORMAT "%13.9" NUMBER 58 /end CHARACTERISTIC
/begin CHARACTERISTIC DINH_FId.DFC_ComGwIMG1RingCnt_CA "inhibitable FIds / FIds to be inhibited by inhibit source DFC_ComGwIMG1RingCnt" VAL_BLK 0x804DCD9C ValA_Wu16 968.000000000 DINH_FIdVerb 0.00 968.000000000 FORMAT "%13.9" NUMBER 58 /end CHARACTERISTIC
/begin CHARACTERISTIC DINH_FId.DFC_ComGwIMG1TOut_CA "inhibitable FIds / FIds to be inhibited by inhibit source DFC_ComGwIMG1TOut" VAL_BLK 0x804DCE10 ValA_Wu16 968.000000000 DINH_FIdVerb 0.00 968.000000000 FORMAT "%13.9" NUMBER 58 /end CHARACTERISTIC
/begin CHARACTERISTIC DINH_FId.DFC_ComGwIMG3ChkSum_CA "inhibitable FIds / FIds to be inhibited by inhibit source DFC_ComGwIMG3ChkSum" VAL_BLK 0x804DCE84 ValA_Wu16 968.000000000 DINH_FIdVerb 0.00 968.000000000 FORMAT "%13.9" NUMBER 60 /end CHARACTERISTIC
/begin CHARACTERISTIC DINH_FId.DFC_ComGwIMG3RingCnt_CA "inhibitable FIds / FIds to be inhibited by inhibit source DFC_ComGwIMG3RingCnt" VAL_BLK 0x804DCEFC ValA_Wu16 968.000000000 DINH_FIdVerb 0.00 968.000000000 FORMAT "%13.9" NUMBER 60 /end CHARACTERISTIC
/begin CHARACTERISTIC DINH_FId.DFC_ComGwIMG3TOut_CA "inhibitable FIds / FIds to be inhibited by inhibit source DFC_ComGwIMG3TOut" VAL_BLK 0x804DCF74 ValA_Wu16 968.000000000 DINH_FIdVerb 0.00 968.000000000 FORMAT "%13.9" NUMBER 60 /end CHARACTERISTIC
/begin CHARACTERISTIC DINH_FId.DFC_ComGwIMG4ChkSum_CA "inhibitable FIds / FIds to be inhibited by inhibit source DFC_ComGwIMG4ChkSum" VAL_BLK 0x804DCFEC ValA_Wu16 968.000000000 DINH_FIdVerb 0.00 968.000000000 FORMAT "%13.9" NUMBER 58 /end CHARACTERISTIC
/begin CHARACTERISTIC DINH_FId.DFC_ComGwIMG4RingCnt_CA "inhibitable FIds / FIds to be inhibited by inhibit source DFC_ComGwIMG4RingCnt" VAL_BLK 0x804DD060 ValA_Wu16 968.000000000 DINH_FIdVerb 0.00 968.000000000 FORMAT "%13.9" NUMBER 58 /end CHARACTERISTIC
/begin CHARACTERISTIC DINH_FId.DFC_ComGwIMG4TOut_CA "inhibitable FIds / FIds to be inhibited by inhibit source DFC_ComGwIMG4TOut" VAL_BLK 0x804DD0D4 ValA_Wu16 968.000000000 DINH_FIdVerb 0.00 968.000000000 FORMAT "%13.9" NUMBER 58 /end CHARACTERISTIC
/begin CHARACTERISTIC DINH_FId.DFC_ComGwIMG5ChkSum_CA "inhibitable FIds / FIds to be inhibited by inhibit source DFC_ComGwIMG5ChkSum" VAL_BLK 0x804DD148 ValA_Wu16 968.000000000 DINH_FIdVerb 0.00 968.000000000 FORMAT "%13.9" NUMBER 57 /end CHARACTERISTIC
/begin CHARACTERISTIC DINH_FId.DFC_ComGwIMG5RingCnt_CA "inhibitable FIds / FIds to be inhibited by inhibit source DFC_ComGwIMG5RingCnt" VAL_BLK 0x804DD1BA ValA_Wu16 968.000000000 DINH_FIdVerb 0.00 968.000000000 FORMAT "%13.9" NUMBER 57 /end CHARACTERISTIC
/begin CHARACTERISTIC DINH_FId.DFC_ComGwIMG5TOut_CA "inhibitable FIds / FIds to be inhibited by inhibit source DFC_ComGwIMG5TOut" VAL_BLK 0x804DD22C ValA_Wu16 968.000000000 DINH_FIdVerb 0.00 968.000000000 FORMAT "%13.9" NUMBER 57 /end CHARACTERISTIC
/begin CHARACTERISTIC DINH_FId.DFC_ComGwIMG6ChkSum_CA "inhibitable FIds / FIds to be inhibited by inhibit source DFC_ComGwIMG6ChkSum" VAL_BLK 0x804DD29E ValA_Wu16 968.000000000 DINH_FIdVerb 0.00 968.000000000 FORMAT "%13.9" NUMBER 52 /end CHARACTERISTIC
/begin CHARACTERISTIC DINH_FId.DFC_ComGwIMG6RingCnt_CA "inhibitable FIds / FIds to be inhibited by inhibit source DFC_ComGwIMG6RingCnt" VAL_BLK 0x804DD306 ValA_Wu16 968.000000000 DINH_FIdVerb 0.00 968.000000000 FORMAT "%13.9" NUMBER 52 /end CHARACTERISTIC
/begin CHARACTERISTIC DINH_FId.DFC_ComGwIMG6TOut_CA "inhibitable FIds / FIds to be inhibited by inhibit source DFC_ComGwIMG6TOut" VAL_BLK 0x804DD36E ValA_Wu16 968.000000000 DINH_FIdVerb 0.00 968.000000000 FORMAT "%13.9" NUMBER 52 /end CHARACTERISTIC
/begin CHARACTERISTIC DINH_FId.DFC_ComIDASBChksum_CA "inhibitable FIds / FIds to be inhibited by inhibit source DFC_ComIDASBChksum" VAL_BLK 0x804DD3D6 ValA_Wu16 968.000000000 DINH_FIdVerb 0.00 968.000000000 FORMAT "%13.9" NUMBER 54 /end CHARACTERISTIC
/begin CHARACTERISTIC DINH_FId.DFC_ComIDASBRingCnt_CA "inhibitable FIds / FIds to be inhibited by inhibit source DFC_ComIDASBRingCnt" VAL_BLK 0x804DD442 ValA_Wu16 968.000000000 DINH_FIdVerb 0.00 968.000000000 FORMAT "%13.9" NUMBER 54 /end CHARACTERISTIC
/begin CHARACTERISTIC DINH_FId.DFC_ComIDASBTOut_CA "inhibitable FIds / FIds to be inhibited by inhibit source DFC_ComIDASBTOut" VAL_BLK 0x804DD4AE ValA_Wu16 968.000000000 DINH_FIdVerb 0.00 968.000000000 FORMAT "%13.9" NUMBER 54 /end CHARACTERISTIC
/begin CHARACTERISTIC DINH_FId.DFC_ComIMGMILReq_CA "inhibitable FIds / FIds to be inhibited by inhibit source DFC_ComIMGMILReq" VAL_BLK 0x804DD51A ValA_Wu16 968.000000000 DINH_FIdVerb 0.00 968.000000000 FORMAT "%13.9" NUMBER 50 /end CHARACTERISTIC
/begin CHARACTERISTIC DINH_FId.DFC_ComISSPrms_CA "inhibitable FIds / FIds to be inhibited by inhibit source DFC_ComISSPrms" VAL_BLK 0x804DD57E ValA_Wu16 968.000000000 DINH_FIdVerb 0.00 968.000000000 FORMAT "%13.9" NUMBER 51 /end CHARACTERISTIC
/begin CHARACTERISTIC DINH_FId.DFC_ComMETAChksum_CA "inhibitable FIds / FIds to be inhibited by inhibit source DFC_ComMETAChksum" VAL_BLK 0x804DD5E4 ValA_Wu16 968.000000000 DINH_FIdVerb 0.00 968.000000000 FORMAT "%13.9" NUMBER 65 /end CHARACTERISTIC
/begin CHARACTERISTIC DINH_FId.DFC_ComMETAChksumPstDrv_CA "inhibitable FIds / FIds to be inhibited by inhibit source DFC_ComMETAChksumPstDrv" VAL_BLK 0x804DD666 ValA_Wu16 968.000000000 DINH_FIdVerb 0.00 968.000000000 FORMAT "%13.9" NUMBER 50 /end CHARACTERISTIC
/begin CHARACTERISTIC DINH_FId.DFC_ComMETARingCnt_CA "inhibitable FIds / FIds to be inhibited by inhibit source DFC_ComMETARingCnt" VAL_BLK 0x804DD6CA ValA_Wu16 968.000000000 DINH_FIdVerb 0.00 968.000000000 FORMAT "%13.9" NUMBER 65 /end CHARACTERISTIC
/begin CHARACTERISTIC DINH_FId.DFC_ComMETARingCntPstDrv_CA "inhibitable FIds / FIds to be inhibited by inhibit source DFC_ComMETARingCntPstDrv" VAL_BLK 0x804DD74C ValA_Wu16 968.000000000 DINH_FIdVerb 0.00 968.000000000 FORMAT "%13.9" NUMBER 50 /end CHARACTERISTIC
/begin CHARACTERISTIC DINH_FId.DFC_ComMETATOut_CA "inhibitable FIds / FIds to be inhibited by inhibit source DFC_ComMETATOut" VAL_BLK 0x804DD7B0 ValA_Wu16 968.000000000 DINH_FIdVerb 0.00 968.000000000 FORMAT "%13.9" NUMBER 65 /end CHARACTERISTIC
/begin CHARACTERISTIC DINH_FId.DFC_ComMETATOutPstDrv_CA "inhibitable FIds / FIds to be inhibited by inhibit source DFC_ComMETATOutPstDrv" VAL_BLK 0x804DD832 ValA_Wu16 968.000000000 DINH_FIdVerb 0.00 968.000000000 FORMAT "%13.9" NUMBER 50 /end CHARACTERISTIC
/begin CHARACTERISTIC DINH_FId.DFC_ComMETCChksum_CA "inhibitable FIds / FIds to be inhibited by inhibit source DFC_ComMETCChksum" VAL_BLK 0x804DD896 ValA_Wu16 968.000000000 DINH_FIdVerb 0.00 968.000000000 FORMAT "%13.9" NUMBER 64 /end CHARACTERISTIC
/begin CHARACTERISTIC DINH_FId.DFC_ComMETCRingCnt_CA "inhibitable FIds / FIds to be inhibited by inhibit source DFC_ComMETCRingCnt" VAL_BLK 0x804DD916 ValA_Wu16 968.000000000 DINH_FIdVerb 0.00 968.000000000 FORMAT "%13.9" NUMBER 64 /end CHARACTERISTIC
/begin CHARACTERISTIC DINH_FId.DFC_ComMETCTOut_CA "inhibitable FIds / FIds to be inhibited by inhibit source DFC_ComMETCTOut" VAL_BLK 0x804DD996 ValA_Wu16 968.000000000 DINH_FIdVerb 0.00 968.000000000 FORMAT "%13.9" NUMBER 64 /end CHARACTERISTIC
/begin CHARACTERISTIC DINH_FId.DFC_ComMETDChksum_CA "inhibitable FIds / FIds to be inhibited by inhibit source DFC_ComMETDChksum" VAL_BLK 0x804DDA16 ValA_Wu16 968.000000000 DINH_FIdVerb 0.00 968.000000000 FORMAT "%13.9" NUMBER 63 /end CHARACTERISTIC
/begin CHARACTERISTIC DINH_FId.DFC_ComMETDRingCnt_CA "inhibitable FIds / FIds to be inhibited by inhibit source DFC_ComMETDRingCnt" VAL_BLK 0x804DDA94 ValA_Wu16 968.000000000 DINH_FIdVerb 0.00 968.000000000 FORMAT "%13.9" NUMBER 63 /end CHARACTERISTIC
/begin CHARACTERISTIC DINH_FId.DFC_ComMETDTOut_CA "inhibitable FIds / FIds to be inhibited by inhibit source DFC_ComMETDTOut" VAL_BLK 0x804DDB12 ValA_Wu16 968.000000000 DINH_FIdVerb 0.00 968.000000000 FORMAT "%13.9" NUMBER 63 /end CHARACTERISTIC
/begin CHARACTERISTIC DINH_FId.DFC_ComMETE2Chksum_CA "inhibitable FIds / FIds to be inhibited by inhibit source DFC_ComMETE2Chksum" VAL_BLK 0x804DDB90 ValA_Wu16 968.000000000 DINH_FIdVerb 0.00 968.000000000 FORMAT "%13.9" NUMBER 62 /end CHARACTERISTIC
/begin CHARACTERISTIC DINH_FId.DFC_ComMETE2RingCnt_CA "inhibitable FIds / FIds to be inhibited by inhibit source DFC_ComMETE2RingCnt" VAL_BLK 0x804DDC0C ValA_Wu16 968.000000000 DINH_FIdVerb 0.00 968.000000000 FORMAT "%13.9" NUMBER 62 /end CHARACTERISTIC
/begin CHARACTERISTIC DINH_FId.DFC_ComMETE2TOut_CA "inhibitable FIds / FIds to be inhibited by inhibit source DFC_ComMETE2TOut" VAL_BLK 0x804DDC88 ValA_Wu16 968.000000000 DINH_FIdVerb 0.00 968.000000000 FORMAT "%13.9" NUMBER 62 /end CHARACTERISTIC
/begin CHARACTERISTIC DINH_FId.DFC_ComMETFChksum_CA "inhibitable FIds / FIds to be inhibited by inhibit source DFC_ComMETFChksum" VAL_BLK 0x804DDD04 ValA_Wu16 968.000000000 DINH_FIdVerb 0.00 968.000000000 FORMAT "%13.9" NUMBER 62 /end CHARACTERISTIC
/begin CHARACTERISTIC DINH_FId.DFC_ComMETFRingCnt_CA "inhibitable FIds / FIds to be inhibited by inhibit source DFC_ComMETFRingCnt" VAL_BLK 0x804DDD80 ValA_Wu16 968.000000000 DINH_FIdVerb 0.00 968.000000000 FORMAT "%13.9" NUMBER 62 /end CHARACTERISTIC
/begin CHARACTERISTIC DINH_FId.DFC_ComMETFTOut_CA "inhibitable FIds / FIds to be inhibited by inhibit source DFC_ComMETFTOut" VAL_BLK 0x804DDDFC ValA_Wu16 968.000000000 DINH_FIdVerb 0.00 968.000000000 FORMAT "%13.9" NUMBER 62 /end CHARACTERISTIC
/begin CHARACTERISTIC DINH_FId.DFC_ComMETGChksum_CA "inhibitable FIds / FIds to be inhibited by inhibit source DFC_ComMETGChksum" VAL_BLK 0x804DDE78 ValA_Wu16 968.000000000 DINH_FIdVerb 0.00 968.000000000 FORMAT "%13.9" NUMBER 62 /end CHARACTERISTIC
/begin CHARACTERISTIC DINH_FId.DFC_ComMETGRingCnt_CA "inhibitable FIds / FIds to be inhibited by inhibit source DFC_ComMETGRingCnt" VAL_BLK 0x804DDEF4 ValA_Wu16 968.000000000 DINH_FIdVerb 0.00 968.000000000 FORMAT "%13.9" NUMBER 62 /end CHARACTERISTIC
/begin CHARACTERISTIC DINH_FId.DFC_ComMETGTOut_CA "inhibitable FIds / FIds to be inhibited by inhibit source DFC_ComMETGTOut" VAL_BLK 0x804DDF70 ValA_Wu16 968.000000000 DINH_FIdVerb 0.00 968.000000000 FORMAT "%13.9" NUMBER 62 /end CHARACTERISTIC
/begin CHARACTERISTIC DINH_FId.DFC_ComMETH2Chksum_CA "inhibitable FIds / FIds to be inhibited by inhibit source DFC_ComMETH2Chksum" VAL_BLK 0x804DDFEC ValA_Wu16 968.000000000 DINH_FIdVerb 0.00 968.000000000 FORMAT "%13.9" NUMBER 62 /end CHARACTERISTIC
/begin CHARACTERISTIC DINH_FId.DFC_ComMETH2RingCnt_CA "inhibitable FIds / FIds to be inhibited by inhibit source DFC_ComMETH2RingCnt" VAL_BLK 0x804DE068 ValA_Wu16 968.000000000 DINH_FIdVerb 0.00 968.000000000 FORMAT "%13.9" NUMBER 62 /end CHARACTERISTIC
/begin CHARACTERISTIC DINH_FId.DFC_ComMETH2TOut_CA "inhibitable FIds / FIds to be inhibited by inhibit source DFC_ComMETH2TOut" VAL_BLK 0x804DE0E4 ValA_Wu16 968.000000000 DINH_FIdVerb 0.00 968.000000000 FORMAT "%13.9" NUMBER 62 /end CHARACTERISTIC
/begin CHARACTERISTIC DINH_FId.DFC_ComMETHChksum_CA "inhibitable FIds / FIds to be inhibited by inhibit source DFC_ComMETHChksum" VAL_BLK 0x804DE160 ValA_Wu16 968.000000000 DINH_FIdVerb 0.00 968.000000000 FORMAT "%13.9" NUMBER 62 /end CHARACTERISTIC
/begin CHARACTERISTIC DINH_FId.DFC_ComMETHRingCnt_CA "inhibitable FIds / FIds to be inhibited by inhibit source DFC_ComMETHRingCnt" VAL_BLK 0x804DE1DC ValA_Wu16 968.000000000 DINH_FIdVerb 0.00 968.000000000 FORMAT "%13.9" NUMBER 62 /end CHARACTERISTIC
/begin CHARACTERISTIC DINH_FId.DFC_ComMETHTOut_CA "inhibitable FIds / FIds to be inhibited by inhibit source DFC_ComMETHTOut" VAL_BLK 0x804DE258 ValA_Wu16 968.000000000 DINH_FIdVerb 0.00 968.000000000 FORMAT "%13.9" NUMBER 62 /end CHARACTERISTIC
/begin CHARACTERISTIC DINH_FId.DFC_ComMETIChksum_CA "inhibitable FIds / FIds to be inhibited by inhibit source DFC_ComMETIChksum" VAL_BLK 0x804DE2D4 ValA_Wu16 968.000000000 DINH_FIdVerb 0.00 968.000000000 FORMAT "%13.9" NUMBER 69 /end CHARACTERISTIC
/begin CHARACTERISTIC DINH_FId.DFC_ComMETIRingCnt_CA "inhibitable FIds / FIds to be inhibited by inhibit source DFC_ComMETIRingCnt" VAL_BLK 0x804DE35E ValA_Wu16 968.000000000 DINH_FIdVerb 0.00 968.000000000 FORMAT "%13.9" NUMBER 69 /end CHARACTERISTIC
/begin CHARACTERISTIC DINH_FId.DFC_ComMETITOut_CA "inhibitable FIds / FIds to be inhibited by inhibit source DFC_ComMETITOut" VAL_BLK 0x804DE3E8 ValA_Wu16 968.000000000 DINH_FIdVerb 0.00 968.000000000 FORMAT "%13.9" NUMBER 69 /end CHARACTERISTIC
/begin CHARACTERISTIC DINH_FId.DFC_ComMETKChksum_CA "inhibitable FIds / FIds to be inhibited by inhibit source DFC_ComMETKChksum" VAL_BLK 0x804DE472 ValA_Wu16 968.000000000 DINH_FIdVerb 0.00 968.000000000 FORMAT "%13.9" NUMBER 62 /end CHARACTERISTIC
/begin CHARACTERISTIC DINH_FId.DFC_ComMETKRingCnt_CA "inhibitable FIds / FIds to be inhibited by inhibit source DFC_ComMETKRingCnt" VAL_BLK 0x804DE4EE ValA_Wu16 968.000000000 DINH_FIdVerb 0.00 968.000000000 FORMAT "%13.9" NUMBER 62 /end CHARACTERISTIC
/begin CHARACTERISTIC DINH_FId.DFC_ComMETKTOut_CA "inhibitable FIds / FIds to be inhibited by inhibit source DFC_ComMETKTOut" VAL_BLK 0x804DE56A ValA_Wu16 968.000000000 DINH_FIdVerb 0.00 968.000000000 FORMAT "%13.9" NUMBER 62 /end CHARACTERISTIC
/begin CHARACTERISTIC DINH_FId.DFC_ComMETLChksum_CA "inhibitable FIds / FIds to be inhibited by inhibit source DFC_ComMETLChksum" VAL_BLK 0x804DE5E6 ValA_Wu16 968.000000000 DINH_FIdVerb 0.00 968.000000000 FORMAT "%13.9" NUMBER 62 /end CHARACTERISTIC
/begin CHARACTERISTIC DINH_FId.DFC_ComMETLRingCnt_CA "inhibitable FIds / FIds to be inhibited by inhibit source DFC_ComMETLRingCnt" VAL_BLK 0x804DE662 ValA_Wu16 968.000000000 DINH_FIdVerb 0.00 968.000000000 FORMAT "%13.9" NUMBER 62 /end CHARACTERISTIC
/begin CHARACTERISTIC DINH_FId.DFC_ComMETLTOut_CA "inhibitable FIds / FIds to be inhibited by inhibit source DFC_ComMETLTOut" VAL_BLK 0x804DE6DE ValA_Wu16 968.000000000 DINH_FIdVerb 0.00 968.000000000 FORMAT "%13.9" NUMBER 62 /end CHARACTERISTIC
/begin CHARACTERISTIC DINH_FId.DFC_ComMETMChksum_CA "inhibitable FIds / FIds to be inhibited by inhibit source DFC_ComMETMChksum" VAL_BLK 0x804DE75A ValA_Wu16 968.000000000 DINH_FIdVerb 0.00 968.000000000 FORMAT "%13.9" NUMBER 61 /end CHARACTERISTIC
/begin CHARACTERISTIC DINH_FId.DFC_ComMETMRingCnt_CA "inhibitable FIds / FIds to be inhibited by inhibit source DFC_ComMETMRingCnt" VAL_BLK 0x804DE7D4 ValA_Wu16 968.000000000 DINH_FIdVerb 0.00 968.000000000 FORMAT "%13.9" NUMBER 61 /end CHARACTERISTIC
/begin CHARACTERISTIC DINH_FId.DFC_ComMETMTOut_CA "inhibitable FIds / FIds to be inhibited by inhibit source DFC_ComMETMTOut" VAL_BLK 0x804DE84E ValA_Wu16 968.000000000 DINH_FIdVerb 0.00 968.000000000 FORMAT "%13.9" NUMBER 61 /end CHARACTERISTIC
/begin CHARACTERISTIC DINH_FId.DFC_ComMETNChksum_CA "inhibitable FIds / FIds to be inhibited by inhibit source DFC_ComMETNChksum" VAL_BLK 0x804DE8C8 ValA_Wu16 968.000000000 DINH_FIdVerb 0.00 968.000000000 FORMAT "%13.9" NUMBER 62 /end CHARACTERISTIC
/begin CHARACTERISTIC DINH_FId.DFC_ComMETNRingCnt_CA "inhibitable FIds / FIds to be inhibited by inhibit source DFC_ComMETNRingCnt" VAL_BLK 0x804DE944 ValA_Wu16 968.000000000 DINH_FIdVerb 0.00 968.000000000 FORMAT "%13.9" NUMBER 62 /end CHARACTERISTIC
/begin CHARACTERISTIC DINH_FId.DFC_ComMETNTOut_CA "inhibitable FIds / FIds to be inhibited by inhibit source DFC_ComMETNTOut" VAL_BLK 0x804DE9C0 ValA_Wu16 968.000000000 DINH_FIdVerb 0.00 968.000000000 FORMAT "%13.9" NUMBER 62 /end CHARACTERISTIC
/begin CHARACTERISTIC DINH_FId.DFC_ComMtrCom_CA "inhibitable FIds / FIds to be inhibited by inhibit source DFC_ComMtrCom" VAL_BLK 0x804DEA3C ValA_Wu16 968.000000000 DINH_FIdVerb 0.00 968.000000000 FORMAT "%13.9" NUMBER 51 /end CHARACTERISTIC
/begin CHARACTERISTIC DINH_FId.DFC_ComPCUChkSum_CA "inhibitable FIds / FIds to be inhibited by inhibit source DFC_ComPCUChkSum" VAL_BLK 0x804DEAA2 ValA_Wu16 968.000000000 DINH_FIdVerb 0.00 968.000000000 FORMAT "%13.9" NUMBER 58 /end CHARACTERISTIC
/begin CHARACTERISTIC DINH_FId.DFC_ComPCURingCnt_CA "inhibitable FIds / FIds to be inhibited by inhibit source DFC_ComPCURingCnt" VAL_BLK 0x804DEB16 ValA_Wu16 968.000000000 DINH_FIdVerb 0.00 968.000000000 FORMAT "%13.9" NUMBER 58 /end CHARACTERISTIC
/begin CHARACTERISTIC DINH_FId.DFC_ComPCUTOut_CA "inhibitable FIds / FIds to be inhibited by inhibit source DFC_ComPCUTOut" VAL_BLK 0x804DEB8A ValA_Wu16 968.000000000 DINH_FIdVerb 0.00 968.000000000 FORMAT "%13.9" NUMBER 58 /end CHARACTERISTIC
/begin CHARACTERISTIC DINH_FId.DFC_ComSRSAChksum_CA "inhibitable FIds / FIds to be inhibited by inhibit source DFC_ComSRSAChksum" VAL_BLK 0x804DEBFE ValA_Wu16 968.000000000 DINH_FIdVerb 0.00 968.000000000 FORMAT "%13.9" NUMBER 58 /end CHARACTERISTIC
/begin CHARACTERISTIC DINH_FId.DFC_ComSRSARingCnt_CA "inhibitable FIds / FIds to be inhibited by inhibit source DFC_ComSRSARingCnt" VAL_BLK 0x804DEC72 ValA_Wu16 968.000000000 DINH_FIdVerb 0.00 968.000000000 FORMAT "%13.9" NUMBER 58 /end CHARACTERISTIC
/begin CHARACTERISTIC DINH_FId.DFC_ComSRSATOut_CA "inhibitable FIds / FIds to be inhibited by inhibit source DFC_ComSRSATOut" VAL_BLK 0x804DECE6 ValA_Wu16 968.000000000 DINH_FIdVerb 0.00 968.000000000 FORMAT "%13.9" NUMBER 58 /end CHARACTERISTIC
/begin CHARACTERISTIC DINH_FId.DFC_ComSRSBChksum_CA "inhibitable FIds / FIds to be inhibited by inhibit source DFC_ComSRSBChksum" VAL_BLK 0x804DED5A ValA_Wu16 968.000000000 DINH_FIdVerb 0.00 968.000000000 FORMAT "%13.9" NUMBER 57 /end CHARACTERISTIC
/begin CHARACTERISTIC DINH_FId.DFC_ComSRSBRingCnt_CA "inhibitable FIds / FIds to be inhibited by inhibit source DFC_ComSRSBRingCnt" VAL_BLK 0x804DEDCC ValA_Wu16 968.000000000 DINH_FIdVerb 0.00 968.000000000 FORMAT "%13.9" NUMBER 57 /end CHARACTERISTIC
/begin CHARACTERISTIC DINH_FId.DFC_ComSRSBTOut_CA "inhibitable FIds / FIds to be inhibited by inhibit source DFC_ComSRSBTOut" VAL_BLK 0x804DEE3E ValA_Wu16 968.000000000 DINH_FIdVerb 0.00 968.000000000 FORMAT "%13.9" NUMBER 57 /end CHARACTERISTIC
/begin CHARACTERISTIC DINH_FId.DFC_ComSRSChksum_CA "inhibitable FIds / FIds to be inhibited by inhibit source DFC_ComSRSChksum" VAL_BLK 0x804DEEB0 ValA_Wu16 968.000000000 DINH_FIdVerb 0.00 968.000000000 FORMAT "%13.9" NUMBER 57 /end CHARACTERISTIC
/begin CHARACTERISTIC DINH_FId.DFC_ComSRSErr_CA "inhibitable FIds / FIds to be inhibited by inhibit source DFC_ComSRSErr" VAL_BLK 0x804DEF22 ValA_Wu16 968.000000000 DINH_FIdVerb 0.00 968.000000000 FORMAT "%13.9" NUMBER 50 /end CHARACTERISTIC
/begin CHARACTERISTIC DINH_FId.DFC_ComSRSRingCnt_CA "inhibitable FIds / FIds to be inhibited by inhibit source DFC_ComSRSRingCnt" VAL_BLK 0x804DEF86 ValA_Wu16 968.000000000 DINH_FIdVerb 0.00 968.000000000 FORMAT "%13.9" NUMBER 57 /end CHARACTERISTIC
/begin CHARACTERISTIC DINH_FId.DFC_ComSRSTOut_CA "inhibitable FIds / FIds to be inhibited by inhibit source DFC_ComSRSTOut" VAL_BLK 0x804DEFF8 ValA_Wu16 968.000000000 DINH_FIdVerb 0.00 968.000000000 FORMAT "%13.9" NUMBER 57 /end CHARACTERISTIC
/begin CHARACTERISTIC DINH_FId.DFC_ComVehSpdPndFltTCU_CA "inhibitable FIds / FIds to be inhibited by inhibit source DFC_ComVehSpdPndFltTCU" VAL_BLK 0x804DF06A ValA_Wu16 968.000000000 DINH_FIdVerb 0.00 968.000000000 FORMAT "%13.9" NUMBER 50 /end CHARACTERISTIC
/begin CHARACTERISTIC DINH_FId.DFC_EbsChartcCurrErr_CA "inhibitable FIds / FIds to be inhibited by inhibit source DFC_EbsChartcCurrErr" VAL_BLK 0x804DF0CE ValA_Wu16 968.000000000 DINH_FIdVerb 0.00 968.000000000 FORMAT "%13.9" NUMBER 63 /end CHARACTERISTIC
/begin CHARACTERISTIC DINH_FId.DFC_EbsSelfDiagErr_CA "inhibitable FIds / FIds to be inhibited by inhibit source DFC_EbsSelfDiagErr" VAL_BLK 0x804DF14C ValA_Wu16 968.000000000 DINH_FIdVerb 0.00 968.000000000 FORMAT "%13.9" NUMBER 63 /end CHARACTERISTIC
/begin CHARACTERISTIC DINH_FId.DFC_GEVlvPhaCsersIntkB1_CA "inhibitable FIds / FIds to be inhibited by inhibit source DFC_GEVlvPhaCsersIntkB1" VAL_BLK 0x804DF1CA ValA_Wu16 968.000000000 DINH_FIdVerb 0.00 968.000000000 FORMAT "%13.9" NUMBER 58 /end CHARACTERISTIC
/begin CHARACTERISTIC DINH_FId.DFC_GEVlvPhaPsOpenLoadIntkB1_CA "inhibitable FIds / FIds to be inhibited by inhibit source DFC_GEVlvPhaPsOpenLoadIntkB1" VAL_BLK 0x804DF23E ValA_Wu16 968.000000000 DINH_FIdVerb 0.00 968.000000000 FORMAT "%13.9" NUMBER 94 /end CHARACTERISTIC
/begin CHARACTERISTIC DINH_FId.DFC_GEVlvPhaPsShoToBattIntkB1_CA "inhibitable FIds / FIds to be inhibited by inhibit source DFC_GEVlvPhaPsShoToBattIntkB1" VAL_BLK 0x804DF2FA ValA_Wu16 968.000000000 DINH_FIdVerb 0.00 968.000000000 FORMAT "%13.9" NUMBER 94 /end CHARACTERISTIC
/begin CHARACTERISTIC DINH_FId.DFC_GEVlvPhaPsShoToGndIntkB1_CA "inhibitable FIds / FIds to be inhibited by inhibit source DFC_GEVlvPhaPsShoToGndIntkB1" VAL_BLK 0x804DF3B6 ValA_Wu16 968.000000000 DINH_FIdVerb 0.00 968.000000000 FORMAT "%13.9" NUMBER 94 /end CHARACTERISTIC
/begin CHARACTERISTIC DINH_FId.DFC_GbxCANDigPlausErr_CA "inhibitable FIds / FIds to be inhibited by inhibit source DFC_GbxCANDigPlausErr" VAL_BLK 0x804DF472 ValA_Wu16 968.000000000 DINH_FIdVerb 0.00 968.000000000 FORMAT "%13.9" NUMBER 52 /end CHARACTERISTIC
/begin CHARACTERISTIC DINH_FId.DFC_GbxNPos1SRCMax_CA "inhibitable FIds / FIds to be inhibited by inhibit source DFC_GbxNPos1SRCMax" VAL_BLK 0x804DF4DA ValA_Wu16 968.000000000 DINH_FIdVerb 0.00 968.000000000 FORMAT "%13.9" NUMBER 60 /end CHARACTERISTIC
/begin CHARACTERISTIC DINH_FId.DFC_GbxNPos1SRCMin_CA "inhibitable FIds / FIds to be inhibited by inhibit source DFC_GbxNPos1SRCMin" VAL_BLK 0x804DF552 ValA_Wu16 968.000000000 DINH_FIdVerb 0.00 968.000000000 FORMAT "%13.9" NUMBER 60 /end CHARACTERISTIC
/begin CHARACTERISTIC DINH_FId.DFC_GbxNPos2SRCMax_CA "inhibitable FIds / FIds to be inhibited by inhibit source DFC_GbxNPos2SRCMax" VAL_BLK 0x804DF5CA ValA_Wu16 968.000000000 DINH_FIdVerb 0.00 968.000000000 FORMAT "%13.9" NUMBER 60 /end CHARACTERISTIC
/begin CHARACTERISTIC DINH_FId.DFC_GbxNPos2SRCMin_CA "inhibitable FIds / FIds to be inhibited by inhibit source DFC_GbxNPos2SRCMin" VAL_BLK 0x804DF642 ValA_Wu16 968.000000000 DINH_FIdVerb 0.00 968.000000000 FORMAT "%13.9" NUMBER 60 /end CHARACTERISTIC
/begin CHARACTERISTIC DINH_FId.DFC_GbxNPosAlvChk_CA "inhibitable FIds / FIds to be inhibited by inhibit source DFC_GbxNPosAlvChk" VAL_BLK 0x804DF6BA ValA_Wu16 968.000000000 DINH_FIdVerb 0.00 968.000000000 FORMAT "%13.9" NUMBER 50 /end CHARACTERISTIC
/begin CHARACTERISTIC DINH_FId.DFC_GbxNPosSyncErr_CA "inhibitable FIds / FIds to be inhibited by inhibit source DFC_GbxNPosSyncErr" VAL_BLK 0x804DF71E ValA_Wu16 968.000000000 DINH_FIdVerb 0.00 968.000000000 FORMAT "%13.9" NUMBER 58 /end CHARACTERISTIC
/begin CHARACTERISTIC DINH_FId.DFC_HEGOS2B1HtrPsMax_CA "inhibitable FIds / FIds to be inhibited by inhibit source DFC_HEGOS2B1HtrPsMax" VAL_BLK 0x804DF792 ValA_Wu16 968.000000000 DINH_FIdVerb 0.00 968.000000000 FORMAT "%13.9" NUMBER 70 /end CHARACTERISTIC
/begin CHARACTERISTIC DINH_FId.DFC_HEGOS2B1HtrPsMin_CA "inhibitable FIds / FIds to be inhibited by inhibit source DFC_HEGOS2B1HtrPsMin" VAL_BLK 0x804DF81E ValA_Wu16 968.000000000 DINH_FIdVerb 0.00 968.000000000 FORMAT "%13.9" NUMBER 70 /end CHARACTERISTIC
/begin CHARACTERISTIC DINH_FId.DFC_HEGOS2B1HtrPsSig_CA "inhibitable FIds / FIds to be inhibited by inhibit source DFC_HEGOS2B1HtrPsSig" VAL_BLK 0x804DF8AA ValA_Wu16 968.000000000 DINH_FIdVerb 0.00 968.000000000 FORMAT "%13.9" NUMBER 70 /end CHARACTERISTIC
/begin CHARACTERISTIC DINH_FId.DFC_LinCSErrACG_CA "inhibitable FIds / FIds to be inhibited by inhibit source DFC_LinCSErrACG" VAL_BLK 0x804DF936 ValA_Wu16 968.000000000 DINH_FIdVerb 0.00 968.000000000 FORMAT "%13.9" NUMBER 68 /end CHARACTERISTIC
/begin CHARACTERISTIC DINH_FId.DFC_LinCSErrAEV_CA "inhibitable FIds / FIds to be inhibited by inhibit source DFC_LinCSErrAEV" VAL_BLK 0x804DF9BE ValA_Wu16 968.000000000 DINH_FIdVerb 0.00 968.000000000 FORMAT "%13.9" NUMBER 52 /end CHARACTERISTIC
/begin CHARACTERISTIC DINH_FId.DFC_LinCSErrDCDC_CA "inhibitable FIds / FIds to be inhibited by inhibit source DFC_LinCSErrDCDC" VAL_BLK 0x804DFA26 ValA_Wu16 968.000000000 DINH_FIdVerb 0.00 968.000000000 FORMAT "%13.9" NUMBER 57 /end CHARACTERISTIC
/begin CHARACTERISTIC DINH_FId.DFC_LinCSErrEBS_CA "inhibitable FIds / FIds to be inhibited by inhibit source DFC_LinCSErrEBS" VAL_BLK 0x804DFA98 ValA_Wu16 968.000000000 DINH_FIdVerb 0.00 968.000000000 FORMAT "%13.9" NUMBER 67 /end CHARACTERISTIC
/begin CHARACTERISTIC DINH_FId.DFC_LinHdrTimeoutErrACG_CA "inhibitable FIds / FIds to be inhibited by inhibit source DFC_LinHdrTimeoutErrACG" VAL_BLK 0x804DFB1E ValA_Wu16 968.000000000 DINH_FIdVerb 0.00 968.000000000 FORMAT "%13.9" NUMBER 68 /end CHARACTERISTIC
/begin CHARACTERISTIC DINH_FId.DFC_LinHdrTimeoutErrAEV_CA "inhibitable FIds / FIds to be inhibited by inhibit source DFC_LinHdrTimeoutErrAEV" VAL_BLK 0x804DFBA6 ValA_Wu16 968.000000000 DINH_FIdVerb 0.00 968.000000000 FORMAT "%13.9" NUMBER 52 /end CHARACTERISTIC
/begin CHARACTERISTIC DINH_FId.DFC_LinHdrTimeoutErrDCDC_CA "inhibitable FIds / FIds to be inhibited by inhibit source DFC_LinHdrTimeoutErrDCDC" VAL_BLK 0x804DFC0E ValA_Wu16 968.000000000 DINH_FIdVerb 0.00 968.000000000 FORMAT "%13.9" NUMBER 57 /end CHARACTERISTIC
/begin CHARACTERISTIC DINH_FId.DFC_LinHdrTimeoutErrEBS_CA "inhibitable FIds / FIds to be inhibited by inhibit source DFC_LinHdrTimeoutErrEBS" VAL_BLK 0x804DFC80 ValA_Wu16 968.000000000 DINH_FIdVerb 0.00 968.000000000 FORMAT "%13.9" NUMBER 67 /end CHARACTERISTIC
/begin CHARACTERISTIC DINH_FId.DFC_LinMsgTimeoutErrACG_CA "inhibitable FIds / FIds to be inhibited by inhibit source DFC_LinMsgTimeoutErrACG" VAL_BLK 0x804DFD06 ValA_Wu16 968.000000000 DINH_FIdVerb 0.00 968.000000000 FORMAT "%13.9" NUMBER 68 /end CHARACTERISTIC
/begin CHARACTERISTIC DINH_FId.DFC_LinMsgTimeoutErrAEV_CA "inhibitable FIds / FIds to be inhibited by inhibit source DFC_LinMsgTimeoutErrAEV" VAL_BLK 0x804DFD8E ValA_Wu16 968.000000000 DINH_FIdVerb 0.00 968.000000000 FORMAT "%13.9" NUMBER 52 /end CHARACTERISTIC
/begin CHARACTERISTIC DINH_FId.DFC_LinMsgTimeoutErrDCDC_CA "inhibitable FIds / FIds to be inhibited by inhibit source DFC_LinMsgTimeoutErrDCDC" VAL_BLK 0x804DFDF6 ValA_Wu16 968.000000000 DINH_FIdVerb 0.00 968.000000000 FORMAT "%13.9" NUMBER 57 /end CHARACTERISTIC
/begin CHARACTERISTIC DINH_FId.DFC_LinMsgTimeoutErrEBS_CA "inhibitable FIds / FIds to be inhibited by inhibit source DFC_LinMsgTimeoutErrEBS" VAL_BLK 0x804DFE68 ValA_Wu16 968.000000000 DINH_FIdVerb 0.00 968.000000000 FORMAT "%13.9" NUMBER 67 /end CHARACTERISTIC
/begin CHARACTERISTIC DINH_FId.DFC_LinNoStrtComErr_CA "inhibitable FIds / FIds to be inhibited by inhibit source DFC_LinNoStrtComErr" VAL_BLK 0x804DFEEE ValA_Wu16 968.000000000 DINH_FIdVerb 0.00 968.000000000 FORMAT "%13.9" NUMBER 65 /end CHARACTERISTIC
/begin CHARACTERISTIC DINH_FId.DFC_LowPresOilP_CA "inhibitable FIds / FIds to be inhibited by inhibit source DFC_LowPresOilP" VAL_BLK 0x804DFF70 ValA_Wu16 968.000000000 DINH_FIdVerb 0.00 968.000000000 FORMAT "%13.9" NUMBER 50 /end CHARACTERISTIC
/begin CHARACTERISTIC DINH_FId.DFC_MisfDetVWhlFrntLeOORHi_CA "inhibitable FIds / FIds to be inhibited by inhibit source DFC_MisfDetVWhlFrntLeOORHi" VAL_BLK 0x804DFFD4 ValA_Wu16 968.000000000 DINH_FIdVerb 0.00 968.000000000 FORMAT "%13.9" NUMBER 50 /end CHARACTERISTIC
/begin CHARACTERISTIC DINH_FId.DFC_MisfDetVWhlFrntLeRatyHi_CA "inhibitable FIds / FIds to be inhibited by inhibit source DFC_MisfDetVWhlFrntLeRatyHi" VAL_BLK 0x804E0038 ValA_Wu16 968.000000000 DINH_FIdVerb 0.00 968.000000000 FORMAT "%13.9" NUMBER 50 /end CHARACTERISTIC
/begin CHARACTERISTIC DINH_FId.DFC_MisfDetVWhlFrntLeRatyLo_CA "inhibitable FIds / FIds to be inhibited by inhibit source DFC_MisfDetVWhlFrntLeRatyLo" VAL_BLK 0x804E009C ValA_Wu16 968.000000000 DINH_FIdVerb 0.00 968.000000000 FORMAT "%13.9" NUMBER 50 /end CHARACTERISTIC
/begin CHARACTERISTIC DINH_FId.DFC_MisfDetVWhlFrntLeStuck_CA "inhibitable FIds / FIds to be inhibited by inhibit source DFC_MisfDetVWhlFrntLeStuck" VAL_BLK 0x804E0100 ValA_Wu16 968.000000000 DINH_FIdVerb 0.00 968.000000000 FORMAT "%13.9" NUMBER 50 /end CHARACTERISTIC
/begin CHARACTERISTIC DINH_FId.DFC_MisfDetVWhlFrntRiOORHi_CA "inhibitable FIds / FIds to be inhibited by inhibit source DFC_MisfDetVWhlFrntRiOORHi" VAL_BLK 0x804E0164 ValA_Wu16 968.000000000 DINH_FIdVerb 0.00 968.000000000 FORMAT "%13.9" NUMBER 50 /end CHARACTERISTIC
/begin CHARACTERISTIC DINH_FId.DFC_MisfDetVWhlFrntRiRatyHi_CA "inhibitable FIds / FIds to be inhibited by inhibit source DFC_MisfDetVWhlFrntRiRatyHi" VAL_BLK 0x804E01C8 ValA_Wu16 968.000000000 DINH_FIdVerb 0.00 968.000000000 FORMAT "%13.9" NUMBER 50 /end CHARACTERISTIC
/begin CHARACTERISTIC DINH_FId.DFC_MisfDetVWhlFrntRiRatyLo_CA "inhibitable FIds / FIds to be inhibited by inhibit source DFC_MisfDetVWhlFrntRiRatyLo" VAL_BLK 0x804E022C ValA_Wu16 968.000000000 DINH_FIdVerb 0.00 968.000000000 FORMAT "%13.9" NUMBER 50 /end CHARACTERISTIC
/begin CHARACTERISTIC DINH_FId.DFC_MisfDetVWhlFrntRiStuck_CA "inhibitable FIds / FIds to be inhibited by inhibit source DFC_MisfDetVWhlFrntRiStuck" VAL_BLK 0x804E0290 ValA_Wu16 968.000000000 DINH_FIdVerb 0.00 968.000000000 FORMAT "%13.9" NUMBER 50 /end CHARACTERISTIC
/begin CHARACTERISTIC DINH_FId.DFC_MisfDetVWhlReLeOORHi_CA "inhibitable FIds / FIds to be inhibited by inhibit source DFC_MisfDetVWhlReLeOORHi" VAL_BLK 0x804E02F4 ValA_Wu16 968.000000000 DINH_FIdVerb 0.00 968.000000000 FORMAT "%13.9" NUMBER 50 /end CHARACTERISTIC
/begin CHARACTERISTIC DINH_FId.DFC_MisfDetVWhlReLeRatyHi_CA "inhibitable FIds / FIds to be inhibited by inhibit source DFC_MisfDetVWhlReLeRatyHi" VAL_BLK 0x804E0358 ValA_Wu16 968.000000000 DINH_FIdVerb 0.00 968.000000000 FORMAT "%13.9" NUMBER 50 /end CHARACTERISTIC
/begin CHARACTERISTIC DINH_FId.DFC_MisfDetVWhlReLeRatyLo_CA "inhibitable FIds / FIds to be inhibited by inhibit source DFC_MisfDetVWhlReLeRatyLo" VAL_BLK 0x804E03BC ValA_Wu16 968.000000000 DINH_FIdVerb 0.00 968.000000000 FORMAT "%13.9" NUMBER 50 /end CHARACTERISTIC
/begin CHARACTERISTIC DINH_FId.DFC_MisfDetVWhlReLeStuck_CA "inhibitable FIds / FIds to be inhibited by inhibit source DFC_MisfDetVWhlReLeStuck" VAL_BLK 0x804E0420 ValA_Wu16 968.000000000 DINH_FIdVerb 0.00 968.000000000 FORMAT "%13.9" NUMBER 50 /end CHARACTERISTIC
/begin CHARACTERISTIC DINH_FId.DFC_MisfDetVWhlReRiOORHi_CA "inhibitable FIds / FIds to be inhibited by inhibit source DFC_MisfDetVWhlReRiOORHi" VAL_BLK 0x804E0484 ValA_Wu16 968.000000000 DINH_FIdVerb 0.00 968.000000000 FORMAT "%13.9" NUMBER 50 /end CHARACTERISTIC
/begin CHARACTERISTIC DINH_FId.DFC_MisfDetVWhlReRiRatyHi_CA "inhibitable FIds / FIds to be inhibited by inhibit source DFC_MisfDetVWhlReRiRatyHi" VAL_BLK 0x804E04E8 ValA_Wu16 968.000000000 DINH_FIdVerb 0.00 968.000000000 FORMAT "%13.9" NUMBER 50 /end CHARACTERISTIC
/begin CHARACTERISTIC DINH_FId.DFC_MisfDetVWhlReRiRatyLo_CA "inhibitable FIds / FIds to be inhibited by inhibit source DFC_MisfDetVWhlReRiRatyLo" VAL_BLK 0x804E054C ValA_Wu16 968.000000000 DINH_FIdVerb 0.00 968.000000000 FORMAT "%13.9" NUMBER 50 /end CHARACTERISTIC
/begin CHARACTERISTIC DINH_FId.DFC_MisfDetVWhlReRiStuck_CA "inhibitable FIds / FIds to be inhibited by inhibit source DFC_MisfDetVWhlReRiStuck" VAL_BLK 0x804E05B0 ValA_Wu16 968.000000000 DINH_FIdVerb 0.00 968.000000000 FORMAT "%13.9" NUMBER 50 /end CHARACTERISTIC
/begin CHARACTERISTIC DINH_FId.DFC_MisfDetdVWhlFrntLePlaus_CA "inhibitable FIds / FIds to be inhibited by inhibit source DFC_MisfDetdVWhlFrntLePlaus" VAL_BLK 0x804E0614 ValA_Wu16 968.000000000 DINH_FIdVerb 0.00 968.000000000 FORMAT "%13.9" NUMBER 50 /end CHARACTERISTIC
/begin CHARACTERISTIC DINH_FId.DFC_MisfDetdVWhlFrntRiPlaus_CA "inhibitable FIds / FIds to be inhibited by inhibit source DFC_MisfDetdVWhlFrntRiPlaus" VAL_BLK 0x804E0678 ValA_Wu16 968.000000000 DINH_FIdVerb 0.00 968.000000000 FORMAT "%13.9" NUMBER 50 /end CHARACTERISTIC
/begin CHARACTERISTIC DINH_FId.DFC_MisfDetdVWhlReLePlaus_CA "inhibitable FIds / FIds to be inhibited by inhibit source DFC_MisfDetdVWhlReLePlaus" VAL_BLK 0x804E06DC ValA_Wu16 968.000000000 DINH_FIdVerb 0.00 968.000000000 FORMAT "%13.9" NUMBER 50 /end CHARACTERISTIC
/begin CHARACTERISTIC DINH_FId.DFC_MisfDetdVWhlReRiPlaus_CA "inhibitable FIds / FIds to be inhibited by inhibit source DFC_MisfDetdVWhlReRiPlaus" VAL_BLK 0x804E0740 ValA_Wu16 968.000000000 DINH_FIdVerb 0.00 968.000000000 FORMAT "%13.9" NUMBER 50 /end CHARACTERISTIC
/begin CHARACTERISTIC DINH_FId.DFC_PEnvSigRngMax_CA "inhibitable FIds / FIds to be inhibited by inhibit source DFC_PEnvSigRngMax" VAL_BLK 0x804E07A4 ValA_Wu16 968.000000000 DINH_FIdVerb 0.00 968.000000000 FORMAT "%13.9" NUMBER 91 /end CHARACTERISTIC
/begin CHARACTERISTIC DINH_FId.DFC_PEnvSigRngMin_CA "inhibitable FIds / FIds to be inhibited by inhibit source DFC_PEnvSigRngMin" VAL_BLK 0x804E085A ValA_Wu16 968.000000000 DINH_FIdVerb 0.00 968.000000000 FORMAT "%13.9" NUMBER 91 /end CHARACTERISTIC
/begin CHARACTERISTIC DINH_FId.DFC_StmFault_CA "inhibitable FIds / FIds to be inhibited by inhibit source DFC_StmFault" VAL_BLK 0x804E0910 ValA_Wu16 968.000000000 DINH_FIdVerb 0.00 968.000000000 FORMAT "%13.9" NUMBER 53 /end CHARACTERISTIC
/begin CHARACTERISTIC DINH_FId.DFC_StrtCtOffPth_CA "inhibitable FIds / FIds to be inhibited by inhibit source DFC_StrtCtOffPth" VAL_BLK 0x804E097A ValA_Wu16 968.000000000 DINH_FIdVerb 0.00 968.000000000 FORMAT "%13.9" NUMBER 58 /end CHARACTERISTIC
/begin CHARACTERISTIC DINH_FId.DFC_StrtCtlErr_CA "inhibitable FIds / FIds to be inhibited by inhibit source DFC_StrtCtlErr" VAL_BLK 0x804E09EE ValA_Wu16 968.000000000 DINH_FIdVerb 0.00 968.000000000 FORMAT "%13.9" NUMBER 51 /end CHARACTERISTIC
/begin CHARACTERISTIC DINH_FId.DFC_StrtFault_CA "inhibitable FIds / FIds to be inhibited by inhibit source DFC_StrtFault" VAL_BLK 0x804E0A54 ValA_Wu16 968.000000000 DINH_FIdVerb 0.00 968.000000000 FORMAT "%13.9" NUMBER 52 /end CHARACTERISTIC
/begin CHARACTERISTIC DINH_FId.DFC_StrtLckJudg1_CA "inhibitable FIds / FIds to be inhibited by inhibit source DFC_StrtLckJudg1" VAL_BLK 0x804E0ABC ValA_Wu16 968.000000000 DINH_FIdVerb 0.00 968.000000000 FORMAT "%13.9" NUMBER 57 /end CHARACTERISTIC
/begin CHARACTERISTIC DINH_FId.DFC_StrtLckJudg2_CA "inhibitable FIds / FIds to be inhibited by inhibit source DFC_StrtLckJudg2" VAL_BLK 0x804E0B2E ValA_Wu16 968.000000000 DINH_FIdVerb 0.00 968.000000000 FORMAT "%13.9" NUMBER 57 /end CHARACTERISTIC
/begin CHARACTERISTIC DINH_FId.DFC_StrtOL_CA "inhibitable FIds / FIds to be inhibited by inhibit source DFC_StrtOL" VAL_BLK 0x804E0BA0 ValA_Wu16 968.000000000 DINH_FIdVerb 0.00 968.000000000 FORMAT "%13.9" NUMBER 57 /end CHARACTERISTIC
/begin CHARACTERISTIC DINH_FId.DFC_StrtOL2_CA "inhibitable FIds / FIds to be inhibited by inhibit source DFC_StrtOL2" VAL_BLK 0x804E0C12 ValA_Wu16 968.000000000 DINH_FIdVerb 0.00 968.000000000 FORMAT "%13.9" NUMBER 57 /end CHARACTERISTIC
/begin CHARACTERISTIC DINH_FId.DFC_StrtSCB_CA "inhibitable FIds / FIds to be inhibited by inhibit source DFC_StrtSCB" VAL_BLK 0x804E0C84 ValA_Wu16 968.000000000 DINH_FIdVerb 0.00 968.000000000 FORMAT "%13.9" NUMBER 58 /end CHARACTERISTIC
/begin CHARACTERISTIC DINH_FId.DFC_StrtSCB2_CA "inhibitable FIds / FIds to be inhibited by inhibit source DFC_StrtSCB2" VAL_BLK 0x804E0CF8 ValA_Wu16 968.000000000 DINH_FIdVerb 0.00 968.000000000 FORMAT "%13.9" NUMBER 58 /end CHARACTERISTIC
/begin CHARACTERISTIC DINH_FId.DFC_StrtSCG_CA "inhibitable FIds / FIds to be inhibited by inhibit source DFC_StrtSCG" VAL_BLK 0x804E0D6C ValA_Wu16 968.000000000 DINH_FIdVerb 0.00 968.000000000 FORMAT "%13.9" NUMBER 58 /end CHARACTERISTIC
/begin CHARACTERISTIC DINH_FId.DFC_StrtSCG2_CA "inhibitable FIds / FIds to be inhibited by inhibit source DFC_StrtSCG2" VAL_BLK 0x804E0DE0 ValA_Wu16 968.000000000 DINH_FIdVerb 0.00 968.000000000 FORMAT "%13.9" NUMBER 58 /end CHARACTERISTIC
/begin CHARACTERISTIC DINH_FId.DFC_StrtStkRly1_CA "inhibitable FIds / FIds to be inhibited by inhibit source DFC_StrtStkRly1" VAL_BLK 0x804E0E54 ValA_Wu16 968.000000000 DINH_FIdVerb 0.00 968.000000000 FORMAT "%13.9" NUMBER 56 /end CHARACTERISTIC
/begin CHARACTERISTIC DINH_FId.DFC_StrtStkRly2_CA "inhibitable FIds / FIds to be inhibited by inhibit source DFC_StrtStkRly2" VAL_BLK 0x804E0EC4 ValA_Wu16 968.000000000 DINH_FIdVerb 0.00 968.000000000 FORMAT "%13.9" NUMBER 56 /end CHARACTERISTIC
/begin CHARACTERISTIC DINH_FId.DFC_TEVEmax_CA "inhibitable FIds / FIds to be inhibited by inhibit source DFC_TEVEmax" VAL_BLK 0x804E0F34 ValA_Wu16 968.000000000 DINH_FIdVerb 0.00 968.000000000 FORMAT "%13.9" NUMBER 82 /end CHARACTERISTIC
/begin CHARACTERISTIC DINH_FId.DFC_TEVEmin_CA "inhibitable FIds / FIds to be inhibited by inhibit source DFC_TEVEmin" VAL_BLK 0x804E0FD8 ValA_Wu16 968.000000000 DINH_FIdVerb 0.00 968.000000000 FORMAT "%13.9" NUMBER 83 /end CHARACTERISTIC
/begin CHARACTERISTIC DINH_FId.DFC_TEVEsig_CA "inhibitable FIds / FIds to be inhibited by inhibit source DFC_TEVEsig" VAL_BLK 0x804E107E ValA_Wu16 968.000000000 DINH_FIdVerb 0.00 968.000000000 FORMAT "%13.9" NUMBER 82 /end CHARACTERISTIC
/begin CHARACTERISTIC DINH_FId.DFC_UegoHeatrPrfmncLoS1B1_CA "inhibitable FIds / FIds to be inhibited by inhibit source DFC_UegoHeatrPrfmncLoS1B1" VAL_BLK 0x804E1122 ValA_Wu16 968.000000000 DINH_FIdVerb 0.00 968.000000000 FORMAT "%13.9" NUMBER 53 /end CHARACTERISTIC
/begin CHARACTERISTIC DINH_FId.DFC_VehVAllPlaus_CA "inhibitable FIds / FIds to be inhibited by inhibit source DFC_VehVAllPlaus" VAL_BLK 0x804E118C ValA_Wu16 968.000000000 DINH_FIdVerb 0.00 968.000000000 FORMAT "%13.9" NUMBER 67 /end CHARACTERISTIC
/begin CHARACTERISTIC DINH_FId.DFC_VehVNCSnsrElecFailr_CA "inhibitable FIds / FIds to be inhibited by inhibit source DFC_VehVNCSnsrElecFailr" VAL_BLK 0x804E1212 ValA_Wu16 968.000000000 DINH_FIdVerb 0.00 968.000000000 FORMAT "%13.9" NUMBER 55 /end CHARACTERISTIC
/begin CHARACTERISTIC DINH_FId.DFC_VehVPlausCan_CA "inhibitable FIds / FIds to be inhibited by inhibit source DFC_VehVPlausCan" VAL_BLK 0x804E1280 ValA_Wu16 968.000000000 DINH_FIdVerb 0.00 968.000000000 FORMAT "%13.9" NUMBER 81 /end CHARACTERISTIC
/begin CHARACTERISTIC DINH_FId.DFC_VehVPlausFco_CA "inhibitable FIds / FIds to be inhibited by inhibit source DFC_VehVPlausFco" VAL_BLK 0x804E1322 ValA_Wu16 968.000000000 DINH_FIdVerb 0.00 968.000000000 FORMAT "%13.9" NUMBER 90 /end CHARACTERISTIC
/begin CHARACTERISTIC DINH_FId.DFC_VehVPlausPwr_CA "inhibitable FIds / FIds to be inhibited by inhibit source DFC_VehVPlausPwr" VAL_BLK 0x804E13D6 ValA_Wu16 968.000000000 DINH_FIdVerb 0.00 968.000000000 FORMAT "%13.9" NUMBER 76 /end CHARACTERISTIC
/begin CHARACTERISTIC DINH_FId.DFC_VehVPlausV2N_CA "inhibitable FIds / FIds to be inhibited by inhibit source DFC_VehVPlausV2N" VAL_BLK 0x804E146E ValA_Wu16 968.000000000 DINH_FIdVerb 0.00 968.000000000 FORMAT "%13.9" NUMBER 76 /end CHARACTERISTIC
/begin CHARACTERISTIC DINH_FId.DFC_VehVSpdSnsrAElecFailr_CA "inhibitable FIds / FIds to be inhibited by inhibit source DFC_VehVSpdSnsrAElecFailr" VAL_BLK 0x804E1506 ValA_Wu16 968.000000000 DINH_FIdVerb 0.00 968.000000000 FORMAT "%13.9" NUMBER 54 /end CHARACTERISTIC
/begin CHARACTERISTIC DINH_FId.DFC_VehVSpdSnsrBElecFailr_CA "inhibitable FIds / FIds to be inhibited by inhibit source DFC_VehVSpdSnsrBElecFailr" VAL_BLK 0x804E1572 ValA_Wu16 968.000000000 DINH_FIdVerb 0.00 968.000000000 FORMAT "%13.9" NUMBER 54 /end CHARACTERISTIC
/begin CHARACTERISTIC DINH_FId.DFC_ClthMax_CA "inhibitable FIds / FIds to be inhibited by inhibit source DFC_ClthMax" VAL_BLK 0x804E15DE ValA_Wu16 968.000000000 DINH_FIdVerb 0.00 968.000000000 FORMAT "%13.9" NUMBER 65 /end CHARACTERISTIC
/begin CHARACTERISTIC DINH_FId.DFC_IgnClPs_DevComErr_CA "inhibitable FIds / FIds to be inhibited by inhibit source DFC_IgnClPs_DevComErr" VAL_BLK 0x804E1660 ValA_Wu16 968.000000000 DINH_FIdVerb 0.00 968.000000000 FORMAT "%13.9" NUMBER 51 /end CHARACTERISTIC
/begin CHARACTERISTIC DINH_FId.DFC_IgnClPs_LineOl_0_CA "inhibitable FIds / FIds to be inhibited by inhibit source DFC_IgnClPs_LineOl_0" VAL_BLK 0x804E16C6 ValA_Wu16 968.000000000 DINH_FIdVerb 0.00 968.000000000 FORMAT "%13.9" NUMBER 55 /end CHARACTERISTIC
/begin CHARACTERISTIC DINH_FId.DFC_IgnClPs_LineOl_1_CA "inhibitable FIds / FIds to be inhibited by inhibit source DFC_IgnClPs_LineOl_1" VAL_BLK 0x804E1734 ValA_Wu16 968.000000000 DINH_FIdVerb 0.00 968.000000000 FORMAT "%13.9" NUMBER 55 /end CHARACTERISTIC
/begin CHARACTERISTIC DINH_FId.DFC_IgnClPs_LineOl_2_CA "inhibitable FIds / FIds to be inhibited by inhibit source DFC_IgnClPs_LineOl_2" VAL_BLK 0x804E17A2 ValA_Wu16 968.000000000 DINH_FIdVerb 0.00 968.000000000 FORMAT "%13.9" NUMBER 55 /end CHARACTERISTIC
/begin CHARACTERISTIC DINH_FId.DFC_IgnClPs_LineOl_3_CA "inhibitable FIds / FIds to be inhibited by inhibit source DFC_IgnClPs_LineOl_3" VAL_BLK 0x804E1810 ValA_Wu16 968.000000000 DINH_FIdVerb 0.00 968.000000000 FORMAT "%13.9" NUMBER 55 /end CHARACTERISTIC
/begin CHARACTERISTIC DINH_FId.DFC_IgnClPs_LineScb_0_CA "inhibitable FIds / FIds to be inhibited by inhibit source DFC_IgnClPs_LineScb_0" VAL_BLK 0x804E187E ValA_Wu16 968.000000000 DINH_FIdVerb 0.00 968.000000000 FORMAT "%13.9" NUMBER 55 /end CHARACTERISTIC
/begin CHARACTERISTIC DINH_FId.DFC_IgnClPs_LineScb_1_CA "inhibitable FIds / FIds to be inhibited by inhibit source DFC_IgnClPs_LineScb_1" VAL_BLK 0x804E18EC ValA_Wu16 968.000000000 DINH_FIdVerb 0.00 968.000000000 FORMAT "%13.9" NUMBER 55 /end CHARACTERISTIC
/begin CHARACTERISTIC DINH_FId.DFC_IgnClPs_LineScb_2_CA "inhibitable FIds / FIds to be inhibited by inhibit source DFC_IgnClPs_LineScb_2" VAL_BLK 0x804E195A ValA_Wu16 968.000000000 DINH_FIdVerb 0.00 968.000000000 FORMAT "%13.9" NUMBER 55 /end CHARACTERISTIC
/begin CHARACTERISTIC DINH_FId.DFC_IgnClPs_LineScb_3_CA "inhibitable FIds / FIds to be inhibited by inhibit source DFC_IgnClPs_LineScb_3" VAL_BLK 0x804E19C8 ValA_Wu16 968.000000000 DINH_FIdVerb 0.00 968.000000000 FORMAT "%13.9" NUMBER 55 /end CHARACTERISTIC
/begin CHARACTERISTIC DINH_FId.DFC_IgnClPs_LineScg_0_CA "inhibitable FIds / FIds to be inhibited by inhibit source DFC_IgnClPs_LineScg_0" VAL_BLK 0x804E1A36 ValA_Wu16 968.000000000 DINH_FIdVerb 0.00 968.000000000 FORMAT "%13.9" NUMBER 55 /end CHARACTERISTIC
/begin CHARACTERISTIC DINH_FId.DFC_IgnClPs_LineScg_1_CA "inhibitable FIds / FIds to be inhibited by inhibit source DFC_IgnClPs_LineScg_1" VAL_BLK 0x804E1AA4 ValA_Wu16 968.000000000 DINH_FIdVerb 0.00 968.000000000 FORMAT "%13.9" NUMBER 55 /end CHARACTERISTIC
/begin CHARACTERISTIC DINH_FId.DFC_IgnClPs_LineScg_2_CA "inhibitable FIds / FIds to be inhibited by inhibit source DFC_IgnClPs_LineScg_2" VAL_BLK 0x804E1B12 ValA_Wu16 968.000000000 DINH_FIdVerb 0.00 968.000000000 FORMAT "%13.9" NUMBER 55 /end CHARACTERISTIC
/begin CHARACTERISTIC DINH_FId.DFC_IgnClPs_LineScg_3_CA "inhibitable FIds / FIds to be inhibited by inhibit source DFC_IgnClPs_LineScg_3" VAL_BLK 0x804E1B80 ValA_Wu16 968.000000000 DINH_FIdVerb 0.00 968.000000000 FORMAT "%13.9" NUMBER 55 /end CHARACTERISTIC
/begin CHARACTERISTIC DINH_FId.DFC_KRVEKOEVAB_CA "inhibitable FIds / FIds to be inhibited by inhibit source DFC_KRVEKOEVAB" VAL_BLK 0x804E1BEE ValA_Wu16 968.000000000 DINH_FIdVerb 0.00 968.000000000 FORMAT "%13.9" NUMBER 50 /end CHARACTERISTIC
/begin CHARACTERISTIC DINH_FId.DFC_KRVEKOEVAB0_CA "inhibitable FIds / FIds to be inhibited by inhibit source DFC_KRVEKOEVAB0" VAL_BLK 0x804E1C52 ValA_Wu16 968.000000000 DINH_FIdVerb 0.00 968.000000000 FORMAT "%13.9" NUMBER 50 /end CHARACTERISTIC
/begin CHARACTERISTIC DINH_FId.DFC_KRVEKOEVAB1_CA "inhibitable FIds / FIds to be inhibited by inhibit source DFC_KRVEKOEVAB1" VAL_BLK 0x804E1CB6 ValA_Wu16 968.000000000 DINH_FIdVerb 0.00 968.000000000 FORMAT "%13.9" NUMBER 50 /end CHARACTERISTIC
/begin CHARACTERISTIC DINH_FId.DFC_KRVEKOEVAB2_CA "inhibitable FIds / FIds to be inhibited by inhibit source DFC_KRVEKOEVAB2" VAL_BLK 0x804E1D1A ValA_Wu16 968.000000000 DINH_FIdVerb 0.00 968.000000000 FORMAT "%13.9" NUMBER 50 /end CHARACTERISTIC
/begin CHARACTERISTIC DINH_FId.DFC_KRVEKOEVAB3_CA "inhibitable FIds / FIds to be inhibited by inhibit source DFC_KRVEKOEVAB3" VAL_BLK 0x804E1D7E ValA_Wu16 968.000000000 DINH_FIdVerb 0.00 968.000000000 FORMAT "%13.9" NUMBER 50 /end CHARACTERISTIC
/begin CHARACTERISTIC DINH_FId.DFC_UegoSigEcuAsicS1B1_CA "inhibitable FIds / FIds to be inhibited by inhibit source DFC_UegoSigEcuAsicS1B1" VAL_BLK 0x804E1DE2 ValA_Wu16 968.000000000 DINH_FIdVerb 0.00 968.000000000 FORMAT "%13.9" NUMBER 85 /end CHARACTERISTIC
/begin CHARACTERISTIC DINH_FId.DFC_UegoSigEcuComS1B1_CA "inhibitable FIds / FIds to be inhibited by inhibit source DFC_UegoSigEcuComS1B1" VAL_BLK 0x804E1E8C ValA_Wu16 968.000000000 DINH_FIdVerb 0.00 968.000000000 FORMAT "%13.9" NUMBER 85 /end CHARACTERISTIC
/begin CHARACTERISTIC DINH_FId.DFC_UegoSigSnsrS1B1_CA "inhibitable FIds / FIds to be inhibited by inhibit source DFC_UegoSigSnsrS1B1" VAL_BLK 0x804E1F36 ValA_Wu16 968.000000000 DINH_FIdVerb 0.00 968.000000000 FORMAT "%13.9" NUMBER 53 /end CHARACTERISTIC
/begin CHARACTERISTIC DINH_FId.DFC_UegoSigWireOlApesS1B1_CA "inhibitable FIds / FIds to be inhibited by inhibit source DFC_UegoSigWireOlApesS1B1" VAL_BLK 0x804E1FA0 ValA_Wu16 968.000000000 DINH_FIdVerb 0.00 968.000000000 FORMAT "%13.9" NUMBER 82 /end CHARACTERISTIC
/begin CHARACTERISTIC DINH_FId.DFC_UegoSigWireOlIpeS1B1_CA "inhibitable FIds / FIds to be inhibited by inhibit source DFC_UegoSigWireOlIpeS1B1" VAL_BLK 0x804E2044 ValA_Wu16 968.000000000 DINH_FIdVerb 0.00 968.000000000 FORMAT "%13.9" NUMBER 85 /end CHARACTERISTIC
/begin CHARACTERISTIC DINH_FId.DFC_UegoSigWireOlReS1B1_CA "inhibitable FIds / FIds to be inhibited by inhibit source DFC_UegoSigWireOlReS1B1" VAL_BLK 0x804E20EE ValA_Wu16 968.000000000 DINH_FIdVerb 0.00 968.000000000 FORMAT "%13.9" NUMBER 85 /end CHARACTERISTIC
/begin CHARACTERISTIC DINH_FId.DFC_UegoSigWireRCmpS1B1_CA "inhibitable FIds / FIds to be inhibited by inhibit source DFC_UegoSigWireRCmpS1B1" VAL_BLK 0x804E2198 ValA_Wu16 968.000000000 DINH_FIdVerb 0.00 968.000000000 FORMAT "%13.9" NUMBER 83 /end CHARACTERISTIC
/begin CHARACTERISTIC DINH_FId.DFC_UegoSigWireScbS1B1_CA "inhibitable FIds / FIds to be inhibited by inhibit source DFC_UegoSigWireScbS1B1" VAL_BLK 0x804E223E ValA_Wu16 968.000000000 DINH_FIdVerb 0.00 968.000000000 FORMAT "%13.9" NUMBER 86 /end CHARACTERISTIC
/begin CHARACTERISTIC DINH_FId.DFC_UegoSigWireScgS1B1_CA "inhibitable FIds / FIds to be inhibited by inhibit source DFC_UegoSigWireScgS1B1" VAL_BLK 0x804E22EA ValA_Wu16 968.000000000 DINH_FIdVerb 0.00 968.000000000 FORMAT "%13.9" NUMBER 86 /end CHARACTERISTIC
/begin CHARACTERISTIC DINH_FId.DFC_AfsPhyRngHiB1_CA "inhibitable FIds / FIds to be inhibited by inhibit source DFC_AfsPhyRngHiB1" VAL_BLK 0x804E2396 ValA_Wu16 968.000000000 DINH_FIdVerb 0.00 968.000000000 FORMAT "%13.9" NUMBER 56 /end CHARACTERISTIC
/begin CHARACTERISTIC DINH_FId.DFC_AfsPhyRngLoB1_CA "inhibitable FIds / FIds to be inhibited by inhibit source DFC_AfsPhyRngLoB1" VAL_BLK 0x804E2406 ValA_Wu16 968.000000000 DINH_FIdVerb 0.00 968.000000000 FORMAT "%13.9" NUMBER 56 /end CHARACTERISTIC
/begin CHARACTERISTIC DINH_FId.DFC_AirCCmprOL_CA "inhibitable FIds / FIds to be inhibited by inhibit source DFC_AirCCmprOL" VAL_BLK 0x804E2476 ValA_Wu16 968.000000000 DINH_FIdVerb 0.00 968.000000000 FORMAT "%13.9" NUMBER 50 /end CHARACTERISTIC
/begin CHARACTERISTIC DINH_FId.DFC_AirCCmprOvrTemp_CA "inhibitable FIds / FIds to be inhibited by inhibit source DFC_AirCCmprOvrTemp" VAL_BLK 0x804E24DA ValA_Wu16 968.000000000 DINH_FIdVerb 0.00 968.000000000 FORMAT "%13.9" NUMBER 50 /end CHARACTERISTIC
/begin CHARACTERISTIC DINH_FId.DFC_AirCCmprSCB_CA "inhibitable FIds / FIds to be inhibited by inhibit source DFC_AirCCmprSCB" VAL_BLK 0x804E253E ValA_Wu16 968.000000000 DINH_FIdVerb 0.00 968.000000000 FORMAT "%13.9" NUMBER 50 /end CHARACTERISTIC
/begin CHARACTERISTIC DINH_FId.DFC_AirCCmprSCG_CA "inhibitable FIds / FIds to be inhibited by inhibit source DFC_AirCCmprSCG" VAL_BLK 0x804E25A2 ValA_Wu16 968.000000000 DINH_FIdVerb 0.00 968.000000000 FORMAT "%13.9" NUMBER 50 /end CHARACTERISTIC
/begin CHARACTERISTIC DINH_FId.DFC_AltErr_CA "inhibitable FIds / FIds to be inhibited by inhibit source DFC_AltErr" VAL_BLK 0x804E2606 ValA_Wu16 968.000000000 DINH_FIdVerb 0.00 968.000000000 FORMAT "%13.9" NUMBER 51 /end CHARACTERISTIC
/begin CHARACTERISTIC DINH_FId.DFC_BattUSRCMax_CA "inhibitable FIds / FIds to be inhibited by inhibit source DFC_BattUSRCMax" VAL_BLK 0x804E266C ValA_Wu16 968.000000000 DINH_FIdVerb 0.00 968.000000000 FORMAT "%13.9" NUMBER 58 /end CHARACTERISTIC
/begin CHARACTERISTIC DINH_FId.DFC_BattUSRCMin_CA "inhibitable FIds / FIds to be inhibited by inhibit source DFC_BattUSRCMin" VAL_BLK 0x804E26E0 ValA_Wu16 968.000000000 DINH_FIdVerb 0.00 968.000000000 FORMAT "%13.9" NUMBER 58 /end CHARACTERISTIC
/begin CHARACTERISTIC DINH_FId.DFC_ComChksTCU1_CA "inhibitable FIds / FIds to be inhibited by inhibit source DFC_ComChksTCU1" VAL_BLK 0x804E2754 ValA_Wu16 968.000000000 DINH_FIdVerb 0.00 968.000000000 FORMAT "%13.9" NUMBER 50 /end CHARACTERISTIC
/begin CHARACTERISTIC DINH_FId.DFC_ComChksTCU11_CA "inhibitable FIds / FIds to be inhibited by inhibit source DFC_ComChksTCU11" VAL_BLK 0x804E27B8 ValA_Wu16 968.000000000 DINH_FIdVerb 0.00 968.000000000 FORMAT "%13.9" NUMBER 51 /end CHARACTERISTIC
/begin CHARACTERISTIC DINH_FId.DFC_ComChksTCU12_CA "inhibitable FIds / FIds to be inhibited by inhibit source DFC_ComChksTCU12" VAL_BLK 0x804E281E ValA_Wu16 968.000000000 DINH_FIdVerb 0.00 968.000000000 FORMAT "%13.9" NUMBER 52 /end CHARACTERISTIC
/begin CHARACTERISTIC DINH_FId.DFC_ComChksTCU13_CA "inhibitable FIds / FIds to be inhibited by inhibit source DFC_ComChksTCU13" VAL_BLK 0x804E2886 ValA_Wu16 968.000000000 DINH_FIdVerb 0.00 968.000000000 FORMAT "%13.9" NUMBER 52 /end CHARACTERISTIC
/begin CHARACTERISTIC DINH_FId.DFC_ComChksTCU2_CA "inhibitable FIds / FIds to be inhibited by inhibit source DFC_ComChksTCU2" VAL_BLK 0x804E28EE ValA_Wu16 968.000000000 DINH_FIdVerb 0.00 968.000000000 FORMAT "%13.9" NUMBER 50 /end CHARACTERISTIC
/begin CHARACTERISTIC DINH_FId.DFC_ComChksTCU3_CA "inhibitable FIds / FIds to be inhibited by inhibit source DFC_ComChksTCU3" VAL_BLK 0x804E2952 ValA_Wu16 968.000000000 DINH_FIdVerb 0.00 968.000000000 FORMAT "%13.9" NUMBER 50 /end CHARACTERISTIC
/begin CHARACTERISTIC DINH_FId.DFC_ComChksTCU4_CA "inhibitable FIds / FIds to be inhibited by inhibit source DFC_ComChksTCU4" VAL_BLK 0x804E29B6 ValA_Wu16 968.000000000 DINH_FIdVerb 0.00 968.000000000 FORMAT "%13.9" NUMBER 50 /end CHARACTERISTIC
/begin CHARACTERISTIC DINH_FId.DFC_ComCntTCU1_CA "inhibitable FIds / FIds to be inhibited by inhibit source DFC_ComCntTCU1" VAL_BLK 0x804E2A1A ValA_Wu16 968.000000000 DINH_FIdVerb 0.00 968.000000000 FORMAT "%13.9" NUMBER 50 /end CHARACTERISTIC
/begin CHARACTERISTIC DINH_FId.DFC_ComCntTCU11_CA "inhibitable FIds / FIds to be inhibited by inhibit source DFC_ComCntTCU11" VAL_BLK 0x804E2A7E ValA_Wu16 968.000000000 DINH_FIdVerb 0.00 968.000000000 FORMAT "%13.9" NUMBER 51 /end CHARACTERISTIC
/begin CHARACTERISTIC DINH_FId.DFC_ComCntTCU12_CA "inhibitable FIds / FIds to be inhibited by inhibit source DFC_ComCntTCU12" VAL_BLK 0x804E2AE4 ValA_Wu16 968.000000000 DINH_FIdVerb 0.00 968.000000000 FORMAT "%13.9" NUMBER 52 /end CHARACTERISTIC
/begin CHARACTERISTIC DINH_FId.DFC_ComCntTCU13_CA "inhibitable FIds / FIds to be inhibited by inhibit source DFC_ComCntTCU13" VAL_BLK 0x804E2B4C ValA_Wu16 968.000000000 DINH_FIdVerb 0.00 968.000000000 FORMAT "%13.9" NUMBER 52 /end CHARACTERISTIC
/begin CHARACTERISTIC DINH_FId.DFC_ComCntTCU2_CA "inhibitable FIds / FIds to be inhibited by inhibit source DFC_ComCntTCU2" VAL_BLK 0x804E2BB4 ValA_Wu16 968.000000000 DINH_FIdVerb 0.00 968.000000000 FORMAT "%13.9" NUMBER 50 /end CHARACTERISTIC
/begin CHARACTERISTIC DINH_FId.DFC_ComCntTCU3_CA "inhibitable FIds / FIds to be inhibited by inhibit source DFC_ComCntTCU3" VAL_BLK 0x804E2C18 ValA_Wu16 968.000000000 DINH_FIdVerb 0.00 968.000000000 FORMAT "%13.9" NUMBER 50 /end CHARACTERISTIC
/begin CHARACTERISTIC DINH_FId.DFC_ComCntTCU4_CA "inhibitable FIds / FIds to be inhibited by inhibit source DFC_ComCntTCU4" VAL_BLK 0x804E2C7C ValA_Wu16 968.000000000 DINH_FIdVerb 0.00 968.000000000 FORMAT "%13.9" NUMBER 50 /end CHARACTERISTIC
/begin CHARACTERISTIC DINH_FId.DFC_ComTOutTCU01_CA "inhibitable FIds / FIds to be inhibited by inhibit source DFC_ComTOutTCU01" VAL_BLK 0x804E2CE0 ValA_Wu16 968.000000000 DINH_FIdVerb 0.00 968.000000000 FORMAT "%13.9" NUMBER 51 /end CHARACTERISTIC
/begin CHARACTERISTIC DINH_FId.DFC_ComTOutTCU02_CA "inhibitable FIds / FIds to be inhibited by inhibit source DFC_ComTOutTCU02" VAL_BLK 0x804E2D46 ValA_Wu16 968.000000000 DINH_FIdVerb 0.00 968.000000000 FORMAT "%13.9" NUMBER 51 /end CHARACTERISTIC
/begin CHARACTERISTIC DINH_FId.DFC_ComTOutTCU1_CA "inhibitable FIds / FIds to be inhibited by inhibit source DFC_ComTOutTCU1" VAL_BLK 0x804E2DAC ValA_Wu16 968.000000000 DINH_FIdVerb 0.00 968.000000000 FORMAT "%13.9" NUMBER 55 /end CHARACTERISTIC
/begin CHARACTERISTIC DINH_FId.DFC_ComTOutTCU11_CA "inhibitable FIds / FIds to be inhibited by inhibit source DFC_ComTOutTCU11" VAL_BLK 0x804E2E1A ValA_Wu16 968.000000000 DINH_FIdVerb 0.00 968.000000000 FORMAT "%13.9" NUMBER 54 /end CHARACTERISTIC
/begin CHARACTERISTIC DINH_FId.DFC_ComTOutTCU12_CA "inhibitable FIds / FIds to be inhibited by inhibit source DFC_ComTOutTCU12" VAL_BLK 0x804E2E86 ValA_Wu16 968.000000000 DINH_FIdVerb 0.00 968.000000000 FORMAT "%13.9" NUMBER 52 /end CHARACTERISTIC
/begin CHARACTERISTIC DINH_FId.DFC_ComTOutTCU13_CA "inhibitable FIds / FIds to be inhibited by inhibit source DFC_ComTOutTCU13" VAL_BLK 0x804E2EEE ValA_Wu16 968.000000000 DINH_FIdVerb 0.00 968.000000000 FORMAT "%13.9" NUMBER 52 /end CHARACTERISTIC
/begin CHARACTERISTIC DINH_FId.DFC_ComTOutTCU14_CA "inhibitable FIds / FIds to be inhibited by inhibit source DFC_ComTOutTCU14" VAL_BLK 0x804E2F56 ValA_Wu16 968.000000000 DINH_FIdVerb 0.00 968.000000000 FORMAT "%13.9" NUMBER 51 /end CHARACTERISTIC
/begin CHARACTERISTIC DINH_FId.DFC_ComTOutTCU2_CA "inhibitable FIds / FIds to be inhibited by inhibit source DFC_ComTOutTCU2" VAL_BLK 0x804E2FBC ValA_Wu16 968.000000000 DINH_FIdVerb 0.00 968.000000000 FORMAT "%13.9" NUMBER 52 /end CHARACTERISTIC
/begin CHARACTERISTIC DINH_FId.DFC_ComTOutTCU3_CA "inhibitable FIds / FIds to be inhibited by inhibit source DFC_ComTOutTCU3" VAL_BLK 0x804E3024 ValA_Wu16 968.000000000 DINH_FIdVerb 0.00 968.000000000 FORMAT "%13.9" NUMBER 52 /end CHARACTERISTIC
/begin CHARACTERISTIC DINH_FId.DFC_ComTOutTCU4_CA "inhibitable FIds / FIds to be inhibited by inhibit source DFC_ComTOutTCU4" VAL_BLK 0x804E308C ValA_Wu16 968.000000000 DINH_FIdVerb 0.00 968.000000000 FORMAT "%13.9" NUMBER 51 /end CHARACTERISTIC
/begin CHARACTERISTIC DINH_FId.DFC_DevLibBattUHi_CA "inhibitable FIds / FIds to be inhibited by inhibit source DFC_DevLibBattUHi" VAL_BLK 0x804E30F2 ValA_Wu16 968.000000000 DINH_FIdVerb 0.00 968.000000000 FORMAT "%13.9" NUMBER 50 /end CHARACTERISTIC
/begin CHARACTERISTIC DINH_FId.DFC_DevLibBattULo_CA "inhibitable FIds / FIds to be inhibited by inhibit source DFC_DevLibBattULo" VAL_BLK 0x804E3156 ValA_Wu16 968.000000000 DINH_FIdVerb 0.00 968.000000000 FORMAT "%13.9" NUMBER 50 /end CHARACTERISTIC
/begin CHARACTERISTIC DINH_FId.DFC_EGRVlvFailSafeActv_CA "inhibitable FIds / FIds to be inhibited by inhibit source DFC_EGRVlvFailSafeActv" VAL_BLK 0x804E31BA ValA_Wu16 968.000000000 DINH_FIdVerb 0.00 968.000000000 FORMAT "%13.9" NUMBER 51 /end CHARACTERISTIC
/begin CHARACTERISTIC DINH_FId.DFC_EGRVlvGovDvtCld_CA "inhibitable FIds / FIds to be inhibited by inhibit source DFC_EGRVlvGovDvtCld" VAL_BLK 0x804E3220 ValA_Wu16 968.000000000 DINH_FIdVerb 0.00 968.000000000 FORMAT "%13.9" NUMBER 51 /end CHARACTERISTIC
/begin CHARACTERISTIC DINH_FId.DFC_EGRVlvPhysSRCMax_CA "inhibitable FIds / FIds to be inhibited by inhibit source DFC_EGRVlvPhysSRCMax" VAL_BLK 0x804E3286 ValA_Wu16 968.000000000 DINH_FIdVerb 0.00 968.000000000 FORMAT "%13.9" NUMBER 54 /end CHARACTERISTIC
/begin CHARACTERISTIC DINH_FId.DFC_EGRVlvPhysSRCMin_CA "inhibitable FIds / FIds to be inhibited by inhibit source DFC_EGRVlvPhysSRCMin" VAL_BLK 0x804E32F2 ValA_Wu16 968.000000000 DINH_FIdVerb 0.00 968.000000000 FORMAT "%13.9" NUMBER 54 /end CHARACTERISTIC
/begin CHARACTERISTIC DINH_FId.DFC_FanDIOOL_0_CA "inhibitable FIds / FIds to be inhibited by inhibit source DFC_FanDIOOL_0" VAL_BLK 0x804E335E ValA_Wu16 968.000000000 DINH_FIdVerb 0.00 968.000000000 FORMAT "%13.9" NUMBER 51 /end CHARACTERISTIC
/begin CHARACTERISTIC DINH_FId.DFC_FanDIOOL_1_CA "inhibitable FIds / FIds to be inhibited by inhibit source DFC_FanDIOOL_1" VAL_BLK 0x804E33C4 ValA_Wu16 968.000000000 DINH_FIdVerb 0.00 968.000000000 FORMAT "%13.9" NUMBER 51 /end CHARACTERISTIC
/begin CHARACTERISTIC DINH_FId.DFC_FanDIOOvrTemp_0_CA "inhibitable FIds / FIds to be inhibited by inhibit source DFC_FanDIOOvrTemp_0" VAL_BLK 0x804E342A ValA_Wu16 968.000000000 DINH_FIdVerb 0.00 968.000000000 FORMAT "%13.9" NUMBER 50 /end CHARACTERISTIC
/begin CHARACTERISTIC DINH_FId.DFC_FanDIOOvrTemp_1_CA "inhibitable FIds / FIds to be inhibited by inhibit source DFC_FanDIOOvrTemp_1" VAL_BLK 0x804E348E ValA_Wu16 968.000000000 DINH_FIdVerb 0.00 968.000000000 FORMAT "%13.9" NUMBER 50 /end CHARACTERISTIC
/begin CHARACTERISTIC DINH_FId.DFC_FanDIOSCB_0_CA "inhibitable FIds / FIds to be inhibited by inhibit source DFC_FanDIOSCB_0" VAL_BLK 0x804E34F2 ValA_Wu16 968.000000000 DINH_FIdVerb 0.00 968.000000000 FORMAT "%13.9" NUMBER 51 /end CHARACTERISTIC
/begin CHARACTERISTIC DINH_FId.DFC_FanDIOSCB_1_CA "inhibitable FIds / FIds to be inhibited by inhibit source DFC_FanDIOSCB_1" VAL_BLK 0x804E3558 ValA_Wu16 968.000000000 DINH_FIdVerb 0.00 968.000000000 FORMAT "%13.9" NUMBER 51 /end CHARACTERISTIC
/begin CHARACTERISTIC DINH_FId.DFC_FanDIOSCG_0_CA "inhibitable FIds / FIds to be inhibited by inhibit source DFC_FanDIOSCG_0" VAL_BLK 0x804E35BE ValA_Wu16 968.000000000 DINH_FIdVerb 0.00 968.000000000 FORMAT "%13.9" NUMBER 51 /end CHARACTERISTIC
/begin CHARACTERISTIC DINH_FId.DFC_FanDIOSCG_1_CA "inhibitable FIds / FIds to be inhibited by inhibit source DFC_FanDIOSCG_1" VAL_BLK 0x804E3624 ValA_Wu16 968.000000000 DINH_FIdVerb 0.00 968.000000000 FORMAT "%13.9" NUMBER 51 /end CHARACTERISTIC
/begin CHARACTERISTIC DINH_FId.DFC_MRlyDcOL_CA "inhibitable FIds / FIds to be inhibited by inhibit source DFC_MRlyDcOL" VAL_BLK 0x804E368A ValA_Wu16 968.000000000 DINH_FIdVerb 0.00 968.000000000 FORMAT "%13.9" NUMBER 50 /end CHARACTERISTIC
/begin CHARACTERISTIC DINH_FId.DFC_MRlyDcSCB_CA "inhibitable FIds / FIds to be inhibited by inhibit source DFC_MRlyDcSCB" VAL_BLK 0x804E36EE ValA_Wu16 968.000000000 DINH_FIdVerb 0.00 968.000000000 FORMAT "%13.9" NUMBER 50 /end CHARACTERISTIC
/begin CHARACTERISTIC DINH_FId.DFC_MRlyDcSCG_CA "inhibitable FIds / FIds to be inhibited by inhibit source DFC_MRlyDcSCG" VAL_BLK 0x804E3752 ValA_Wu16 968.000000000 DINH_FIdVerb 0.00 968.000000000 FORMAT "%13.9" NUMBER 50 /end CHARACTERISTIC
/begin CHARACTERISTIC DINH_FId.DFC_PSPOL_CA "inhibitable FIds / FIds to be inhibited by inhibit source DFC_PSPOL" VAL_BLK 0x804E37B6 ValA_Wu16 968.000000000 DINH_FIdVerb 0.00 968.000000000 FORMAT "%13.9" NUMBER 50 /end CHARACTERISTIC
/begin CHARACTERISTIC DINH_FId.DFC_PSPOvrTemp_CA "inhibitable FIds / FIds to be inhibited by inhibit source DFC_PSPOvrTemp" VAL_BLK 0x804E381A ValA_Wu16 968.000000000 DINH_FIdVerb 0.00 968.000000000 FORMAT "%13.9" NUMBER 50 /end CHARACTERISTIC
/begin CHARACTERISTIC DINH_FId.DFC_PSPSCB_CA "inhibitable FIds / FIds to be inhibited by inhibit source DFC_PSPSCB" VAL_BLK 0x804E387E ValA_Wu16 968.000000000 DINH_FIdVerb 0.00 968.000000000 FORMAT "%13.9" NUMBER 50 /end CHARACTERISTIC
/begin CHARACTERISTIC DINH_FId.DFC_PSPSCG_CA "inhibitable FIds / FIds to be inhibited by inhibit source DFC_PSPSCG" VAL_BLK 0x804E38E2 ValA_Wu16 968.000000000 DINH_FIdVerb 0.00 968.000000000 FORMAT "%13.9" NUMBER 50 /end CHARACTERISTIC
/begin CHARACTERISTIC DINH_FId.DFC_T50Err_CA "inhibitable FIds / FIds to be inhibited by inhibit source DFC_T50Err" VAL_BLK 0x804E3946 ValA_Wu16 968.000000000 DINH_FIdVerb 0.00 968.000000000 FORMAT "%13.9" NUMBER 51 /end CHARACTERISTIC
/begin CHARACTERISTIC DINH_FId.DFC_ThrVlvLoBattB1_CA "inhibitable FIds / FIds to be inhibited by inhibit source DFC_ThrVlvLoBattB1" VAL_BLK 0x804E39AC ValA_Wu16 968.000000000 DINH_FIdVerb 0.00 968.000000000 FORMAT "%13.9" NUMBER 50 /end CHARACTERISTIC
/begin CHARACTERISTIC DINH_FId.DFC_UegoSigOperPlausS1B1_CA "inhibitable FIds / FIds to be inhibited by inhibit source DFC_UegoSigOperPlausS1B1" VAL_BLK 0x804E3A10 ValA_Wu16 968.000000000 DINH_FIdVerb 0.00 968.000000000 FORMAT "%13.9" NUMBER 73 /end CHARACTERISTIC
/begin CHARACTERISTIC DINH_FId.DFC_VehVPhysRngHi_CA "inhibitable FIds / FIds to be inhibited by inhibit source DFC_VehVPhysRngHi" VAL_BLK 0x804E3AA2 ValA_Wu16 968.000000000 DINH_FIdVerb 0.00 968.000000000 FORMAT "%13.9" NUMBER 99 /end CHARACTERISTIC
/begin CHARACTERISTIC DINH_FId.DFC_VehVSclOutOL_CA "inhibitable FIds / FIds to be inhibited by inhibit source DFC_VehVSclOutOL" VAL_BLK 0x804E3B68 ValA_Wu16 968.000000000 DINH_FIdVerb 0.00 968.000000000 FORMAT "%13.9" NUMBER 50 /end CHARACTERISTIC
/begin CHARACTERISTIC DINH_FId.DFC_VehVSclOutOT_CA "inhibitable FIds / FIds to be inhibited by inhibit source DFC_VehVSclOutOT" VAL_BLK 0x804E3BCC ValA_Wu16 968.000000000 DINH_FIdVerb 0.00 968.000000000 FORMAT "%13.9" NUMBER 50 /end CHARACTERISTIC
/begin CHARACTERISTIC DINH_FId.DFC_VehVSclOutSCB_CA "inhibitable FIds / FIds to be inhibited by inhibit source DFC_VehVSclOutSCB" VAL_BLK 0x804E3C30 ValA_Wu16 968.000000000 DINH_FIdVerb 0.00 968.000000000 FORMAT "%13.9" NUMBER 50 /end CHARACTERISTIC
/begin CHARACTERISTIC DINH_FId.DFC_VehVSclOutSCG_CA "inhibitable FIds / FIds to be inhibited by inhibit source DFC_VehVSclOutSCG" VAL_BLK 0x804E3C94 ValA_Wu16 968.000000000 DINH_FIdVerb 0.00 968.000000000 FORMAT "%13.9" NUMBER 50 /end CHARACTERISTIC
/begin CHARACTERISTIC DINH_FId.DFC_VehVSigFL_CA "inhibitable FIds / FIds to be inhibited by inhibit source DFC_VehVSigFL" VAL_BLK 0x804E3CF8 ValA_Wu16 968.000000000 DINH_FIdVerb 0.00 968.000000000 FORMAT "%13.9" NUMBER 51 /end CHARACTERISTIC
/begin CHARACTERISTIC DINH_FId.DFC_VehVSigFR_CA "inhibitable FIds / FIds to be inhibited by inhibit source DFC_VehVSigFR" VAL_BLK 0x804E3D5E ValA_Wu16 968.000000000 DINH_FIdVerb 0.00 968.000000000 FORMAT "%13.9" NUMBER 51 /end CHARACTERISTIC
/begin CHARACTERISTIC DINH_FId.DFC_VehVSigRL_CA "inhibitable FIds / FIds to be inhibited by inhibit source DFC_VehVSigRL" VAL_BLK 0x804E3DC4 ValA_Wu16 968.000000000 DINH_FIdVerb 0.00 968.000000000 FORMAT "%13.9" NUMBER 51 /end CHARACTERISTIC
/begin CHARACTERISTIC DINH_FId.DFC_VehVSigRR_CA "inhibitable FIds / FIds to be inhibited by inhibit source DFC_VehVSigRR" VAL_BLK 0x804E3E2A ValA_Wu16 968.000000000 DINH_FIdVerb 0.00 968.000000000 FORMAT "%13.9" NUMBER 51 /end CHARACTERISTIC
/begin CHARACTERISTIC DINH_FId.DFC_VehVSnsrARngHi_CA "inhibitable FIds / FIds to be inhibited by inhibit source DFC_VehVSnsrARngHi" VAL_BLK 0x804E3E90 ValA_Wu16 968.000000000 DINH_FIdVerb 0.00 968.000000000 FORMAT "%13.9" NUMBER 50 /end CHARACTERISTIC
/begin CHARACTERISTIC DINH_FId.DFC_VehVSnsrBRngHi_CA "inhibitable FIds / FIds to be inhibited by inhibit source DFC_VehVSnsrBRngHi" VAL_BLK 0x804E3EF4 ValA_Wu16 968.000000000 DINH_FIdVerb 0.00 968.000000000 FORMAT "%13.9" NUMBER 50 /end CHARACTERISTIC
/begin CHARACTERISTIC DINH_FId.DFC_VehVSpdRtyDiag_CA "inhibitable FIds / FIds to be inhibited by inhibit source DFC_VehVSpdRtyDiag" VAL_BLK 0x804E3F58 ValA_Wu16 968.000000000 DINH_FIdVerb 0.00 968.000000000 FORMAT "%13.9" NUMBER 51 /end CHARACTERISTIC
/begin CHARACTERISTIC DINH_FId.DFC_DHFHD_CA "inhibitable FIds / FIds to be inhibited by inhibit source DFC_DHFHD" VAL_BLK 0x804E3FBE ValA_Wu16 968.000000000 DINH_FIdVerb 0.00 968.000000000 FORMAT "%13.9" NUMBER 51 /end CHARACTERISTIC
/begin CHARACTERISTIC DINH_FId.DFC_InjVlv_DI_DcDc_CA "inhibitable FIds / FIds to be inhibited by inhibit source DFC_InjVlv_DI_DcDc" VAL_BLK 0x804E4024 ValA_Wu16 968.000000000 DINH_FIdVerb 0.00 968.000000000 FORMAT "%13.9" NUMBER 50 /end CHARACTERISTIC
/begin CHARACTERISTIC DINH_FId.DFC_InjVlv_DI_NoLd_0_CA "inhibitable FIds / FIds to be inhibited by inhibit source DFC_InjVlv_DI_NoLd_0" VAL_BLK 0x804E4088 ValA_Wu16 968.000000000 DINH_FIdVerb 0.00 968.000000000 FORMAT "%13.9" NUMBER 60 /end CHARACTERISTIC
/begin CHARACTERISTIC DINH_FId.DFC_InjVlv_DI_NoLd_1_CA "inhibitable FIds / FIds to be inhibited by inhibit source DFC_InjVlv_DI_NoLd_1" VAL_BLK 0x804E4100 ValA_Wu16 968.000000000 DINH_FIdVerb 0.00 968.000000000 FORMAT "%13.9" NUMBER 60 /end CHARACTERISTIC
/begin CHARACTERISTIC DINH_FId.DFC_InjVlv_DI_NoLd_2_CA "inhibitable FIds / FIds to be inhibited by inhibit source DFC_InjVlv_DI_NoLd_2" VAL_BLK 0x804E4178 ValA_Wu16 968.000000000 DINH_FIdVerb 0.00 968.000000000 FORMAT "%13.9" NUMBER 60 /end CHARACTERISTIC
/begin CHARACTERISTIC DINH_FId.DFC_InjVlv_DI_NoLd_3_CA "inhibitable FIds / FIds to be inhibited by inhibit source DFC_InjVlv_DI_NoLd_3" VAL_BLK 0x804E41F0 ValA_Wu16 968.000000000 DINH_FIdVerb 0.00 968.000000000 FORMAT "%13.9" NUMBER 60 /end CHARACTERISTIC
/begin CHARACTERISTIC DINH_FId.DFC_InjVlv_DI_ScBnk_0_CA "inhibitable FIds / FIds to be inhibited by inhibit source DFC_InjVlv_DI_ScBnk_0" VAL_BLK 0x804E4268 ValA_Wu16 968.000000000 DINH_FIdVerb 0.00 968.000000000 FORMAT "%13.9" NUMBER 60 /end CHARACTERISTIC
/begin CHARACTERISTIC DINH_FId.DFC_InjVlv_DI_ScBnk_1_CA "inhibitable FIds / FIds to be inhibited by inhibit source DFC_InjVlv_DI_ScBnk_1" VAL_BLK 0x804E42E0 ValA_Wu16 968.000000000 DINH_FIdVerb 0.00 968.000000000 FORMAT "%13.9" NUMBER 60 /end CHARACTERISTIC
/begin CHARACTERISTIC DINH_FId.DFC_InjVlv_DI_ScBnk_2_CA "inhibitable FIds / FIds to be inhibited by inhibit source DFC_InjVlv_DI_ScBnk_2" VAL_BLK 0x804E4358 ValA_Wu16 968.000000000 DINH_FIdVerb 0.00 968.000000000 FORMAT "%13.9" NUMBER 60 /end CHARACTERISTIC
/begin CHARACTERISTIC DINH_FId.DFC_InjVlv_DI_ScBnk_3_CA "inhibitable FIds / FIds to be inhibited by inhibit source DFC_InjVlv_DI_ScBnk_3" VAL_BLK 0x804E43D0 ValA_Wu16 968.000000000 DINH_FIdVerb 0.00 968.000000000 FORMAT "%13.9" NUMBER 60 /end CHARACTERISTIC
/begin CHARACTERISTIC DINH_FId.DFC_InjVlv_DI_ScCyl_0_CA "inhibitable FIds / FIds to be inhibited by inhibit source DFC_InjVlv_DI_ScCyl_0" VAL_BLK 0x804E4448 ValA_Wu16 968.000000000 DINH_FIdVerb 0.00 968.000000000 FORMAT "%13.9" NUMBER 60 /end CHARACTERISTIC
/begin CHARACTERISTIC DINH_FId.DFC_InjVlv_DI_ScCyl_1_CA "inhibitable FIds / FIds to be inhibited by inhibit source DFC_InjVlv_DI_ScCyl_1" VAL_BLK 0x804E44C0 ValA_Wu16 968.000000000 DINH_FIdVerb 0.00 968.000000000 FORMAT "%13.9" NUMBER 60 /end CHARACTERISTIC
/begin CHARACTERISTIC DINH_FId.DFC_InjVlv_DI_ScCyl_2_CA "inhibitable FIds / FIds to be inhibited by inhibit source DFC_InjVlv_DI_ScCyl_2" VAL_BLK 0x804E4538 ValA_Wu16 968.000000000 DINH_FIdVerb 0.00 968.000000000 FORMAT "%13.9" NUMBER 60 /end CHARACTERISTIC
/begin CHARACTERISTIC DINH_FId.DFC_InjVlv_DI_ScCyl_3_CA "inhibitable FIds / FIds to be inhibited by inhibit source DFC_InjVlv_DI_ScCyl_3" VAL_BLK 0x804E45B0 ValA_Wu16 968.000000000 DINH_FIdVerb 0.00 968.000000000 FORMAT "%13.9" NUMBER 60 /end CHARACTERISTIC
/begin CHARACTERISTIC DINH_FId.DFC_InjVlv_DI_ScHsLs_0_CA "inhibitable FIds / FIds to be inhibited by inhibit source DFC_InjVlv_DI_ScHsLs_0" VAL_BLK 0x804E4628 ValA_Wu16 968.000000000 DINH_FIdVerb 0.00 968.000000000 FORMAT "%13.9" NUMBER 60 /end CHARACTERISTIC
/begin CHARACTERISTIC DINH_FId.DFC_InjVlv_DI_ScHsLs_1_CA "inhibitable FIds / FIds to be inhibited by inhibit source DFC_InjVlv_DI_ScHsLs_1" VAL_BLK 0x804E46A0 ValA_Wu16 968.000000000 DINH_FIdVerb 0.00 968.000000000 FORMAT "%13.9" NUMBER 60 /end CHARACTERISTIC
/begin CHARACTERISTIC DINH_FId.DFC_InjVlv_DI_ScHsLs_2_CA "inhibitable FIds / FIds to be inhibited by inhibit source DFC_InjVlv_DI_ScHsLs_2" VAL_BLK 0x804E4718 ValA_Wu16 968.000000000 DINH_FIdVerb 0.00 968.000000000 FORMAT "%13.9" NUMBER 60 /end CHARACTERISTIC
/begin CHARACTERISTIC DINH_FId.DFC_InjVlv_DI_ScHsLs_3_CA "inhibitable FIds / FIds to be inhibited by inhibit source DFC_InjVlv_DI_ScHsLs_3" VAL_BLK 0x804E4790 ValA_Wu16 968.000000000 DINH_FIdVerb 0.00 968.000000000 FORMAT "%13.9" NUMBER 60 /end CHARACTERISTIC
/begin CHARACTERISTIC DINH_FId.DFC_MfPsDiaOpenLoad1_CA "inhibitable FIds / FIds to be inhibited by inhibit source DFC_MfPsDiaOpenLoad1" VAL_BLK 0x804E4808 ValA_Wu16 968.000000000 DINH_FIdVerb 0.00 968.000000000 FORMAT "%13.9" NUMBER 65 /end CHARACTERISTIC
/begin CHARACTERISTIC DINH_FId.DFC_MfPsDiaScHiS1_CA "inhibitable FIds / FIds to be inhibited by inhibit source DFC_MfPsDiaScHiS1" VAL_BLK 0x804E488A ValA_Wu16 968.000000000 DINH_FIdVerb 0.00 968.000000000 FORMAT "%13.9" NUMBER 65 /end CHARACTERISTIC
/begin CHARACTERISTIC DINH_FId.DFC_MfPsDiaScHiSLowS1_CA "inhibitable FIds / FIds to be inhibited by inhibit source DFC_MfPsDiaScHiSLowS1" VAL_BLK 0x804E490C ValA_Wu16 968.000000000 DINH_FIdVerb 0.00 968.000000000 FORMAT "%13.9" NUMBER 65 /end CHARACTERISTIC
/begin CHARACTERISTIC DINH_FId.DFC_MfPsDiaScLowS1_CA "inhibitable FIds / FIds to be inhibited by inhibit source DFC_MfPsDiaScLowS1" VAL_BLK 0x804E498E ValA_Wu16 968.000000000 DINH_FIdVerb 0.00 968.000000000 FORMAT "%13.9" NUMBER 65 /end CHARACTERISTIC
/begin CHARACTERISTIC DINH_FId.DFC_ACEvpTPhysRngHi_CA "inhibitable FIds / FIds to be inhibited by inhibit source DFC_ACEvpTPhysRngHi" VAL_BLK 0x804E4A10 ValA_Wu16 968.000000000 DINH_FIdVerb 0.00 968.000000000 FORMAT "%13.9" NUMBER 52 /end CHARACTERISTIC
/begin CHARACTERISTIC DINH_FId.DFC_ACEvpTPhysRngLo_CA "inhibitable FIds / FIds to be inhibited by inhibit source DFC_ACEvpTPhysRngLo" VAL_BLK 0x804E4A78 ValA_Wu16 968.000000000 DINH_FIdVerb 0.00 968.000000000 FORMAT "%13.9" NUMBER 52 /end CHARACTERISTIC
/begin CHARACTERISTIC DINH_FId.DFC_ACEvpTSRCMax_CA "inhibitable FIds / FIds to be inhibited by inhibit source DFC_ACEvpTSRCMax" VAL_BLK 0x804E4AE0 ValA_Wu16 968.000000000 DINH_FIdVerb 0.00 968.000000000 FORMAT "%13.9" NUMBER 53 /end CHARACTERISTIC
/begin CHARACTERISTIC DINH_FId.DFC_ACEvpTSRCMin_CA "inhibitable FIds / FIds to be inhibited by inhibit source DFC_ACEvpTSRCMin" VAL_BLK 0x804E4B4A ValA_Wu16 968.000000000 DINH_FIdVerb 0.00 968.000000000 FORMAT "%13.9" NUMBER 53 /end CHARACTERISTIC
/begin CHARACTERISTIC DINH_FId.DFC_AfsRawSigRngHiB1_CA "inhibitable FIds / FIds to be inhibited by inhibit source DFC_AfsRawSigRngHiB1" VAL_BLK 0x804E4BB4 ValA_Wu16 968.000000000 DINH_FIdVerb 0.00 968.000000000 FORMAT "%13.9" NUMBER 57 /end CHARACTERISTIC
/begin CHARACTERISTIC DINH_FId.DFC_AfsRawSigRngLoB1_CA "inhibitable FIds / FIds to be inhibited by inhibit source DFC_AfsRawSigRngLoB1" VAL_BLK 0x804E4C26 ValA_Wu16 968.000000000 DINH_FIdVerb 0.00 968.000000000 FORMAT "%13.9" NUMBER 57 /end CHARACTERISTIC
/begin CHARACTERISTIC DINH_FId.DFC_AfsSnsrErrB1_CA "inhibitable FIds / FIds to be inhibited by inhibit source DFC_AfsSnsrErrB1" VAL_BLK 0x804E4C98 ValA_Wu16 968.000000000 DINH_FIdVerb 0.00 968.000000000 FORMAT "%13.9" NUMBER 57 /end CHARACTERISTIC
/begin CHARACTERISTIC DINH_FId.DFC_AirCClntPAnaSRCMax_CA "inhibitable FIds / FIds to be inhibited by inhibit source DFC_AirCClntPAnaSRCMax" VAL_BLK 0x804E4D0A ValA_Wu16 968.000000000 DINH_FIdVerb 0.00 968.000000000 FORMAT "%13.9" NUMBER 56 /end CHARACTERISTIC
/begin CHARACTERISTIC DINH_FId.DFC_AirCClntPAnaSRCMin_CA "inhibitable FIds / FIds to be inhibited by inhibit source DFC_AirCClntPAnaSRCMin" VAL_BLK 0x804E4D7A ValA_Wu16 968.000000000 DINH_FIdVerb 0.00 968.000000000 FORMAT "%13.9" NUMBER 56 /end CHARACTERISTIC
/begin CHARACTERISTIC DINH_FId.DFC_AirCSwtNpl_CA "inhibitable FIds / FIds to be inhibited by inhibit source DFC_AirCSwtNpl" VAL_BLK 0x804E4DEA ValA_Wu16 968.000000000 DINH_FIdVerb 0.00 968.000000000 FORMAT "%13.9" NUMBER 51 /end CHARACTERISTIC
/begin CHARACTERISTIC DINH_FId.DFC_AirCSwtSig_CA "inhibitable FIds / FIds to be inhibited by inhibit source DFC_AirCSwtSig" VAL_BLK 0x804E4E50 ValA_Wu16 968.000000000 DINH_FIdVerb 0.00 968.000000000 FORMAT "%13.9" NUMBER 51 /end CHARACTERISTIC
/begin CHARACTERISTIC DINH_FId.DFC_Brk_CA "inhibitable FIds / FIds to be inhibited by inhibit source DFC_Brk" VAL_BLK 0x804E4EB6 ValA_Wu16 968.000000000 DINH_FIdVerb 0.00 968.000000000 FORMAT "%13.9" NUMBER 50 /end CHARACTERISTIC
/begin CHARACTERISTIC DINH_FId.DFC_BrkBstSensSCB_CA "inhibitable FIds / FIds to be inhibited by inhibit source DFC_BrkBstSensSCB" VAL_BLK 0x804E4F1A ValA_Wu16 968.000000000 DINH_FIdVerb 0.00 968.000000000 FORMAT "%13.9" NUMBER 53 /end CHARACTERISTIC
/begin CHARACTERISTIC DINH_FId.DFC_BrkBstSensSCG_CA "inhibitable FIds / FIds to be inhibited by inhibit source DFC_BrkBstSensSCG" VAL_BLK 0x804E4F84 ValA_Wu16 968.000000000 DINH_FIdVerb 0.00 968.000000000 FORMAT "%13.9" NUMBER 53 /end CHARACTERISTIC
/begin CHARACTERISTIC DINH_FId.DFC_BrkSig_CA "inhibitable FIds / FIds to be inhibited by inhibit source DFC_BrkSig" VAL_BLK 0x804E4FEE ValA_Wu16 968.000000000 DINH_FIdVerb 0.00 968.000000000 FORMAT "%13.9" NUMBER 54 /end CHARACTERISTIC
/begin CHARACTERISTIC DINH_FId.DFC_ClthSig_CA "inhibitable FIds / FIds to be inhibited by inhibit source DFC_ClthSig" VAL_BLK 0x804E505A ValA_Wu16 968.000000000 DINH_FIdVerb 0.00 968.000000000 FORMAT "%13.9" NUMBER 63 /end CHARACTERISTIC
/begin CHARACTERISTIC DINH_FId.DFC_EGRVlvCurrLim_CA "inhibitable FIds / FIds to be inhibited by inhibit source DFC_EGRVlvCurrLim" VAL_BLK 0x804E50D8 ValA_Wu16 968.000000000 DINH_FIdVerb 0.00 968.000000000 FORMAT "%13.9" NUMBER 54 /end CHARACTERISTIC
/begin CHARACTERISTIC DINH_FId.DFC_EGRVlvOL_CA "inhibitable FIds / FIds to be inhibited by inhibit source DFC_EGRVlvOL" VAL_BLK 0x804E5144 ValA_Wu16 968.000000000 DINH_FIdVerb 0.00 968.000000000 FORMAT "%13.9" NUMBER 68 /end CHARACTERISTIC
/begin CHARACTERISTIC DINH_FId.DFC_EGRVlvOvrTemp_CA "inhibitable FIds / FIds to be inhibited by inhibit source DFC_EGRVlvOvrTemp" VAL_BLK 0x804E51CC ValA_Wu16 968.000000000 DINH_FIdVerb 0.00 968.000000000 FORMAT "%13.9" NUMBER 50 /end CHARACTERISTIC
/begin CHARACTERISTIC DINH_FId.DFC_EGRVlvSCB_CA "inhibitable FIds / FIds to be inhibited by inhibit source DFC_EGRVlvSCB" VAL_BLK 0x804E5230 ValA_Wu16 968.000000000 DINH_FIdVerb 0.00 968.000000000 FORMAT "%13.9" NUMBER 69 /end CHARACTERISTIC
/begin CHARACTERISTIC DINH_FId.DFC_EGRVlvSCG_CA "inhibitable FIds / FIds to be inhibited by inhibit source DFC_EGRVlvSCG" VAL_BLK 0x804E52BA ValA_Wu16 968.000000000 DINH_FIdVerb 0.00 968.000000000 FORMAT "%13.9" NUMBER 68 /end CHARACTERISTIC
/begin CHARACTERISTIC DINH_FId.DFC_EGRVlvSRCMax_CA "inhibitable FIds / FIds to be inhibited by inhibit source DFC_EGRVlvSRCMax" VAL_BLK 0x804E5342 ValA_Wu16 968.000000000 DINH_FIdVerb 0.00 968.000000000 FORMAT "%13.9" NUMBER 61 /end CHARACTERISTIC
/begin CHARACTERISTIC DINH_FId.DFC_EGRVlvSRCMin_CA "inhibitable FIds / FIds to be inhibited by inhibit source DFC_EGRVlvSRCMin" VAL_BLK 0x804E53BC ValA_Wu16 968.000000000 DINH_FIdVerb 0.00 968.000000000 FORMAT "%13.9" NUMBER 60 /end CHARACTERISTIC
/begin CHARACTERISTIC DINH_FId.DFC_HLSDemOvhtEngLim_CA "inhibitable FIds / FIds to be inhibited by inhibit source DFC_HLSDemOvhtEngLim" VAL_BLK 0x804E5434 ValA_Wu16 968.000000000 DINH_FIdVerb 0.00 968.000000000 FORMAT "%13.9" NUMBER 50 /end CHARACTERISTIC
/begin CHARACTERISTIC DINH_FId.DFC_OilPSwmpSRCMax_CA "inhibitable FIds / FIds to be inhibited by inhibit source DFC_OilPSwmpSRCMax" VAL_BLK 0x804E5498 ValA_Wu16 968.000000000 DINH_FIdVerb 0.00 968.000000000 FORMAT "%13.9" NUMBER 59 /end CHARACTERISTIC
/begin CHARACTERISTIC DINH_FId.DFC_OilPSwmpSRCMin_CA "inhibitable FIds / FIds to be inhibited by inhibit source DFC_OilPSwmpSRCMin" VAL_BLK 0x804E550E ValA_Wu16 968.000000000 DINH_FIdVerb 0.00 968.000000000 FORMAT "%13.9" NUMBER 60 /end CHARACTERISTIC
/begin CHARACTERISTIC DINH_FId.DFC_PIntkVUsLineHiB1_CA "inhibitable FIds / FIds to be inhibited by inhibit source DFC_PIntkVUsLineHiB1" VAL_BLK 0x804E5586 ValA_Wu16 968.000000000 DINH_FIdVerb 0.00 968.000000000 FORMAT "%13.9" NUMBER 97 /end CHARACTERISTIC
/begin CHARACTERISTIC DINH_FId.DFC_PIntkVUsLineLoB1_CA "inhibitable FIds / FIds to be inhibited by inhibit source DFC_PIntkVUsLineLoB1" VAL_BLK 0x804E5648 ValA_Wu16 968.000000000 DINH_FIdVerb 0.00 968.000000000 FORMAT "%13.9" NUMBER 97 /end CHARACTERISTIC
/begin CHARACTERISTIC DINH_FId.DFC_VehVPhysRngLo_CA "inhibitable FIds / FIds to be inhibited by inhibit source DFC_VehVPhysRngLo" VAL_BLK 0x804E570A ValA_Wu16 968.000000000 DINH_FIdVerb 0.00 968.000000000 FORMAT "%13.9" NUMBER 82 /end CHARACTERISTIC
/begin CHARACTERISTIC DINH_FId.DFC_VehVSigCan_CA "inhibitable FIds / FIds to be inhibited by inhibit source DFC_VehVSigCan" VAL_BLK 0x804E57AE ValA_Wu16 968.000000000 DINH_FIdVerb 0.00 968.000000000 FORMAT "%13.9" NUMBER 54 /end CHARACTERISTIC
/begin CHARACTERISTIC DINH_FId.DFC_VehVSigCanSafe_CA "inhibitable FIds / FIds to be inhibited by inhibit source DFC_VehVSigCanSafe" VAL_BLK 0x804E581A ValA_Wu16 968.000000000 DINH_FIdVerb 0.00 968.000000000 FORMAT "%13.9" NUMBER 57 /end CHARACTERISTIC
/begin CHARACTERISTIC DINH_FId.DFC_VlvLftFbOilPSnsrIntk11SRCMax_CA "inhibitable FIds / FIds to be inhibited by inhibit source DFC_VlvLftFbOilPSnsrIntk11SRCMax" VAL_BLK 0x804E588C ValA_Wu16 968.000000000 DINH_FIdVerb 0.00 968.000000000 FORMAT "%13.9" NUMBER 79 /end CHARACTERISTIC
/begin CHARACTERISTIC DINH_FId.DFC_VlvLftFbOilPSnsrIntk11SRCMin_CA "inhibitable FIds / FIds to be inhibited by inhibit source DFC_VlvLftFbOilPSnsrIntk11SRCMin" VAL_BLK 0x804E592A ValA_Wu16 968.000000000 DINH_FIdVerb 0.00 968.000000000 FORMAT "%13.9" NUMBER 79 /end CHARACTERISTIC
/begin CHARACTERISTIC DINH_FId.DFC_ClthNpl_CA "inhibitable FIds / FIds to be inhibited by inhibit source DFC_ClthNpl" VAL_BLK 0x804E59C8 ValA_Wu16 968.000000000 DINH_FIdVerb 0.00 968.000000000 FORMAT "%13.9" NUMBER 64 /end CHARACTERISTIC
/begin CHARACTERISTIC DINH_FId.DFC_GbxPNPosnDrvCdn_CA "inhibitable FIds / FIds to be inhibited by inhibit source DFC_GbxPNPosnDrvCdn" VAL_BLK 0x804E5A48 ValA_Wu16 968.000000000 DINH_FIdVerb 0.00 968.000000000 FORMAT "%13.9" NUMBER 61 /end CHARACTERISTIC
/begin CHARACTERISTIC DINH_FId.DFC_GbxPNPosnPlausy_CA "inhibitable FIds / FIds to be inhibited by inhibit source DFC_GbxPNPosnPlausy" VAL_BLK 0x804E5AC2 ValA_Wu16 968.000000000 DINH_FIdVerb 0.00 968.000000000 FORMAT "%13.9" NUMBER 55 /end CHARACTERISTIC
/begin CHARACTERISTIC DINH_FId.DFC_AfsSigErrLineHiB1_CA "inhibitable FIds / FIds to be inhibited by inhibit source DFC_AfsSigErrLineHiB1" VAL_BLK 0x804E5B30 ValA_Wu16 968.000000000 DINH_FIdVerb 0.00 968.000000000 FORMAT "%13.9" NUMBER 58 /end CHARACTERISTIC
/begin CHARACTERISTIC DINH_FId.DFC_AfsSigErrLineLoB1_CA "inhibitable FIds / FIds to be inhibited by inhibit source DFC_AfsSigErrLineLoB1" VAL_BLK 0x804E5BA4 ValA_Wu16 968.000000000 DINH_FIdVerb 0.00 968.000000000 FORMAT "%13.9" NUMBER 58 /end CHARACTERISTIC
/begin CHARACTERISTIC DINH_FId.DFC_PEnvCcMax_CA "inhibitable FIds / FIds to be inhibited by inhibit source DFC_PEnvCcMax" VAL_BLK 0x804E5C18 ValA_Wu16 968.000000000 DINH_FIdVerb 0.00 968.000000000 FORMAT "%13.9" NUMBER 85 /end CHARACTERISTIC
/begin CHARACTERISTIC DINH_FId.DFC_PEnvCcMin_CA "inhibitable FIds / FIds to be inhibited by inhibit source DFC_PEnvCcMin" VAL_BLK 0x804E5CC2 ValA_Wu16 968.000000000 DINH_FIdVerb 0.00 968.000000000 FORMAT "%13.9" NUMBER 85 /end CHARACTERISTIC
/begin CHARACTERISTIC DINH_FId.DFC_PEnvRngChkMax_CA "inhibitable FIds / FIds to be inhibited by inhibit source DFC_PEnvRngChkMax" VAL_BLK 0x804E5D6C ValA_Wu16 968.000000000 DINH_FIdVerb 0.00 968.000000000 FORMAT "%13.9" NUMBER 86 /end CHARACTERISTIC
/begin CHARACTERISTIC DINH_FId.DFC_PEnvRngChkMin_CA "inhibitable FIds / FIds to be inhibited by inhibit source DFC_PEnvRngChkMin" VAL_BLK 0x804E5E18 ValA_Wu16 968.000000000 DINH_FIdVerb 0.00 968.000000000 FORMAT "%13.9" NUMBER 86 /end CHARACTERISTIC
/begin CHARACTERISTIC DINH_FId.DFC_PEnvSnsrPlaus_CA "inhibitable FIds / FIds to be inhibited by inhibit source DFC_PEnvSnsrPlaus" VAL_BLK 0x804E5EC4 ValA_Wu16 968.000000000 DINH_FIdVerb 0.00 968.000000000 FORMAT "%13.9" NUMBER 82 /end CHARACTERISTIC
/begin CHARACTERISTIC DINH_FId.DFC_UEGOHeatrRlyPsOLS1B1_CA "inhibitable FIds / FIds to be inhibited by inhibit source DFC_UEGOHeatrRlyPsOLS1B1" VAL_BLK 0x804E5F68 ValA_Wu16 968.000000000 DINH_FIdVerb 0.00 968.000000000 FORMAT "%13.9" NUMBER 84 /end CHARACTERISTIC
/begin CHARACTERISTIC DINH_FId.DFC_UEGOHeatrRlyPsSCBS1B1_CA "inhibitable FIds / FIds to be inhibited by inhibit source DFC_UEGOHeatrRlyPsSCBS1B1" VAL_BLK 0x804E6010 ValA_Wu16 968.000000000 DINH_FIdVerb 0.00 968.000000000 FORMAT "%13.9" NUMBER 84 /end CHARACTERISTIC
/begin CHARACTERISTIC DINH_FId.DFC_UEGOHeatrRlyPsSCGS1B1_CA "inhibitable FIds / FIds to be inhibited by inhibit source DFC_UEGOHeatrRlyPsSCGS1B1" VAL_BLK 0x804E60B8 ValA_Wu16 968.000000000 DINH_FIdVerb 0.00 968.000000000 FORMAT "%13.9" NUMBER 82 /end CHARACTERISTIC
/begin CHARACTERISTIC DINH_FId.DFC_UegoHeatrWireOlS1B1_CA "inhibitable FIds / FIds to be inhibited by inhibit source DFC_UegoHeatrWireOlS1B1" VAL_BLK 0x804E615C ValA_Wu16 968.000000000 DINH_FIdVerb 0.00 968.000000000 FORMAT "%13.9" NUMBER 84 /end CHARACTERISTIC
/begin CHARACTERISTIC DINH_FId.DFC_UegoHeatrWireScbS1B1_CA "inhibitable FIds / FIds to be inhibited by inhibit source DFC_UegoHeatrWireScbS1B1" VAL_BLK 0x804E6204 ValA_Wu16 968.000000000 DINH_FIdVerb 0.00 968.000000000 FORMAT "%13.9" NUMBER 84 /end CHARACTERISTIC
/begin CHARACTERISTIC DINH_FId.DFC_UegoHeatrWireScgS1B1_CA "inhibitable FIds / FIds to be inhibited by inhibit source DFC_UegoHeatrWireScgS1B1" VAL_BLK 0x804E62AC ValA_Wu16 968.000000000 DINH_FIdVerb 0.00 968.000000000 FORMAT "%13.9" NUMBER 85 /end CHARACTERISTIC
/begin CHARACTERISTIC DINH_FId.DFC_KnDetSens1PortAMax_CA "inhibitable FIds / FIds to be inhibited by inhibit source DFC_KnDetSens1PortAMax" VAL_BLK 0x804E6356 ValA_Wu16 968.000000000 DINH_FIdVerb 0.00 968.000000000 FORMAT "%13.9" NUMBER 58 /end CHARACTERISTIC
/begin CHARACTERISTIC DINH_FId.DFC_KnDetSens1PortAMin_CA "inhibitable FIds / FIds to be inhibited by inhibit source DFC_KnDetSens1PortAMin" VAL_BLK 0x804E63CA ValA_Wu16 968.000000000 DINH_FIdVerb 0.00 968.000000000 FORMAT "%13.9" NUMBER 58 /end CHARACTERISTIC
/begin CHARACTERISTIC DINH_FId.DFC_KnDetSens1PortBMax_CA "inhibitable FIds / FIds to be inhibited by inhibit source DFC_KnDetSens1PortBMax" VAL_BLK 0x804E643E ValA_Wu16 968.000000000 DINH_FIdVerb 0.00 968.000000000 FORMAT "%13.9" NUMBER 58 /end CHARACTERISTIC
/begin CHARACTERISTIC DINH_FId.DFC_KnDetSens1PortBMin_CA "inhibitable FIds / FIds to be inhibited by inhibit source DFC_KnDetSens1PortBMin" VAL_BLK 0x804E64B2 ValA_Wu16 968.000000000 DINH_FIdVerb 0.00 968.000000000 FORMAT "%13.9" NUMBER 58 /end CHARACTERISTIC
/begin CHARACTERISTIC DINH_FId.DFC_Clth2ONStuck_CA "inhibitable FIds / FIds to be inhibited by inhibit source DFC_Clth2ONStuck" VAL_BLK 0x804E6526 ValA_Wu16 968.000000000 DINH_FIdVerb 0.00 968.000000000 FORMAT "%13.9" NUMBER 52 /end CHARACTERISTIC
/begin CHARACTERISTIC DINH_FId.DFC_Clth2ONStuckLdc_CA "inhibitable FIds / FIds to be inhibited by inhibit source DFC_Clth2ONStuckLdc" VAL_BLK 0x804E658E ValA_Wu16 968.000000000 DINH_FIdVerb 0.00 968.000000000 FORMAT "%13.9" NUMBER 52 /end CHARACTERISTIC
/begin CHARACTERISTIC DINH_FId.DFC_Clth3ONStuckLdc_CA "inhibitable FIds / FIds to be inhibited by inhibit source DFC_Clth3ONStuckLdc" VAL_BLK 0x804E65F6 ValA_Wu16 968.000000000 DINH_FIdVerb 0.00 968.000000000 FORMAT "%13.9" NUMBER 55 /end CHARACTERISTIC
/begin CHARACTERISTIC DINH_FId.DFC_Clth3ONStuckPostDrv_CA "inhibitable FIds / FIds to be inhibited by inhibit source DFC_Clth3ONStuckPostDrv" VAL_BLK 0x804E6664 ValA_Wu16 968.000000000 DINH_FIdVerb 0.00 968.000000000 FORMAT "%13.9" NUMBER 54 /end CHARACTERISTIC
/begin CHARACTERISTIC DINH_FId.DFC_Clth4ONStuck_CA "inhibitable FIds / FIds to be inhibited by inhibit source DFC_Clth4ONStuck" VAL_BLK 0x804E66D0 ValA_Wu16 968.000000000 DINH_FIdVerb 0.00 968.000000000 FORMAT "%13.9" NUMBER 51 /end CHARACTERISTIC
/begin CHARACTERISTIC DINH_FId.DFC_Clth4ONStuckLdc_CA "inhibitable FIds / FIds to be inhibited by inhibit source DFC_Clth4ONStuckLdc" VAL_BLK 0x804E6736 ValA_Wu16 968.000000000 DINH_FIdVerb 0.00 968.000000000 FORMAT "%13.9" NUMBER 59 /end CHARACTERISTIC
/begin CHARACTERISTIC DINH_FId.DFC_ComBCMUnit_CA "inhibitable FIds / FIds to be inhibited by inhibit source DFC_ComBCMUnit" VAL_BLK 0x804E67AC ValA_Wu16 968.000000000 DINH_FIdVerb 0.00 968.000000000 FORMAT "%13.9" NUMBER 50 /end CHARACTERISTIC
/begin CHARACTERISTIC DINH_FId.DFC_ComDLCTCU01_CA "inhibitable FIds / FIds to be inhibited by inhibit source DFC_ComDLCTCU01" VAL_BLK 0x804E6810 ValA_Wu16 968.000000000 DINH_FIdVerb 0.00 968.000000000 FORMAT "%13.9" NUMBER 51 /end CHARACTERISTIC
/begin CHARACTERISTIC DINH_FId.DFC_ComDLCTCU02_CA "inhibitable FIds / FIds to be inhibited by inhibit source DFC_ComDLCTCU02" VAL_BLK 0x804E6876 ValA_Wu16 968.000000000 DINH_FIdVerb 0.00 968.000000000 FORMAT "%13.9" NUMBER 51 /end CHARACTERISTIC
/begin CHARACTERISTIC DINH_FId.DFC_ComDLCTCU1_CA "inhibitable FIds / FIds to be inhibited by inhibit source DFC_ComDLCTCU1" VAL_BLK 0x804E68DC ValA_Wu16 968.000000000 DINH_FIdVerb 0.00 968.000000000 FORMAT "%13.9" NUMBER 55 /end CHARACTERISTIC
/begin CHARACTERISTIC DINH_FId.DFC_ComDLCTCU11_CA "inhibitable FIds / FIds to be inhibited by inhibit source DFC_ComDLCTCU11" VAL_BLK 0x804E694A ValA_Wu16 968.000000000 DINH_FIdVerb 0.00 968.000000000 FORMAT "%13.9" NUMBER 54 /end CHARACTERISTIC
/begin CHARACTERISTIC DINH_FId.DFC_ComDLCTCU12_CA "inhibitable FIds / FIds to be inhibited by inhibit source DFC_ComDLCTCU12" VAL_BLK 0x804E69B6 ValA_Wu16 968.000000000 DINH_FIdVerb 0.00 968.000000000 FORMAT "%13.9" NUMBER 52 /end CHARACTERISTIC
/begin CHARACTERISTIC DINH_FId.DFC_ComDLCTCU13_CA "inhibitable FIds / FIds to be inhibited by inhibit source DFC_ComDLCTCU13" VAL_BLK 0x804E6A1E ValA_Wu16 968.000000000 DINH_FIdVerb 0.00 968.000000000 FORMAT "%13.9" NUMBER 52 /end CHARACTERISTIC
/begin CHARACTERISTIC DINH_FId.DFC_ComDLCTCU14_CA "inhibitable FIds / FIds to be inhibited by inhibit source DFC_ComDLCTCU14" VAL_BLK 0x804E6A86 ValA_Wu16 968.000000000 DINH_FIdVerb 0.00 968.000000000 FORMAT "%13.9" NUMBER 51 /end CHARACTERISTIC
/begin CHARACTERISTIC DINH_FId.DFC_ComDLCTCU2_CA "inhibitable FIds / FIds to be inhibited by inhibit source DFC_ComDLCTCU2" VAL_BLK 0x804E6AEC ValA_Wu16 968.000000000 DINH_FIdVerb 0.00 968.000000000 FORMAT "%13.9" NUMBER 52 /end CHARACTERISTIC
/begin CHARACTERISTIC DINH_FId.DFC_ComDLCTCU3_CA "inhibitable FIds / FIds to be inhibited by inhibit source DFC_ComDLCTCU3" VAL_BLK 0x804E6B54 ValA_Wu16 968.000000000 DINH_FIdVerb 0.00 968.000000000 FORMAT "%13.9" NUMBER 52 /end CHARACTERISTIC
/begin CHARACTERISTIC DINH_FId.DFC_ComDLCTCU4_CA "inhibitable FIds / FIds to be inhibited by inhibit source DFC_ComDLCTCU4" VAL_BLK 0x804E6BBC ValA_Wu16 968.000000000 DINH_FIdVerb 0.00 968.000000000 FORMAT "%13.9" NUMBER 51 /end CHARACTERISTIC
/begin CHARACTERISTIC DINH_FId.DFC_ComEPSUnit_CA "inhibitable FIds / FIds to be inhibited by inhibit source DFC_ComEPSUnit" VAL_BLK 0x804E6C22 ValA_Wu16 968.000000000 DINH_FIdVerb 0.00 968.000000000 FORMAT "%13.9" NUMBER 50 /end CHARACTERISTIC
/begin CHARACTERISTIC DINH_FId.DFC_ComIDASBUnit_CA "inhibitable FIds / FIds to be inhibited by inhibit source DFC_ComIDASBUnit" VAL_BLK 0x804E6C86 ValA_Wu16 968.000000000 DINH_FIdVerb 0.00 968.000000000 FORMAT "%13.9" NUMBER 50 /end CHARACTERISTIC
/begin CHARACTERISTIC DINH_FId.DFC_ComIMGUnit_CA "inhibitable FIds / FIds to be inhibited by inhibit source DFC_ComIMGUnit" VAL_BLK 0x804E6CEA ValA_Wu16 968.000000000 DINH_FIdVerb 0.00 968.000000000 FORMAT "%13.9" NUMBER 50 /end CHARACTERISTIC
/begin CHARACTERISTIC DINH_FId.DFC_ComMETUnit_CA "inhibitable FIds / FIds to be inhibited by inhibit source DFC_ComMETUnit" VAL_BLK 0x804E6D4E ValA_Wu16 968.000000000 DINH_FIdVerb 0.00 968.000000000 FORMAT "%13.9" NUMBER 50 /end CHARACTERISTIC
/begin CHARACTERISTIC DINH_FId.DFC_ComSRSUnit_CA "inhibitable FIds / FIds to be inhibited by inhibit source DFC_ComSRSUnit" VAL_BLK 0x804E6DB2 ValA_Wu16 968.000000000 DINH_FIdVerb 0.00 968.000000000 FORMAT "%13.9" NUMBER 50 /end CHARACTERISTIC
/begin CHARACTERISTIC DINH_FId.DFC_ComVSAUnit_CA "inhibitable FIds / FIds to be inhibited by inhibit source DFC_ComVSAUnit" VAL_BLK 0x804E6E16 ValA_Wu16 968.000000000 DINH_FIdVerb 0.00 968.000000000 FORMAT "%13.9" NUMBER 50 /end CHARACTERISTIC
/begin CHARACTERISTIC DINH_FId.DFC_EbsSocFlt_CA "inhibitable FIds / FIds to be inhibited by inhibit source DFC_EbsSocFlt" VAL_BLK 0x804E6E7A ValA_Wu16 968.000000000 DINH_FIdVerb 0.00 968.000000000 FORMAT "%13.9" NUMBER 50 /end CHARACTERISTIC
/begin CHARACTERISTIC DINH_FId.DFC_I14229VINErr_CA "inhibitable FIds / FIds to be inhibited by inhibit source DFC_I14229VINErr" VAL_BLK 0x804E6EDE ValA_Wu16 968.000000000 DINH_FIdVerb 0.00 968.000000000 FORMAT "%13.9" NUMBER 50 /end CHARACTERISTIC
/begin CHARACTERISTIC DINH_FId.DFC_InjCatHeatgErr_CA "inhibitable FIds / FIds to be inhibited by inhibit source DFC_InjCatHeatgErr" VAL_BLK 0x804E6F42 ValA_Wu16 968.000000000 DINH_FIdVerb 0.00 968.000000000 FORMAT "%13.9" NUMBER 50 /end CHARACTERISTIC
/begin CHARACTERISTIC DINH_FId.DFC_InjSysMulInjDiagErr_CA "inhibitable FIds / FIds to be inhibited by inhibit source DFC_InjSysMulInjDiagErr" VAL_BLK 0x804E6FA6 ValA_Wu16 968.000000000 DINH_FIdVerb 0.00 968.000000000 FORMAT "%13.9" NUMBER 50 /end CHARACTERISTIC
/begin CHARACTERISTIC DINH_FId.DFC_LLRHmax_CA "inhibitable FIds / FIds to be inhibited by inhibit source DFC_LLRHmax" VAL_BLK 0x804E700A ValA_Wu16 968.000000000 DINH_FIdVerb 0.00 968.000000000 FORMAT "%13.9" NUMBER 58 /end CHARACTERISTIC
/begin CHARACTERISTIC DINH_FId.DFC_LLRHmin_CA "inhibitable FIds / FIds to be inhibited by inhibit source DFC_LLRHmin" VAL_BLK 0x804E707E ValA_Wu16 968.000000000 DINH_FIdVerb 0.00 968.000000000 FORMAT "%13.9" NUMBER 58 /end CHARACTERISTIC
/begin CHARACTERISTIC DINH_FId.DFC_LLRHnpl_CA "inhibitable FIds / FIds to be inhibited by inhibit source DFC_LLRHnpl" VAL_BLK 0x804E70F2 ValA_Wu16 968.000000000 DINH_FIdVerb 0.00 968.000000000 FORMAT "%13.9" NUMBER 58 /end CHARACTERISTIC
/begin CHARACTERISTIC DINH_FId.DFC_LLRKHmax_CA "inhibitable FIds / FIds to be inhibited by inhibit source DFC_LLRKHmax" VAL_BLK 0x804E7166 ValA_Wu16 968.000000000 DINH_FIdVerb 0.00 968.000000000 FORMAT "%13.9" NUMBER 50 /end CHARACTERISTIC
/begin CHARACTERISTIC DINH_FId.DFC_LLRKHmin_CA "inhibitable FIds / FIds to be inhibited by inhibit source DFC_LLRKHmin" VAL_BLK 0x804E71CA ValA_Wu16 968.000000000 DINH_FIdVerb 0.00 968.000000000 FORMAT "%13.9" NUMBER 50 /end CHARACTERISTIC
/begin CHARACTERISTIC DINH_FId.DFC_LLRKHnpl_CA "inhibitable FIds / FIds to be inhibited by inhibit source DFC_LLRKHnpl" VAL_BLK 0x804E722E ValA_Wu16 968.000000000 DINH_FIdVerb 0.00 968.000000000 FORMAT "%13.9" NUMBER 50 /end CHARACTERISTIC
/begin CHARACTERISTIC DINH_FId.DFC_LinACGUnit_CA "inhibitable FIds / FIds to be inhibited by inhibit source DFC_LinACGUnit" VAL_BLK 0x804E7292 ValA_Wu16 968.000000000 DINH_FIdVerb 0.00 968.000000000 FORMAT "%13.9" NUMBER 50 /end CHARACTERISTIC
/begin CHARACTERISTIC DINH_FId.DFC_LinAEVUnit_CA "inhibitable FIds / FIds to be inhibited by inhibit source DFC_LinAEVUnit" VAL_BLK 0x804E72F6 ValA_Wu16 968.000000000 DINH_FIdVerb 0.00 968.000000000 FORMAT "%13.9" NUMBER 50 /end CHARACTERISTIC
/begin CHARACTERISTIC DINH_FId.DFC_LinEBSUnit_CA "inhibitable FIds / FIds to be inhibited by inhibit source DFC_LinEBSUnit" VAL_BLK 0x804E735A ValA_Wu16 968.000000000 DINH_FIdVerb 0.00 968.000000000 FORMAT "%13.9" NUMBER 50 /end CHARACTERISTIC
/begin MEASUREMENT DINH_stFId.FId_UEGOHeatrPwrStgDiagRelsS1B1 "Inhibit Status of FIds / Status of function identifier FId_UEGOHeatrPwrStgDiagRelsS1B1" UWORD DFC_OneToOne 1 100 0.00 65535.00 FORMAT "%8.2" ECU_ADDRESS 0x60013C8C /end MEASUREMENT
/begin MEASUREMENT DINH_stFId.FId_UEGOModCtrlRelsS1B1 "Inhibit Status of FIds / Status of function identifier FId_UEGOModCtrlRelsS1B1" UWORD DFC_OneToOne 1 100 0.00 65535.00 FORMAT "%8.2" ECU_ADDRESS 0x60013C8E /end MEASUREMENT
/begin MEASUREMENT DINH_stFId.FId_UEGOStrtDiagInhRprtErrS1B1 "Inhibit Status of FIds / Status of function identifier FId_UEGOStrtDiagInhRprtErrS1B1" UWORD DFC_OneToOne 1 100 0.00 65535.00 FORMAT "%8.2" ECU_ADDRESS 0x60013C90 /end MEASUREMENT
/begin MEASUREMENT DINH_stFId.FId_UEGOStrtDiagRelsS1B1 "Inhibit Status of FIds / Status of function identifier FId_UEGOStrtDiagRelsS1B1" UWORD DFC_OneToOne 1 100 0.00 65535.00 FORMAT "%8.2" ECU_ADDRESS 0x60013C92 /end MEASUREMENT
/begin MEASUREMENT DINH_stFId.FId_UEGOTCeramicRelsS1B1 "Inhibit Status of FIds / Status of function identifier FId_UEGOTCeramicRelsS1B1" UWORD DFC_OneToOne 1 100 0.00 65535.00 FORMAT "%8.2" ECU_ADDRESS 0x60013C94 /end MEASUREMENT
/begin MEASUREMENT DINH_stFId.FId_UegoDiagRelsBattSplyOk "Inhibit Status of FIds / Status of function identifier FId_UegoDiagRelsBattSplyOk" UWORD DFC_OneToOne 1 100 0.00 65535.00 FORMAT "%8.2" ECU_ADDRESS 0x60013C96 /end MEASUREMENT
/begin MEASUREMENT DINH_stFId.FId_UegoDiagSigEcuAsicS1B1 "Inhibit Status of FIds / Status of function identifier FId_UegoDiagSigEcuAsicS1B1" UWORD DFC_OneToOne 1 100 0.00 65535.00 FORMAT "%8.2" ECU_ADDRESS 0x60013C98 /end MEASUREMENT
/begin MEASUREMENT DINH_stFId.FId_UegoDiagSigEcuComS1B1 "Inhibit Status of FIds / Status of function identifier FId_UegoDiagSigEcuComS1B1" UWORD DFC_OneToOne 1 100 0.00 65535.00 FORMAT "%8.2" ECU_ADDRESS 0x60013C9A /end MEASUREMENT
/begin MEASUREMENT DINH_stFId.FId_UegoDiagSigOperPlausS1B1 "Inhibit Status of FIds / Status of function identifier FId_UegoDiagSigOperPlausS1B1" UWORD DFC_OneToOne 1 100 0.00 65535.00 FORMAT "%8.2" ECU_ADDRESS 0x60013C9C /end MEASUREMENT
/begin MEASUREMENT DINH_stFId.FId_UegoDiagSigSnsrS1B1 "Inhibit Status of FIds / Status of function identifier FId_UegoDiagSigSnsrS1B1" UWORD DFC_OneToOne 1 100 0.00 65535.00 FORMAT "%8.2" ECU_ADDRESS 0x60013C9E /end MEASUREMENT
/begin MEASUREMENT DINH_stFId.FId_UegoDiagSigWireOlS1B1 "Inhibit Status of FIds / Status of function identifier FId_UegoDiagSigWireOlS1B1" UWORD DFC_OneToOne 1 100 0.00 65535.00 FORMAT "%8.2" ECU_ADDRESS 0x60013CA0 /end MEASUREMENT
/begin MEASUREMENT DINH_stFId.FId_UegoDiagSigWireScS1B1 "Inhibit Status of FIds / Status of function identifier FId_UegoDiagSigWireScS1B1" UWORD DFC_OneToOne 1 100 0.00 65535.00 FORMAT "%8.2" ECU_ADDRESS 0x60013CA2 /end MEASUREMENT
/begin MEASUREMENT DINH_stFId.FId_UegoDiagSigWireScTstdS1B1 "Inhibit Status of FIds / Status of function identifier FId_UegoDiagSigWireScTstdS1B1" UWORD DFC_OneToOne 1 100 0.00 65535.00 FORMAT "%8.2" ECU_ADDRESS 0x60013CA4 /end MEASUREMENT
/begin MEASUREMENT DINH_stFId.FId_UegoInhbOperRelsS1B1 "Inhibit Status of FIds / Status of function identifier FId_UegoInhbOperRelsS1B1" UWORD DFC_OneToOne 1 100 0.00 65535.00 FORMAT "%8.2" ECU_ADDRESS 0x60013CA6 /end MEASUREMENT
/begin MEASUREMENT DINH_stFId.FId_UegoO2HiPrcsnS1B1 "Inhibit Status of FIds / Status of function identifier FId_UegoO2HiPrcsnS1B1" UWORD DFC_OneToOne 1 100 0.00 65535.00 FORMAT "%8.2" ECU_ADDRESS 0x60013CA8 /end MEASUREMENT
/begin MEASUREMENT DINH_stFId.FId_UegoO2PlausErrS1B1 "Inhibit Status of FIds / Status of function identifier FId_UegoO2PlausErrS1B1" UWORD DFC_OneToOne 1 100 0.00 65535.00 FORMAT "%8.2" ECU_ADDRESS 0x60013CAA /end MEASUREMENT
/begin MEASUREMENT DINH_stFId.FId_UegoO2VldS1B1 "Inhibit Status of FIds / Status of function identifier FId_UegoO2VldS1B1" UWORD DFC_OneToOne 1 100 0.00 65535.00 FORMAT "%8.2" ECU_ADDRESS 0x60013CAC /end MEASUREMENT
/begin MEASUREMENT DINH_stFId.FId_UegoOperPlausBattSplyOk "Inhibit Status of FIds / Status of function identifier FId_UegoOperPlausBattSplyOk" UWORD DFC_OneToOne 1 100 0.00 65535.00 FORMAT "%8.2" ECU_ADDRESS 0x60013CAE /end MEASUREMENT
/begin MEASUREMENT DINH_stFId.FId_UegoPlausErrHndlg "Inhibit Status of FIds / Status of function identifier FId_UegoPlausErrHndlg" UWORD DFC_OneToOne 1 100 0.00 65535.00 FORMAT "%8.2" ECU_ADDRESS 0x60013CB0 /end MEASUREMENT
/begin MEASUREMENT DINH_stFId.FId_VMSIDCSRmpShOff "Inhibit Status of FIds / Status of function identifier FId_VMSIDCSRmpShOff" UWORD DFC_OneToOne 1 100 0.00 65535.00 FORMAT "%8.2" ECU_ADDRESS 0x60013CB2 /end MEASUREMENT
/begin MEASUREMENT DINH_stFId.FId_VMSIDCSShOff "Inhibit Status of FIds / Status of function identifier FId_VMSIDCSShOff" UWORD DFC_OneToOne 1 100 0.00 65535.00 FORMAT "%8.2" ECU_ADDRESS 0x60013CB4 /end MEASUREMENT
/begin MEASUREMENT DINH_stFId.FId_VMSITCSRmpShOff "Inhibit Status of FIds / Status of function identifier FId_VMSITCSRmpShOff" UWORD DFC_OneToOne 1 100 0.00 65535.00 FORMAT "%8.2" ECU_ADDRESS 0x60013CB6 /end MEASUREMENT
/begin MEASUREMENT DINH_stFId.FId_VMSITCSShOff "Inhibit Status of FIds / Status of function identifier FId_VMSITCSShOff" UWORD DFC_OneToOne 1 100 0.00 65535.00 FORMAT "%8.2" ECU_ADDRESS 0x60013CB8 /end MEASUREMENT
/begin MEASUREMENT DINH_stFId.FId_VSACANErr "Inhibit Status of FIds / Status of function identifier FId_VSACANErr" UWORD DFC_OneToOne 1 100 0.00 65535.00 FORMAT "%8.2" ECU_ADDRESS 0x60013CBA /end MEASUREMENT
/begin MEASUREMENT DINH_stFId.FId_VehStcACGFailr "Inhibit Status of FIds / Status of function identifier FId_VehStcACGFailr" UWORD DFC_OneToOne 1 100 0.00 65535.00 FORMAT "%8.2" ECU_ADDRESS 0x60013CBC /end MEASUREMENT
/begin MEASUREMENT DINH_stFId.FId_VehStcBattMngFailr "Inhibit Status of FIds / Status of function identifier FId_VehStcBattMngFailr" UWORD DFC_OneToOne 1 100 0.00 65535.00 FORMAT "%8.2" ECU_ADDRESS 0x60013CBE /end MEASUREMENT
/begin MEASUREMENT DINH_stFId.FId_VehStcDCDCFailr "Inhibit Status of FIds / Status of function identifier FId_VehStcDCDCFailr" UWORD DFC_OneToOne 1 100 0.00 65535.00 FORMAT "%8.2" ECU_ADDRESS 0x60013CC0 /end MEASUREMENT
/begin MEASUREMENT DINH_stFId.FId_VehStcEBSFailr "Inhibit Status of FIds / Status of function identifier FId_VehStcEBSFailr" UWORD DFC_OneToOne 1 100 0.00 65535.00 FORMAT "%8.2" ECU_ADDRESS 0x60013CC2 /end MEASUREMENT
/begin MEASUREMENT DINH_stFId.FId_VehStcMisf "Inhibit Status of FIds / Status of function identifier FId_VehStcMisf" UWORD DFC_OneToOne 1 100 0.00 65535.00 FORMAT "%8.2" ECU_ADDRESS 0x60013CC4 /end MEASUREMENT
/begin MEASUREMENT DINH_stFId.FId_VehStcMtrComFailr "Inhibit Status of FIds / Status of function identifier FId_VehStcMtrComFailr" UWORD DFC_OneToOne 1 100 0.00 65535.00 FORMAT "%8.2" ECU_ADDRESS 0x60013CC6 /end MEASUREMENT
/begin MEASUREMENT DINH_stFId.FId_VehStcNVMFailr "Inhibit Status of FIds / Status of function identifier FId_VehStcNVMFailr" UWORD DFC_OneToOne 1 100 0.00 65535.00 FORMAT "%8.2" ECU_ADDRESS 0x60013CC8 /end MEASUREMENT
/begin MEASUREMENT DINH_stFId.FId_VehVCANFrzVal "Inhibit Status of FIds / Status of function identifier FId_VehVCANFrzVal" UWORD DFC_OneToOne 1 100 0.00 65535.00 FORMAT "%8.2" ECU_ADDRESS 0x60013CCA /end MEASUREMENT
/begin MEASUREMENT DINH_stFId.FId_VehVCANReplVal "Inhibit Status of FIds / Status of function identifier FId_VehVCANReplVal" UWORD DFC_OneToOne 1 100 0.00 65535.00 FORMAT "%8.2" ECU_ADDRESS 0x60013CCC /end MEASUREMENT
/begin MEASUREMENT DINH_stFId.FId_VehVCanSafeFrzVal "Inhibit Status of FIds / Status of function identifier FId_VehVCanSafeFrzVal" UWORD DFC_OneToOne 1 100 0.00 65535.00 FORMAT "%8.2" ECU_ADDRESS 0x60013CCE /end MEASUREMENT
/begin MEASUREMENT DINH_stFId.FId_VehVCanSafeReplVal "Inhibit Status of FIds / Status of function identifier FId_VehVCanSafeReplVal" UWORD DFC_OneToOne 1 100 0.00 65535.00 FORMAT "%8.2" ECU_ADDRESS 0x60013CD0 /end MEASUREMENT
/begin MEASUREMENT DINH_stFId.FId_VehVCom "Inhibit Status of FIds / Status of function identifier FId_VehVCom" UWORD DFC_OneToOne 1 100 0.00 65535.00 FORMAT "%8.2" ECU_ADDRESS 0x60013CD2 /end MEASUREMENT
/begin MEASUREMENT DINH_stFId.FId_VehVExcdLim "Inhibit Status of FIds / Status of function identifier FId_VehVExcdLim" UWORD DFC_OneToOne 1 100 0.00 65535.00 FORMAT "%8.2" ECU_ADDRESS 0x60013CD4 /end MEASUREMENT
/begin MEASUREMENT DINH_stFId.FId_VehVFrzVal "Inhibit Status of FIds / Status of function identifier FId_VehVFrzVal" UWORD DFC_OneToOne 1 100 0.00 65535.00 FORMAT "%8.2" ECU_ADDRESS 0x60013CD6 /end MEASUREMENT
/begin MEASUREMENT DINH_stFId.FId_VehVNCSnsrElecFailr "Inhibit Status of FIds / Status of function identifier FId_VehVNCSnsrElecFailr" UWORD DFC_OneToOne 1 100 0.00 65535.00 FORMAT "%8.2" ECU_ADDRESS 0x60013CD8 /end MEASUREMENT
/begin MEASUREMENT DINH_stFId.FId_VehVOBDFrzVal "Inhibit Status of FIds / Status of function identifier FId_VehVOBDFrzVal" UWORD DFC_OneToOne 1 100 0.00 65535.00 FORMAT "%8.2" ECU_ADDRESS 0x60013CDA /end MEASUREMENT
/begin MEASUREMENT DINH_stFId.FId_VehVOBDReplVal "Inhibit Status of FIds / Status of function identifier FId_VehVOBDReplVal" UWORD DFC_OneToOne 1 100 0.00 65535.00 FORMAT "%8.2" ECU_ADDRESS 0x60013CDC /end MEASUREMENT
/begin MEASUREMENT DINH_stFId.FId_VehVOutCanErr "Inhibit Status of FIds / Status of function identifier FId_VehVOutCanErr" UWORD DFC_OneToOne 1 100 0.00 65535.00 FORMAT "%8.2" ECU_ADDRESS 0x60013CDE /end MEASUREMENT
/begin MEASUREMENT DINH_stFId.FId_VehVPWMFrzVal "Inhibit Status of FIds / Status of function identifier FId_VehVPWMFrzVal" UWORD DFC_OneToOne 1 100 0.00 65535.00 FORMAT "%8.2" ECU_ADDRESS 0x60013CE0 /end MEASUREMENT
/begin MEASUREMENT DINH_stFId.FId_VehVPWMReplVal "Inhibit Status of FIds / Status of function identifier FId_VehVPWMReplVal" UWORD DFC_OneToOne 1 100 0.00 65535.00 FORMAT "%8.2" ECU_ADDRESS 0x60013CE2 /end MEASUREMENT
/begin MEASUREMENT DINH_stFId.FId_VehVPhysRng "Inhibit Status of FIds / Status of function identifier FId_VehVPhysRng" UWORD DFC_OneToOne 1 100 0.00 65535.00 FORMAT "%8.2" ECU_ADDRESS 0x60013CE4 /end MEASUREMENT
/begin MEASUREMENT DINH_stFId.FId_VehVPlaus "Inhibit Status of FIds / Status of function identifier FId_VehVPlaus" UWORD DFC_OneToOne 1 100 0.00 65535.00 FORMAT "%8.2" ECU_ADDRESS 0x60013CE6 /end MEASUREMENT
/begin MEASUREMENT DINH_stFId.FId_VehVPlausCan "Inhibit Status of FIds / Status of function identifier FId_VehVPlausCan" UWORD DFC_OneToOne 1 100 0.00 65535.00 FORMAT "%8.2" ECU_ADDRESS 0x60013CE8 /end MEASUREMENT
/begin MEASUREMENT DINH_stFId.FId_VehVPlausFco "Inhibit Status of FIds / Status of function identifier FId_VehVPlausFco" UWORD DFC_OneToOne 1 100 0.00 65535.00 FORMAT "%8.2" ECU_ADDRESS 0x60013CEA /end MEASUREMENT
/begin MEASUREMENT DINH_stFId.FId_VehVPlausPwr "Inhibit Status of FIds / Status of function identifier FId_VehVPlausPwr" UWORD DFC_OneToOne 1 100 0.00 65535.00 FORMAT "%8.2" ECU_ADDRESS 0x60013CEC /end MEASUREMENT
/begin MEASUREMENT DINH_stFId.FId_VehVPlausV2N "Inhibit Status of FIds / Status of function identifier FId_VehVPlausV2N" UWORD DFC_OneToOne 1 100 0.00 65535.00 FORMAT "%8.2" ECU_ADDRESS 0x60013CEE /end MEASUREMENT
/begin MEASUREMENT DINH_stFId.FId_VehVReplVal "Inhibit Status of FIds / Status of function identifier FId_VehVReplVal" UWORD DFC_OneToOne 1 100 0.00 65535.00 FORMAT "%8.2" ECU_ADDRESS 0x60013CF0 /end MEASUREMENT
/begin MEASUREMENT DINH_stFId.FId_VehVSigCan "Inhibit Status of FIds / Status of function identifier FId_VehVSigCan" UWORD DFC_OneToOne 1 100 0.00 65535.00 FORMAT "%8.2" ECU_ADDRESS 0x60013CF2 /end MEASUREMENT
/begin MEASUREMENT DINH_stFId.FId_VehVSigCanSafe "Inhibit Status of FIds / Status of function identifier FId_VehVSigCanSafe" UWORD DFC_OneToOne 1 100 0.00 65535.00 FORMAT "%8.2" ECU_ADDRESS 0x60013CF4 /end MEASUREMENT
/begin MEASUREMENT DINH_stFId.FId_VehVSngWhlCanFrzVal "Inhibit Status of FIds / Status of function identifier FId_VehVSngWhlCanFrzVal" UWORD DFC_OneToOne 1 100 0.00 65535.00 FORMAT "%8.2" ECU_ADDRESS 0x60013CF6 /end MEASUREMENT
/begin MEASUREMENT DINH_stFId.FId_VehVSngWhlCanReplVal "Inhibit Status of FIds / Status of function identifier FId_VehVSngWhlCanReplVal" UWORD DFC_OneToOne 1 100 0.00 65535.00 FORMAT "%8.2" ECU_ADDRESS 0x60013CF8 /end MEASUREMENT
/begin MEASUREMENT DINH_stFId.FId_VehVSnsrARngHi "Inhibit Status of FIds / Status of function identifier FId_VehVSnsrARngHi" UWORD DFC_OneToOne 1 100 0.00 65535.00 FORMAT "%8.2" ECU_ADDRESS 0x60013CFA /end MEASUREMENT
/begin MEASUREMENT DINH_stFId.FId_VehVSnsrBRngHi "Inhibit Status of FIds / Status of function identifier FId_VehVSnsrBRngHi" UWORD DFC_OneToOne 1 100 0.00 65535.00 FORMAT "%8.2" ECU_ADDRESS 0x60013CFC /end MEASUREMENT
/begin MEASUREMENT DINH_stFId.FId_VehVSpdRtyDiag "Inhibit Status of FIds / Status of function identifier FId_VehVSpdRtyDiag" UWORD DFC_OneToOne 1 100 0.00 65535.00 FORMAT "%8.2" ECU_ADDRESS 0x60013CFE /end MEASUREMENT
/begin MEASUREMENT DINH_stFId.FId_VehVSpdSnsrAElecFailr "Inhibit Status of FIds / Status of function identifier FId_VehVSpdSnsrAElecFailr" UWORD DFC_OneToOne 1 100 0.00 65535.00 FORMAT "%8.2" ECU_ADDRESS 0x60013D00 /end MEASUREMENT
/begin MEASUREMENT DINH_stFId.FId_VehVSpdSnsrBElecFailr "Inhibit Status of FIds / Status of function identifier FId_VehVSpdSnsrBElecFailr" UWORD DFC_OneToOne 1 100 0.00 65535.00 FORMAT "%8.2" ECU_ADDRESS 0x60013D02 /end MEASUREMENT
/begin MEASUREMENT DINH_stFId.FId_VehVvFLWhlSpd "Inhibit Status of FIds / Status of function identifier FId_VehVvFLWhlSpd" UWORD DFC_OneToOne 1 100 0.00 65535.00 FORMAT "%8.2" ECU_ADDRESS 0x60013D04 /end MEASUREMENT
/begin MEASUREMENT DINH_stFId.FId_VehVvFRWhlSpd "Inhibit Status of FIds / Status of function identifier FId_VehVvFRWhlSpd" UWORD DFC_OneToOne 1 100 0.00 65535.00 FORMAT "%8.2" ECU_ADDRESS 0x60013D06 /end MEASUREMENT
/begin MEASUREMENT DINH_stFId.FId_VehVvRLWhlSpd "Inhibit Status of FIds / Status of function identifier FId_VehVvRLWhlSpd" UWORD DFC_OneToOne 1 100 0.00 65535.00 FORMAT "%8.2" ECU_ADDRESS 0x60013D08 /end MEASUREMENT
/begin MEASUREMENT DINH_stFId.FId_VehVvRRWhlSpd "Inhibit Status of FIds / Status of function identifier FId_VehVvRRWhlSpd" UWORD DFC_OneToOne 1 100 0.00 65535.00 FORMAT "%8.2" ECU_ADDRESS 0x60013D0A /end MEASUREMENT
/begin MEASUREMENT DINH_stFId.FId_VldtLamDynS1B1 "Inhibit Status of FIds / Status of function identifier FId_VldtLamDynS1B1" UWORD DFC_OneToOne 1 100 0.00 65535.00 FORMAT "%8.2" ECU_ADDRESS 0x60013D0C /end MEASUREMENT
/begin MEASUREMENT DINH_stFId.FId_VlvLftFbIntkOilPSnsr11SRC "Inhibit Status of FIds / Status of function identifier FId_VlvLftFbIntkOilPSnsr11SRC" UWORD DFC_OneToOne 1 100 0.00 65535.00 FORMAT "%8.2" ECU_ADDRESS 0x60013D0E /end MEASUREMENT
/begin MEASUREMENT DINH_stFId.FId_VlvLftFbSwtIntk11Diag "Inhibit Status of FIds / Status of function identifier FId_VlvLftFbSwtIntk11Diag" UWORD DFC_OneToOne 1 100 0.00 65535.00 FORMAT "%8.2" ECU_ADDRESS 0x60013D10 /end MEASUREMENT
/begin MEASUREMENT DINH_stFId.FId_ZGLZSR "Inhibit Status of FIds / Status of function identifier FId_ZGLZSR" UWORD DFC_OneToOne 1 100 0.00 65535.00 FORMAT "%8.2" ECU_ADDRESS 0x60013D12 /end MEASUREMENT
/begin MEASUREMENT DINH_stFId.FId_airIntkFltSnsrKnkPrtnIgn "Inhibit Status of FIds / Status of function identifier FId_airIntkFltSnsrKnkPrtnIgn" UWORD DFC_OneToOne 1 100 0.00 65535.00 FORMAT "%8.2" ECU_ADDRESS 0x60013D14 /end MEASUREMENT
/begin MEASUREMENT DINH_stFId.FId_ctrladpncvo "Inhibit Status of FIds / Status of function identifier FId_ctrladpncvo" UWORD DFC_OneToOne 1 100 0.00 65535.00 FORMAT "%8.2" ECU_ADDRESS 0x60013D16 /end MEASUREMENT
/begin MEASUREMENT DINH_stFId.FId_stChkChgnSys "Inhibit Status of FIds / Status of function identifier FId_stChkChgnSys" UWORD DFC_OneToOne 1 100 0.00 65535.00 FORMAT "%8.2" ECU_ADDRESS 0x60013D18 /end MEASUREMENT
/begin MEASUREMENT DINH_stFId.FId_stChkChgnSys2DC "Inhibit Status of FIds / Status of function identifier FId_stChkChgnSys2DC" UWORD DFC_OneToOne 1 100 0.00 65535.00 FORMAT "%8.2" ECU_ADDRESS 0x60013D1A /end MEASUREMENT
/begin MEASUREMENT DINH_stFId.FId_tFltSnsrKnkPrtnIgn "Inhibit Status of FIds / Status of function identifier FId_tFltSnsrKnkPrtnIgn" UWORD DFC_OneToOne 1 100 0.00 65535.00 FORMAT "%8.2" ECU_ADDRESS 0x60013D1C /end MEASUREMENT
/begin MEASUREMENT DINH_stMod7VisyCmpl "status of the first completed calculation of mode7 visibility" UBYTE OneToOne 1 100 0.00 255.0 BIT_MASK 0x1 FORMAT "%5.1" ECU_ADDRESS 0x600109D6 /end MEASUREMENT
/begin MEASUREMENT DINH_xFIDObsvInh_mp "DFCs and DSQs which inhibit the FId currently" UWORD DFCDSQ_Verb 1 100 0.00 65535.0000000 FORMAT "%13.7" ARRAY_SIZE 5 ECU_ADDRESS 0x70009D6C /end MEASUREMENT
/begin MEASUREMENT DINH_xFIDObsvRls_mp "DFCs and DSQs which don't inhibit the FId currently" UWORD DFCDSQ_Verb 1 100 0.00 65535.0000000 FORMAT "%13.7" ARRAY_SIZE 5 ECU_ADDRESS 0x70009D62 /end MEASUREMENT
/begin FUNCTION DINH "30000.27.0_1.0.0Diagnostic Inhibit Handler"
 /begin DEF_CHARACTERISTIC DINH_FId.DFC_AAVEmax_CA DINH_FId.DFC_AAVEmin_CA DINH_FId.DFC_AAVEsig_CA DINH_FId.DFC_AltIOACGFailr_CA DINH_FId.DFC_AltIOACGHiVltg_CA DINH_FId.DFC_AltIOACGLoVltg_CA DINH_FId.DFC_AltIOACGTHi_CA DINH_FId.DFC_AltIODConnACG_CA DINH_FId.DFC_BGOELWAF_CA DINH_FId.DFC_BattUHiFailr_CA DINH_FId.DFC_BattULoFailr_CA DINH_FId.DFC_BrkBstPDriftHiErr_CA DINH_FId.DFC_BrkBstPDriftLoErr_CA DINH_FId.DFC_BrkBstPSnsrStuck_CA DINH_FId.DFC_BrkMnSwtContOn_CA DINH_FId.DFC_BrkMnSwtNotStp_CA DINH_FId.DFC_BrkNpl_CA DINH_FId.DFC_BrkRdntSwtContOn_CA DINH_FId.DFC_BrkRdntSwtNotStp_CA DINH_FId.DFC_Clth3ONStuck_CA DINH_FId.DFC_Clth4OFFStuck_CA DINH_FId.DFC_ClthOFFStuck_CA DINH_FId.DFC_ClthONStuck_CA DINH_FId.DFC_ClthStkFailInfo_CA DINH_FId.DFC_ComACFailInfo_CA DINH_FId.DFC_ComATFTValErr_CA DINH_FId.DFC_ComATMILReq_CA DINH_FId.DFC_ComAYCAChksum_CA DINH_FId.DFC_ComAYCARingCnt_CA DINH_FId.DFC_ComAYCATOut_CA DINH_FId.DFC_ComAYCDChkSum_CA DINH_FId.DFC_ComAYCDTOut_CA DINH_FId.DFC_ComAYCFChksum_CA DINH_FId.DFC_ComAYCFRingCnt_CA DINH_FId.DFC_ComAYCFTOut_CA DINH_FId.DFC_ComAYCGChksum_CA DINH_FId.DFC_ComAYCGRingCnt_CA DINH_FId.DFC_ComAYCGTOut_CA DINH_FId.DFC_ComAYCIChkSum_CA DINH_FId.DFC_ComAYCIRingCnt_CA DINH_FId.DFC_ComAYCITOut_CA DINH_FId.DFC_ComBCM1ChkSum_CA DINH_FId.DFC_ComBCM1RingCnt_CA DINH_FId.DFC_ComBCM1TOut_CA DINH_FId.DFC_ComCANABusOffErr_CA DINH_FId.DFC_ComCANBBusOffErr_CA DINH_FId.DFC_ComCANCBusOffErr_CA DINH_FId.DFC_ComCGW1ChkSum_CA DINH_FId.DFC_ComCGW1RingCnt_CA DINH_FId.DFC_ComCGW1TOut_CA DINH_FId.DFC_ComConvBoostErr_CA DINH_FId.DFC_ComConvSlipErr_CA DINH_FId.DFC_ComDCDCPrfmncErr_CA DINH_FId.DFC_ComDCDCTempWarn_CA DINH_FId.DFC_ComEAT10Chksum_CA DINH_FId.DFC_ComEAT10RingCnt_CA DINH_FId.DFC_ComEAT10TOut_CA DINH_FId.DFC_ComEAT11ChkSum_CA DINH_FId.DFC_ComEAT11RingCnt_CA DINH_FId.DFC_ComEAT11TOut_CA DINH_FId.DFC_ComEAT12ChkSum_CA DINH_FId.DFC_ComEAT12RingCnt_CA DINH_FId.DFC_ComEAT12TOut_CA DINH_FId.DFC_ComEAT13ChkSum_CA DINH_FId.DFC_ComEAT13RingCnt_CA DINH_FId.DFC_ComEAT13TOut_CA DINH_FId.DFC_ComEAT1Chksum_CA DINH_FId.DFC_ComEAT1RingCnt_CA DINH_FId.DFC_ComEAT1TOut_CA DINH_FId.DFC_ComEAT2ChkSum_CA DINH_FId.DFC_ComEAT2RingCnt_CA DINH_FId.DFC_ComEAT2TOut_CA DINH_FId.DFC_ComEAT4ChkSum_CA DINH_FId.DFC_ComEAT4RingCnt_CA DINH_FId.DFC_ComEAT4TOut_CA DINH_FId.DFC_ComEAT6Chksum_CA DINH_FId.DFC_ComEAT6RingCnt_CA DINH_FId.DFC_ComEAT6TOut_CA DINH_FId.DFC_ComEAT7Chksum_CA DINH_FId.DFC_ComEAT7RingCnt_CA DINH_FId.DFC_ComEAT7TOut_CA DINH_FId.DFC_ComEAT8Chksum_CA DINH_FId.DFC_ComEAT8RingCnt_CA DINH_FId.DFC_ComEAT8TOut_CA DINH_FId.DFC_ComEATAChksum_CA DINH_FId.DFC_ComEATARingCnt_CA DINH_FId.DFC_ComEATATOut_CA DINH_FId.DFC_ComEATBChkSum_CA DINH_FId.DFC_ComEATBRingCnt_CA DINH_FId.DFC_ComEATBTOut_CA DINH_FId.DFC_ComEATCChksum_CA DINH_FId.DFC_ComEATCRingCnt_CA DINH_FId.DFC_ComEATCTOut_CA DINH_FId.DFC_ComEPBBChkSum_CA DINH_FId.DFC_ComEPBBRingCnt_CA DINH_FId.DFC_ComEPBBTOut_CA DINH_FId.DFC_ComEPBChksum_CA DINH_FId.DFC_ComEPBTOut_CA DINH_FId.DFC_ComEPBctRing_CA DINH_FId.DFC_ComEPS1Chksum_CA DINH_FId.DFC_ComEPS1RingCnt_CA DINH_FId.DFC_ComEPS1TOut_CA DINH_FId.DFC_ComEngCanRxErr_CA DINH_FId.DFC_ComGrvySnsrErr_CA DINH_FId.DFC_ComGwIMG1ChkSum_CA DINH_FId.DFC_ComGwIMG1RingCnt_CA DINH_FId.DFC_ComGwIMG1TOut_CA DINH_FId.DFC_ComGwIMG3ChkSum_CA DINH_FId.DFC_ComGwIMG3RingCnt_CA DINH_FId.DFC_ComGwIMG3TOut_CA DINH_FId.DFC_ComGwIMG4ChkSum_CA DINH_FId.DFC_ComGwIMG4RingCnt_CA DINH_FId.DFC_ComGwIMG4TOut_CA DINH_FId.DFC_ComGwIMG5ChkSum_CA DINH_FId.DFC_ComGwIMG5RingCnt_CA DINH_FId.DFC_ComGwIMG5TOut_CA DINH_FId.DFC_ComGwIMG6ChkSum_CA DINH_FId.DFC_ComGwIMG6RingCnt_CA DINH_FId.DFC_ComGwIMG6TOut_CA DINH_FId.DFC_ComIDASBChksum_CA DINH_FId.DFC_ComIDASBRingCnt_CA DINH_FId.DFC_ComIDASBTOut_CA DINH_FId.DFC_ComIMGMILReq_CA DINH_FId.DFC_ComISSPrms_CA DINH_FId.DFC_ComMETAChksum_CA DINH_FId.DFC_ComMETAChksumPstDrv_CA DINH_FId.DFC_ComMETARingCnt_CA DINH_FId.DFC_ComMETARingCntPstDrv_CA DINH_FId.DFC_ComMETATOut_CA DINH_FId.DFC_ComMETATOutPstDrv_CA DINH_FId.DFC_ComMETCChksum_CA DINH_FId.DFC_ComMETCRingCnt_CA DINH_FId.DFC_ComMETCTOut_CA DINH_FId.DFC_ComMETDChksum_CA DINH_FId.DFC_ComMETDRingCnt_CA DINH_FId.DFC_ComMETDTOut_CA DINH_FId.DFC_ComMETE2Chksum_CA DINH_FId.DFC_ComMETE2RingCnt_CA DINH_FId.DFC_ComMETE2TOut_CA DINH_FId.DFC_ComMETFChksum_CA DINH_FId.DFC_ComMETFRingCnt_CA DINH_FId.DFC_ComMETFTOut_CA DINH_FId.DFC_ComMETGChksum_CA DINH_FId.DFC_ComMETGRingCnt_CA DINH_FId.DFC_ComMETGTOut_CA DINH_FId.DFC_ComMETH2Chksum_CA DINH_FId.DFC_ComMETH2RingCnt_CA DINH_FId.DFC_ComMETH2TOut_CA DINH_FId.DFC_ComMETHChksum_CA DINH_FId.DFC_ComMETHRingCnt_CA DINH_FId.DFC_ComMETHTOut_CA DINH_FId.DFC_ComMETIChksum_CA DINH_FId.DFC_ComMETIRingCnt_CA DINH_FId.DFC_ComMETITOut_CA DINH_FId.DFC_ComMETKChksum_CA DINH_FId.DFC_ComMETKRingCnt_CA DINH_FId.DFC_ComMETKTOut_CA DINH_FId.DFC_ComMETLChksum_CA DINH_FId.DFC_ComMETLRingCnt_CA DINH_FId.DFC_ComMETLTOut_CA DINH_FId.DFC_ComMETMChksum_CA DINH_FId.DFC_ComMETMRingCnt_CA DINH_FId.DFC_ComMETMTOut_CA DINH_FId.DFC_ComMETNChksum_CA DINH_FId.DFC_ComMETNRingCnt_CA DINH_FId.DFC_ComMETNTOut_CA DINH_FId.DFC_ComMtrCom_CA DINH_FId.DFC_ComPCUChkSum_CA DINH_FId.DFC_ComPCURingCnt_CA DINH_FId.DFC_ComPCUTOut_CA DINH_FId.DFC_ComSRSAChksum_CA DINH_FId.DFC_ComSRSARingCnt_CA DINH_FId.DFC_ComSRSATOut_CA DINH_FId.DFC_ComSRSBChksum_CA DINH_FId.DFC_ComSRSBRingCnt_CA DINH_FId.DFC_ComSRSBTOut_CA DINH_FId.DFC_ComSRSChksum_CA DINH_FId.DFC_ComSRSErr_CA DINH_FId.DFC_ComSRSRingCnt_CA DINH_FId.DFC_ComSRSTOut_CA DINH_FId.DFC_ComVehSpdPndFltTCU_CA DINH_FId.DFC_EbsChartcCurrErr_CA DINH_FId.DFC_EbsSelfDiagErr_CA DINH_FId.DFC_GEVlvPhaCsersIntkB1_CA DINH_FId.DFC_GEVlvPhaPsOpenLoadIntkB1_CA DINH_FId.DFC_GEVlvPhaPsShoToBattIntkB1_CA DINH_FId.DFC_GEVlvPhaPsShoToGndIntkB1_CA DINH_FId.DFC_GbxCANDigPlausErr_CA DINH_FId.DFC_GbxNPos1SRCMax_CA DINH_FId.DFC_GbxNPos1SRCMin_CA DINH_FId.DFC_GbxNPos2SRCMax_CA DINH_FId.DFC_GbxNPos2SRCMin_CA DINH_FId.DFC_GbxNPosAlvChk_CA DINH_FId.DFC_GbxNPosSyncErr_CA DINH_FId.DFC_HEGOS2B1HtrPsMax_CA DINH_FId.DFC_HEGOS2B1HtrPsMin_CA DINH_FId.DFC_HEGOS2B1HtrPsSig_CA DINH_FId.DFC_LinCSErrACG_CA DINH_FId.DFC_LinCSErrAEV_CA DINH_FId.DFC_LinCSErrDCDC_CA DINH_FId.DFC_LinCSErrEBS_CA DINH_FId.DFC_LinHdrTimeoutErrACG_CA DINH_FId.DFC_LinHdrTimeoutErrAEV_CA DINH_FId.DFC_LinHdrTimeoutErrDCDC_CA DINH_FId.DFC_LinHdrTimeoutErrEBS_CA DINH_FId.DFC_LinMsgTimeoutErrACG_CA DINH_FId.DFC_LinMsgTimeoutErrAEV_CA DINH_FId.DFC_LinMsgTimeoutErrDCDC_CA DINH_FId.DFC_LinMsgTimeoutErrEBS_CA DINH_FId.DFC_LinNoStrtComErr_CA DINH_FId.DFC_LowPresOilP_CA DINH_FId.DFC_MisfDetVWhlFrntLeOORHi_CA DINH_FId.DFC_MisfDetVWhlFrntLeRatyHi_CA DINH_FId.DFC_MisfDetVWhlFrntLeRatyLo_CA DINH_FId.DFC_MisfDetVWhlFrntLeStuck_CA DINH_FId.DFC_MisfDetVWhlFrntRiOORHi_CA DINH_FId.DFC_MisfDetVWhlFrntRiRatyHi_CA DINH_FId.DFC_MisfDetVWhlFrntRiRatyLo_CA DINH_FId.DFC_MisfDetVWhlFrntRiStuck_CA DINH_FId.DFC_MisfDetVWhlReLeOORHi_CA DINH_FId.DFC_MisfDetVWhlReLeRatyHi_CA DINH_FId.DFC_MisfDetVWhlReLeRatyLo_CA DINH_FId.DFC_MisfDetVWhlReLeStuck_CA DINH_FId.DFC_MisfDetVWhlReRiOORHi_CA DINH_FId.DFC_MisfDetVWhlReRiRatyHi_CA DINH_FId.DFC_MisfDetVWhlReRiRatyLo_CA DINH_FId.DFC_MisfDetVWhlReRiStuck_CA DINH_FId.DFC_MisfDetdVWhlFrntLePlaus_CA DINH_FId.DFC_MisfDetdVWhlFrntRiPlaus_CA DINH_FId.DFC_MisfDetdVWhlReLePlaus_CA DINH_FId.DFC_MisfDetdVWhlReRiPlaus_CA DINH_FId.DFC_PEnvSigRngMax_CA DINH_FId.DFC_PEnvSigRngMin_CA DINH_FId.DFC_StmFault_CA DINH_FId.DFC_StrtCtOffPth_CA DINH_FId.DFC_StrtCtlErr_CA DINH_FId.DFC_StrtFault_CA DINH_FId.DFC_StrtLckJudg1_CA DINH_FId.DFC_StrtLckJudg2_CA DINH_FId.DFC_StrtOL_CA DINH_FId.DFC_StrtOL2_CA DINH_FId.DFC_StrtSCB_CA DINH_FId.DFC_StrtSCB2_CA DINH_FId.DFC_StrtSCG_CA DINH_FId.DFC_StrtSCG2_CA DINH_FId.DFC_StrtStkRly1_CA DINH_FId.DFC_StrtStkRly2_CA DINH_FId.DFC_TEVEmax_CA DINH_FId.DFC_TEVEmin_CA DINH_FId.DFC_TEVEsig_CA DINH_FId.DFC_UegoHeatrPrfmncLoS1B1_CA DINH_FId.DFC_VehVAllPlaus_CA DINH_FId.DFC_VehVNCSnsrElecFailr_CA DINH_FId.DFC_VehVPlausCan_CA DINH_FId.DFC_VehVPlausFco_CA DINH_FId.DFC_VehVPlausPwr_CA DINH_FId.DFC_VehVPlausV2N_CA DINH_FId.DFC_VehVSpdSnsrAElecFailr_CA DINH_FId.DFC_VehVSpdSnsrBElecFailr_CA DINH_FId.DFC_ClthMax_CA DINH_FId.DFC_IgnClPs_DevComErr_CA DINH_FId.DFC_IgnClPs_LineOl_0_CA DINH_FId.DFC_IgnClPs_LineOl_1_CA DINH_FId.DFC_IgnClPs_LineOl_2_CA DINH_FId.DFC_IgnClPs_LineOl_3_CA DINH_FId.DFC_IgnClPs_LineScb_0_CA DINH_FId.DFC_IgnClPs_LineScb_1_CA DINH_FId.DFC_IgnClPs_LineScb_2_CA DINH_FId.DFC_IgnClPs_LineScb_3_CA DINH_FId.DFC_IgnClPs_LineScg_0_CA DINH_FId.DFC_IgnClPs_LineScg_1_CA DINH_FId.DFC_IgnClPs_LineScg_2_CA DINH_FId.DFC_IgnClPs_LineScg_3_CA DINH_FId.DFC_KRVEKOEVAB_CA DINH_FId.DFC_KRVEKOEVAB0_CA DINH_FId.DFC_KRVEKOEVAB1_CA DINH_FId.DFC_KRVEKOEVAB2_CA DINH_FId.DFC_KRVEKOEVAB3_CA DINH_FId.DFC_UegoSigEcuAsicS1B1_CA DINH_FId.DFC_UegoSigEcuComS1B1_CA DINH_FId.DFC_UegoSigSnsrS1B1_CA DINH_FId.DFC_UegoSigWireOlApesS1B1_CA DINH_FId.DFC_UegoSigWireOlIpeS1B1_CA DINH_FId.DFC_UegoSigWireOlReS1B1_CA DINH_FId.DFC_UegoSigWireRCmpS1B1_CA DINH_FId.DFC_UegoSigWireScbS1B1_CA DINH_FId.DFC_UegoSigWireScgS1B1_CA DINH_FId.DFC_AfsPhyRngHiB1_CA DINH_FId.DFC_AfsPhyRngLoB1_CA DINH_FId.DFC_AirCCmprOL_CA DINH_FId.DFC_AirCCmprOvrTemp_CA DINH_FId.DFC_AirCCmprSCB_CA DINH_FId.DFC_AirCCmprSCG_CA DINH_FId.DFC_AltErr_CA DINH_FId.DFC_BattUSRCMax_CA DINH_FId.DFC_BattUSRCMin_CA DINH_FId.DFC_ComChksTCU1_CA DINH_FId.DFC_ComChksTCU11_CA DINH_FId.DFC_ComChksTCU12_CA DINH_FId.DFC_ComChksTCU13_CA DINH_FId.DFC_ComChksTCU2_CA DINH_FId.DFC_ComChksTCU3_CA DINH_FId.DFC_ComChksTCU4_CA DINH_FId.DFC_ComCntTCU1_CA DINH_FId.DFC_ComCntTCU11_CA DINH_FId.DFC_ComCntTCU12_CA DINH_FId.DFC_ComCntTCU13_CA DINH_FId.DFC_ComCntTCU2_CA DINH_FId.DFC_ComCntTCU3_CA DINH_FId.DFC_ComCntTCU4_CA DINH_FId.DFC_ComTOutTCU01_CA DINH_FId.DFC_ComTOutTCU02_CA DINH_FId.DFC_ComTOutTCU1_CA DINH_FId.DFC_ComTOutTCU11_CA DINH_FId.DFC_ComTOutTCU12_CA DINH_FId.DFC_ComTOutTCU13_CA DINH_FId.DFC_ComTOutTCU14_CA DINH_FId.DFC_ComTOutTCU2_CA DINH_FId.DFC_ComTOutTCU3_CA DINH_FId.DFC_ComTOutTCU4_CA DINH_FId.DFC_DevLibBattUHi_CA DINH_FId.DFC_DevLibBattULo_CA DINH_FId.DFC_EGRVlvFailSafeActv_CA DINH_FId.DFC_EGRVlvGovDvtCld_CA DINH_FId.DFC_EGRVlvPhysSRCMax_CA DINH_FId.DFC_EGRVlvPhysSRCMin_CA DINH_FId.DFC_FanDIOOL_0_CA DINH_FId.DFC_FanDIOOL_1_CA DINH_FId.DFC_FanDIOOvrTemp_0_CA DINH_FId.DFC_FanDIOOvrTemp_1_CA DINH_FId.DFC_FanDIOSCB_0_CA DINH_FId.DFC_FanDIOSCB_1_CA DINH_FId.DFC_FanDIOSCG_0_CA DINH_FId.DFC_FanDIOSCG_1_CA DINH_FId.DFC_MRlyDcOL_CA DINH_FId.DFC_MRlyDcSCB_CA DINH_FId.DFC_MRlyDcSCG_CA DINH_FId.DFC_PSPOL_CA DINH_FId.DFC_PSPOvrTemp_CA DINH_FId.DFC_PSPSCB_CA DINH_FId.DFC_PSPSCG_CA DINH_FId.DFC_T50Err_CA DINH_FId.DFC_ThrVlvLoBattB1_CA DINH_FId.DFC_UegoSigOperPlausS1B1_CA DINH_FId.DFC_VehVPhysRngHi_CA DINH_FId.DFC_VehVSclOutOL_CA DINH_FId.DFC_VehVSclOutOT_CA DINH_FId.DFC_VehVSclOutSCB_CA DINH_FId.DFC_VehVSclOutSCG_CA DINH_FId.DFC_VehVSigFL_CA DINH_FId.DFC_VehVSigFR_CA DINH_FId.DFC_VehVSigRL_CA DINH_FId.DFC_VehVSigRR_CA DINH_FId.DFC_VehVSnsrARngHi_CA DINH_FId.DFC_VehVSnsrBRngHi_CA DINH_FId.DFC_VehVSpdRtyDiag_CA DINH_FId.DFC_DHFHD_CA DINH_FId.DFC_InjVlv_DI_DcDc_CA DINH_FId.DFC_InjVlv_DI_NoLd_0_CA DINH_FId.DFC_InjVlv_DI_NoLd_1_CA DINH_FId.DFC_InjVlv_DI_NoLd_2_CA DINH_FId.DFC_InjVlv_DI_NoLd_3_CA DINH_FId.DFC_InjVlv_DI_ScBnk_0_CA DINH_FId.DFC_InjVlv_DI_ScBnk_1_CA DINH_FId.DFC_InjVlv_DI_ScBnk_2_CA DINH_FId.DFC_InjVlv_DI_ScBnk_3_CA DINH_FId.DFC_InjVlv_DI_ScCyl_0_CA DINH_FId.DFC_InjVlv_DI_ScCyl_1_CA DINH_FId.DFC_InjVlv_DI_ScCyl_2_CA DINH_FId.DFC_InjVlv_DI_ScCyl_3_CA DINH_FId.DFC_InjVlv_DI_ScHsLs_0_CA DINH_FId.DFC_InjVlv_DI_ScHsLs_1_CA DINH_FId.DFC_InjVlv_DI_ScHsLs_2_CA DINH_FId.DFC_InjVlv_DI_ScHsLs_3_CA DINH_FId.DFC_MfPsDiaOpenLoad1_CA DINH_FId.DFC_MfPsDiaScHiS1_CA DINH_FId.DFC_MfPsDiaScHiSLowS1_CA DINH_FId.DFC_MfPsDiaScLowS1_CA DINH_FId.DFC_ACEvpTPhysRngHi_CA DINH_FId.DFC_ACEvpTPhysRngLo_CA DINH_FId.DFC_ACEvpTSRCMax_CA DINH_FId.DFC_ACEvpTSRCMin_CA DINH_FId.DFC_AfsRawSigRngHiB1_CA DINH_FId.DFC_AfsRawSigRngLoB1_CA DINH_FId.DFC_AfsSnsrErrB1_CA DINH_FId.DFC_AirCClntPAnaSRCMax_CA DINH_FId.DFC_AirCClntPAnaSRCMin_CA DINH_FId.DFC_AirCSwtNpl_CA DINH_FId.DFC_AirCSwtSig_CA DINH_FId.DFC_Brk_CA DINH_FId.DFC_BrkBstSensSCB_CA DINH_FId.DFC_BrkBstSensSCG_CA DINH_FId.DFC_BrkSig_CA DINH_FId.DFC_ClthSig_CA DINH_FId.DFC_EGRVlvCurrLim_CA DINH_FId.DFC_EGRVlvOL_CA DINH_FId.DFC_EGRVlvOvrTemp_CA DINH_FId.DFC_EGRVlvSCB_CA DINH_FId.DFC_EGRVlvSCG_CA DINH_FId.DFC_EGRVlvSRCMax_CA DINH_FId.DFC_EGRVlvSRCMin_CA DINH_FId.DFC_HLSDemOvhtEngLim_CA DINH_FId.DFC_OilPSwmpSRCMax_CA DINH_FId.DFC_OilPSwmpSRCMin_CA DINH_FId.DFC_PIntkVUsLineHiB1_CA DINH_FId.DFC_PIntkVUsLineLoB1_CA DINH_FId.DFC_VehVPhysRngLo_CA DINH_FId.DFC_VehVSigCan_CA DINH_FId.DFC_VehVSigCanSafe_CA DINH_FId.DFC_VlvLftFbOilPSnsrIntk11SRCMax_CA DINH_FId.DFC_VlvLftFbOilPSnsrIntk11SRCMin_CA DINH_FId.DFC_ClthNpl_CA DINH_FId.DFC_GbxPNPosnDrvCdn_CA DINH_FId.DFC_GbxPNPosnPlausy_CA DINH_FId.DFC_AfsSigErrLineHiB1_CA DINH_FId.DFC_AfsSigErrLineLoB1_CA DINH_FId.DFC_PEnvCcMax_CA DINH_FId.DFC_PEnvCcMin_CA DINH_FId.DFC_PEnvRngChkMax_CA DINH_FId.DFC_PEnvRngChkMin_CA DINH_FId.DFC_PEnvSnsrPlaus_CA DINH_FId.DFC_UEGOHeatrRlyPsOLS1B1_CA DINH_FId.DFC_UEGOHeatrRlyPsSCBS1B1_CA DINH_FId.DFC_UEGOHeatrRlyPsSCGS1B1_CA DINH_FId.DFC_UegoHeatrWireOlS1B1_CA DINH_FId.DFC_UegoHeatrWireScbS1B1_CA DINH_FId.DFC_UegoHeatrWireScgS1B1_CA DINH_FId.DFC_KnDetSens1PortAMax_CA DINH_FId.DFC_KnDetSens1PortAMin_CA DINH_FId.DFC_KnDetSens1PortBMax_CA DINH_FId.DFC_KnDetSens1PortBMin_CA DINH_FId.DFC_Clth2ONStuck_CA DINH_FId.DFC_Clth2ONStuckLdc_CA DINH_FId.DFC_Clth3ONStuckLdc_CA DINH_FId.DFC_Clth3ONStuckPostDrv_CA DINH_FId.DFC_Clth4ONStuck_CA DINH_FId.DFC_Clth4ONStuckLdc_CA DINH_FId.DFC_ComBCMUnit_CA DINH_FId.DFC_ComDLCTCU01_CA DINH_FId.DFC_ComDLCTCU02_CA DINH_FId.DFC_ComDLCTCU1_CA DINH_FId.DFC_ComDLCTCU11_CA DINH_FId.DFC_ComDLCTCU12_CA DINH_FId.DFC_ComDLCTCU13_CA DINH_FId.DFC_ComDLCTCU14_CA DINH_FId.DFC_ComDLCTCU2_CA DINH_FId.DFC_ComDLCTCU3_CA DINH_FId.DFC_ComDLCTCU4_CA DINH_FId.DFC_ComEPSUnit_CA DINH_FId.DFC_ComIDASBUnit_CA DINH_FId.DFC_ComIMGUnit_CA DINH_FId.DFC_ComMETUnit_CA DINH_FId.DFC_ComSRSUnit_CA DINH_FId.DFC_ComVSAUnit_CA DINH_FId.DFC_EbsSocFlt_CA DINH_FId.DFC_I14229VINErr_CA DINH_FId.DFC_InjCatHeatgErr_CA DINH_FId.DFC_InjSysMulInjDiagErr_CA DINH_FId.DFC_LLRHmax_CA DINH_FId.DFC_LLRHmin_CA DINH_FId.DFC_LLRHnpl_CA DINH_FId.DFC_LLRKHmax_CA DINH_FId.DFC_LLRKHmin_CA DINH_FId.DFC_LLRKHnpl_CA DINH_FId.DFC_LinACGUnit_CA DINH_FId.DFC_LinAEVUnit_CA DINH_FId.DFC_LinEBSUnit_CA /end DEF_CHARACTERISTIC
 /begin LOC_MEASUREMENT DINH_stFId.FId_UEGOHeatrPwrStgDiagRelsS1B1 DINH_stFId.FId_UEGOModCtrlRelsS1B1 DINH_stFId.FId_UEGOStrtDiagInhRprtErrS1B1 DINH_stFId.FId_UEGOStrtDiagRelsS1B1 DINH_stFId.FId_UEGOTCeramicRelsS1B1 DINH_stFId.FId_UegoDiagRelsBattSplyOk DINH_stFId.FId_UegoDiagSigEcuAsicS1B1 DINH_stFId.FId_UegoDiagSigEcuComS1B1 DINH_stFId.FId_UegoDiagSigOperPlausS1B1 DINH_stFId.FId_UegoDiagSigSnsrS1B1 DINH_stFId.FId_UegoDiagSigWireOlS1B1 DINH_stFId.FId_UegoDiagSigWireScS1B1 DINH_stFId.FId_UegoDiagSigWireScTstdS1B1 DINH_stFId.FId_UegoInhbOperRelsS1B1 DINH_stFId.FId_UegoO2HiPrcsnS1B1 DINH_stFId.FId_UegoO2PlausErrS1B1 DINH_stFId.FId_UegoO2VldS1B1 DINH_stFId.FId_UegoOperPlausBattSplyOk DINH_stFId.FId_UegoPlausErrHndlg DINH_stFId.FId_VMSIDCSRmpShOff DINH_stFId.FId_VMSIDCSShOff DINH_stFId.FId_VMSITCSRmpShOff DINH_stFId.FId_VMSITCSShOff DINH_stFId.FId_VSACANErr DINH_stFId.FId_VehStcACGFailr DINH_stFId.FId_VehStcBattMngFailr DINH_stFId.FId_VehStcDCDCFailr DINH_stFId.FId_VehStcEBSFailr DINH_stFId.FId_VehStcMisf DINH_stFId.FId_VehStcMtrComFailr DINH_stFId.FId_VehStcNVMFailr DINH_stFId.FId_VehVCANFrzVal DINH_stFId.FId_VehVCANReplVal DINH_stFId.FId_VehVCanSafeFrzVal DINH_stFId.FId_VehVCanSafeReplVal DINH_stFId.FId_VehVCom DINH_stFId.FId_VehVExcdLim DINH_stFId.FId_VehVFrzVal DINH_stFId.FId_VehVNCSnsrElecFailr DINH_stFId.FId_VehVOBDFrzVal DINH_stFId.FId_VehVOBDReplVal DINH_stFId.FId_VehVOutCanErr DINH_stFId.FId_VehVPWMFrzVal DINH_stFId.FId_VehVPWMReplVal DINH_stFId.FId_VehVPhysRng DINH_stFId.FId_VehVPlaus DINH_stFId.FId_VehVPlausCan DINH_stFId.FId_VehVPlausFco DINH_stFId.FId_VehVPlausPwr DINH_stFId.FId_VehVPlausV2N DINH_stFId.FId_VehVReplVal DINH_stFId.FId_VehVSigCan DINH_stFId.FId_VehVSigCanSafe DINH_stFId.FId_VehVSngWhlCanFrzVal DINH_stFId.FId_VehVSngWhlCanReplVal DINH_stFId.FId_VehVSnsrARngHi DINH_stFId.FId_VehVSnsrBRngHi DINH_stFId.FId_VehVSpdRtyDiag DINH_stFId.FId_VehVSpdSnsrAElecFailr DINH_stFId.FId_VehVSpdSnsrBElecFailr DINH_stFId.FId_VehVvFLWhlSpd DINH_stFId.FId_VehVvFRWhlSpd DINH_stFId.FId_VehVvRLWhlSpd DINH_stFId.FId_VehVvRRWhlSpd DINH_stFId.FId_VldtLamDynS1B1 DINH_stFId.FId_VlvLftFbIntkOilPSnsr11SRC DINH_stFId.FId_VlvLftFbSwtIntk11Diag DINH_stFId.FId_ZGLZSR DINH_stFId.FId_airIntkFltSnsrKnkPrtnIgn DINH_stFId.FId_ctrladpncvo DINH_stFId.FId_stChkChgnSys DINH_stFId.FId_stChkChgnSys2DC DINH_stFId.FId_tFltSnsrKnkPrtnIgn DINH_stMod7VisyCmpl DINH_xFIDObsvInh_mp DINH_xFIDObsvRls_mp /end LOC_MEASUREMENT
 FUNCTION_VERSION "30000.27.0_1.0.0" /end FUNCTION
/begin COMPU_METHOD DFCDSQ_Verb "" TAB_VERB "%6.3" "-" COMPU_TAB_REF DFCDSQ_Verb /end COMPU_METHOD
/begin COMPU_VTAB DFCDSQ_Verb "" TAB_VERB 947 0 "NoInhibit" 1 "DFC_AAVEmax" 2 "DFC_AAVEmin" 3 "DFC_AAVEsig" 4 "DFC_AltIOACGFailr" 5 "DFC_AltIOACGHiVltg" 6 "DFC_AltIOACGLoVltg" 7 "DFC_AltIOACGTHi" 8 "DFC_AltIODConnACG" 9 "DFC_BGOELWAF" 10 "DFC_BattUHiFailr" 11 "DFC_BattULoFailr" 12 "DFC_BrkBstPDriftHiErr" 13 "DFC_BrkBstPDriftLoErr" 14 "DFC_BrkBstPSnsrStuck" 15 "DFC_BrkMnSwtContOn" 16 "DFC_BrkMnSwtNotStp" 17 "DFC_BrkNpl" 18 "DFC_BrkRdntSwtContOn" 19 "DFC_BrkRdntSwtNotStp" 20 "DFC_Clth3ONStuck" 21 "DFC_Clth4OFFStuck" 22 "DFC_ClthOFFStuck" 23 "DFC_ClthONStuck" 24 "DFC_ClthStkFailInfo" 25 "DFC_ComACFailInfo" 26 "DFC_ComATFTValErr" 27 "DFC_ComATMILReq" 28 "DFC_ComAYCAChksum" 29 "DFC_ComAYCARingCnt" 30 "DFC_ComAYCATOut" 31 "DFC_ComAYCDChkSum" 32 "DFC_ComAYCDTOut" 33 "DFC_ComAYCFChksum" 34 "DFC_ComAYCFRingCnt" 35 "DFC_ComAYCFTOut" 36 "DFC_ComAYCGChksum" 37 "DFC_ComAYCGRingCnt" 38 "DFC_ComAYCGTOut" 39 "DFC_ComAYCIChkSum" 40 "DFC_ComAYCIRingCnt" 41 "DFC_ComAYCITOut" 42 "DFC_ComBCM1ChkSum" 43 "DFC_ComBCM1RingCnt" 44 "DFC_ComBCM1TOut" 45 "DFC_ComCANABusOffErr" 46 "DFC_ComCANBBusOffErr" 47 "DFC_ComCANCBusOffErr" 48 "DFC_ComCGW1ChkSum" 49 "DFC_ComCGW1RingCnt" 50 "DFC_ComCGW1TOut" 51 "DFC_ComConvBoostErr" 52 "DFC_ComConvSlipErr" 53 "DFC_ComDCDCPrfmncErr" 54 "DFC_ComDCDCTempWarn" 55 "DFC_ComEAT10Chksum" 56 "DFC_ComEAT10RingCnt" 57 "DFC_ComEAT10TOut" 58 "DFC_ComEAT11ChkSum" 59 "DFC_ComEAT11RingCnt" 60 "DFC_ComEAT11TOut" 61 "DFC_ComEAT12ChkSum" 62 "DFC_ComEAT12RingCnt" 63 "DFC_ComEAT12TOut" 64 "DFC_ComEAT13ChkSum" 65 "DFC_ComEAT13RingCnt" 66 "DFC_ComEAT13TOut" 67 "DFC_ComEAT1Chksum" 68 "DFC_ComEAT1RingCnt" 69 "DFC_ComEAT1TOut" 70 "DFC_ComEAT2ChkSum" 71 "DFC_ComEAT2RingCnt" 72 "DFC_ComEAT2TOut" 73 "DFC_ComEAT4ChkSum" 74 "DFC_ComEAT4RingCnt" 75 "DFC_ComEAT4TOut" 76 "DFC_ComEAT6Chksum" 77 "DFC_ComEAT6RingCnt" 78 "DFC_ComEAT6TOut" 79 "DFC_ComEAT7Chksum" 80 "DFC_ComEAT7RingCnt" 81 "DFC_ComEAT7TOut" 82 "DFC_ComEAT8Chksum" 83 "DFC_ComEAT8RingCnt" 84 "DFC_ComEAT8TOut" 85 "DFC_ComEATAChksum" 86 "DFC_ComEATARingCnt" 87 "DFC_ComEATATOut" 88 "DFC_ComEATBChkSum" 89 "DFC_ComEATBRingCnt" 90 "DFC_ComEATBTOut" 91 "DFC_ComEATCChksum" 92 "DFC_ComEATCRingCnt" 93 "DFC_ComEATCTOut" 94 "DFC_ComEPBBChkSum" 95 "DFC_ComEPBBRingCnt" 96 "DFC_ComEPBBTOut" 97 "DFC_ComEPBChksum" 98 "DFC_ComEPBTOut" 99 "DFC_ComEPBctRing" 100 "DFC_ComEPS1Chksum" 101 "DFC_ComEPS1RingCnt" 102 "DFC_ComEPS1TOut" 103 "DFC_ComEngCanRxErr" 104 "DFC_ComGrvySnsrErr" 105 "DFC_ComGwIMG1ChkSum" 106 "DFC_ComGwIMG1RingCnt" 107 "DFC_ComGwIMG1TOut" 108 "DFC_ComGwIMG3ChkSum" 109 "DFC_ComGwIMG3RingCnt" 110 "DFC_ComGwIMG3TOut" 111 "DFC_ComGwIMG4ChkSum" 112 "DFC_ComGwIMG4RingCnt" 113 "DFC_ComGwIMG4TOut" 114 "DFC_ComGwIMG5ChkSum" 115 "DFC_ComGwIMG5RingCnt" 116 "DFC_ComGwIMG5TOut" 117 "DFC_ComGwIMG6ChkSum" 118 "DFC_ComGwIMG6RingCnt" 119 "DFC_ComGwIMG6TOut" 120 "DFC_ComIDASBChksum" 121 "DFC_ComIDASBRingCnt" 122 "DFC_ComIDASBTOut" 123 "DFC_ComIMGMILReq" 124 "DFC_ComISSPrms" 125 "DFC_ComMETAChksum" 126 "DFC_ComMETAChksumPstDrv" 127 "DFC_ComMETARingCnt" 128 "DFC_ComMETARingCntPstDrv" 129 "DFC_ComMETATOut" 130 "DFC_ComMETATOutPstDrv" 131 "DFC_ComMETCChksum" 132 "DFC_ComMETCRingCnt" 133 "DFC_ComMETCTOut" 134 "DFC_ComMETDChksum" 135 "DFC_ComMETDRingCnt" 136 "DFC_ComMETDTOut" 137 "DFC_ComMETE2Chksum" 138 "DFC_ComMETE2RingCnt" 139 "DFC_ComMETE2TOut" 140 "DFC_ComMETFChksum" 141 "DFC_ComMETFRingCnt" 142 "DFC_ComMETFTOut" 143 "DFC_ComMETGChksum" 144 "DFC_ComMETGRingCnt" 145 "DFC_ComMETGTOut" 146 "DFC_ComMETH2Chksum" 147 "DFC_ComMETH2RingCnt" 148 "DFC_ComMETH2TOut" 149 "DFC_ComMETHChksum" 150 "DFC_ComMETHRingCnt" 151 "DFC_ComMETHTOut" 152 "DFC_ComMETIChksum" 153 "DFC_ComMETIRingCnt" 154 "DFC_ComMETITOut" 155 "DFC_ComMETKChksum" 156 "DFC_ComMETKRingCnt" 157 "DFC_ComMETKTOut" 158 "DFC_ComMETLChksum" 159 "DFC_ComMETLRingCnt" 160 "DFC_ComMETLTOut" 161 "DFC_ComMETMChksum" 162 "DFC_ComMETMRingCnt" 163 "DFC_ComMETMTOut" 164 "DFC_ComMETNChksum" 165 "DFC_ComMETNRingCnt" 166 "DFC_ComMETNTOut" 167 "DFC_ComMtrCom" 168 "DFC_ComPCUChkSum" 169 "DFC_ComPCURingCnt" 170 "DFC_ComPCUTOut" 171 "DFC_ComSRSAChksum" 172 "DFC_ComSRSARingCnt" 173 "DFC_ComSRSATOut" 174 "DFC_ComSRSBChksum" 175 "DFC_ComSRSBRingCnt" 176 "DFC_ComSRSBTOut" 177 "DFC_ComSRSChksum" 178 "DFC_ComSRSErr" 179 "DFC_ComSRSRingCnt" 180 "DFC_ComSRSTOut" 181 "DFC_ComVehSpdPndFltTCU" 182 "DFC_EbsChartcCurrErr" 183 "DFC_EbsSelfDiagErr" 184 "DFC_GEVlvPhaCsersIntkB1" 185 "DFC_GEVlvPhaPsOpenLoadIntkB1" 186 "DFC_GEVlvPhaPsShoToBattIntkB1" 187 "DFC_GEVlvPhaPsShoToGndIntkB1" 188 "DFC_GbxCANDigPlausErr" 189 "DFC_GbxNPos1SRCMax" 190 "DFC_GbxNPos1SRCMin" 191 "DFC_GbxNPos2SRCMax" 192 "DFC_GbxNPos2SRCMin" 193 "DFC_GbxNPosAlvChk" 194 "DFC_GbxNPosSyncErr" 195 "DFC_HEGOS2B1HtrPsMax" 196 "DFC_HEGOS2B1HtrPsMin" 197 "DFC_HEGOS2B1HtrPsSig" 198 "DFC_LinCSErrACG" 199 "DFC_LinCSErrAEV" 200 "DFC_LinCSErrDCDC" 201 "DFC_LinCSErrEBS" 202 "DFC_LinHdrTimeoutErrACG" 203 "DFC_LinHdrTimeoutErrAEV" 204 "DFC_LinHdrTimeoutErrDCDC" 205 "DFC_LinHdrTimeoutErrEBS" 206 "DFC_LinMsgTimeoutErrACG" 207 "DFC_LinMsgTimeoutErrAEV" 208 "DFC_LinMsgTimeoutErrDCDC" 209 "DFC_LinMsgTimeoutErrEBS" 210 "DFC_LinNoStrtComErr" 211 "DFC_LowPresOilP" 212 "DFC_MisfDetVWhlFrntLeOORHi" 213 "DFC_MisfDetVWhlFrntLeRatyHi" 214 "DFC_MisfDetVWhlFrntLeRatyLo" 215 "DFC_MisfDetVWhlFrntLeStuck" 216 "DFC_MisfDetVWhlFrntRiOORHi" 217 "DFC_MisfDetVWhlFrntRiRatyHi" 218 "DFC_MisfDetVWhlFrntRiRatyLo" 219 "DFC_MisfDetVWhlFrntRiStuck" 220 "DFC_MisfDetVWhlReLeOORHi" 221 "DFC_MisfDetVWhlReLeRatyHi" 222 "DFC_MisfDetVWhlReLeRatyLo" 223 "DFC_MisfDetVWhlReLeStuck" 224 "DFC_MisfDetVWhlReRiOORHi" 225 "DFC_MisfDetVWhlReRiRatyHi" 226 "DFC_MisfDetVWhlReRiRatyLo" 227 "DFC_MisfDetVWhlReRiStuck" 228 "DFC_MisfDetdVWhlFrntLePlaus" 229 "DFC_MisfDetdVWhlFrntRiPlaus" 230 "DFC_MisfDetdVWhlReLePlaus" 231 "DFC_MisfDetdVWhlReRiPlaus" 232 "DFC_PEnvSigRngMax" 233 "DFC_PEnvSigRngMin" 234 "DFC_StmFault" 235 "DFC_StrtCtOffPth" 236 "DFC_StrtCtlErr" 237 "DFC_StrtFault" 238 "DFC_StrtLckJudg1" 239 "DFC_StrtLckJudg2" 240 "DFC_StrtOL" 241 "DFC_StrtOL2" 242 "DFC_StrtSCB" 243 "DFC_StrtSCB2" 244 "DFC_StrtSCG" 245 "DFC_StrtSCG2" 246 "DFC_StrtStkRly1" 247 "DFC_StrtStkRly2" 248 "DFC_TEVEmax" 249 "DFC_TEVEmin" 250 "DFC_TEVEsig" 251 "DFC_UegoHeatrPrfmncLoS1B1" 252 "DFC_VehVAllPlaus" 253 "DFC_VehVNCSnsrElecFailr" 254 "DFC_VehVPlausCan" 255 "DFC_VehVPlausFco" 256 "DFC_VehVPlausPwr" 257 "DFC_VehVPlausV2N" 258 "DFC_VehVSpdSnsrAElecFailr" 259 "DFC_VehVSpdSnsrBElecFailr" 260 "DFC_ClthMax" 261 "DFC_IgnClPs_DevComErr" 262 "DFC_IgnClPs_LineOl_0" 263 "DFC_IgnClPs_LineOl_1" 264 "DFC_IgnClPs_LineOl_2" 265 "DFC_IgnClPs_LineOl_3" 266 "DFC_IgnClPs_LineScb_0" 267 "DFC_IgnClPs_LineScb_1" 268 "DFC_IgnClPs_LineScb_2" 269 "DFC_IgnClPs_LineScb_3" 270 "DFC_IgnClPs_LineScg_0" 271 "DFC_IgnClPs_LineScg_1" 272 "DFC_IgnClPs_LineScg_2" 273 "DFC_IgnClPs_LineScg_3" 274 "DFC_KRVEKOEVAB" 275 "DFC_KRVEKOEVAB0" 276 "DFC_KRVEKOEVAB1" 277 "DFC_KRVEKOEVAB2" 278 "DFC_KRVEKOEVAB3" 279 "DFC_UegoSigEcuAsicS1B1" 280 "DFC_UegoSigEcuComS1B1" 281 "DFC_UegoSigSnsrS1B1" 282 "DFC_UegoSigWireOlApesS1B1" 283 "DFC_UegoSigWireOlIpeS1B1" 284 "DFC_UegoSigWireOlReS1B1" 285 "DFC_UegoSigWireRCmpS1B1" 286 "DFC_UegoSigWireScbS1B1" 287 "DFC_UegoSigWireScgS1B1" 288 "DFC_AfsPhyRngHiB1" 289 "DFC_AfsPhyRngLoB1" 290 "DFC_AirCCmprOL" 291 "DFC_AirCCmprOvrTemp" 292 "DFC_AirCCmprSCB" 293 "DFC_AirCCmprSCG" 294 "DFC_AltErr" 295 "DFC_BattUSRCMax" 296 "DFC_BattUSRCMin" 297 "DFC_ComChksTCU1" 298 "DFC_ComChksTCU11" 299 "DFC_ComChksTCU12" 300 "DFC_ComChksTCU13" 301 "DFC_ComChksTCU2" 302 "DFC_ComChksTCU3" 303 "DFC_ComChksTCU4" 304 "DFC_ComCntTCU1" 305 "DFC_ComCntTCU11" 306 "DFC_ComCntTCU12" 307 "DFC_ComCntTCU13" 308 "DFC_ComCntTCU2" 309 "DFC_ComCntTCU3" 310 "DFC_ComCntTCU4" 311 "DFC_ComTOutTCU01" 312 "DFC_ComTOutTCU02" 313 "DFC_ComTOutTCU1" 314 "DFC_ComTOutTCU11" 315 "DFC_ComTOutTCU12" 316 "DFC_ComTOutTCU13" 317 "DFC_ComTOutTCU14" 318 "DFC_ComTOutTCU2" 319 "DFC_ComTOutTCU3" 320 "DFC_ComTOutTCU4" 321 "DFC_DevLibBattUHi" 322 "DFC_DevLibBattULo" 323 "DFC_EGRVlvFailSafeActv" 324 "DFC_EGRVlvGovDvtCld" 325 "DFC_EGRVlvPhysSRCMax" 326 "DFC_EGRVlvPhysSRCMin" 327 "DFC_FanDIOOL_0" 328 "DFC_FanDIOOL_1" 329 "DFC_FanDIOOvrTemp_0" 330 "DFC_FanDIOOvrTemp_1" 331 "DFC_FanDIOSCB_0" 332 "DFC_FanDIOSCB_1" 333 "DFC_FanDIOSCG_0" 334 "DFC_FanDIOSCG_1" 335 "DFC_MRlyDcOL" 336 "DFC_MRlyDcSCB" 337 "DFC_MRlyDcSCG" 338 "DFC_PSPOL" 339 "DFC_PSPOvrTemp" 340 "DFC_PSPSCB" 341 "DFC_PSPSCG" 342 "DFC_T50Err" 343 "DFC_ThrVlvLoBattB1" 344 "DFC_UegoSigOperPlausS1B1" 345 "DFC_VehVPhysRngHi" 346 "DFC_VehVSclOutOL" 347 "DFC_VehVSclOutOT" 348 "DFC_VehVSclOutSCB" 349 "DFC_VehVSclOutSCG" 350 "DFC_VehVSigFL" 351 "DFC_VehVSigFR" 352 "DFC_VehVSigRL" 353 "DFC_VehVSigRR" 354 "DFC_VehVSnsrARngHi" 355 "DFC_VehVSnsrBRngHi" 356 "DFC_VehVSpdRtyDiag" 357 "DFC_DHFHD" 358 "DFC_InjVlv_DI_DcDc" 359 "DFC_InjVlv_DI_NoLd_0" 360 "DFC_InjVlv_DI_NoLd_1" 361 "DFC_InjVlv_DI_NoLd_2" 362 "DFC_InjVlv_DI_NoLd_3" 363 "DFC_InjVlv_DI_ScBnk_0" 364 "DFC_InjVlv_DI_ScBnk_1" 365 "DFC_InjVlv_DI_ScBnk_2" 366 "DFC_InjVlv_DI_ScBnk_3" 367 "DFC_InjVlv_DI_ScCyl_0" 368 "DFC_InjVlv_DI_ScCyl_1" 369 "DFC_InjVlv_DI_ScCyl_2" 370 "DFC_InjVlv_DI_ScCyl_3" 371 "DFC_InjVlv_DI_ScHsLs_0" 372 "DFC_InjVlv_DI_ScHsLs_1" 373 "DFC_InjVlv_DI_ScHsLs_2" 374 "DFC_InjVlv_DI_ScHsLs_3" 375 "DFC_MfPsDiaOpenLoad1" 376 "DFC_MfPsDiaScHiS1" 377 "DFC_MfPsDiaScHiSLowS1" 378 "DFC_MfPsDiaScLowS1" 379 "DFC_ACEvpTPhysRngHi" 380 "DFC_ACEvpTPhysRngLo" 381 "DFC_ACEvpTSRCMax" 382 "DFC_ACEvpTSRCMin" 383 "DFC_AfsRawSigRngHiB1" 384 "DFC_AfsRawSigRngLoB1" 385 "DFC_AfsSnsrErrB1" 386 "DFC_AirCClntPAnaSRCMax" 387 "DFC_AirCClntPAnaSRCMin" 388 "DFC_AirCSwtNpl" 389 "DFC_AirCSwtSig" 390 "DFC_Brk" 391 "DFC_BrkBstSensSCB" 392 "DFC_BrkBstSensSCG" 393 "DFC_BrkSig" 394 "DFC_ClthSig" 395 "DFC_EGRVlvCurrLim" 396 "DFC_EGRVlvOL" 397 "DFC_EGRVlvOvrTemp" 398 "DFC_EGRVlvSCB" 399 "DFC_EGRVlvSCG" 400 "DFC_EGRVlvSRCMax" 401 "DFC_EGRVlvSRCMin" 402 "DFC_HLSDemOvhtEngLim" 403 "DFC_OilPSwmpSRCMax" 404 "DFC_OilPSwmpSRCMin" 405 "DFC_PIntkVUsLineHiB1" 406 "DFC_PIntkVUsLineLoB1" 407 "DFC_VehVPhysRngLo" 408 "DFC_VehVSigCan" 409 "DFC_VehVSigCanSafe" 410 "DFC_VlvLftFbOilPSnsrIntk11SRCMax" 411 "DFC_VlvLftFbOilPSnsrIntk11SRCMin" 412 "DFC_ClthNpl" 413 "DFC_GbxPNPosnDrvCdn" 414 "DFC_GbxPNPosnPlausy" 415 "DFC_AfsSigErrLineHiB1" 416 "DFC_AfsSigErrLineLoB1" 417 "DFC_PEnvCcMax" 418 "DFC_PEnvCcMin" 419 "DFC_PEnvRngChkMax" 420 "DFC_PEnvRngChkMin" 421 "DFC_PEnvSnsrPlaus" 422 "DFC_UEGOHeatrRlyPsOLS1B1" 423 "DFC_UEGOHeatrRlyPsSCBS1B1" 424 "DFC_UEGOHeatrRlyPsSCGS1B1" 425 "DFC_UegoHeatrWireOlS1B1" 426 "DFC_UegoHeatrWireScbS1B1" 427 "DFC_UegoHeatrWireScgS1B1" 428 "DFC_KnDetSens1PortAMax" 429 "DFC_KnDetSens1PortAMin" 430 "DFC_KnDetSens1PortBMax" 431 "DFC_KnDetSens1PortBMin" 432 "DFC_Clth2ONStuck" 433 "DFC_Clth2ONStuckLdc" 434 "DFC_Clth3ONStuckLdc" 435 "DFC_Clth3ONStuckPostDrv" 436 "DFC_Clth4ONStuck" 437 "DFC_Clth4ONStuckLdc" 438 "DFC_ComBCMUnit" 439 "DFC_ComDLCTCU01" 440 "DFC_ComDLCTCU02" 441 "DFC_ComDLCTCU1" 442 "DFC_ComDLCTCU11" 443 "DFC_ComDLCTCU12" 444 "DFC_ComDLCTCU13" 445 "DFC_ComDLCTCU14" 446 "DFC_ComDLCTCU2" 447 "DFC_ComDLCTCU3" 448 "DFC_ComDLCTCU4" 449 "DFC_ComEPSUnit" 450 "DFC_ComIDASBUnit" 451 "DFC_ComIMGUnit" 452 "DFC_ComMETUnit" 453 "DFC_ComSRSUnit" 454 "DFC_ComVSAUnit" 455 "DFC_EbsSocFlt" 456 "DFC_I14229VINErr" 457 "DFC_InjCatHeatgErr" 458 "DFC_InjSysMulInjDiagErr" 459 "DFC_LLRHmax" 460 "DFC_LLRHmin" 461 "DFC_LLRHnpl" 462 "DFC_LLRKHmax" 463 "DFC_LLRKHmin" 464 "DFC_LLRKHnpl" 465 "DFC_LinACGUnit" 466 "DFC_LinAEVUnit" 467 "DFC_LinEBSUnit" 468 "DFC_RoughRoad" 469 "DFC_SiaEEPRdErr" 470 "DFC_SiaEEPWrngCod" 471 "DFC_UegoHeatrStrtS1B1" 472 "DFC_BusDiagCANAPPLBusOff" 473 "DFC_BusDiagCANCANCBusOff" 474 "DFC_BusDiagCANVEHICLEBusOff" 475 "DFC_RBA_IODIAGPWR_rba_IoExtCy329_SignalVltSply_0" 476 "DFC_RBA_IODIAGPWR_rba_IoExtCy329_SignalVltSply_0OT" 477 "DFC_RBA_IODIAGPWR_rba_IoExtCy329_SignalVltSply_0OV" 478 "DFC_RBA_IODIAGPWR_rba_IoExtCy329_SignalVltSply_0SCG" 479 "DFC_RBA_IODIAGPWR_rba_IoExtCy329_SignalVltSply_0UV" 480 "DFC_RBA_IODIAGPWR_rba_IoExtCy329_SignalVltSply_1" 481 "DFC_RBA_IODIAGPWR_rba_IoExtCy329_SignalVltSply_1OT" 482 "DFC_RBA_IODIAGPWR_rba_IoExtCy329_SignalVltSply_1OV" 483 "DFC_RBA_IODIAGPWR_rba_IoExtCy329_SignalVltSply_1SCG" 484 "DFC_RBA_IODIAGPWR_rba_IoExtCy329_SignalVltSply_1UV" 485 "DFC_RBA_IODIAGPWR_rba_IoExtCy329_SignalVltSply_2" 486 "DFC_RBA_IODIAGPWR_rba_IoExtCy329_SignalVltSply_2OT" 487 "DFC_RBA_IODIAGPWR_rba_IoExtCy329_SignalVltSply_2OV" 488 "DFC_RBA_IODIAGPWR_rba_IoExtCy329_SignalVltSply_2SCG" 489 "DFC_RBA_IODIAGPWR_rba_IoExtCy329_SignalVltSply_2UV" 490 "DFC_CAN_E_TIMEOUT" 491 "DFC_LIN_E_TIMEOUT" 492 "DFC_MRlyOL" 493 "DFC_MRlySCB" 494 "DFC_MRlySCG" 495 "DFC_rba_MultiStackTrace_Threshold" 496 "DFC_BSWM_E_ACTION_FAILED" 497 "DFC_BSWM_E_INTRPTQUEUE_FULL" 498 "DFC_RBA_IOEXTLIB_KEEPALIVE_DRV" 499 "DFC_RBA_IOEXTLIB_KEEPALIVE_INI" 500 "DFC_rba_IoSigRtc_StopCounter" 501 "DFC_rba_MRly_Diag_Stk_Event" 502 "DFC_rba_MemDiag_MemReadErr" 503 "DFC_rba_MemDiag_MemWrErr" 504 "DFC_rba_SyC_IrrSwOffTrigEngRun_Event" 505 "DFC_rba_T15_Diag_ComInVld_Event" 506 "DFC_rba_T15_Diag_ComOff_HwOn_Event" 507 "DFC_rba_T15_Diag_ComOn_HwOff_Event" 508 "DFC_AAVmin" 509 "DFC_AGRSUS" 510 "DFC_AfsPlausDiagHi" 511 "DFC_AfsPlausDiagLo" 512 "DFC_AfsVrntDiagErrB1" 513 "DFC_AppAllSnsrDfct" 514 "DFC_BBKRnldg" 515 "DFC_BBKRsyne" 516 "DFC_BattUStdbyDiaOL" 517 "DFC_BigLeakIntkMnfldEmiInfl" 518 "DFC_BlkdLineTank" 519 "DFC_BrkMnSwtContOnWarnLmp" 520 "DFC_BrkMnSwtNotStpWarnLmp" 521 "DFC_BrkRdntSwtContOnWarnLmp" 522 "DFC_BrkRdntSwtNotStpWarnLmp" 523 "DFC_CEngDsTColdStrtMax" 524 "DFC_CEngDsTColdStrtMin" 525 "DFC_CEngDsTImps" 526 "DFC_CEngDsTPlausHSC" 527 "DFC_CEngDsTPlausLSC" 528 "DFC_CEngDsTPlausSTC" 529 "DFC_CEngDsTSRCMax" 530 "DFC_CEngDsTSRCMin" 531 "DFC_CEngDsTSig" 532 "DFC_CEngUsTColdStrtMax" 533 "DFC_CEngUsTColdStrtMin" 534 "DFC_CEngUsTLooseCnctn" 535 "DFC_CEngUsTSRCMax" 536 "DFC_CEngUsTSRCMin" 537 "DFC_ComDCDCACCFailr" 538 "DFC_DCDCFltDet" 539 "DFC_DKRSA" 540 "DFC_DKVSmax" 541 "DFC_DKnpl" 542 "DFC_DSKVRmax" 543 "DFC_DSKVRmin" 544 "DFC_DSKVRnpl" 545 "DFC_DSKVRsig" 546 "DFC_DSKVSsig" 547 "DFC_DSSmax" 548 "DFC_DSTDmax" 549 "DFC_DSTEmax" 550 "DFC_DSTEmin" 551 "DFC_DSTOFmax" 552 "DFC_DSTRmax" 553 "DFC_DSTRmin" 554 "DFC_DSTRnpl" 555 "DFC_DSTRsig" 556 "DFC_DSTTI" 557 "DFC_DSUmax" 558 "DFC_DiagCpv1DteskLoLoadStuckClsd" 559 "DFC_DiagCpv1DteskLoLoadStuckOpen" 560 "DFC_EGRVlvDrftClsd" 561 "DFC_EGRVlvDrftOpn" 562 "DFC_EGRVlvJamVlvClsd" 563 "DFC_EGRVlvJamVlvOpn" 564 "DFC_EGRVlvSprgBrk" 565 "DFC_EGRVlvTempMdlEEPErr" 566 "DFC_EGRVlvTmpErr" 567 "DFC_EGSDUS2B1LtrDly" 568 "DFC_EGSDUS2B1LtrPT1" 569 "DFC_EGSDUS2B1RtlDly" 570 "DFC_EGSDUS2B1RtlPT1" 571 "DFC_EGSDUS2B1TarLean" 572 "DFC_EGSDUS2B1TarRich" 573 "DFC_EONVmax" 574 "DFC_ETAKHLmax" 575 "DFC_ETAKHTmax" 576 "DFC_ETHSEmax" 577 "DFC_ETHSEmin" 578 "DFC_ETHSFmax" 579 "DFC_ETHSFmin" 580 "DFC_ETHSFsig" 581 "DFC_ETHSNPWmax" 582 "DFC_ETHSNPWmin" 583 "DFC_ETHSNPWsig" 584 "DFC_ETHSPLnpl" 585 "DFC_ETHSTPLnpl" 586 "DFC_EngICO" 587 "DFC_EngPrtOvrSpdMon" 588 "DFC_EpmCaSI1ErrSig" 589 "DFC_EpmCaSI1MntErr" 590 "DFC_EpmCaSI1NoSigMax" 591 "DFC_EpmCaSI1NoSigMin" 592 "DFC_EpmCaSI1OfsErr" 593 "DFC_EpmCrSDGI" 594 "DFC_EpmCrSErrSig" 595 "DFC_EpmCrSNoSig" 596 "DFC_EtaEngIdleNonCsers" 597 "DFC_EtaEngPtlNonCsers" 598 "DFC_FRAmax" 599 "DFC_FRAmin" 600 "DFC_FSTEmax" 601 "DFC_FSTEmin" 602 "DFC_FSTRmax" 603 "DFC_FSTRmin" 604 "DFC_FSTRnpl" 605 "DFC_FSTmax" 606 "DFC_FTDLAmax" 607 "DFC_FTDLAmin" 608 "DFC_FuPHiSnsrEleclmax" 609 "DFC_FuPHiSnsrEleclmin" 610 "DFC_FuPHiSnsrEleclnpl" 611 "DFC_FuPHiSnsrURngMax" 612 "DFC_FuPHiSnsrURngMin" 613 "DFC_FuSnsrPhyRngMaxErr" 614 "DFC_FuSnsrPhyRngMinErr" 615 "DFC_GEVlvLockPinDiagIntkB1" 616 "DFC_GEVlvPhaSlowIntkB1" 617 "DFC_GEVlvPhaTargIntkB1" 618 "DFC_GbxRvsSwtStk" 619 "DFC_HDRKHmax" 620 "DFC_HDRKHmin" 621 "DFC_HDRPLmax" 622 "DFC_HDRPLmin" 623 "DFC_HDRmax" 624 "DFC_HDRmin" 625 "DFC_HEGOS2B1ElecMax" 626 "DFC_HEGOS2B1ElecMin" 627 "DFC_HEGOS2B1ElecSig" 628 "DFC_HEGOS2B1HtgNpl" 629 "DFC_HEV00max" 630 "DFC_HEV01max" 631 "DFC_HEV02max" 632 "DFC_HEV03max" 633 "DFC_HEVE0max" 634 "DFC_HEVE1max" 635 "DFC_HFMmax" 636 "DFC_HiPSysHiPMaxLimExcdd" 637 "DFC_IVGdiCtlCvoErrMax_0" 638 "DFC_IVGdiCtlCvoErrMax_1" 639 "DFC_IVGdiCtlCvoErrMax_2" 640 "DFC_IVGdiCtlCvoErrMax_3" 641 "DFC_IVGdiCtlCvoErrMin_0" 642 "DFC_IVGdiCtlCvoErrMin_1" 643 "DFC_IVGdiCtlCvoErrMin_2" 644 "DFC_IVGdiCtlCvoErrMin_3" 645 "DFC_IVGdiCtlCvoErrMinMax" 646 "DFC_IVGdiCtlCvoSigPlausErrSmrCdn" 647 "DFC_IVGdiCtl_CvoErr" 648 "DFC_IVGdiCtl_CvoSigPlaus_0" 649 "DFC_IVGdiCtl_CvoSigPlaus_1" 650 "DFC_IVGdiCtl_CvoSigPlaus_2" 651 "DFC_IVGdiCtl_CvoSigPlaus_3" 652 "DFC_IntkAirTAirFltDsCrssMax" 653 "DFC_IntkAirTAirFltDsCrssMin" 654 "DFC_IntkAirTAirFltDsHSCMax" 655 "DFC_IntkAirTAirFltDsImps" 656 "DFC_IntkAirTAirFltDsPRCMax" 657 "DFC_IntkAirTAirFltDsPRCMin" 658 "DFC_IntkAirTAirFltDsSRCMax" 659 "DFC_IntkAirTAirFltDsSRCMin" 660 "DFC_IntkAirTAirFltDsSTC" 661 "DFC_IntkAirTIntkMnfldCrssMax" 662 "DFC_IntkAirTIntkMnfldCrssMin" 663 "DFC_IntkAirTIntkMnfldHSCMax" 664 "DFC_IntkAirTIntkMnfldImps" 665 "DFC_IntkAirTIntkMnfldPRCMax" 666 "DFC_IntkAirTIntkMnfldPRCMin" 667 "DFC_IntkAirTIntkMnfldSRCMax" 668 "DFC_IntkAirTIntkMnfldSRCMin" 669 "DFC_IntkAirTIntkMnfldSTC" 670 "DFC_KRREGRLMX" 671 "DFC_KRVEKOCVLCI" 672 "DFC_KRVEKOENCHMT" 673 "DFC_KRVEKOENCHMT0" 674 "DFC_KRVEKOENCHMT1" 675 "DFC_KRVEKOENCHMT2" 676 "DFC_KRVEKOENCHMT3" 677 "DFC_KRVEKOENCHMT4" 678 "DFC_KRVEKOENCHMT5" 679 "DFC_KRVEKOENCHMT6" 680 "DFC_KRVEKOENCHMT7" 681 "DFC_KRVEKORLMX" 682 "DFC_KRVEKORLMXL" 683 "DFC_KS1max" 684 "DFC_KS1min" 685 "DFC_LMmax" 686 "DFC_LZSRnpl" 687 "DFC_LamDynDiagS1B1" 688 "DFC_LeakIntkMnfldEmiInfl" 689 "DFC_LinFrameErrDCDC" 690 "DFC_LinOverrunErrDCDC" 691 "DFC_MD00max" 692 "DFC_MDBmax" 693 "DFC_MDCat" 694 "DFC_MDCatCrit" 695 "DFC_MDCatCurr" 696 "DFC_MDCyl_0" 697 "DFC_MDCyl_1" 698 "DFC_MDCyl_2" 699 "DFC_MDCyl_3" 700 "DFC_MDEmi" 701 "DFC_MDEmiStrt" 702 "DFC_MDFco" 703 "DFC_MDMpl" 704 "DFC_MDSegTiAdpn" 705 "DFC_MDmax" 706 "DFC_MFuOilMax" 707 "DFC_MOXEMM_SMU_ALM0_0" 708 "DFC_MOXEMM_SMU_ALM0_1" 709 "DFC_MOXEMM_SMU_ALM0_10" 710 "DFC_MOXEMM_SMU_ALM0_11" 711 "DFC_MOXEMM_SMU_ALM0_13" 712 "DFC_MOXEMM_SMU_ALM0_14" 713 "DFC_MOXEMM_SMU_ALM0_2" 714 "DFC_MOXEMM_SMU_ALM0_22" 715 "DFC_MOXEMM_SMU_ALM0_23" 716 "DFC_MOXEMM_SMU_ALM0_4" 717 "DFC_MOXEMM_SMU_ALM0_5" 718 "DFC_MOXEMM_SMU_ALM0_7" 719 "DFC_MOXEMM_SMU_ALM0_8" 720 "DFC_MOXEMM_SMU_ALM10_16" 721 "DFC_MOXEMM_SMU_ALM10_17" 722 "DFC_MOXEMM_SMU_ALM10_21" 723 "DFC_MOXEMM_SMU_ALM11_0" 724 "DFC_MOXEMM_SMU_ALM11_1" 725 "DFC_MOXEMM_SMU_ALM11_2" 726 "DFC_MOXEMM_SMU_ALM11_3" 727 "DFC_MOXEMM_SMU_ALM11_4" 728 "DFC_MOXEMM_SMU_ALM11_5" 729 "DFC_MOXEMM_SMU_ALM11_8" 730 "DFC_MOXEMM_SMU_ALM11_9" 731 "DFC_MOXEMM_SMU_ALM1_0" 732 "DFC_MOXEMM_SMU_ALM1_1" 733 "DFC_MOXEMM_SMU_ALM1_10" 734 "DFC_MOXEMM_SMU_ALM1_11" 735 "DFC_MOXEMM_SMU_ALM1_13" 736 "DFC_MOXEMM_SMU_ALM1_14" 737 "DFC_MOXEMM_SMU_ALM1_2" 738 "DFC_MOXEMM_SMU_ALM1_22" 739 "DFC_MOXEMM_SMU_ALM1_23" 740 "DFC_MOXEMM_SMU_ALM1_4" 741 "DFC_MOXEMM_SMU_ALM1_5" 742 "DFC_MOXEMM_SMU_ALM1_7" 743 "DFC_MOXEMM_SMU_ALM1_8" 744 "DFC_MOXEMM_SMU_ALM21_0" 745 "DFC_MOXEMM_SMU_ALM21_16" 746 "DFC_MOXEMM_SMU_ALM21_3" 747 "DFC_MOXEMM_SMU_ALM2_1" 748 "DFC_MOXEMM_SMU_ALM2_10" 749 "DFC_MOXEMM_SMU_ALM2_11" 750 "DFC_MOXEMM_SMU_ALM2_13" 751 "DFC_MOXEMM_SMU_ALM2_14" 752 "DFC_MOXEMM_SMU_ALM2_22" 753 "DFC_MOXEMM_SMU_ALM2_23" 754 "DFC_MOXEMM_SMU_ALM2_4" 755 "DFC_MOXEMM_SMU_ALM2_5" 756 "DFC_MOXEMM_SMU_ALM2_7" 757 "DFC_MOXEMM_SMU_ALM2_8" 758 "DFC_MOXEMM_SMU_ALM6_0" 759 "DFC_MOXEMM_SMU_ALM6_11" 760 "DFC_MOXEMM_SMU_ALM6_12" 761 "DFC_MOXEMM_SMU_ALM6_14" 762 "DFC_MOXEMM_SMU_ALM6_15" 763 "DFC_MOXEMM_SMU_ALM6_17" 764 "DFC_MOXEMM_SMU_ALM6_18" 765 "DFC_MOXEMM_SMU_ALM6_20" 766 "DFC_MOXEMM_SMU_ALM6_21" 767 "DFC_MOXEMM_SMU_ALM6_25" 768 "DFC_MOXEMM_SMU_ALM6_4" 769 "DFC_MOXEMM_SMU_ALM6_5" 770 "DFC_MOXEMM_SMU_ALM6_7" 771 "DFC_MOXEMM_SMU_ALM6_8" 772 "DFC_MOXEMM_SMU_ALM7_1" 773 "DFC_MOXEMM_SMU_ALM7_12" 774 "DFC_MOXEMM_SMU_ALM7_13" 775 "DFC_MOXEMM_SMU_ALM7_14" 776 "DFC_MOXEMM_SMU_ALM7_15" 777 "DFC_MOXEMM_SMU_ALM7_16" 778 "DFC_MOXEMM_SMU_ALM7_17" 779 "DFC_MOXEMM_SMU_ALM7_2" 780 "DFC_MOXEMM_SMU_ALM7_20" 781 "DFC_MOXEMM_SMU_ALM7_25" 782 "DFC_MOXEMM_SMU_ALM7_26" 783 "DFC_MOXEMM_SMU_ALM7_28" 784 "DFC_MOXEMM_SMU_ALM7_29" 785 "DFC_MOXEMM_SMU_ALM7_30" 786 "DFC_MOXEMM_SMU_ALM7_31" 787 "DFC_MOXEMM_SMU_ALM8_0" 788 "DFC_MOXEMM_SMU_ALM8_1" 789 "DFC_MOXEMM_SMU_ALM8_10" 790 "DFC_MOXEMM_SMU_ALM8_11" 791 "DFC_MOXEMM_SMU_ALM8_12" 792 "DFC_MOXEMM_SMU_ALM8_16" 793 "DFC_MOXEMM_SMU_ALM8_18" 794 "DFC_MOXEMM_SMU_ALM8_2" 795 "DFC_MOXEMM_SMU_ALM8_3" 796 "DFC_MOXEMM_SMU_ALM8_31" 797 "DFC_MOXEMM_SMU_ALM8_4" 798 "DFC_MOXEMM_SMU_ALM9_0" 799 "DFC_MOXEMM_SMU_ALM9_15" 800 "DFC_MOXEMM_SMU_ALM9_3" 801 "DFC_MoCADCNTP" 802 "DFC_MoCADCTst" 803 "DFC_MoCSOPICO" 804 "DFC_MoFAPP" 805 "DFC_MoFAirFilgPrdc" 806 "DFC_MoFAirFlCtOffGdi" 807 "DFC_MoFAirFlCylGdi" 808 "DFC_MoFAirFlFF" 809 "DFC_MoFAirFlIn" 810 "DFC_MoFAirFlMixCtlGdiChkAirFl" 811 "DFC_MoFAirFlMixCtlGdiChkCtrl" 812 "DFC_MoFAirFlMode" 813 "DFC_MoFESpd" 814 "DFC_MoFIACo" 815 "DFC_MoFICOL1" 816 "DFC_MoFICOL2" 817 "DFC_MoFStrt" 818 "DFC_MoFTrqCmp" 819 "DFC_MoFTrqCmpMax" 820 "DFC_MoFTrqCmpMin" 821 "DFC_MoFVarPostBldSel" 822 "DFC_MoXEMMHwLTMCUFW" 823 "DFC_MoXEMMHwLTMonBIST" 824 "DFC_MoXEMMHwLTRegMonTest" 825 "DFC_MoXEMMHwLTStbySMUAlvTest" 826 "DFC_MoXEMMHwLTTempSens" 827 "DFC_MoXEMMHwLTUCBCfg" 828 "DFC_NWSEmax" 829 "DFC_NWSmax" 830 "DFC_OCWDAABEActv" 831 "DFC_OCWDACom" 832 "DFC_OCWDAErrPin" 833 "DFC_OCWDAOvrVltg" 834 "DFC_ORAmax" 835 "DFC_ORAmin" 836 "DFC_OilPPlaus" 837 "DFC_PLLSUmax" 838 "DFC_PLLSUmin" 839 "DFC_PSR1max" 840 "DFC_PSRBmax" 841 "DFC_PSRBmin" 842 "DFC_PSRPmax" 843 "DFC_PSRPmin" 844 "DFC_PSRPsig" 845 "DFC_PSRmax" 846 "DFC_PUmax" 847 "DFC_P_VSE11_OL" 848 "DFC_P_VSE11_SCB" 849 "DFC_P_VSE11_SCG" 850 "DFC_PhyHighAPP1" 851 "DFC_PhyHighAPP2" 852 "DFC_PhyLowAPP1" 853 "DFC_PhyLowAPP2" 854 "DFC_SRCHighAPP1" 855 "DFC_SRCHighAPP2" 856 "DFC_SRCLowAPP1" 857 "DFC_SRCLowAPP2" 858 "DFC_SSpMon2" 859 "DFC_STHDRmax" 860 "DFC_SWReset_0" 861 "DFC_SWReset_1" 862 "DFC_SWReset_2" 863 "DFC_SyncAPP" 864 "DFC_TANKLnpl" 865 "DFC_TAmax_Dummy" 866 "DFC_TESFmax" 867 "DFC_TESGmax" 868 "DFC_TKAEmax" 869 "DFC_TKAEmin" 870 "DFC_TKARmax" 871 "DFC_TKARnpl" 872 "DFC_TMmax_Dummy" 873 "DFC_TUMmax_Dummy" 874 "DFC_TWCDPriCatB1" 875 "DFC_ThrVlvClsdPosnFirstOffsLrnImpoB1" 876 "DFC_ThrVlvClsdPosnOffsLrnImpoB1" 877 "DFC_ThrVlvClsdPosnOffsLrnMaxB1" 878 "DFC_ThrVlvClsdPosnOffsLrnMinB1" 879 "DFC_ThrVlvCtrlDeB1" 880 "DFC_ThrVlvDycB1" 881 "DFC_ThrVlvLimpAirPosnMaxAbsltDriftB1" 882 "DFC_ThrVlvLimpAirPosnMaxB1" 883 "DFC_ThrVlvLimpAirPosnMaxRelDriftB1" 884 "DFC_ThrVlvLimpAirPosnMinB1" 885 "DFC_ThrVlvOpenLoadB1" 886 "DFC_ThrVlvOpenSprgB1" 887 "DFC_ThrVlvOpenSprgSprdB1" 888 "DFC_ThrVlvOpenSprgTwnB1" 889 "DFC_ThrVlvOverTB1" 890 "DFC_ThrVlvRetSprgB1" 891 "DFC_ThrVlvRetSprgSprdB1" 892 "DFC_ThrVlvRetSprgTwnB1" 893 "DFC_ThrVlvSens1MaxB1" 894 "DFC_ThrVlvSens1NplB1" 895 "DFC_ThrVlvSens2MaxB1" 896 "DFC_ThrVlvSens2MinB1" 897 "DFC_ThrVlvSens2NplB1" 898 "DFC_ThrVlvShoCircB1" 899 "DFC_ThrVlvSpiErrB1" 900 "DFC_ThrvlvSens1MinB1" 901 "DFC_TiOffTBasdChkFast" 902 "DFC_TiOffTBasdChkSlow" 903 "DFC_UEGOSnsrMntdS1B1" 904 "DFC_VehVSig" 905 "DFC_VlvLftFbSwtIntk11SpclFail" 906 "DFC_VlvLftFbSwtIntk11StdFail" 907 "DSQ_ACClntP" 908 "DSQ_ACEvpT" 909 "DSQ_AirCCmprActr" 910 "DSQ_BattU" 911 "DSQ_BattULo" 912 "DSQ_BrkBstPMdl" 913 "DSQ_BrkP" 914 "DSQ_BrkPSnsr" 915 "DSQ_CoVMDIDASFail" 916 "DSQ_DSMInhibitAlways" 917 "DSQ_EGRVlv_GovDesVal" 918 "DSQ_ElecLd" 919 "DSQ_EngICO" 920 "DSQ_EpmCaSSigQuality" 921 "DSQ_EpmReverseRun" 922 "DSQ_FanDIO_0" 923 "DSQ_FanDIO_1" 924 "DSQ_FuelP" 925 "DSQ_FuelT" 926 "DSQ_GEVCtlTOilCylHd" 927 "DSQ_GEVlvAgIntkB1" 928 "DSQ_GbxPNPos" 929 "DSQ_GbxPosNotPN" 930 "DSQ_InjVlv_DI_CylOk" 931 "DSQ_MRly" 932 "DSQ_OilP" 933 "DSQ_PEnvMeasVld" 934 "DSQ_PEnvVld" 935 "DSQ_PEnv_pRaw" 936 "DSQ_PRail" 937 "DSQ_PThrVlvUs" 938 "DSQ_PThrVlvUsB1" 939 "DSQ_StrtImobChk" 940 "DSQ_TDevCenColdStrt" 941 "DSQ_VehV" 942 "DSQ_VehVSens" 943 "DSQ_VehVSnsr" 944 "DSQ_stAPP" 945 "DSQ_stComEAT4" 65535 "Inhibited_Trip" DEFAULT_VALUE "---" /end COMPU_VTAB
/begin COMPU_METHOD DFC_OneToOne "" RAT_FUNC "%6.2" "-" COEFFS 0 1 0 0 0 1 /end COMPU_METHOD
/begin COMPU_METHOD DINH_FIdVerb "" TAB_VERB "%6.3" "-" COMPU_TAB_REF DINH_FIdVerb /end COMPU_METHOD
/begin COMPU_VTAB DINH_FIdVerb "" TAB_VERB 969 0 "FId_Unused" 1 "FID_AFRA" 2 "FID_AORA" 3 "FID_ATEH" 4 "FID_ATEL" 5 "FID_ATEN" 6 "FID_ATLDI" 7 "FID_ATLDO" 8 "FID_BEONV" 9 "FId_EGSDCmnSeg1B1Parl" 10 "FID_BAGRA" 11 "FID_BAGRASD" 12 "FID_BDSTOF" 13 "FID_BFVDFRM" 14 "FID_BHOM" 15 "FID_BLLRH" 16 "FID_BLLRKH" 17 "FID_BPLSU" 18 "FID_FRAMBAVMB" 19 "FId_CatHeatgColdStrtReq" 20 "FId_CatHeatgWrmReq" 21 "FId_DSMBDEPHSpOpMode" 22 "FId_EGRVlvCoord" 23 "FId_EGSDO2FuTrmB1" 24 "FId_EGSDO2SnsrMntdRelsS1B1" 25 "FId_EGSDO2_LamOffsFastS1B1" 26 "FId_MisfDetDnAdpnNv" 27 "FId_bascadpncvo" 28 "FID_AGRS" 29 "FID_BBAGR" 30 "FID_BBAGRA" 31 "FID_BGFKMS" 32 "FID_BGMSDKS" 33 "FID_CAGRSUS" 34 "FID_CBGTFUELM" 35 "FID_CBGTHDEV" 36 "FID_CDESVF" 37 "FID_CDETHS" 38 "FID_CDRCTSTRT" 39 "FID_CDSKV" 40 "FID_CDSKVRNO" 41 "FID_CDSKVRPO" 42 "FID_CDSKVRaty" 43 "FID_CDSKVRng" 44 "FID_CDSKVS" 45 "FID_CDSTR" 46 "FID_CDSTTI" 47 "FID_CETHG" 48 "FID_CETHSPLnpl" 49 "FID_CETHSTPLnpl" 50 "FID_CETKHL" 51 "FID_CETKHT" 52 "FID_CGDISTRT" 53 "FID_CGLSRDP" 54 "FID_CHDR" 55 "FID_CHDRKH" 56 "FID_CHDRPL" 57 "FID_CLLKHV" 58 "FID_CLLRHV" 59 "FID_CLZSRDP" 60 "FID_CLZSRHP" 61 "FID_CNLHP" 62 "FID_CNLHP2" 63 "FID_CNLKO2" 64 "FID_CNLKO3" 65 "FID_CNLLP" 66 "FID_CNLPL" 67 "FID_CNLPS" 68 "FID_CNSAD" 69 "FID_CNSAD2" 70 "FID_CPSRB" 71 "FID_CPSRP" 72 "FID_CSTHDR" 73 "FID_CSTRTCTL" 74 "FID_CTESF" 75 "FID_CTESG" 76 "FID_CTHIPSTRT" 77 "FID_CTKACS" 78 "FID_CTMSV" 79 "FID_CTOSP" 80 "FID_DHFERR" 81 "FID_DKRSA" 82 "FID_DLLRBandEndTst" 83 "FID_DLLRShrtTrpSpdRmp" 84 "FID_FEDKAHB" 85 "FID_FEDKAPB" 86 "FID_FEDSSB" 87 "FID_FOFSTP" 88 "FID_FONSTP" 89 "FID_FUEDK" 90 "FID_FVLRA" 91 "FID_KRREGact" 92 "FID_KRREGloc" 93 "FID_LRADLSU" 94 "FID_LRALSVErr" 95 "FID_LRAPLLSU" 96 "FID_LUSTP" 97 "FID_LnKS1" 98 "FID_PLSUV" 99 "FID_PSRMOZDG" 100 "FID_PSRMOZG" 101 "FID_STRTDIA" 102 "FID_STRTSTM" 103 "FID_TFA1CSMW" 104 "FID_TFA2CSMW" 105 "FID_TKACSMW" 106 "FID_TMCSMW" 107 "FID_TOCHOilSwmpTQly" 108 "FID_TOCHTME" 109 "FID_TOSPCSMW" 110 "FID_TSRLX" 111 "FID_UEGOHeatrRlyS1B1" 112 "FID_VehStvSSEOk" 113 "FID_VldtLamPlausMaxS1B1" 114 "FID_VldtLamPlausMinS1B1" 115 "FId_ACClntPSSPMon" 116 "FId_ACCompComCANBusOff" 117 "FId_ACCompComCANErrMtr" 118 "FId_ACComp_HiUTWSnsrErr" 119 "FId_ACComp_LoUTWSnsrErr" 120 "FId_ACComp_PDSnsrErr" 121 "FId_ACComp_VehSpdSnsrErr" 122 "FId_ACCtl_ACStrtCut" 123 "FId_ACCtl_APP1" 124 "FId_ACCtl_APP2" 125 "FId_ACCtl_APPSync" 126 "FId_ACCtl_AcOff" 127 "FId_ACCtl_Clmb" 128 "FId_ACCtl_DK1" 129 "FId_ACCtl_DK2" 130 "FId_ACCtl_DKSync" 131 "FId_ACCtl_VehSpdSnsrErr" 132 "FId_ACCtl_pAC" 133 "FId_ACEvpTCANErr" 134 "FId_ACEvpTFrzVal" 135 "FId_ACEvpTPhysRng" 136 "FId_ACEvpTRplVal" 137 "FId_AFCLFailr" 138 "FId_AFS" 139 "FId_AFSPhyRng" 140 "FId_APP1SigPath" 141 "FId_APP2SigPath" 142 "FId_APPBrkErr" 143 "FId_APPLETVldnErr" 144 "FId_APPLrn" 145 "FId_APPVehVErr" 146 "FId_AccPedDrvModComErr" 147 "FId_AccPedDrvModFailr" 148 "FId_AccPedNMaxLim" 149 "FId_AccPedNMinLim" 150 "FId_AccPedNMinLimBrkApp" 151 "FId_AccPedTrqLim" 152 "FId_AfsDdDiag" 153 "FId_AfsDiagErr" 154 "FId_AfsDiagTst" 155 "FId_AfsPlausDiag" 156 "FId_AfsVrntDiag" 157 "FId_AirCClntPFrzVal" 158 "FId_AirCClntPRplVal" 159 "FId_AirCSwt" 160 "FId_AirDvPAdpnPEnv" 161 "FId_AirDvPAdpnPIntkVUsB1" 162 "FId_AirDvPPSnsrAdpn_PModeActv" 163 "FId_AltACGFailr" 164 "FId_AltAPPErrSt" 165 "FId_AltBattMngtFailr" 166 "FId_AltBrkErrSt" 167 "FId_AltComErr" 168 "FId_AltENGB" 169 "FId_AltElecLoadErr" 170 "FId_AltEnvTErr" 171 "FId_AltFFAltLoadFast" 172 "FId_AltFFAltLoadSlow" 173 "FId_AltIOACGErr" 174 "FId_AltIOACGLinComFailr" 175 "FId_AltIOComErr" 176 "FId_AltLinErr" 177 "FId_AltPwr" 178 "FId_AltVehVErrSt" 179 "FId_AltvCluFail" 180 "FId_BGAGRTS" 181 "FId_BGFKMSEPSR" 182 "FId_BGFKMSEPU" 183 "FId_BGFKMSESumClr" 184 "FId_BGFKMSHFME" 185 "FId_BGFKMSHFMZ" 186 "FId_BGFKMSZPSR" 187 "FId_BGOSCCat1B1" 188 "FId_BGOSCCat2B1" 189 "FId_BattAltFailr" 190 "FId_BattMngtFailr" 191 "FId_BattSigPtd" 192 "FId_BattU2MEDSRC" 193 "FId_BattUDrpPrvOff" 194 "FId_BattUFrzVal" 195 "FId_BattUHiFailrEna" 196 "FId_BattUIMGTCUCANFailr" 197 "FId_BattULoFailrEna" 198 "FId_BattUReplVal" 199 "FId_BattUSRC" 200 "FId_BlwrComErr" 201 "FId_BrkBstMdl" 202 "FId_BrkBstMdlBrkP" 203 "FId_BrkBstMdlBrkSt" 204 "FId_BrkBstMdlEnvP" 205 "FId_BrkBstPDetnInhbn" 206 "FId_BrkBstPMstCylPSnsrFail" 207 "FId_BrkBstPSnsrStuckDetn" 208 "FId_BrkBstSigPath" 209 "FId_BrkBstVehVv" 210 "FId_BrkMnSwtErr" 211 "FId_BrkPFrzVal" 212 "FId_BrkPOilPres" 213 "FId_BrkPReplVal" 214 "FId_BrkPedEngStopEna" 215 "FId_BrkRdntSwtErr" 216 "FId_CAGRSDS" 217 "FId_CEngDsTColdStrt" 218 "FId_CEngDsTColdStrtErr" 219 "FId_CEngDsTHSC" 220 "FId_CEngDsTLSC" 221 "FId_CEngDsTPlausErr" 222 "FId_CEngDsTReplMdlEngStop" 223 "FId_CEngDsTSTC" 224 "FId_CEngDsTSnsrElec" 225 "FId_CEngDsTSwtReplMdl" 226 "FId_CEngUsTColdChkErr" 227 "FId_CEngUsTCrssChk" 228 "FId_CEngUsTElecErr" 229 "FId_CEngUsTSnsrElecErr" 230 "FId_CEngUsTSwtReplMdl" 231 "FId_CInjCatHeatgDiag" 232 "FId_CMSUDKSOM1" 233 "FId_CMSUDKSOM2" 234 "FId_CatHeatgEomShtrpAct" 235 "FId_ChrctlAgrsErr" 236 "FId_ChrctlAgrscf" 237 "FId_ClntTempENGB" 238 "FId_Clth" 239 "FId_Clth2" 240 "FId_Clth3StuckOn" 241 "FId_Clth4" 242 "FId_ClthCAN" 243 "FId_ClthMax" 244 "FId_ClthStk" 245 "FId_ClthStkErr" 246 "FId_ClthStkFailr" 247 "FId_ClthStkOFFStuck" 248 "FId_ClthStkONStuck" 249 "FId_ClthSwtFailr" 250 "FId_CntrShaftFailr" 251 "FId_CoEOMGdiEomErrLcy" 252 "FId_CoESSBlowrVld" 253 "FId_CoETM" 254 "FId_CoETS_StTrqLimErr1" 255 "FId_CoETS_StTrqLimErr2" 256 "FId_CoEngStopEnblStSpEngT" 257 "FId_CoEngStopEnblStSpLSU" 258 "FId_CoEngStopEnblStSpTcT" 259 "FId_CoEngStopEnblSysErr" 260 "FId_CoEngVlvLftSpIntk" 261 "FId_CoPOMStrtgDevStrtr" 262 "FId_CoPOM_FirstStrtAut" 263 "FId_CoTS_SwtOff" 264 "FId_CoVOMACCComFailr" 265 "FId_CoVOMBrkPedISABSigFailr" 266 "FId_CoVOMEngCrkAbort" 267 "FId_CoVOMEngRstrtEnaCdn" 268 "FId_CoVOMISSEng" 269 "FId_ComACRly" 270 "FId_ComAPPSensFail" 271 "FId_ComAPedl" 272 "FId_ComAYCA" 273 "FId_ComAYCAMon" 274 "FId_ComAYCD" 275 "FId_ComAYCDMon" 276 "FId_ComAYCF" 277 "FId_ComAYCFMon" 278 "FId_ComAYCG" 279 "FId_ComAYCGMon" 280 "FId_ComAYCI" 281 "FId_ComAYCIMon" 282 "FId_ComAirPThrUsSnsrErr" 283 "FId_ComAltFail" 284 "FId_ComAppVehSnsrFailr" 285 "FId_ComBCM1" 286 "FId_ComBCM1Mon" 287 "FId_ComBCMUnitCfmdErr" 288 "FId_ComBCMUnitNotTstd" 289 "FId_ComBstCtrl" 290 "FId_ComCANVEHICLEBusOff" 291 "FId_ComCGW1" 292 "FId_ComCGW1Mon" 293 "FId_ComClthSt" 294 "FId_ComConvClth" 295 "FId_ComCrCtlReq" 296 "FId_ComCrsMaiIndcnLampReq" 297 "FId_ComCrsSetIndcnLampReq" 298 "FId_ComDCDCCdn" 299 "FId_ComDCDCErr" 300 "FId_ComDesGearCurr" 301 "FId_ComDetrmAirM" 302 "FId_ComDwnShiftCtrlReq" 303 "FId_ComEAT1" 304 "FId_ComEAT10" 305 "FId_ComEAT10Mon" 306 "FId_ComEAT11" 307 "FId_ComEAT11Mon" 308 "FId_ComEAT12" 309 "FId_ComEAT12Mon" 310 "FId_ComEAT13" 311 "FId_ComEAT13Mon" 312 "FId_ComEAT1Mon" 313 "FId_ComEAT2" 314 "FId_ComEAT2Mon" 315 "FId_ComEAT4" 316 "FId_ComEAT4Mon" 317 "FId_ComEAT6" 318 "FId_ComEAT6Mon" 319 "FId_ComEAT7" 320 "FId_ComEAT7Mon" 321 "FId_ComEAT8" 322 "FId_ComEAT8Mon" 323 "FId_ComEATA" 324 "FId_ComEATAMon" 325 "FId_ComEATB" 326 "FId_ComEATBMon" 327 "FId_ComEATC" 328 "FId_ComEATCMon" 329 "FId_ComEBSSelfDiagErr" 330 "FId_ComECUHwErr" 331 "FId_ComEGRVlvErr" 332 "FId_ComEMSIntAirTemp" 333 "FId_ComEPB" 334 "FId_ComEPBB" 335 "FId_ComEPBBMon" 336 "FId_ComEPBMon" 337 "FId_ComEPS1" 338 "FId_ComEPS1Mon" 339 "FId_ComEPSUnitCfmdErr" 340 "FId_ComEPSUnitNotTstd" 341 "FId_ComEngBrkOvrdInfo" 342 "FId_ComEngBrkOvrdMtr" 343 "FId_ComEngBrkSwErr" 344 "FId_ComEngPosng" 345 "FId_ComEngRPMLim" 346 "FId_ComEngTrqLim" 347 "FId_ComEnvtlAirPSnsrErr" 348 "FId_ComEstmTqNormJdg" 349 "FId_ComEthnlSErr" 350 "FId_ComFlSply" 351 "FId_ComFuCnsBitDurgIdleStop" 352 "FId_ComGEVCntrl" 353 "FId_ComGbxNPosFail" 354 "FId_ComGbxTemp" 355 "FId_ComGwIMG1" 356 "FId_ComGwIMG1Mon" 357 "FId_ComGwIMG3" 358 "FId_ComGwIMG3Mon" 359 "FId_ComGwIMG4" 360 "FId_ComGwIMG4Mon" 361 "FId_ComGwIMG5" 362 "FId_ComGwIMG5Mon" 363 "FId_ComGwIMG6" 364 "FId_ComGwIMG6Mon" 365 "FId_ComHFMSnsrErr" 366 "FId_ComIDASB" 367 "FId_ComIDASBMon" 368 "FId_ComIDASBUnitCfmdErr" 369 "FId_ComIDASBUnitNotTstd" 370 "FId_ComIDASEngFail" 371 "FId_ComIDASEngFailMil" 372 "FId_ComIMGUnitCfmdErr" 373 "FId_ComIMGUnitNotTstd" 374 "FId_ComISG2" 375 "FId_ComIgnCtrl" 376 "FId_ComInjCtrl" 377 "FId_ComIntkAirPSnsrErr" 378 "FId_ComLamCtrl" 379 "FId_ComMETA" 380 "FId_ComMETAMon" 381 "FId_ComMETC" 382 "FId_ComMETCMon" 383 "FId_ComMETD" 384 "FId_ComMETDMon" 385 "FId_ComMETE2" 386 "FId_ComMETE2Mon" 387 "FId_ComMETF" 388 "FId_ComMETFMon" 389 "FId_ComMETG" 390 "FId_ComMETGMon" 391 "FId_ComMETH" 392 "FId_ComMETH2" 393 "FId_ComMETH2Mon" 394 "FId_ComMETHMon" 395 "FId_ComMETI" 396 "FId_ComMETIMon" 397 "FId_ComMETK" 398 "FId_ComMETKMon" 399 "FId_ComMETL" 400 "FId_ComMETLMon" 401 "FId_ComMETM" 402 "FId_ComMETMMon" 403 "FId_ComMETN" 404 "FId_ComMETNMon" 405 "FId_ComMETUnitCfmdErr" 406 "FId_ComMETUnitNotTstd" 407 "FId_ComMisf" 408 "FId_ComMon" 409 "FId_ComNTrbn" 410 "FId_ComODOff" 411 "FId_ComOilLvlLamp" 412 "FId_ComOilPWarnLamp" 413 "FId_ComPASensFail" 414 "FId_ComPBSensFail" 415 "FId_ComPCU" 416 "FId_ComPCUMon" 417 "FId_ComPosActnSpdLimrFctReq" 418 "FId_ComSRS" 419 "FId_ComSRSA" 420 "FId_ComSRSAMon" 421 "FId_ComSRSB" 422 "FId_ComSRSBMon" 423 "FId_ComSRSMon" 424 "FId_ComSRSUnitCfmdErr" 425 "FId_ComSRSUnitNotTstd" 426 "FId_ComSTFlt" 427 "FId_ComSpdLimrDevActvn" 428 "FId_ComTCU01" 429 "FId_ComTCU02" 430 "FId_ComTCU1" 431 "FId_ComTCU11" 432 "FId_ComTCU12" 433 "FId_ComTCU13" 434 "FId_ComTCU14" 435 "FId_ComTCU2" 436 "FId_ComTCU3" 437 "FId_ComTCU4" 438 "FId_ComTCUGear" 439 "FId_ComTarGearDwnShift" 440 "FId_ComTarGearUpShift" 441 "FId_ComThrPosnFail" 442 "FId_ComThrVlv" 443 "FId_ComTrboChrgnErr" 444 "FId_ComTrqAccuracySlow" 445 "FId_ComTrqReqFast" 446 "FId_ComTrqReqSlow" 447 "FId_ComVSAErr" 448 "FId_ComVSAUnitCfmdErr" 449 "FId_ComVSAUnitNotTstd" 450 "FId_ComVehSpdFlLvl" 451 "FId_ComVehSpdFltChk" 452 "FId_ComVehSpdImpsErr" 453 "FId_ComVlvLftCtrl" 454 "FId_ComvolEng" 455 "FId_ConvLdCalcLvrPos" 456 "FId_ConvLdNTrbnCan" 457 "FId_ConvLdOilCoolrPmp" 458 "FId_ConvLdOilTemp" 459 "FId_ConvLdTrqLdCan" 460 "FId_ConvLdVel" 461 "FId_CooltTVldyTMdl" 462 "FId_CptProtnCamsft" 463 "FId_CptProtnExhTempMdl" 464 "FId_CptProtnO2SnsrB1" 465 "FId_CptProtnVVeh" 466 "FId_CrCUI1EFRxErr" 467 "FId_CrCUICANRxErr" 468 "FId_CrCUIFCMRxErr" 469 "FId_CrCUIMETDRxErr" 470 "FId_CrCtlACCRxErr" 471 "FId_CrCtlAppSnsrErr" 472 "FId_CrCtlShutOffEng" 473 "FId_CstrPurgGnrlTstrReq" 474 "FId_DAGRS" 475 "FId_DELibBrkBstP" 476 "FId_DELibCEngDsT" 477 "FId_DELibCEngUsT" 478 "FId_DELibEngDatEng" 479 "FId_DELibEnvP" 480 "FId_DELibEnvT" 481 "FId_DELibFuelT" 482 "FId_DELibIntkAirT" 483 "FId_DELibNRCat" 484 "FId_DELibOilP" 485 "FId_DELibOilSwmpT" 486 "FId_DELibPRelPfilDs" 487 "FId_DELibTEGRClrLPDs" 488 "FId_DEONVEBPEnv" 489 "FId_DEONVTCCpv1DteskLoLoadStuckClsd" 490 "FId_DEONVTCCpv1DteskLoLoadStuckOpen" 491 "FId_DIUMPRCldStrtMon" 492 "FId_DIUMPREvapMon" 493 "FId_DIUMPRGenDenom1" 494 "FId_DIUMPRGenDenom1PDTC" 495 "FId_DIUMPRGenDenom2" 496 "FId_DIUMPRGenDenom3" 497 "FId_DIUMPRIgn" 498 "FId_DOGov" 499 "FId_DSMWarmUpCycle" 500 "FId_DTESKEBCpv1DteskLoLoadStuckClsd" 501 "FId_DTESKEBCpv1DteskLoLoadStuckOpen" 502 "FId_DTESKEnvCondVld" 503 "FId_DTESKFuLvlCondVld" 504 "FId_DTESKvfz" 505 "FId_DdskvFraTstd" 506 "FId_DdskvOraTstd" 507 "FId_DewDetTKAMax" 508 "FId_DiagBlkdLine" 509 "FId_DiagCpv1DteskLoLoad" 510 "FId_DkrsaEpmNoSig" 511 "FId_EBBCANErrFrzVal" 512 "FId_EBBCANErrReplVal" 513 "FId_EGLZSR" 514 "FId_EGRVlvActrOff" 515 "FId_EGRVlvCldStrt" 516 "FId_EGRVlvClnVrfy" 517 "FId_EGRVlvCtrlErr" 518 "FId_EGRVlvEngTempDef" 519 "FId_EGRVlvFailSafeActv" 520 "FId_EGRVlvFrzVal" 521 "FId_EGRVlvGovOn" 522 "FId_EGRVlvGovOnCld" 523 "FId_EGRVlvGovrOnRelsFct" 524 "FId_EGRVlvILimn" 525 "FId_EGRVlvIni" 526 "FId_EGRVlvMon" 527 "FId_EGRVlvOfsLrnInhib" 528 "FId_EGRVlvPhysRng" 529 "FId_EGRVlvPsSwtOff" 530 "FId_EGRVlvPwrStgMonDis" 531 "FId_EGRVlvRplVal" 532 "FId_EGRVlvSSpMon" 533 "FId_EGRVlvSnsrErr" 534 "FId_EGRVlvTempCmp" 535 "FId_EGRVlvTempMdlEEPErr" 536 "FId_EGRVlvTmpErrCnt" 537 "FId_EGRVlvTrlPtr" 538 "FId_EGRVlv_VehvErr" 539 "FId_EGRVlviActIEfcLimn" 540 "FId_EGRVlvpDsbcInvld" 541 "FId_EGSDO2OffsRstDsmS1B1" 542 "FId_EGSDO2_LamOffsSlowS1" 543 "FId_EGSDO2_RstFltSuspcnOffsB1" 544 "FId_EGSDUS2B1DlyEvln" 545 "FId_EGSDUS2B1LtrDly" 546 "FId_EGSDUS2B1LtrPT1" 547 "FId_EGSDUS2B1PT1Evln" 548 "FId_EGSDUS2B1RtlDly" 549 "FId_EGSDUS2B1RtlPT1" 550 "FId_EGSDUS2B1TarEvln" 551 "FId_EGSDUS2B1TarLean" 552 "FId_EGSDUS2B1TarRich" 553 "FId_EGSSigO2S1B1" 554 "FId_ELZSR" 555 "FId_EPBErr" 556 "FId_EPBFrmErr" 557 "FId_EPBFrmErrClth" 558 "FId_ETHSCPErrDrvCyc" 559 "FId_EVPComFailr" 560 "FId_EbsLinErr" 561 "FId_ElecLdComErr" 562 "FId_ElecLdFrzVal" 563 "FId_ElecLdHdLiComErr" 564 "FId_ElecLdRplVal" 565 "FId_ElecLoadEPSComErr" 566 "FId_EngBlkTWrn" 567 "FId_EngCooltTFail" 568 "FId_EngDemTqLimnCamsftErr" 569 "FId_EngDemTqLimnErrThmstHeatCtrlCirc" 570 "FId_EngDemTqLimnOilPmp" 571 "FId_EngDemTrqLimErrAPP" 572 "FId_EngIntkAirFail" 573 "FId_EngPrtErrVehV" 574 "FId_EngSpd30DegFail" 575 "FId_EngStrtEnaEthAdap" 576 "FId_EngStrt_EnaCep" 577 "FId_EngStrt_InjProhb" 578 "FId_EngStrt_VehVInhb" 579 "FId_EngTqRvsnEnaFlg" 580 "FId_EnvTPrimMod" 581 "FId_EnvTPrimModIniVal" 582 "FId_EnvTSensSum" 583 "FId_EnvTtAirFltDs" 584 "FId_EnvTtCEngDsT" 585 "FId_EnvTtIntkMnfld" 586 "FId_EomCvoAllwd" 587 "FId_EpmBCr" 588 "FId_EpmCaSAdapCaSI1" 589 "FId_EpmCaSAdapRstI1" 590 "FId_EpmCaSDiagI1" 591 "FId_EpmCaSErrCaSI1" 592 "FId_EpmCaSOfsDiagCaSI1" 593 "FId_EpmCaSOfsErrCaSI1" 594 "FId_EpmCaSSegI1" 595 "FId_EpmCaSSpdPlausI1" 596 "FId_EpmCrSDiag" 597 "FId_EpmCrSDiagVeh" 598 "FId_EpmCrSErr" 599 "FId_EpmOpMode_ALELock" 600 "FId_EpmOpMode_DirStLock" 601 "FId_EpmRRSCrSFaultCheck" 602 "FId_EpmRRSDGIFaultCheck" 603 "FId_EpmRRSRdCheck" 604 "FId_EpmRRSVehVFaultChck" 605 "FId_EpmSynLockCaSSync" 606 "FId_EpmTmpSuppRvsRotCASI1" 607 "FId_EtaEngIdleNonCsers" 608 "FId_EtaEngPtlNonCsers" 609 "FId_EthnlSnsrErrCdn" 610 "FId_EvapActrCcvElecDiag" 611 "FId_EvapPSnsrTankPhyRngChk" 612 "FId_FanCtlACClntP" 613 "FId_FanCtlACGModFail" 614 "FId_FanCtlAPP1" 615 "FId_FanCtlAPP2" 616 "FId_FanCtlAPPSync" 617 "FId_FanCtlBlowrU" 618 "FId_FanCtlCooltT" 619 "FId_FanCtlCooltT2" 620 "FId_FanCtlEnvT" 621 "FId_FanCtlLiSwtInfo" 622 "FId_FanCtlSpd" 623 "FId_FanCtlTSnsrErr" 624 "FId_FanCtlThr1" 625 "FId_FanCtlThr2" 626 "FId_FcoReq" 627 "FId_FiMFID_rba_MRly_Diag_Stk" 628 "FId_FlComErr" 629 "FId_FlDevPlauDiagFuSnsr" 630 "FId_FlLvlNoSigErr" 631 "FId_FlLvlVehSpdSigErr" 632 "FId_FlLvlVehVErr" 633 "FId_FlMALamDynDiag" 634 "FId_FlSplGAltLin" 635 "FId_FlTnkQnt" 636 "FId_FuMixHotFilmErr" 637 "FId_FuMixUegoErrExcl" 638 "FId_FuPHiRailEthnlSnsrErr" 639 "FId_FuPurg_TEVError" 640 "FId_FuSnsrPhyRngErr" 641 "FId_GEVCtlAVCAdprCBBNWEErrIntk" 642 "FId_GEVCtlAVCAdprIntkB1" 643 "FId_GEVCtlAVCAdprNWSEErrIntk" 644 "FId_GEVCtlAdpnEnaIntk" 645 "FId_GEVCtlAdpnEnaShtrpActv" 646 "FId_GEVCtlClngIntk" 647 "FId_GEVCtlMinOvlIntk" 648 "FId_GEVCtlPOilSnsr" 649 "FId_GEVCtlPhaEnaIntk" 650 "FId_GEVCtlPhaSpTstrIntk" 651 "FId_GEVCtlRefAdpnMntChck" 652 "FId_GEVCtlRefAdpnMntChckTstd" 653 "FId_GEVCtlReqRefAdpnTstrIntk" 654 "FId_GEVCtlReqRefAdpnTstrIntkTstd" 655 "FId_GEVCtlVlvLftEnaIntk" 656 "FId_GEVCtlVlvOpenClsdIntkB1" 657 "FId_GEVlvLockPinDiagIntkB1" 658 "FId_GEVlvPhaDiagEnaCsersIntkB1" 659 "FId_GEVlvPhaDiagEnaIntkB1" 660 "FId_GEVlvPhaPsIntkB1" 661 "FId_GbxAnNeutPosnErr" 662 "FId_GbxCANDigPlausErr" 663 "FId_GbxCANNeutSigErr" 664 "FId_GbxPNPosSig" 665 "FId_GbxPNPosnComErr" 666 "FId_GbxPNPosnDiagDrvCdnRels" 667 "FId_GbxPNPosnDiagDrvCodnHealRels" 668 "FId_GbxPNPosnDiagPlausyRels" 669 "FId_GbxPNPosnSubsVal" 670 "FId_GbxRvsSwtStk" 671 "FId_GbxSnsrSplyUErr" 672 "FId_GbxSpstReqOk" 673 "FId_GlbDaLSumvXPtd" 674 "FId_GslThrVlvSnsrDiagB1" 675 "FId_HEGOS2B1DElec" 676 "FId_HEGOS2B1DHtg" 677 "FId_HEGOS2B1Htg" 678 "FId_HEGOS2B1HtrPsSt" 679 "FId_HEGOS2B1InVld" 680 "FId_HEGOS2B1LSPsDiaDi" 681 "FId_HLSDemBrkFlt" 682 "FId_HLSDemErr1" 683 "FId_HLSDemErr2" 684 "FId_HLSDemIntkAirTemp" 685 "FId_HLSDemMotTemp" 686 "FId_HLSDemMstCyldpVld" 687 "FId_HLSDemSpdClthGearAccrSigErr" 688 "FId_HLSDem_DrvOffSuprt" 689 "FId_HLSDem_DrvOffSuprtBrkHldSys" 690 "FId_HLSDem_DrvOffSuprtLAS" 691 "FId_HLSDem_PModeActv" 692 "FId_HLSDem_TModeActv" 693 "FId_HLSDem_TraSubFcn" 694 "FId_HLSDem_nMaxLimErr1" 695 "FId_HLSDem_nMaxLimErr2" 696 "FId_HLSDem_nMaxLimErr3" 697 "FId_HLSDem_nMaxVErr" 698 "FId_I14229APP" 699 "FId_I14229CANErr" 700 "FId_I14229FlLvlFltComErr" 701 "FId_I14229VTCErr" 702 "FId_IMGISABComErr" 703 "FId_InhbLamDynS1B1" 704 "FId_InhbnBlkdLineDiag" 705 "FId_InhibitAlways" 706 "FId_InhibitNever" 707 "FId_InjSysMulInjDiagErr" 708 "FId_InjVlvPs_Bank1OnlyErr" 709 "FId_InjVlvPs_Bank1Tested" 710 "FId_InjVlvPs_Bank2OnlyErr" 711 "FId_InjVlvPs_Bank2Tested" 712 "FId_InjVlvPs_Bank3OnlyErr" 713 "FId_InjVlvPs_Bank3Tested" 714 "FId_IntkAirTAirFltDsCrssChk" 715 "FId_IntkAirTAirFltDsPlausChk" 716 "FId_IntkAirTIntkMnfldCrssChk" 717 "FId_IntkAirTIntkMnfldPlausChk" 718 "FId_IntkAirTIntkMnfldRepl" 719 "FId_IntkAirTSnsr1Elec" 720 "FId_IntkAirTSnsr1PRC" 721 "FId_IntkAirTSnsr1Sum" 722 "FId_IntkAirTSnsr2Elec" 723 "FId_IntkAirTSnsr2PRC" 724 "FId_IntkAirTSnsr2Sum" 725 "FId_IntkArTempENGB" 726 "FId_LIGovDfrstI" 727 "FId_LIGovUndrBrk" 728 "FId_LINDCDCRxErr" 729 "FId_LLimAppSnsrErr" 730 "FId_LLimAppSnsrSyncErr" 731 "FId_LLimMTVehSpdSnsrErr" 732 "FId_LLimShutOffEng" 733 "FId_LRSEBMisf" 734 "FId_LZSR" 735 "FId_LeakToMnfld" 736 "FId_LeakToMnfldTstd" 737 "FId_LimpHomPsErrInjtr" 738 "FId_LinACGUnitCfmdErr" 739 "FId_LinACGUnitNotTstd" 740 "FId_LinAEVUnitCfmdErr" 741 "FId_LinAEVUnitNotTstd" 742 "FId_LinEBSUnitCfmdErr" 743 "FId_LinEBSUnitNotTstd" 744 "FId_LowPresOilP" 745 "FId_MFlowAirCrkcsSubVal" 746 "FId_MFuOilMax" 747 "FId_MaiLoadSnsr" 748 "FId_MaiShaftFailr" 749 "FId_MfPsDia1" 750 "FId_MisfDetDnAdpn" 751 "FId_MisfDetDnAdpnPlaus" 752 "FId_MisfDetEnvP" 753 "FId_MisfDetSegTiAdpnFco" 754 "FId_MisfDetShtrpAct" 755 "FId_MisfDetStc" 756 "FId_MisfDetV" 757 "FId_MisfDetVWhlFrntLe" 758 "FId_MisfDetVWhlFrntRi" 759 "FId_MisfDetVWhlReLe" 760 "FId_MisfDetVWhlReRi" 761 "FId_NLimVehHalt" 762 "FId_NSHTDAmbT" 763 "FId_NSHTDEngT" 764 "FId_NSHTILimHiAltiLoIdleSp" 765 "FId_NeutPosnFailr" 766 "FId_O2StorgMdlMD" 767 "FId_OilCmbdSen_LvlDfctHW" 768 "FId_OilPCtrlVlvNpl" 769 "FId_OilPFrzVal" 770 "FId_OilPPlaus" 771 "FId_OilPPlausAftRun" 772 "FId_OilPPlausMax" 773 "FId_OilPPlausMin" 774 "FId_OilPPlausT15" 775 "FId_OilPRplVal" 776 "FId_OilPSnsrErr" 777 "FId_OilPSwmpSRC" 778 "FId_OilSwmpTCEngDsTWrmUp" 779 "FId_OilSwmpT_B_tospg" 780 "FId_OilSwmpT_B_tospgg" 781 "FId_OilSwmpT_CmbdSnsrErr" 782 "FId_OilSwmpT_CmbdSnsrTiTErr" 783 "FId_OilSwmpT_EnvT" 784 "FId_OilSwmpT_TSnsrErr" 785 "FId_PEnvMeasVld" 786 "FId_PEnvModel" 787 "FId_PEnvPlausDiagVDD" 788 "FId_PEnvRawVldVDD" 789 "FId_PEnvRefSnsr" 790 "FId_PEnvSigRngVld" 791 "FId_PEnvSnsrPlausVDD" 792 "FId_PEnvVldVDD" 793 "FId_PIDA6SigSrcErr" 794 "FId_PIntkMnfldPlaus" 795 "FId_PIntkVUsElecDiagB1" 796 "FId_PSPCtlDisbl" 797 "FId_PSPCtlIntkAirVapLock" 798 "FId_PSPCtlPreRun" 799 "FId_PSPCtlVapLock" 800 "FId_PSPDiagDisbl" 801 "FId_PTGripConv" 802 "FId_PTGripConvStrt" 803 "FId_PTGripMnlClth" 804 "FId_PTGripMnlClthStrt" 805 "FId_PTTrqRatCANPtd" 806 "FId_PThrVlVUsVldB1" 807 "FId_PThrVlvUsMeasdVldB1" 808 "FId_P_VSE11_Diag" 809 "FId_PrmId03_FltRdnS1B1" 810 "FId_PrmId03_FltUegoS1B1" 811 "FId_RevLck" 812 "FId_RstAdpnPIntkMnfldAfs" 813 "FId_RvsPosnFailr" 814 "FId_SSEEPBRelease" 815 "FId_SSEFCANPRelease" 816 "FId_SSEPTCANPRelease" 817 "FId_SSEStartRelease" 818 "FId_SSEStartReleaseMTCl10" 819 "FId_SSEStartReleaseMTCl100" 820 "FId_SSEStartReleaseMTCl20" 821 "FId_SSEStartReleaseMTCl90" 822 "FId_SSEStartRequest" 823 "FId_SSEStopRelease" 824 "FId_SSEStrtStopRelease" 825 "FId_SSESysOff" 826 "FId_SSEUI2DCSysFailr" 827 "FId_SSEUIBCANErr" 828 "FId_SSEUISysFail" 829 "FId_SiaEEPErr" 830 "FId_SnglWhlErrDiagEna" 831 "FId_StrtCtlAutoCrkModeCdn" 832 "FId_StrtCtlComEngStrtErr" 833 "FId_StrtCtlNPCdnCncl" 834 "FId_StrtCtlNoCpuFailr" 835 "FId_StrtCtlNoFailCanLine" 836 "FId_StrtCtlNoFailPTCanLine" 837 "FId_StrtCtlPNPosnSubsVal" 838 "FId_StrtCtlSTMFailr" 839 "FId_StrtErrShaft" 840 "FId_SumErrHndlg" 841 "FId_SysDiagComErr" 842 "FId_SysDiagModInhbErr" 843 "FId_TOSPM" 844 "FId_TWCCILck" 845 "FId_TWCCILckExtd" 846 "FId_TWCCIRstB1" 847 "FId_TWCCIRstDSMClearB1" 848 "FId_TWCCLsuB1" 849 "FId_TWCCLsuCyc" 850 "FId_TWCCLsuDynB1" 851 "FId_TWCCMisfDetn" 852 "FId_TWCDPriCatParB1" 853 "FId_TWCDPriCatVldnB1" 854 "FId_TankPCpv1DteskLoLoadStuckClsd" 855 "FId_TankPCpv1DteskLoLoadStuckOpen" 856 "FId_TankPSnsrElecChkVld" 857 "FId_ThrVlvMon" 858 "FId_ThrVlvOffsLrnPrmsB1" 859 "FId_TiOffTBasdChkFast" 860 "FId_TiOffTBasdChkSlow" 861 "FId_TiOffVdClk" 862 "FId_TqDecelOffsInhb" 863 "FId_TraAddAirCANPtd" 864 "FId_TraAddClntCANPtd" 865 "FId_TraFwdRvsCluInfo" 866 "FId_TraGbxNPos" 867 "FId_TraGearInfoCanCom" 868 "FId_TraGearInfoDet" 869 "FId_TraGearInfoGearShftActv" 870 "FId_TraGearInfoInfoCan" 871 "FId_TraGearInfoLevPos" 872 "FId_TraGearInfoLoRng" 873 "FId_TraGearInfoRTra" 874 "FId_TraGearInfoRevGear" 875 "FId_TraGearReq" 876 "FId_TraNoShftIdctr" 877 "FId_TraPrtGearCANPtd" 878 "FId_TraPrtGearIndpdtProblem" 879 "FId_TraRPosn" 880 "FId_TraRtnIntfcASTIntv" 881 "FId_TraRtnIntfcIdlSetP" 882 "FId_TraRtnIntfcNMaxCan" 883 "FId_TraRtnIntfcNMaxVel" 884 "FId_TraTrqRedLmpHmeDec" 885 "FId_TraTrqRedLmpHmeInc" 886 "FId_TraTrqRedPTCanErr" 887 "FId_TraTrqRedTIIntvDes" 888 "FId_TraTrqRedTIIntvLead" 889 "FId_TraTrqRedTSCIntvDes" 890 "FId_TraTrqRedTSCIntvLead" 891 "FId_TraTrsmTypHw" 892 "FId_TranIdleDes" 893 "FId_UEGOHeatgUpRglS1B1" 894 "FId_UEGOHeatrCtrlS1B1" 895 "FId_UEGOHeatrPrfmncDiagRelsS1B1" 896 "FId_UEGOHeatrPwrStgDiagRelsS1B1" 897 "FId_UEGOModCtrlRelsS1B1" 898 "FId_UEGOStrtDiagInhRprtErrS1B1" 899 "FId_UEGOStrtDiagRelsS1B1" 900 "FId_UEGOTCeramicRelsS1B1" 901 "FId_UegoDiagRelsBattSplyOk" 902 "FId_UegoDiagSigEcuAsicS1B1" 903 "FId_UegoDiagSigEcuComS1B1" 904 "FId_UegoDiagSigOperPlausS1B1" 905 "FId_UegoDiagSigSnsrS1B1" 906 "FId_UegoDiagSigWireOlS1B1" 907 "FId_UegoDiagSigWireScS1B1" 908 "FId_UegoDiagSigWireScTstdS1B1" 909 "FId_UegoInhbOperRelsS1B1" 910 "FId_UegoO2HiPrcsnS1B1" 911 "FId_UegoO2PlausErrS1B1" 912 "FId_UegoO2VldS1B1" 913 "FId_UegoOperPlausBattSplyOk" 914 "FId_UegoPlausErrHndlg" 915 "FId_VMSIDCSRmpShOff" 916 "FId_VMSIDCSShOff" 917 "FId_VMSITCSRmpShOff" 918 "FId_VMSITCSShOff" 919 "FId_VSACANErr" 920 "FId_VehStcACGFailr" 921 "FId_VehStcBattMngFailr" 922 "FId_VehStcDCDCFailr" 923 "FId_VehStcEBSFailr" 924 "FId_VehStcMisf" 925 "FId_VehStcMtrComFailr" 926 "FId_VehStcNVMFailr" 927 "FId_VehVCANFrzVal" 928 "FId_VehVCANReplVal" 929 "FId_VehVCanSafeFrzVal" 930 "FId_VehVCanSafeReplVal" 931 "FId_VehVCom" 932 "FId_VehVExcdLim" 933 "FId_VehVFrzVal" 934 "FId_VehVNCSnsrElecFailr" 935 "FId_VehVOBDFrzVal" 936 "FId_VehVOBDReplVal" 937 "FId_VehVOutCanErr" 938 "FId_VehVPWMFrzVal" 939 "FId_VehVPWMReplVal" 940 "FId_VehVPhysRng" 941 "FId_VehVPlaus" 942 "FId_VehVPlausCan" 943 "FId_VehVPlausFco" 944 "FId_VehVPlausPwr" 945 "FId_VehVPlausV2N" 946 "FId_VehVReplVal" 947 "FId_VehVSigCan" 948 "FId_VehVSigCanSafe" 949 "FId_VehVSngWhlCanFrzVal" 950 "FId_VehVSngWhlCanReplVal" 951 "FId_VehVSnsrARngHi" 952 "FId_VehVSnsrBRngHi" 953 "FId_VehVSpdRtyDiag" 954 "FId_VehVSpdSnsrAElecFailr" 955 "FId_VehVSpdSnsrBElecFailr" 956 "FId_VehVvFLWhlSpd" 957 "FId_VehVvFRWhlSpd" 958 "FId_VehVvRLWhlSpd" 959 "FId_VehVvRRWhlSpd" 960 "FId_VldtLamDynS1B1" 961 "FId_VlvLftFbIntkOilPSnsr11SRC" 962 "FId_VlvLftFbSwtIntk11Diag" 963 "FId_ZGLZSR" 964 "FId_airIntkFltSnsrKnkPrtnIgn" 965 "FId_ctrladpncvo" 966 "FId_stChkChgnSys" 967 "FId_stChkChgnSys2DC" 968 "FId_tFltSnsrKnkPrtnIgn" DEFAULT_VALUE "---" /end COMPU_VTAB
/begin COMPU_METHOD OneToOne "" RAT_FUNC "%6.2" "-" COEFFS 0 1 0 0 0 1 /end COMPU_METHOD
/begin RECORD_LAYOUT ValA_Wu16 FNC_VALUES 1 UWORD COLUMN_DIR DIRECT /end RECORD_LAYOUT
/end MODULE
/end PROJECT
