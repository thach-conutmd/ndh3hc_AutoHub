ASAP2_VERSION 1 60
/begin PROJECT MG1CS022 "MG1CS022"
/begin HEADER "" VERSION "MG1CS022_62XSC_V037_TPROT" PROJECT_NO MG1CS022 /end HEADER
/begin MODULE DIM ""
/begin MOD_COMMON "" BYTE_ORDER MSB_LAST ALIGNMENT_BYTE 1 ALIGNMENT_WORD 2 ALIGNMENT_LONG 4 ALIGNMENT_INT64 4 ALIGNMENT_FLOAT32_IEEE 4 ALIGNMENT_FLOAT64_IEEE 4 DATA_SIZE 32 /end MOD_COMMON
/begin CHARACTERISTIC DFC_CtlMsk.DFC_DSUmax_C "Behaviour control mask / Behaviour control masks of check DFC_DSUmax" VALUE 0x804D911A Val_Wu16 65535.00 DFES_OneToOne 0.00 65535.00 FORMAT "%8.2" /end CHARACTERISTIC
/begin CHARACTERISTIC DFC_CtlMsk.DFC_DiagCpv1DteskLoLoadStuckClsd_C "Behaviour control mask / Behaviour control masks of check DFC_DiagCpv1DteskLoLoadStuckClsd" VALUE 0x804D911C Val_Wu16 65535.00 DFES_OneToOne 0.00 65535.00 FORMAT "%8.2" /end CHARACTERISTIC
/begin CHARACTERISTIC DFC_CtlMsk.DFC_DiagCpv1DteskLoLoadStuckOpen_C "Behaviour control mask / Behaviour control masks of check DFC_DiagCpv1DteskLoLoadStuckOpen" VALUE 0x804D911E Val_Wu16 65535.00 DFES_OneToOne 0.00 65535.00 FORMAT "%8.2" /end CHARACTERISTIC
/begin CHARACTERISTIC DFC_CtlMsk.DFC_EGRVlvDrftClsd_C "Behaviour control mask / Behaviour control masks of check DFC_EGRVlvDrftClsd" VALUE 0x804D9120 Val_Wu16 65535.00 DFES_OneToOne 0.00 65535.00 FORMAT "%8.2" /end CHARACTERISTIC
/begin CHARACTERISTIC DFC_CtlMsk.DFC_EGRVlvDrftOpn_C "Behaviour control mask / Behaviour control masks of check DFC_EGRVlvDrftOpn" VALUE 0x804D9122 Val_Wu16 65535.00 DFES_OneToOne 0.00 65535.00 FORMAT "%8.2" /end CHARACTERISTIC
/begin CHARACTERISTIC DFC_CtlMsk.DFC_EGRVlvJamVlvClsd_C "Behaviour control mask / Behaviour control masks of check DFC_EGRVlvJamVlvClsd" VALUE 0x804D9124 Val_Wu16 65535.00 DFES_OneToOne 0.00 65535.00 FORMAT "%8.2" /end CHARACTERISTIC
/begin CHARACTERISTIC DFC_CtlMsk.DFC_EGRVlvJamVlvOpn_C "Behaviour control mask / Behaviour control masks of check DFC_EGRVlvJamVlvOpn" VALUE 0x804D9126 Val_Wu16 65535.00 DFES_OneToOne 0.00 65535.00 FORMAT "%8.2" /end CHARACTERISTIC
/begin CHARACTERISTIC DFC_CtlMsk.DFC_EGRVlvSprgBrk_C "Behaviour control mask / Behaviour control masks of check DFC_EGRVlvSprgBrk" VALUE 0x804D9128 Val_Wu16 65535.00 DFES_OneToOne 0.00 65535.00 FORMAT "%8.2" /end CHARACTERISTIC
/begin CHARACTERISTIC DFC_CtlMsk.DFC_EGRVlvTempMdlEEPErr_C "Behaviour control mask / Behaviour control masks of check DFC_EGRVlvTempMdlEEPErr" VALUE 0x804D912A Val_Wu16 65535.00 DFES_OneToOne 0.00 65535.00 FORMAT "%8.2" /end CHARACTERISTIC
/begin CHARACTERISTIC DFC_CtlMsk.DFC_EGRVlvTmpErr_C "Behaviour control mask / Behaviour control masks of check DFC_EGRVlvTmpErr" VALUE 0x804D912C Val_Wu16 65535.00 DFES_OneToOne 0.00 65535.00 FORMAT "%8.2" /end CHARACTERISTIC
/begin CHARACTERISTIC DFC_CtlMsk.DFC_EGSDUS2B1LtrDly_C "Behaviour control mask / Behaviour control masks of check DFC_EGSDUS2B1LtrDly" VALUE 0x804D912E Val_Wu16 65535.00 DFES_OneToOne 0.00 65535.00 FORMAT "%8.2" /end CHARACTERISTIC
/begin CHARACTERISTIC DFC_CtlMsk.DFC_EGSDUS2B1LtrPT1_C "Behaviour control mask / Behaviour control masks of check DFC_EGSDUS2B1LtrPT1" VALUE 0x804D9130 Val_Wu16 65535.00 DFES_OneToOne 0.00 65535.00 FORMAT "%8.2" /end CHARACTERISTIC
/begin CHARACTERISTIC DFC_CtlMsk.DFC_EGSDUS2B1RtlDly_C "Behaviour control mask / Behaviour control masks of check DFC_EGSDUS2B1RtlDly" VALUE 0x804D9132 Val_Wu16 65535.00 DFES_OneToOne 0.00 65535.00 FORMAT "%8.2" /end CHARACTERISTIC
/begin CHARACTERISTIC DFC_CtlMsk.DFC_EGSDUS2B1RtlPT1_C "Behaviour control mask / Behaviour control masks of check DFC_EGSDUS2B1RtlPT1" VALUE 0x804D9134 Val_Wu16 65535.00 DFES_OneToOne 0.00 65535.00 FORMAT "%8.2" /end CHARACTERISTIC
/begin CHARACTERISTIC DFC_CtlMsk.DFC_EGSDUS2B1TarLean_C "Behaviour control mask / Behaviour control masks of check DFC_EGSDUS2B1TarLean" VALUE 0x804D9136 Val_Wu16 65535.00 DFES_OneToOne 0.00 65535.00 FORMAT "%8.2" /end CHARACTERISTIC
/begin CHARACTERISTIC DFC_CtlMsk.DFC_EGSDUS2B1TarRich_C "Behaviour control mask / Behaviour control masks of check DFC_EGSDUS2B1TarRich" VALUE 0x804D9138 Val_Wu16 65535.00 DFES_OneToOne 0.00 65535.00 FORMAT "%8.2" /end CHARACTERISTIC
/begin CHARACTERISTIC DFC_CtlMsk.DFC_EONVmax_C "Behaviour control mask / Behaviour control masks of check DFC_EONVmax" VALUE 0x804D913A Val_Wu16 65535.00 DFES_OneToOne 0.00 65535.00 FORMAT "%8.2" /end CHARACTERISTIC
/begin CHARACTERISTIC DFC_CtlMsk.DFC_ETAKHLmax_C "Behaviour control mask / Behaviour control masks of check DFC_ETAKHLmax" VALUE 0x804D913C Val_Wu16 65535.00 DFES_OneToOne 0.00 65535.00 FORMAT "%8.2" /end CHARACTERISTIC
/begin CHARACTERISTIC DFC_CtlMsk.DFC_ETAKHTmax_C "Behaviour control mask / Behaviour control masks of check DFC_ETAKHTmax" VALUE 0x804D913E Val_Wu16 65535.00 DFES_OneToOne 0.00 65535.00 FORMAT "%8.2" /end CHARACTERISTIC
/begin CHARACTERISTIC DFC_CtlMsk.DFC_ETHSEmax_C "Behaviour control mask / Behaviour control masks of check DFC_ETHSEmax" VALUE 0x804D9140 Val_Wu16 65535.00 DFES_OneToOne 0.00 65535.00 FORMAT "%8.2" /end CHARACTERISTIC
/begin CHARACTERISTIC DFC_CtlMsk.DFC_ETHSEmin_C "Behaviour control mask / Behaviour control masks of check DFC_ETHSEmin" VALUE 0x804D9142 Val_Wu16 65535.00 DFES_OneToOne 0.00 65535.00 FORMAT "%8.2" /end CHARACTERISTIC
/begin CHARACTERISTIC DFC_CtlMsk.DFC_ETHSFmax_C "Behaviour control mask / Behaviour control masks of check DFC_ETHSFmax" VALUE 0x804D9144 Val_Wu16 65535.00 DFES_OneToOne 0.00 65535.00 FORMAT "%8.2" /end CHARACTERISTIC
/begin CHARACTERISTIC DFC_CtlMsk.DFC_ETHSFmin_C "Behaviour control mask / Behaviour control masks of check DFC_ETHSFmin" VALUE 0x804D9146 Val_Wu16 65535.00 DFES_OneToOne 0.00 65535.00 FORMAT "%8.2" /end CHARACTERISTIC
/begin CHARACTERISTIC DFC_CtlMsk.DFC_ETHSFsig_C "Behaviour control mask / Behaviour control masks of check DFC_ETHSFsig" VALUE 0x804D9148 Val_Wu16 65535.00 DFES_OneToOne 0.00 65535.00 FORMAT "%8.2" /end CHARACTERISTIC
/begin CHARACTERISTIC DFC_CtlMsk.DFC_ETHSNPWmax_C "Behaviour control mask / Behaviour control masks of check DFC_ETHSNPWmax" VALUE 0x804D914A Val_Wu16 65535.00 DFES_OneToOne 0.00 65535.00 FORMAT "%8.2" /end CHARACTERISTIC
/begin CHARACTERISTIC DFC_CtlMsk.DFC_ETHSNPWmin_C "Behaviour control mask / Behaviour control masks of check DFC_ETHSNPWmin" VALUE 0x804D914C Val_Wu16 65535.00 DFES_OneToOne 0.00 65535.00 FORMAT "%8.2" /end CHARACTERISTIC
/begin CHARACTERISTIC DFC_CtlMsk.DFC_ETHSNPWsig_C "Behaviour control mask / Behaviour control masks of check DFC_ETHSNPWsig" VALUE 0x804D914E Val_Wu16 65535.00 DFES_OneToOne 0.00 65535.00 FORMAT "%8.2" /end CHARACTERISTIC
/begin CHARACTERISTIC DFC_CtlMsk.DFC_ETHSPLnpl_C "Behaviour control mask / Behaviour control masks of check DFC_ETHSPLnpl" VALUE 0x804D9150 Val_Wu16 65535.00 DFES_OneToOne 0.00 65535.00 FORMAT "%8.2" /end CHARACTERISTIC
/begin CHARACTERISTIC DFC_CtlMsk.DFC_ETHSTPLnpl_C "Behaviour control mask / Behaviour control masks of check DFC_ETHSTPLnpl" VALUE 0x804D9152 Val_Wu16 65535.00 DFES_OneToOne 0.00 65535.00 FORMAT "%8.2" /end CHARACTERISTIC
/begin CHARACTERISTIC DFC_CtlMsk.DFC_EngICO_C "Behaviour control mask / Behaviour control masks of check DFC_EngICO" VALUE 0x804D9154 Val_Wu16 65535.00 DFES_OneToOne 0.00 65535.00 FORMAT "%8.2" /end CHARACTERISTIC
/begin CHARACTERISTIC DFC_CtlMsk.DFC_EngPrtOvrSpdMon_C "Behaviour control mask / Behaviour control masks of check DFC_EngPrtOvrSpdMon" VALUE 0x804D9156 Val_Wu16 65535.00 DFES_OneToOne 0.00 65535.00 FORMAT "%8.2" /end CHARACTERISTIC
/begin CHARACTERISTIC DFC_CtlMsk.DFC_EpmCaSI1ErrSig_C "Behaviour control mask / Behaviour control masks of check DFC_EpmCaSI1ErrSig" VALUE 0x804D9158 Val_Wu16 65535.00 DFES_OneToOne 0.00 65535.00 FORMAT "%8.2" /end CHARACTERISTIC
/begin CHARACTERISTIC DFC_CtlMsk.DFC_EpmCaSI1MntErr_C "Behaviour control mask / Behaviour control masks of check DFC_EpmCaSI1MntErr" VALUE 0x804D915A Val_Wu16 65535.00 DFES_OneToOne 0.00 65535.00 FORMAT "%8.2" /end CHARACTERISTIC
/begin CHARACTERISTIC DFC_CtlMsk.DFC_EpmCaSI1NoSigMax_C "Behaviour control mask / Behaviour control masks of check DFC_EpmCaSI1NoSigMax" VALUE 0x804D915C Val_Wu16 65535.00 DFES_OneToOne 0.00 65535.00 FORMAT "%8.2" /end CHARACTERISTIC
/begin CHARACTERISTIC DFC_CtlMsk.DFC_EpmCaSI1NoSigMin_C "Behaviour control mask / Behaviour control masks of check DFC_EpmCaSI1NoSigMin" VALUE 0x804D915E Val_Wu16 65535.00 DFES_OneToOne 0.00 65535.00 FORMAT "%8.2" /end CHARACTERISTIC
/begin CHARACTERISTIC DFC_CtlMsk.DFC_EpmCaSI1OfsErr_C "Behaviour control mask / Behaviour control masks of check DFC_EpmCaSI1OfsErr" VALUE 0x804D9160 Val_Wu16 65535.00 DFES_OneToOne 0.00 65535.00 FORMAT "%8.2" /end CHARACTERISTIC
/begin CHARACTERISTIC DFC_CtlMsk.DFC_EpmCrSDGI_C "Behaviour control mask / Behaviour control masks of check DFC_EpmCrSDGI" VALUE 0x804D9162 Val_Wu16 65535.00 DFES_OneToOne 0.00 65535.00 FORMAT "%8.2" /end CHARACTERISTIC
/begin CHARACTERISTIC DFC_CtlMsk.DFC_EpmCrSErrSig_C "Behaviour control mask / Behaviour control masks of check DFC_EpmCrSErrSig" VALUE 0x804D9164 Val_Wu16 65535.00 DFES_OneToOne 0.00 65535.00 FORMAT "%8.2" /end CHARACTERISTIC
/begin CHARACTERISTIC DFC_CtlMsk.DFC_EpmCrSNoSig_C "Behaviour control mask / Behaviour control masks of check DFC_EpmCrSNoSig" VALUE 0x804D9166 Val_Wu16 65535.00 DFES_OneToOne 0.00 65535.00 FORMAT "%8.2" /end CHARACTERISTIC
/begin CHARACTERISTIC DFC_CtlMsk.DFC_EtaEngIdleNonCsers_C "Behaviour control mask / Behaviour control masks of check DFC_EtaEngIdleNonCsers" VALUE 0x804D9168 Val_Wu16 65535.00 DFES_OneToOne 0.00 65535.00 FORMAT "%8.2" /end CHARACTERISTIC
/begin CHARACTERISTIC DFC_CtlMsk.DFC_EtaEngPtlNonCsers_C "Behaviour control mask / Behaviour control masks of check DFC_EtaEngPtlNonCsers" VALUE 0x804D916A Val_Wu16 65535.00 DFES_OneToOne 0.00 65535.00 FORMAT "%8.2" /end CHARACTERISTIC
/begin CHARACTERISTIC DFC_CtlMsk.DFC_FRAmax_C "Behaviour control mask / Behaviour control masks of check DFC_FRAmax" VALUE 0x804D916C Val_Wu16 65535.00 DFES_OneToOne 0.00 65535.00 FORMAT "%8.2" /end CHARACTERISTIC
/begin CHARACTERISTIC DFC_CtlMsk.DFC_FRAmin_C "Behaviour control mask / Behaviour control masks of check DFC_FRAmin" VALUE 0x804D916E Val_Wu16 65535.00 DFES_OneToOne 0.00 65535.00 FORMAT "%8.2" /end CHARACTERISTIC
/begin CHARACTERISTIC DFC_CtlMsk.DFC_FSTEmax_C "Behaviour control mask / Behaviour control masks of check DFC_FSTEmax" VALUE 0x804D9170 Val_Wu16 65535.00 DFES_OneToOne 0.00 65535.00 FORMAT "%8.2" /end CHARACTERISTIC
/begin CHARACTERISTIC DFC_CtlMsk.DFC_FSTEmin_C "Behaviour control mask / Behaviour control masks of check DFC_FSTEmin" VALUE 0x804D9172 Val_Wu16 65535.00 DFES_OneToOne 0.00 65535.00 FORMAT "%8.2" /end CHARACTERISTIC
/begin CHARACTERISTIC DFC_CtlMsk.DFC_FSTRmax_C "Behaviour control mask / Behaviour control masks of check DFC_FSTRmax" VALUE 0x804D9174 Val_Wu16 65535.00 DFES_OneToOne 0.00 65535.00 FORMAT "%8.2" /end CHARACTERISTIC
/begin CHARACTERISTIC DFC_CtlMsk.DFC_FSTRmin_C "Behaviour control mask / Behaviour control masks of check DFC_FSTRmin" VALUE 0x804D9176 Val_Wu16 65535.00 DFES_OneToOne 0.00 65535.00 FORMAT "%8.2" /end CHARACTERISTIC
/begin CHARACTERISTIC DFC_CtlMsk.DFC_FSTRnpl_C "Behaviour control mask / Behaviour control masks of check DFC_FSTRnpl" VALUE 0x804D9178 Val_Wu16 65535.00 DFES_OneToOne 0.00 65535.00 FORMAT "%8.2" /end CHARACTERISTIC
/begin CHARACTERISTIC DFC_CtlMsk.DFC_FSTmax_C "Behaviour control mask / Behaviour control masks of check DFC_FSTmax" VALUE 0x804D917A Val_Wu16 65535.00 DFES_OneToOne 0.00 65535.00 FORMAT "%8.2" /end CHARACTERISTIC
/begin CHARACTERISTIC DFC_CtlMsk.DFC_FTDLAmax_C "Behaviour control mask / Behaviour control masks of check DFC_FTDLAmax" VALUE 0x804D917C Val_Wu16 65535.00 DFES_OneToOne 0.00 65535.00 FORMAT "%8.2" /end CHARACTERISTIC
/begin CHARACTERISTIC DFC_CtlMsk.DFC_FTDLAmin_C "Behaviour control mask / Behaviour control masks of check DFC_FTDLAmin" VALUE 0x804D917E Val_Wu16 65535.00 DFES_OneToOne 0.00 65535.00 FORMAT "%8.2" /end CHARACTERISTIC
/begin CHARACTERISTIC DFC_CtlMsk.DFC_FuPHiSnsrEleclmax_C "Behaviour control mask / Behaviour control masks of check DFC_FuPHiSnsrEleclmax" VALUE 0x804D9180 Val_Wu16 65535.00 DFES_OneToOne 0.00 65535.00 FORMAT "%8.2" /end CHARACTERISTIC
/begin CHARACTERISTIC DFC_CtlMsk.DFC_FuPHiSnsrEleclmin_C "Behaviour control mask / Behaviour control masks of check DFC_FuPHiSnsrEleclmin" VALUE 0x804D9182 Val_Wu16 65535.00 DFES_OneToOne 0.00 65535.00 FORMAT "%8.2" /end CHARACTERISTIC
/begin CHARACTERISTIC DFC_CtlMsk.DFC_FuPHiSnsrEleclnpl_C "Behaviour control mask / Behaviour control masks of check DFC_FuPHiSnsrEleclnpl" VALUE 0x804D9184 Val_Wu16 65535.00 DFES_OneToOne 0.00 65535.00 FORMAT "%8.2" /end CHARACTERISTIC
/begin CHARACTERISTIC DFC_CtlMsk.DFC_FuPHiSnsrURngMax_C "Behaviour control mask / Behaviour control masks of check DFC_FuPHiSnsrURngMax" VALUE 0x804D9186 Val_Wu16 65535.00 DFES_OneToOne 0.00 65535.00 FORMAT "%8.2" /end CHARACTERISTIC
/begin CHARACTERISTIC DFC_CtlMsk.DFC_FuPHiSnsrURngMin_C "Behaviour control mask / Behaviour control masks of check DFC_FuPHiSnsrURngMin" VALUE 0x804D9188 Val_Wu16 65535.00 DFES_OneToOne 0.00 65535.00 FORMAT "%8.2" /end CHARACTERISTIC
/begin CHARACTERISTIC DFC_CtlMsk.DFC_FuSnsrPhyRngMaxErr_C "Behaviour control mask / Behaviour control masks of check DFC_FuSnsrPhyRngMaxErr" VALUE 0x804D918A Val_Wu16 65535.00 DFES_OneToOne 0.00 65535.00 FORMAT "%8.2" /end CHARACTERISTIC
/begin CHARACTERISTIC DFC_CtlMsk.DFC_FuSnsrPhyRngMinErr_C "Behaviour control mask / Behaviour control masks of check DFC_FuSnsrPhyRngMinErr" VALUE 0x804D918C Val_Wu16 65535.00 DFES_OneToOne 0.00 65535.00 FORMAT "%8.2" /end CHARACTERISTIC
/begin CHARACTERISTIC DFC_CtlMsk.DFC_GEVlvLockPinDiagIntkB1_C "Behaviour control mask / Behaviour control masks of check DFC_GEVlvLockPinDiagIntkB1" VALUE 0x804D918E Val_Wu16 65535.00 DFES_OneToOne 0.00 65535.00 FORMAT "%8.2" /end CHARACTERISTIC
/begin CHARACTERISTIC DFC_CtlMsk.DFC_GEVlvPhaSlowIntkB1_C "Behaviour control mask / Behaviour control masks of check DFC_GEVlvPhaSlowIntkB1" VALUE 0x804D9190 Val_Wu16 65535.00 DFES_OneToOne 0.00 65535.00 FORMAT "%8.2" /end CHARACTERISTIC
/begin CHARACTERISTIC DFC_CtlMsk.DFC_GEVlvPhaTargIntkB1_C "Behaviour control mask / Behaviour control masks of check DFC_GEVlvPhaTargIntkB1" VALUE 0x804D9192 Val_Wu16 65535.00 DFES_OneToOne 0.00 65535.00 FORMAT "%8.2" /end CHARACTERISTIC
/begin CHARACTERISTIC DFC_CtlMsk.DFC_GbxRvsSwtStk_C "Behaviour control mask / Behaviour control masks of check DFC_GbxRvsSwtStk" VALUE 0x804D9194 Val_Wu16 65535.00 DFES_OneToOne 0.00 65535.00 FORMAT "%8.2" /end CHARACTERISTIC
/begin CHARACTERISTIC DFC_CtlMsk.DFC_HDRKHmax_C "Behaviour control mask / Behaviour control masks of check DFC_HDRKHmax" VALUE 0x804D9196 Val_Wu16 65535.00 DFES_OneToOne 0.00 65535.00 FORMAT "%8.2" /end CHARACTERISTIC
/begin CHARACTERISTIC DFC_CtlMsk.DFC_HDRKHmin_C "Behaviour control mask / Behaviour control masks of check DFC_HDRKHmin" VALUE 0x804D9198 Val_Wu16 65535.00 DFES_OneToOne 0.00 65535.00 FORMAT "%8.2" /end CHARACTERISTIC
/begin CHARACTERISTIC DFC_CtlMsk.DFC_HDRPLmax_C "Behaviour control mask / Behaviour control masks of check DFC_HDRPLmax" VALUE 0x804D919A Val_Wu16 65535.00 DFES_OneToOne 0.00 65535.00 FORMAT "%8.2" /end CHARACTERISTIC
/begin CHARACTERISTIC DFC_CtlMsk.DFC_HDRPLmin_C "Behaviour control mask / Behaviour control masks of check DFC_HDRPLmin" VALUE 0x804D919C Val_Wu16 65535.00 DFES_OneToOne 0.00 65535.00 FORMAT "%8.2" /end CHARACTERISTIC
/begin CHARACTERISTIC DFC_CtlMsk.DFC_HDRmax_C "Behaviour control mask / Behaviour control masks of check DFC_HDRmax" VALUE 0x804D919E Val_Wu16 65535.00 DFES_OneToOne 0.00 65535.00 FORMAT "%8.2" /end CHARACTERISTIC
/begin CHARACTERISTIC DFC_CtlMsk.DFC_HDRmin_C "Behaviour control mask / Behaviour control masks of check DFC_HDRmin" VALUE 0x804D91A0 Val_Wu16 65535.00 DFES_OneToOne 0.00 65535.00 FORMAT "%8.2" /end CHARACTERISTIC
/begin CHARACTERISTIC DFC_CtlMsk.DFC_HEGOS2B1ElecMax_C "Behaviour control mask / Behaviour control masks of check DFC_HEGOS2B1ElecMax" VALUE 0x804D91A2 Val_Wu16 65535.00 DFES_OneToOne 0.00 65535.00 FORMAT "%8.2" /end CHARACTERISTIC
/begin CHARACTERISTIC DFC_CtlMsk.DFC_HEGOS2B1ElecMin_C "Behaviour control mask / Behaviour control masks of check DFC_HEGOS2B1ElecMin" VALUE 0x804D91A4 Val_Wu16 65535.00 DFES_OneToOne 0.00 65535.00 FORMAT "%8.2" /end CHARACTERISTIC
/begin CHARACTERISTIC DFC_CtlMsk.DFC_HEGOS2B1ElecSig_C "Behaviour control mask / Behaviour control masks of check DFC_HEGOS2B1ElecSig" VALUE 0x804D91A6 Val_Wu16 65535.00 DFES_OneToOne 0.00 65535.00 FORMAT "%8.2" /end CHARACTERISTIC
/begin CHARACTERISTIC DFC_CtlMsk.DFC_HEGOS2B1HtgNpl_C "Behaviour control mask / Behaviour control masks of check DFC_HEGOS2B1HtgNpl" VALUE 0x804D91A8 Val_Wu16 65535.00 DFES_OneToOne 0.00 65535.00 FORMAT "%8.2" /end CHARACTERISTIC
/begin CHARACTERISTIC DFC_CtlMsk.DFC_HEV00max_C "Behaviour control mask / Behaviour control masks of check DFC_HEV00max" VALUE 0x804D91AA Val_Wu16 65535.00 DFES_OneToOne 0.00 65535.00 FORMAT "%8.2" /end CHARACTERISTIC
/begin CHARACTERISTIC DFC_CtlMsk.DFC_HEV01max_C "Behaviour control mask / Behaviour control masks of check DFC_HEV01max" VALUE 0x804D91AC Val_Wu16 65535.00 DFES_OneToOne 0.00 65535.00 FORMAT "%8.2" /end CHARACTERISTIC
/begin CHARACTERISTIC DFC_CtlMsk.DFC_HEV02max_C "Behaviour control mask / Behaviour control masks of check DFC_HEV02max" VALUE 0x804D91AE Val_Wu16 65535.00 DFES_OneToOne 0.00 65535.00 FORMAT "%8.2" /end CHARACTERISTIC
/begin CHARACTERISTIC DFC_CtlMsk.DFC_HEV03max_C "Behaviour control mask / Behaviour control masks of check DFC_HEV03max" VALUE 0x804D91B0 Val_Wu16 65535.00 DFES_OneToOne 0.00 65535.00 FORMAT "%8.2" /end CHARACTERISTIC
/begin CHARACTERISTIC DFC_CtlMsk.DFC_HEVE0max_C "Behaviour control mask / Behaviour control masks of check DFC_HEVE0max" VALUE 0x804D91B2 Val_Wu16 65535.00 DFES_OneToOne 0.00 65535.00 FORMAT "%8.2" /end CHARACTERISTIC
/begin CHARACTERISTIC DFC_CtlMsk.DFC_HEVE1max_C "Behaviour control mask / Behaviour control masks of check DFC_HEVE1max" VALUE 0x804D91B4 Val_Wu16 65535.00 DFES_OneToOne 0.00 65535.00 FORMAT "%8.2" /end CHARACTERISTIC
/begin CHARACTERISTIC DFC_CtlMsk.DFC_HFMmax_C "Behaviour control mask / Behaviour control masks of check DFC_HFMmax" VALUE 0x804D91B6 Val_Wu16 65535.00 DFES_OneToOne 0.00 65535.00 FORMAT "%8.2" /end CHARACTERISTIC
/begin CHARACTERISTIC DFC_CtlMsk.DFC_HiPSysHiPMaxLimExcdd_C "Behaviour control mask / Behaviour control masks of check DFC_HiPSysHiPMaxLimExcdd" VALUE 0x804D91B8 Val_Wu16 65535.00 DFES_OneToOne 0.00 65535.00 FORMAT "%8.2" /end CHARACTERISTIC
/begin CHARACTERISTIC DFC_CtlMsk.DFC_IVGdiCtlCvoErrMax_0_C "Behaviour control mask / Behaviour control masks of check DFC_IVGdiCtlCvoErrMax_0" VALUE 0x804D91BA Val_Wu16 65535.00 DFES_OneToOne 0.00 65535.00 FORMAT "%8.2" /end CHARACTERISTIC
/begin CHARACTERISTIC DFC_CtlMsk.DFC_IVGdiCtlCvoErrMax_1_C "Behaviour control mask / Behaviour control masks of check DFC_IVGdiCtlCvoErrMax_1" VALUE 0x804D91BC Val_Wu16 65535.00 DFES_OneToOne 0.00 65535.00 FORMAT "%8.2" /end CHARACTERISTIC
/begin CHARACTERISTIC DFC_CtlMsk.DFC_IVGdiCtlCvoErrMax_2_C "Behaviour control mask / Behaviour control masks of check DFC_IVGdiCtlCvoErrMax_2" VALUE 0x804D91BE Val_Wu16 65535.00 DFES_OneToOne 0.00 65535.00 FORMAT "%8.2" /end CHARACTERISTIC
/begin CHARACTERISTIC DFC_CtlMsk.DFC_IVGdiCtlCvoErrMax_3_C "Behaviour control mask / Behaviour control masks of check DFC_IVGdiCtlCvoErrMax_3" VALUE 0x804D91C0 Val_Wu16 65535.00 DFES_OneToOne 0.00 65535.00 FORMAT "%8.2" /end CHARACTERISTIC
/begin CHARACTERISTIC DFC_CtlMsk.DFC_IVGdiCtlCvoErrMin_0_C "Behaviour control mask / Behaviour control masks of check DFC_IVGdiCtlCvoErrMin_0" VALUE 0x804D91C2 Val_Wu16 65535.00 DFES_OneToOne 0.00 65535.00 FORMAT "%8.2" /end CHARACTERISTIC
/begin CHARACTERISTIC DFC_CtlMsk.DFC_IVGdiCtlCvoErrMin_1_C "Behaviour control mask / Behaviour control masks of check DFC_IVGdiCtlCvoErrMin_1" VALUE 0x804D91C4 Val_Wu16 65535.00 DFES_OneToOne 0.00 65535.00 FORMAT "%8.2" /end CHARACTERISTIC
/begin CHARACTERISTIC DFC_CtlMsk.DFC_IVGdiCtlCvoErrMin_2_C "Behaviour control mask / Behaviour control masks of check DFC_IVGdiCtlCvoErrMin_2" VALUE 0x804D91C6 Val_Wu16 65535.00 DFES_OneToOne 0.00 65535.00 FORMAT "%8.2" /end CHARACTERISTIC
/begin CHARACTERISTIC DFC_CtlMsk.DFC_IVGdiCtlCvoErrMin_3_C "Behaviour control mask / Behaviour control masks of check DFC_IVGdiCtlCvoErrMin_3" VALUE 0x804D91C8 Val_Wu16 65535.00 DFES_OneToOne 0.00 65535.00 FORMAT "%8.2" /end CHARACTERISTIC
/begin CHARACTERISTIC DFC_CtlMsk.DFC_IVGdiCtlCvoErrMinMax_C "Behaviour control mask / Behaviour control masks of check DFC_IVGdiCtlCvoErrMinMax" VALUE 0x804D91CA Val_Wu16 65535.00 DFES_OneToOne 0.00 65535.00 FORMAT "%8.2" /end CHARACTERISTIC
/begin CHARACTERISTIC DFC_CtlMsk.DFC_IVGdiCtlCvoSigPlausErrSmrCdn_C "Behaviour control mask / Behaviour control masks of check DFC_IVGdiCtlCvoSigPlausErrSmrCdn" VALUE 0x804D91CC Val_Wu16 65535.00 DFES_OneToOne 0.00 65535.00 FORMAT "%8.2" /end CHARACTERISTIC
/begin CHARACTERISTIC DFC_CtlMsk.DFC_IVGdiCtl_CvoErr_C "Behaviour control mask / Behaviour control masks of check DFC_IVGdiCtl_CvoErr" VALUE 0x804D91CE Val_Wu16 65535.00 DFES_OneToOne 0.00 65535.00 FORMAT "%8.2" /end CHARACTERISTIC
/begin CHARACTERISTIC DFC_CtlMsk.DFC_IVGdiCtl_CvoSigPlaus_0_C "Behaviour control mask / Behaviour control masks of check DFC_IVGdiCtl_CvoSigPlaus_0" VALUE 0x804D91D0 Val_Wu16 65535.00 DFES_OneToOne 0.00 65535.00 FORMAT "%8.2" /end CHARACTERISTIC
/begin CHARACTERISTIC DFC_CtlMsk.DFC_IVGdiCtl_CvoSigPlaus_1_C "Behaviour control mask / Behaviour control masks of check DFC_IVGdiCtl_CvoSigPlaus_1" VALUE 0x804D91D2 Val_Wu16 65535.00 DFES_OneToOne 0.00 65535.00 FORMAT "%8.2" /end CHARACTERISTIC
/begin CHARACTERISTIC DFC_CtlMsk.DFC_IVGdiCtl_CvoSigPlaus_2_C "Behaviour control mask / Behaviour control masks of check DFC_IVGdiCtl_CvoSigPlaus_2" VALUE 0x804D91D4 Val_Wu16 65535.00 DFES_OneToOne 0.00 65535.00 FORMAT "%8.2" /end CHARACTERISTIC
/begin CHARACTERISTIC DFC_CtlMsk.DFC_IVGdiCtl_CvoSigPlaus_3_C "Behaviour control mask / Behaviour control masks of check DFC_IVGdiCtl_CvoSigPlaus_3" VALUE 0x804D91D6 Val_Wu16 65535.00 DFES_OneToOne 0.00 65535.00 FORMAT "%8.2" /end CHARACTERISTIC
/begin CHARACTERISTIC DFC_CtlMsk.DFC_IntkAirTAirFltDsCrssMax_C "Behaviour control mask / Behaviour control masks of check DFC_IntkAirTAirFltDsCrssMax" VALUE 0x804D91D8 Val_Wu16 65535.00 DFES_OneToOne 0.00 65535.00 FORMAT "%8.2" /end CHARACTERISTIC
/begin CHARACTERISTIC DFC_CtlMsk.DFC_IntkAirTAirFltDsCrssMin_C "Behaviour control mask / Behaviour control masks of check DFC_IntkAirTAirFltDsCrssMin" VALUE 0x804D91DA Val_Wu16 65535.00 DFES_OneToOne 0.00 65535.00 FORMAT "%8.2" /end CHARACTERISTIC
/begin CHARACTERISTIC DFC_CtlMsk.DFC_IntkAirTAirFltDsHSCMax_C "Behaviour control mask / Behaviour control masks of check DFC_IntkAirTAirFltDsHSCMax" VALUE 0x804D91DC Val_Wu16 65535.00 DFES_OneToOne 0.00 65535.00 FORMAT "%8.2" /end CHARACTERISTIC
/begin CHARACTERISTIC DFC_CtlMsk.DFC_IntkAirTAirFltDsImps_C "Behaviour control mask / Behaviour control masks of check DFC_IntkAirTAirFltDsImps" VALUE 0x804D91DE Val_Wu16 65535.00 DFES_OneToOne 0.00 65535.00 FORMAT "%8.2" /end CHARACTERISTIC
/begin CHARACTERISTIC DFC_CtlMsk.DFC_IntkAirTAirFltDsPRCMax_C "Behaviour control mask / Behaviour control masks of check DFC_IntkAirTAirFltDsPRCMax" VALUE 0x804D91E0 Val_Wu16 65535.00 DFES_OneToOne 0.00 65535.00 FORMAT "%8.2" /end CHARACTERISTIC
/begin CHARACTERISTIC DFC_CtlMsk.DFC_IntkAirTAirFltDsPRCMin_C "Behaviour control mask / Behaviour control masks of check DFC_IntkAirTAirFltDsPRCMin" VALUE 0x804D91E2 Val_Wu16 65535.00 DFES_OneToOne 0.00 65535.00 FORMAT "%8.2" /end CHARACTERISTIC
/begin CHARACTERISTIC DFC_CtlMsk.DFC_IntkAirTAirFltDsSRCMax_C "Behaviour control mask / Behaviour control masks of check DFC_IntkAirTAirFltDsSRCMax" VALUE 0x804D91E4 Val_Wu16 65535.00 DFES_OneToOne 0.00 65535.00 FORMAT "%8.2" /end CHARACTERISTIC
/begin CHARACTERISTIC DFC_CtlMsk.DFC_IntkAirTAirFltDsSRCMin_C "Behaviour control mask / Behaviour control masks of check DFC_IntkAirTAirFltDsSRCMin" VALUE 0x804D91E6 Val_Wu16 65535.00 DFES_OneToOne 0.00 65535.00 FORMAT "%8.2" /end CHARACTERISTIC
/begin CHARACTERISTIC DFC_CtlMsk.DFC_IntkAirTAirFltDsSTC_C "Behaviour control mask / Behaviour control masks of check DFC_IntkAirTAirFltDsSTC" VALUE 0x804D91E8 Val_Wu16 65535.00 DFES_OneToOne 0.00 65535.00 FORMAT "%8.2" /end CHARACTERISTIC
/begin CHARACTERISTIC DFC_CtlMsk.DFC_IntkAirTIntkMnfldCrssMax_C "Behaviour control mask / Behaviour control masks of check DFC_IntkAirTIntkMnfldCrssMax" VALUE 0x804D91EA Val_Wu16 65535.00 DFES_OneToOne 0.00 65535.00 FORMAT "%8.2" /end CHARACTERISTIC
/begin CHARACTERISTIC DFC_CtlMsk.DFC_IntkAirTIntkMnfldCrssMin_C "Behaviour control mask / Behaviour control masks of check DFC_IntkAirTIntkMnfldCrssMin" VALUE 0x804D91EC Val_Wu16 65535.00 DFES_OneToOne 0.00 65535.00 FORMAT "%8.2" /end CHARACTERISTIC
/begin CHARACTERISTIC DFC_CtlMsk.DFC_IntkAirTIntkMnfldHSCMax_C "Behaviour control mask / Behaviour control masks of check DFC_IntkAirTIntkMnfldHSCMax" VALUE 0x804D91EE Val_Wu16 65535.00 DFES_OneToOne 0.00 65535.00 FORMAT "%8.2" /end CHARACTERISTIC
/begin CHARACTERISTIC DFC_CtlMsk.DFC_IntkAirTIntkMnfldImps_C "Behaviour control mask / Behaviour control masks of check DFC_IntkAirTIntkMnfldImps" VALUE 0x804D91F0 Val_Wu16 65535.00 DFES_OneToOne 0.00 65535.00 FORMAT "%8.2" /end CHARACTERISTIC
/begin CHARACTERISTIC DFC_CtlMsk.DFC_IntkAirTIntkMnfldPRCMax_C "Behaviour control mask / Behaviour control masks of check DFC_IntkAirTIntkMnfldPRCMax" VALUE 0x804D91F2 Val_Wu16 65535.00 DFES_OneToOne 0.00 65535.00 FORMAT "%8.2" /end CHARACTERISTIC
/begin CHARACTERISTIC DFC_CtlMsk.DFC_IntkAirTIntkMnfldPRCMin_C "Behaviour control mask / Behaviour control masks of check DFC_IntkAirTIntkMnfldPRCMin" VALUE 0x804D91F4 Val_Wu16 65535.00 DFES_OneToOne 0.00 65535.00 FORMAT "%8.2" /end CHARACTERISTIC
/begin CHARACTERISTIC DFC_CtlMsk.DFC_IntkAirTIntkMnfldSRCMax_C "Behaviour control mask / Behaviour control masks of check DFC_IntkAirTIntkMnfldSRCMax" VALUE 0x804D91F6 Val_Wu16 65535.00 DFES_OneToOne 0.00 65535.00 FORMAT "%8.2" /end CHARACTERISTIC
/begin CHARACTERISTIC DFC_CtlMsk.DFC_IntkAirTIntkMnfldSRCMin_C "Behaviour control mask / Behaviour control masks of check DFC_IntkAirTIntkMnfldSRCMin" VALUE 0x804D91F8 Val_Wu16 65535.00 DFES_OneToOne 0.00 65535.00 FORMAT "%8.2" /end CHARACTERISTIC
/begin CHARACTERISTIC DFC_CtlMsk.DFC_IntkAirTIntkMnfldSTC_C "Behaviour control mask / Behaviour control masks of check DFC_IntkAirTIntkMnfldSTC" VALUE 0x804D91FA Val_Wu16 65535.00 DFES_OneToOne 0.00 65535.00 FORMAT "%8.2" /end CHARACTERISTIC
/begin CHARACTERISTIC DFC_CtlMsk.DFC_KRREGRLMX_C "Behaviour control mask / Behaviour control masks of check DFC_KRREGRLMX" VALUE 0x804D91FC Val_Wu16 65535.00 DFES_OneToOne 0.00 65535.00 FORMAT "%8.2" /end CHARACTERISTIC
/begin CHARACTERISTIC DFC_CtlMsk.DFC_KRVEKOCVLCI_C "Behaviour control mask / Behaviour control masks of check DFC_KRVEKOCVLCI" VALUE 0x804D91FE Val_Wu16 65535.00 DFES_OneToOne 0.00 65535.00 FORMAT "%8.2" /end CHARACTERISTIC
/begin CHARACTERISTIC DFC_CtlMsk.DFC_KRVEKOENCHMT_C "Behaviour control mask / Behaviour control masks of check DFC_KRVEKOENCHMT" VALUE 0x804D9200 Val_Wu16 65535.00 DFES_OneToOne 0.00 65535.00 FORMAT "%8.2" /end CHARACTERISTIC
/begin CHARACTERISTIC DFC_CtlMsk.DFC_KRVEKOENCHMT0_C "Behaviour control mask / Behaviour control masks of check DFC_KRVEKOENCHMT0" VALUE 0x804D9202 Val_Wu16 65535.00 DFES_OneToOne 0.00 65535.00 FORMAT "%8.2" /end CHARACTERISTIC
/begin CHARACTERISTIC DFC_CtlMsk.DFC_KRVEKOENCHMT1_C "Behaviour control mask / Behaviour control masks of check DFC_KRVEKOENCHMT1" VALUE 0x804D9204 Val_Wu16 65535.00 DFES_OneToOne 0.00 65535.00 FORMAT "%8.2" /end CHARACTERISTIC
/begin CHARACTERISTIC DFC_CtlMsk.DFC_KRVEKOENCHMT2_C "Behaviour control mask / Behaviour control masks of check DFC_KRVEKOENCHMT2" VALUE 0x804D9206 Val_Wu16 65535.00 DFES_OneToOne 0.00 65535.00 FORMAT "%8.2" /end CHARACTERISTIC
/begin CHARACTERISTIC DFC_CtlMsk.DFC_KRVEKOENCHMT3_C "Behaviour control mask / Behaviour control masks of check DFC_KRVEKOENCHMT3" VALUE 0x804D9208 Val_Wu16 65535.00 DFES_OneToOne 0.00 65535.00 FORMAT "%8.2" /end CHARACTERISTIC
/begin CHARACTERISTIC DFC_CtlMsk.DFC_KRVEKOENCHMT4_C "Behaviour control mask / Behaviour control masks of check DFC_KRVEKOENCHMT4" VALUE 0x804D920A Val_Wu16 65535.00 DFES_OneToOne 0.00 65535.00 FORMAT "%8.2" /end CHARACTERISTIC
/begin CHARACTERISTIC DFC_CtlMsk.DFC_KRVEKOENCHMT5_C "Behaviour control mask / Behaviour control masks of check DFC_KRVEKOENCHMT5" VALUE 0x804D920C Val_Wu16 65535.00 DFES_OneToOne 0.00 65535.00 FORMAT "%8.2" /end CHARACTERISTIC
/begin CHARACTERISTIC DFC_CtlMsk.DFC_KRVEKOENCHMT6_C "Behaviour control mask / Behaviour control masks of check DFC_KRVEKOENCHMT6" VALUE 0x804D920E Val_Wu16 65535.00 DFES_OneToOne 0.00 65535.00 FORMAT "%8.2" /end CHARACTERISTIC
/begin CHARACTERISTIC DFC_CtlMsk.DFC_KRVEKOENCHMT7_C "Behaviour control mask / Behaviour control masks of check DFC_KRVEKOENCHMT7" VALUE 0x804D9210 Val_Wu16 65535.00 DFES_OneToOne 0.00 65535.00 FORMAT "%8.2" /end CHARACTERISTIC
/begin CHARACTERISTIC DFC_CtlMsk.DFC_KRVEKORLMX_C "Behaviour control mask / Behaviour control masks of check DFC_KRVEKORLMX" VALUE 0x804D9212 Val_Wu16 65535.00 DFES_OneToOne 0.00 65535.00 FORMAT "%8.2" /end CHARACTERISTIC
/begin CHARACTERISTIC DFC_CtlMsk.DFC_KRVEKORLMXL_C "Behaviour control mask / Behaviour control masks of check DFC_KRVEKORLMXL" VALUE 0x804D9214 Val_Wu16 65535.00 DFES_OneToOne 0.00 65535.00 FORMAT "%8.2" /end CHARACTERISTIC
/begin CHARACTERISTIC DFC_CtlMsk.DFC_KS1max_C "Behaviour control mask / Behaviour control masks of check DFC_KS1max" VALUE 0x804D9216 Val_Wu16 65535.00 DFES_OneToOne 0.00 65535.00 FORMAT "%8.2" /end CHARACTERISTIC
/begin CHARACTERISTIC DFC_CtlMsk.DFC_KS1min_C "Behaviour control mask / Behaviour control masks of check DFC_KS1min" VALUE 0x804D9218 Val_Wu16 65535.00 DFES_OneToOne 0.00 65535.00 FORMAT "%8.2" /end CHARACTERISTIC
/begin CHARACTERISTIC DFC_CtlMsk.DFC_LMmax_C "Behaviour control mask / Behaviour control masks of check DFC_LMmax" VALUE 0x804D921A Val_Wu16 65535.00 DFES_OneToOne 0.00 65535.00 FORMAT "%8.2" /end CHARACTERISTIC
/begin CHARACTERISTIC DFC_CtlMsk.DFC_LZSRnpl_C "Behaviour control mask / Behaviour control masks of check DFC_LZSRnpl" VALUE 0x804D921C Val_Wu16 65535.00 DFES_OneToOne 0.00 65535.00 FORMAT "%8.2" /end CHARACTERISTIC
/begin CHARACTERISTIC DFC_CtlMsk.DFC_LamDynDiagS1B1_C "Behaviour control mask / Behaviour control masks of check DFC_LamDynDiagS1B1" VALUE 0x804D921E Val_Wu16 65535.00 DFES_OneToOne 0.00 65535.00 FORMAT "%8.2" /end CHARACTERISTIC
/begin CHARACTERISTIC DFC_CtlMsk.DFC_LeakIntkMnfldEmiInfl_C "Behaviour control mask / Behaviour control masks of check DFC_LeakIntkMnfldEmiInfl" VALUE 0x804D9220 Val_Wu16 65535.00 DFES_OneToOne 0.00 65535.00 FORMAT "%8.2" /end CHARACTERISTIC
/begin CHARACTERISTIC DFC_CtlMsk.DFC_LinFrameErrDCDC_C "Behaviour control mask / Behaviour control masks of check DFC_LinFrameErrDCDC" VALUE 0x804D9222 Val_Wu16 65535.00 DFES_OneToOne 0.00 65535.00 FORMAT "%8.2" /end CHARACTERISTIC
/begin CHARACTERISTIC DFC_CtlMsk.DFC_LinOverrunErrDCDC_C "Behaviour control mask / Behaviour control masks of check DFC_LinOverrunErrDCDC" VALUE 0x804D9224 Val_Wu16 65535.00 DFES_OneToOne 0.00 65535.00 FORMAT "%8.2" /end CHARACTERISTIC
/begin CHARACTERISTIC DFC_CtlMsk.DFC_MD00max_C "Behaviour control mask / Behaviour control masks of check DFC_MD00max" VALUE 0x804D9226 Val_Wu16 65535.00 DFES_OneToOne 0.00 65535.00 FORMAT "%8.2" /end CHARACTERISTIC
/begin CHARACTERISTIC DFC_CtlMsk.DFC_MDBmax_C "Behaviour control mask / Behaviour control masks of check DFC_MDBmax" VALUE 0x804D9228 Val_Wu16 65535.00 DFES_OneToOne 0.00 65535.00 FORMAT "%8.2" /end CHARACTERISTIC
/begin CHARACTERISTIC DFC_CtlMsk.DFC_MDCat_C "Behaviour control mask / Behaviour control masks of check DFC_MDCat" VALUE 0x804D922A Val_Wu16 65535.00 DFES_OneToOne 0.00 65535.00 FORMAT "%8.2" /end CHARACTERISTIC
/begin CHARACTERISTIC DFC_CtlMsk.DFC_MDCatCrit_C "Behaviour control mask / Behaviour control masks of check DFC_MDCatCrit" VALUE 0x804D922C Val_Wu16 65535.00 DFES_OneToOne 0.00 65535.00 FORMAT "%8.2" /end CHARACTERISTIC
/begin CHARACTERISTIC DFC_CtlMsk.DFC_MDCatCurr_C "Behaviour control mask / Behaviour control masks of check DFC_MDCatCurr" VALUE 0x804D922E Val_Wu16 65535.00 DFES_OneToOne 0.00 65535.00 FORMAT "%8.2" /end CHARACTERISTIC
/begin CHARACTERISTIC DFC_CtlMsk.DFC_MDCyl_0_C "Behaviour control mask / Behaviour control masks of check DFC_MDCyl_0" VALUE 0x804D9230 Val_Wu16 65535.00 DFES_OneToOne 0.00 65535.00 FORMAT "%8.2" /end CHARACTERISTIC
/begin CHARACTERISTIC DFC_CtlMsk.DFC_MDCyl_1_C "Behaviour control mask / Behaviour control masks of check DFC_MDCyl_1" VALUE 0x804D9232 Val_Wu16 65535.00 DFES_OneToOne 0.00 65535.00 FORMAT "%8.2" /end CHARACTERISTIC
/begin CHARACTERISTIC DFC_CtlMsk.DFC_MDCyl_2_C "Behaviour control mask / Behaviour control masks of check DFC_MDCyl_2" VALUE 0x804D9234 Val_Wu16 65535.00 DFES_OneToOne 0.00 65535.00 FORMAT "%8.2" /end CHARACTERISTIC
/begin CHARACTERISTIC DFC_CtlMsk.DFC_MDCyl_3_C "Behaviour control mask / Behaviour control masks of check DFC_MDCyl_3" VALUE 0x804D9236 Val_Wu16 65535.00 DFES_OneToOne 0.00 65535.00 FORMAT "%8.2" /end CHARACTERISTIC
/begin CHARACTERISTIC DFC_CtlMsk.DFC_MDEmi_C "Behaviour control mask / Behaviour control masks of check DFC_MDEmi" VALUE 0x804D9238 Val_Wu16 65535.00 DFES_OneToOne 0.00 65535.00 FORMAT "%8.2" /end CHARACTERISTIC
/begin CHARACTERISTIC DFC_CtlMsk.DFC_MDEmiStrt_C "Behaviour control mask / Behaviour control masks of check DFC_MDEmiStrt" VALUE 0x804D923A Val_Wu16 65535.00 DFES_OneToOne 0.00 65535.00 FORMAT "%8.2" /end CHARACTERISTIC
/begin CHARACTERISTIC DFC_CtlMsk.DFC_MDFco_C "Behaviour control mask / Behaviour control masks of check DFC_MDFco" VALUE 0x804D923C Val_Wu16 65535.00 DFES_OneToOne 0.00 65535.00 FORMAT "%8.2" /end CHARACTERISTIC
/begin CHARACTERISTIC DFC_CtlMsk.DFC_MDMpl_C "Behaviour control mask / Behaviour control masks of check DFC_MDMpl" VALUE 0x804D923E Val_Wu16 65535.00 DFES_OneToOne 0.00 65535.00 FORMAT "%8.2" /end CHARACTERISTIC
/begin CHARACTERISTIC DFC_CtlMsk.DFC_MDSegTiAdpn_C "Behaviour control mask / Behaviour control masks of check DFC_MDSegTiAdpn" VALUE 0x804D9240 Val_Wu16 65535.00 DFES_OneToOne 0.00 65535.00 FORMAT "%8.2" /end CHARACTERISTIC
/begin CHARACTERISTIC DFC_CtlMsk.DFC_MDmax_C "Behaviour control mask / Behaviour control masks of check DFC_MDmax" VALUE 0x804D9242 Val_Wu16 65535.00 DFES_OneToOne 0.00 65535.00 FORMAT "%8.2" /end CHARACTERISTIC
/begin CHARACTERISTIC DFC_CtlMsk.DFC_MFuOilMax_C "Behaviour control mask / Behaviour control masks of check DFC_MFuOilMax" VALUE 0x804D9244 Val_Wu16 65535.00 DFES_OneToOne 0.00 65535.00 FORMAT "%8.2" /end CHARACTERISTIC
/begin CHARACTERISTIC DFC_CtlMsk.DFC_MOXEMM_SMU_ALM0_0_C "Behaviour control mask / Behaviour control masks of check DFC_MOXEMM_SMU_ALM0_0" VALUE 0x804D9246 Val_Wu16 65535.00 DFES_OneToOne 0.00 65535.00 FORMAT "%8.2" /end CHARACTERISTIC
/begin CHARACTERISTIC DFC_CtlMsk.DFC_MOXEMM_SMU_ALM0_1_C "Behaviour control mask / Behaviour control masks of check DFC_MOXEMM_SMU_ALM0_1" VALUE 0x804D9248 Val_Wu16 65535.00 DFES_OneToOne 0.00 65535.00 FORMAT "%8.2" /end CHARACTERISTIC
/begin CHARACTERISTIC DFC_CtlMsk.DFC_MOXEMM_SMU_ALM0_10_C "Behaviour control mask / Behaviour control masks of check DFC_MOXEMM_SMU_ALM0_10" VALUE 0x804D924A Val_Wu16 65535.00 DFES_OneToOne 0.00 65535.00 FORMAT "%8.2" /end CHARACTERISTIC
/begin CHARACTERISTIC DFC_CtlMsk.DFC_MOXEMM_SMU_ALM0_11_C "Behaviour control mask / Behaviour control masks of check DFC_MOXEMM_SMU_ALM0_11" VALUE 0x804D924C Val_Wu16 65535.00 DFES_OneToOne 0.00 65535.00 FORMAT "%8.2" /end CHARACTERISTIC
/begin CHARACTERISTIC DFC_CtlMsk.DFC_MOXEMM_SMU_ALM0_13_C "Behaviour control mask / Behaviour control masks of check DFC_MOXEMM_SMU_ALM0_13" VALUE 0x804D924E Val_Wu16 65535.00 DFES_OneToOne 0.00 65535.00 FORMAT "%8.2" /end CHARACTERISTIC
/begin CHARACTERISTIC DFC_CtlMsk.DFC_MOXEMM_SMU_ALM0_14_C "Behaviour control mask / Behaviour control masks of check DFC_MOXEMM_SMU_ALM0_14" VALUE 0x804D9250 Val_Wu16 65535.00 DFES_OneToOne 0.00 65535.00 FORMAT "%8.2" /end CHARACTERISTIC
/begin CHARACTERISTIC DFC_CtlMsk.DFC_MOXEMM_SMU_ALM0_2_C "Behaviour control mask / Behaviour control masks of check DFC_MOXEMM_SMU_ALM0_2" VALUE 0x804D9252 Val_Wu16 65535.00 DFES_OneToOne 0.00 65535.00 FORMAT "%8.2" /end CHARACTERISTIC
/begin CHARACTERISTIC DFC_CtlMsk.DFC_MOXEMM_SMU_ALM0_22_C "Behaviour control mask / Behaviour control masks of check DFC_MOXEMM_SMU_ALM0_22" VALUE 0x804D9254 Val_Wu16 65535.00 DFES_OneToOne 0.00 65535.00 FORMAT "%8.2" /end CHARACTERISTIC
/begin CHARACTERISTIC DFC_CtlMsk.DFC_MOXEMM_SMU_ALM0_23_C "Behaviour control mask / Behaviour control masks of check DFC_MOXEMM_SMU_ALM0_23" VALUE 0x804D9256 Val_Wu16 65535.00 DFES_OneToOne 0.00 65535.00 FORMAT "%8.2" /end CHARACTERISTIC
/begin CHARACTERISTIC DFC_CtlMsk.DFC_MOXEMM_SMU_ALM0_4_C "Behaviour control mask / Behaviour control masks of check DFC_MOXEMM_SMU_ALM0_4" VALUE 0x804D9258 Val_Wu16 65535.00 DFES_OneToOne 0.00 65535.00 FORMAT "%8.2" /end CHARACTERISTIC
/begin CHARACTERISTIC DFC_CtlMsk.DFC_MOXEMM_SMU_ALM0_5_C "Behaviour control mask / Behaviour control masks of check DFC_MOXEMM_SMU_ALM0_5" VALUE 0x804D925A Val_Wu16 65535.00 DFES_OneToOne 0.00 65535.00 FORMAT "%8.2" /end CHARACTERISTIC
/begin CHARACTERISTIC DFC_CtlMsk.DFC_MOXEMM_SMU_ALM0_7_C "Behaviour control mask / Behaviour control masks of check DFC_MOXEMM_SMU_ALM0_7" VALUE 0x804D925C Val_Wu16 65535.00 DFES_OneToOne 0.00 65535.00 FORMAT "%8.2" /end CHARACTERISTIC
/begin CHARACTERISTIC DFC_CtlMsk.DFC_MOXEMM_SMU_ALM0_8_C "Behaviour control mask / Behaviour control masks of check DFC_MOXEMM_SMU_ALM0_8" VALUE 0x804D925E Val_Wu16 65535.00 DFES_OneToOne 0.00 65535.00 FORMAT "%8.2" /end CHARACTERISTIC
/begin CHARACTERISTIC DFC_CtlMsk.DFC_MOXEMM_SMU_ALM10_16_C "Behaviour control mask / Behaviour control masks of check DFC_MOXEMM_SMU_ALM10_16" VALUE 0x804D9260 Val_Wu16 65535.00 DFES_OneToOne 0.00 65535.00 FORMAT "%8.2" /end CHARACTERISTIC
/begin CHARACTERISTIC DFC_CtlMsk.DFC_MOXEMM_SMU_ALM10_17_C "Behaviour control mask / Behaviour control masks of check DFC_MOXEMM_SMU_ALM10_17" VALUE 0x804D9262 Val_Wu16 65535.00 DFES_OneToOne 0.00 65535.00 FORMAT "%8.2" /end CHARACTERISTIC
/begin CHARACTERISTIC DFC_CtlMsk.DFC_MOXEMM_SMU_ALM10_21_C "Behaviour control mask / Behaviour control masks of check DFC_MOXEMM_SMU_ALM10_21" VALUE 0x804D9264 Val_Wu16 65535.00 DFES_OneToOne 0.00 65535.00 FORMAT "%8.2" /end CHARACTERISTIC
/begin CHARACTERISTIC DFC_CtlMsk.DFC_MOXEMM_SMU_ALM11_0_C "Behaviour control mask / Behaviour control masks of check DFC_MOXEMM_SMU_ALM11_0" VALUE 0x804D9266 Val_Wu16 65535.00 DFES_OneToOne 0.00 65535.00 FORMAT "%8.2" /end CHARACTERISTIC
/begin CHARACTERISTIC DFC_CtlMsk.DFC_MOXEMM_SMU_ALM11_1_C "Behaviour control mask / Behaviour control masks of check DFC_MOXEMM_SMU_ALM11_1" VALUE 0x804D9268 Val_Wu16 65535.00 DFES_OneToOne 0.00 65535.00 FORMAT "%8.2" /end CHARACTERISTIC
/begin CHARACTERISTIC DFC_CtlMsk.DFC_MOXEMM_SMU_ALM11_2_C "Behaviour control mask / Behaviour control masks of check DFC_MOXEMM_SMU_ALM11_2" VALUE 0x804D926A Val_Wu16 65535.00 DFES_OneToOne 0.00 65535.00 FORMAT "%8.2" /end CHARACTERISTIC
/begin CHARACTERISTIC DFC_CtlMsk.DFC_MOXEMM_SMU_ALM11_3_C "Behaviour control mask / Behaviour control masks of check DFC_MOXEMM_SMU_ALM11_3" VALUE 0x804D926C Val_Wu16 65535.00 DFES_OneToOne 0.00 65535.00 FORMAT "%8.2" /end CHARACTERISTIC
/begin CHARACTERISTIC DFC_CtlMsk.DFC_MOXEMM_SMU_ALM11_4_C "Behaviour control mask / Behaviour control masks of check DFC_MOXEMM_SMU_ALM11_4" VALUE 0x804D926E Val_Wu16 65535.00 DFES_OneToOne 0.00 65535.00 FORMAT "%8.2" /end CHARACTERISTIC
/begin CHARACTERISTIC DFC_CtlMsk.DFC_MOXEMM_SMU_ALM11_5_C "Behaviour control mask / Behaviour control masks of check DFC_MOXEMM_SMU_ALM11_5" VALUE 0x804D9270 Val_Wu16 65535.00 DFES_OneToOne 0.00 65535.00 FORMAT "%8.2" /end CHARACTERISTIC
/begin CHARACTERISTIC DFC_CtlMsk.DFC_MOXEMM_SMU_ALM11_8_C "Behaviour control mask / Behaviour control masks of check DFC_MOXEMM_SMU_ALM11_8" VALUE 0x804D9272 Val_Wu16 65535.00 DFES_OneToOne 0.00 65535.00 FORMAT "%8.2" /end CHARACTERISTIC
/begin CHARACTERISTIC DFC_CtlMsk.DFC_MOXEMM_SMU_ALM11_9_C "Behaviour control mask / Behaviour control masks of check DFC_MOXEMM_SMU_ALM11_9" VALUE 0x804D9274 Val_Wu16 65535.00 DFES_OneToOne 0.00 65535.00 FORMAT "%8.2" /end CHARACTERISTIC
/begin CHARACTERISTIC DFC_CtlMsk.DFC_MOXEMM_SMU_ALM1_0_C "Behaviour control mask / Behaviour control masks of check DFC_MOXEMM_SMU_ALM1_0" VALUE 0x804D9276 Val_Wu16 65535.00 DFES_OneToOne 0.00 65535.00 FORMAT "%8.2" /end CHARACTERISTIC
/begin CHARACTERISTIC DFC_CtlMsk.DFC_MOXEMM_SMU_ALM1_1_C "Behaviour control mask / Behaviour control masks of check DFC_MOXEMM_SMU_ALM1_1" VALUE 0x804D9278 Val_Wu16 65535.00 DFES_OneToOne 0.00 65535.00 FORMAT "%8.2" /end CHARACTERISTIC
/begin CHARACTERISTIC DFC_CtlMsk.DFC_MOXEMM_SMU_ALM1_10_C "Behaviour control mask / Behaviour control masks of check DFC_MOXEMM_SMU_ALM1_10" VALUE 0x804D927A Val_Wu16 65535.00 DFES_OneToOne 0.00 65535.00 FORMAT "%8.2" /end CHARACTERISTIC
/begin CHARACTERISTIC DFC_CtlMsk.DFC_MOXEMM_SMU_ALM1_11_C "Behaviour control mask / Behaviour control masks of check DFC_MOXEMM_SMU_ALM1_11" VALUE 0x804D927C Val_Wu16 65535.00 DFES_OneToOne 0.00 65535.00 FORMAT "%8.2" /end CHARACTERISTIC
/begin CHARACTERISTIC DFC_CtlMsk.DFC_MOXEMM_SMU_ALM1_13_C "Behaviour control mask / Behaviour control masks of check DFC_MOXEMM_SMU_ALM1_13" VALUE 0x804D927E Val_Wu16 65535.00 DFES_OneToOne 0.00 65535.00 FORMAT "%8.2" /end CHARACTERISTIC
/begin CHARACTERISTIC DFC_CtlMsk.DFC_MOXEMM_SMU_ALM1_14_C "Behaviour control mask / Behaviour control masks of check DFC_MOXEMM_SMU_ALM1_14" VALUE 0x804D9280 Val_Wu16 65535.00 DFES_OneToOne 0.00 65535.00 FORMAT "%8.2" /end CHARACTERISTIC
/begin CHARACTERISTIC DFC_CtlMsk.DFC_MOXEMM_SMU_ALM1_2_C "Behaviour control mask / Behaviour control masks of check DFC_MOXEMM_SMU_ALM1_2" VALUE 0x804D9282 Val_Wu16 65535.00 DFES_OneToOne 0.00 65535.00 FORMAT "%8.2" /end CHARACTERISTIC
/begin CHARACTERISTIC DFC_CtlMsk.DFC_MOXEMM_SMU_ALM1_22_C "Behaviour control mask / Behaviour control masks of check DFC_MOXEMM_SMU_ALM1_22" VALUE 0x804D9284 Val_Wu16 65535.00 DFES_OneToOne 0.00 65535.00 FORMAT "%8.2" /end CHARACTERISTIC
/begin CHARACTERISTIC DFC_CtlMsk.DFC_MOXEMM_SMU_ALM1_23_C "Behaviour control mask / Behaviour control masks of check DFC_MOXEMM_SMU_ALM1_23" VALUE 0x804D9286 Val_Wu16 65535.00 DFES_OneToOne 0.00 65535.00 FORMAT "%8.2" /end CHARACTERISTIC
/begin CHARACTERISTIC DFC_CtlMsk.DFC_MOXEMM_SMU_ALM1_4_C "Behaviour control mask / Behaviour control masks of check DFC_MOXEMM_SMU_ALM1_4" VALUE 0x804D9288 Val_Wu16 65535.00 DFES_OneToOne 0.00 65535.00 FORMAT "%8.2" /end CHARACTERISTIC
/begin CHARACTERISTIC DFC_CtlMsk.DFC_MOXEMM_SMU_ALM1_5_C "Behaviour control mask / Behaviour control masks of check DFC_MOXEMM_SMU_ALM1_5" VALUE 0x804D928A Val_Wu16 65535.00 DFES_OneToOne 0.00 65535.00 FORMAT "%8.2" /end CHARACTERISTIC
/begin CHARACTERISTIC DFC_CtlMsk.DFC_MOXEMM_SMU_ALM1_7_C "Behaviour control mask / Behaviour control masks of check DFC_MOXEMM_SMU_ALM1_7" VALUE 0x804D928C Val_Wu16 65535.00 DFES_OneToOne 0.00 65535.00 FORMAT "%8.2" /end CHARACTERISTIC
/begin CHARACTERISTIC DFC_CtlMsk.DFC_MOXEMM_SMU_ALM1_8_C "Behaviour control mask / Behaviour control masks of check DFC_MOXEMM_SMU_ALM1_8" VALUE 0x804D928E Val_Wu16 65535.00 DFES_OneToOne 0.00 65535.00 FORMAT "%8.2" /end CHARACTERISTIC
/begin CHARACTERISTIC DFC_CtlMsk.DFC_MOXEMM_SMU_ALM21_0_C "Behaviour control mask / Behaviour control masks of check DFC_MOXEMM_SMU_ALM21_0" VALUE 0x804D9290 Val_Wu16 65535.00 DFES_OneToOne 0.00 65535.00 FORMAT "%8.2" /end CHARACTERISTIC
/begin CHARACTERISTIC DFC_CtlMsk.DFC_MOXEMM_SMU_ALM21_16_C "Behaviour control mask / Behaviour control masks of check DFC_MOXEMM_SMU_ALM21_16" VALUE 0x804D9292 Val_Wu16 65535.00 DFES_OneToOne 0.00 65535.00 FORMAT "%8.2" /end CHARACTERISTIC
/begin CHARACTERISTIC DFC_CtlMsk.DFC_MOXEMM_SMU_ALM21_3_C "Behaviour control mask / Behaviour control masks of check DFC_MOXEMM_SMU_ALM21_3" VALUE 0x804D9294 Val_Wu16 65535.00 DFES_OneToOne 0.00 65535.00 FORMAT "%8.2" /end CHARACTERISTIC
/begin CHARACTERISTIC DFC_CtlMsk.DFC_MOXEMM_SMU_ALM2_1_C "Behaviour control mask / Behaviour control masks of check DFC_MOXEMM_SMU_ALM2_1" VALUE 0x804D9296 Val_Wu16 65535.00 DFES_OneToOne 0.00 65535.00 FORMAT "%8.2" /end CHARACTERISTIC
/begin CHARACTERISTIC DFC_CtlMsk.DFC_MOXEMM_SMU_ALM2_10_C "Behaviour control mask / Behaviour control masks of check DFC_MOXEMM_SMU_ALM2_10" VALUE 0x804D9298 Val_Wu16 65535.00 DFES_OneToOne 0.00 65535.00 FORMAT "%8.2" /end CHARACTERISTIC
/begin CHARACTERISTIC DFC_CtlMsk.DFC_MOXEMM_SMU_ALM2_11_C "Behaviour control mask / Behaviour control masks of check DFC_MOXEMM_SMU_ALM2_11" VALUE 0x804D929A Val_Wu16 65535.00 DFES_OneToOne 0.00 65535.00 FORMAT "%8.2" /end CHARACTERISTIC
/begin CHARACTERISTIC DFC_CtlMsk.DFC_MOXEMM_SMU_ALM2_13_C "Behaviour control mask / Behaviour control masks of check DFC_MOXEMM_SMU_ALM2_13" VALUE 0x804D929C Val_Wu16 65535.00 DFES_OneToOne 0.00 65535.00 FORMAT "%8.2" /end CHARACTERISTIC
/begin CHARACTERISTIC DFC_CtlMsk.DFC_MOXEMM_SMU_ALM2_14_C "Behaviour control mask / Behaviour control masks of check DFC_MOXEMM_SMU_ALM2_14" VALUE 0x804D929E Val_Wu16 65535.00 DFES_OneToOne 0.00 65535.00 FORMAT "%8.2" /end CHARACTERISTIC
/begin CHARACTERISTIC DFC_CtlMsk.DFC_MOXEMM_SMU_ALM2_22_C "Behaviour control mask / Behaviour control masks of check DFC_MOXEMM_SMU_ALM2_22" VALUE 0x804D92A0 Val_Wu16 65535.00 DFES_OneToOne 0.00 65535.00 FORMAT "%8.2" /end CHARACTERISTIC
/begin CHARACTERISTIC DFC_CtlMsk.DFC_MOXEMM_SMU_ALM2_23_C "Behaviour control mask / Behaviour control masks of check DFC_MOXEMM_SMU_ALM2_23" VALUE 0x804D92A2 Val_Wu16 65535.00 DFES_OneToOne 0.00 65535.00 FORMAT "%8.2" /end CHARACTERISTIC
/begin CHARACTERISTIC DFC_CtlMsk.DFC_MOXEMM_SMU_ALM2_4_C "Behaviour control mask / Behaviour control masks of check DFC_MOXEMM_SMU_ALM2_4" VALUE 0x804D92A4 Val_Wu16 65535.00 DFES_OneToOne 0.00 65535.00 FORMAT "%8.2" /end CHARACTERISTIC
/begin CHARACTERISTIC DFC_CtlMsk.DFC_MOXEMM_SMU_ALM2_5_C "Behaviour control mask / Behaviour control masks of check DFC_MOXEMM_SMU_ALM2_5" VALUE 0x804D92A6 Val_Wu16 65535.00 DFES_OneToOne 0.00 65535.00 FORMAT "%8.2" /end CHARACTERISTIC
/begin CHARACTERISTIC DFC_CtlMsk.DFC_MOXEMM_SMU_ALM2_7_C "Behaviour control mask / Behaviour control masks of check DFC_MOXEMM_SMU_ALM2_7" VALUE 0x804D92A8 Val_Wu16 65535.00 DFES_OneToOne 0.00 65535.00 FORMAT "%8.2" /end CHARACTERISTIC
/begin CHARACTERISTIC DFC_CtlMsk.DFC_MOXEMM_SMU_ALM2_8_C "Behaviour control mask / Behaviour control masks of check DFC_MOXEMM_SMU_ALM2_8" VALUE 0x804D92AA Val_Wu16 65535.00 DFES_OneToOne 0.00 65535.00 FORMAT "%8.2" /end CHARACTERISTIC
/begin CHARACTERISTIC DFC_CtlMsk.DFC_MOXEMM_SMU_ALM6_0_C "Behaviour control mask / Behaviour control masks of check DFC_MOXEMM_SMU_ALM6_0" VALUE 0x804D92AC Val_Wu16 65535.00 DFES_OneToOne 0.00 65535.00 FORMAT "%8.2" /end CHARACTERISTIC
/begin CHARACTERISTIC DFC_CtlMsk.DFC_MOXEMM_SMU_ALM6_11_C "Behaviour control mask / Behaviour control masks of check DFC_MOXEMM_SMU_ALM6_11" VALUE 0x804D92AE Val_Wu16 65535.00 DFES_OneToOne 0.00 65535.00 FORMAT "%8.2" /end CHARACTERISTIC
/begin CHARACTERISTIC DFC_CtlMsk.DFC_MOXEMM_SMU_ALM6_12_C "Behaviour control mask / Behaviour control masks of check DFC_MOXEMM_SMU_ALM6_12" VALUE 0x804D92B0 Val_Wu16 65535.00 DFES_OneToOne 0.00 65535.00 FORMAT "%8.2" /end CHARACTERISTIC
/begin CHARACTERISTIC DFC_CtlMsk.DFC_MOXEMM_SMU_ALM6_14_C "Behaviour control mask / Behaviour control masks of check DFC_MOXEMM_SMU_ALM6_14" VALUE 0x804D92B2 Val_Wu16 65535.00 DFES_OneToOne 0.00 65535.00 FORMAT "%8.2" /end CHARACTERISTIC
/begin CHARACTERISTIC DFC_CtlMsk.DFC_MOXEMM_SMU_ALM6_15_C "Behaviour control mask / Behaviour control masks of check DFC_MOXEMM_SMU_ALM6_15" VALUE 0x804D92B4 Val_Wu16 65535.00 DFES_OneToOne 0.00 65535.00 FORMAT "%8.2" /end CHARACTERISTIC
/begin CHARACTERISTIC DFC_CtlMsk.DFC_MOXEMM_SMU_ALM6_17_C "Behaviour control mask / Behaviour control masks of check DFC_MOXEMM_SMU_ALM6_17" VALUE 0x804D92B6 Val_Wu16 65535.00 DFES_OneToOne 0.00 65535.00 FORMAT "%8.2" /end CHARACTERISTIC
/begin CHARACTERISTIC DFC_CtlMsk.DFC_MOXEMM_SMU_ALM6_18_C "Behaviour control mask / Behaviour control masks of check DFC_MOXEMM_SMU_ALM6_18" VALUE 0x804D92B8 Val_Wu16 65535.00 DFES_OneToOne 0.00 65535.00 FORMAT "%8.2" /end CHARACTERISTIC
/begin CHARACTERISTIC DFC_CtlMsk.DFC_MOXEMM_SMU_ALM6_20_C "Behaviour control mask / Behaviour control masks of check DFC_MOXEMM_SMU_ALM6_20" VALUE 0x804D92BA Val_Wu16 65535.00 DFES_OneToOne 0.00 65535.00 FORMAT "%8.2" /end CHARACTERISTIC
/begin CHARACTERISTIC DFC_CtlMsk.DFC_MOXEMM_SMU_ALM6_21_C "Behaviour control mask / Behaviour control masks of check DFC_MOXEMM_SMU_ALM6_21" VALUE 0x804D92BC Val_Wu16 65535.00 DFES_OneToOne 0.00 65535.00 FORMAT "%8.2" /end CHARACTERISTIC
/begin CHARACTERISTIC DFC_CtlMsk.DFC_MOXEMM_SMU_ALM6_25_C "Behaviour control mask / Behaviour control masks of check DFC_MOXEMM_SMU_ALM6_25" VALUE 0x804D92BE Val_Wu16 65535.00 DFES_OneToOne 0.00 65535.00 FORMAT "%8.2" /end CHARACTERISTIC
/begin CHARACTERISTIC DFC_CtlMsk.DFC_MOXEMM_SMU_ALM6_4_C "Behaviour control mask / Behaviour control masks of check DFC_MOXEMM_SMU_ALM6_4" VALUE 0x804D92C0 Val_Wu16 65535.00 DFES_OneToOne 0.00 65535.00 FORMAT "%8.2" /end CHARACTERISTIC
/begin CHARACTERISTIC DFC_CtlMsk.DFC_MOXEMM_SMU_ALM6_5_C "Behaviour control mask / Behaviour control masks of check DFC_MOXEMM_SMU_ALM6_5" VALUE 0x804D92C2 Val_Wu16 65535.00 DFES_OneToOne 0.00 65535.00 FORMAT "%8.2" /end CHARACTERISTIC
/begin CHARACTERISTIC DFC_CtlMsk.DFC_MOXEMM_SMU_ALM6_7_C "Behaviour control mask / Behaviour control masks of check DFC_MOXEMM_SMU_ALM6_7" VALUE 0x804D92C4 Val_Wu16 65535.00 DFES_OneToOne 0.00 65535.00 FORMAT "%8.2" /end CHARACTERISTIC
/begin CHARACTERISTIC DFC_CtlMsk.DFC_MOXEMM_SMU_ALM6_8_C "Behaviour control mask / Behaviour control masks of check DFC_MOXEMM_SMU_ALM6_8" VALUE 0x804D92C6 Val_Wu16 65535.00 DFES_OneToOne 0.00 65535.00 FORMAT "%8.2" /end CHARACTERISTIC
/begin CHARACTERISTIC DFC_CtlMsk.DFC_MOXEMM_SMU_ALM7_1_C "Behaviour control mask / Behaviour control masks of check DFC_MOXEMM_SMU_ALM7_1" VALUE 0x804D92C8 Val_Wu16 65535.00 DFES_OneToOne 0.00 65535.00 FORMAT "%8.2" /end CHARACTERISTIC
/begin CHARACTERISTIC DFC_CtlMsk.DFC_MOXEMM_SMU_ALM7_12_C "Behaviour control mask / Behaviour control masks of check DFC_MOXEMM_SMU_ALM7_12" VALUE 0x804D92CA Val_Wu16 65535.00 DFES_OneToOne 0.00 65535.00 FORMAT "%8.2" /end CHARACTERISTIC
/begin CHARACTERISTIC DFC_CtlMsk.DFC_MOXEMM_SMU_ALM7_13_C "Behaviour control mask / Behaviour control masks of check DFC_MOXEMM_SMU_ALM7_13" VALUE 0x804D92CC Val_Wu16 65535.00 DFES_OneToOne 0.00 65535.00 FORMAT "%8.2" /end CHARACTERISTIC
/begin CHARACTERISTIC DFC_CtlMsk.DFC_MOXEMM_SMU_ALM7_14_C "Behaviour control mask / Behaviour control masks of check DFC_MOXEMM_SMU_ALM7_14" VALUE 0x804D92CE Val_Wu16 65535.00 DFES_OneToOne 0.00 65535.00 FORMAT "%8.2" /end CHARACTERISTIC
/begin CHARACTERISTIC DFC_CtlMsk.DFC_MOXEMM_SMU_ALM7_15_C "Behaviour control mask / Behaviour control masks of check DFC_MOXEMM_SMU_ALM7_15" VALUE 0x804D92D0 Val_Wu16 65535.00 DFES_OneToOne 0.00 65535.00 FORMAT "%8.2" /end CHARACTERISTIC
/begin CHARACTERISTIC DFC_CtlMsk.DFC_MOXEMM_SMU_ALM7_16_C "Behaviour control mask / Behaviour control masks of check DFC_MOXEMM_SMU_ALM7_16" VALUE 0x804D92D2 Val_Wu16 65535.00 DFES_OneToOne 0.00 65535.00 FORMAT "%8.2" /end CHARACTERISTIC
/begin CHARACTERISTIC DFC_CtlMsk.DFC_MOXEMM_SMU_ALM7_17_C "Behaviour control mask / Behaviour control masks of check DFC_MOXEMM_SMU_ALM7_17" VALUE 0x804D92D4 Val_Wu16 65535.00 DFES_OneToOne 0.00 65535.00 FORMAT "%8.2" /end CHARACTERISTIC
/begin CHARACTERISTIC DFC_CtlMsk.DFC_MOXEMM_SMU_ALM7_2_C "Behaviour control mask / Behaviour control masks of check DFC_MOXEMM_SMU_ALM7_2" VALUE 0x804D92D6 Val_Wu16 65535.00 DFES_OneToOne 0.00 65535.00 FORMAT "%8.2" /end CHARACTERISTIC
/begin CHARACTERISTIC DFC_CtlMsk.DFC_MOXEMM_SMU_ALM7_20_C "Behaviour control mask / Behaviour control masks of check DFC_MOXEMM_SMU_ALM7_20" VALUE 0x804D92D8 Val_Wu16 65535.00 DFES_OneToOne 0.00 65535.00 FORMAT "%8.2" /end CHARACTERISTIC
/begin CHARACTERISTIC DFC_CtlMsk.DFC_MOXEMM_SMU_ALM7_25_C "Behaviour control mask / Behaviour control masks of check DFC_MOXEMM_SMU_ALM7_25" VALUE 0x804D92DA Val_Wu16 65535.00 DFES_OneToOne 0.00 65535.00 FORMAT "%8.2" /end CHARACTERISTIC
/begin CHARACTERISTIC DFC_CtlMsk.DFC_MOXEMM_SMU_ALM7_26_C "Behaviour control mask / Behaviour control masks of check DFC_MOXEMM_SMU_ALM7_26" VALUE 0x804D92DC Val_Wu16 65535.00 DFES_OneToOne 0.00 65535.00 FORMAT "%8.2" /end CHARACTERISTIC
/begin CHARACTERISTIC DFC_CtlMsk.DFC_MOXEMM_SMU_ALM7_28_C "Behaviour control mask / Behaviour control masks of check DFC_MOXEMM_SMU_ALM7_28" VALUE 0x804D92DE Val_Wu16 65535.00 DFES_OneToOne 0.00 65535.00 FORMAT "%8.2" /end CHARACTERISTIC
/begin CHARACTERISTIC DFC_CtlMsk.DFC_MOXEMM_SMU_ALM7_29_C "Behaviour control mask / Behaviour control masks of check DFC_MOXEMM_SMU_ALM7_29" VALUE 0x804D92E0 Val_Wu16 65535.00 DFES_OneToOne 0.00 65535.00 FORMAT "%8.2" /end CHARACTERISTIC
/begin CHARACTERISTIC DFC_CtlMsk.DFC_MOXEMM_SMU_ALM7_30_C "Behaviour control mask / Behaviour control masks of check DFC_MOXEMM_SMU_ALM7_30" VALUE 0x804D92E2 Val_Wu16 65535.00 DFES_OneToOne 0.00 65535.00 FORMAT "%8.2" /end CHARACTERISTIC
/begin CHARACTERISTIC DFC_CtlMsk.DFC_MOXEMM_SMU_ALM7_31_C "Behaviour control mask / Behaviour control masks of check DFC_MOXEMM_SMU_ALM7_31" VALUE 0x804D92E4 Val_Wu16 65535.00 DFES_OneToOne 0.00 65535.00 FORMAT "%8.2" /end CHARACTERISTIC
/begin CHARACTERISTIC DFC_CtlMsk.DFC_MOXEMM_SMU_ALM8_0_C "Behaviour control mask / Behaviour control masks of check DFC_MOXEMM_SMU_ALM8_0" VALUE 0x804D92E6 Val_Wu16 65535.00 DFES_OneToOne 0.00 65535.00 FORMAT "%8.2" /end CHARACTERISTIC
/begin CHARACTERISTIC DFC_CtlMsk.DFC_MOXEMM_SMU_ALM8_1_C "Behaviour control mask / Behaviour control masks of check DFC_MOXEMM_SMU_ALM8_1" VALUE 0x804D92E8 Val_Wu16 65535.00 DFES_OneToOne 0.00 65535.00 FORMAT "%8.2" /end CHARACTERISTIC
/begin CHARACTERISTIC DFC_CtlMsk.DFC_MOXEMM_SMU_ALM8_10_C "Behaviour control mask / Behaviour control masks of check DFC_MOXEMM_SMU_ALM8_10" VALUE 0x804D92EA Val_Wu16 65535.00 DFES_OneToOne 0.00 65535.00 FORMAT "%8.2" /end CHARACTERISTIC
/begin CHARACTERISTIC DFC_CtlMsk.DFC_MOXEMM_SMU_ALM8_11_C "Behaviour control mask / Behaviour control masks of check DFC_MOXEMM_SMU_ALM8_11" VALUE 0x804D92EC Val_Wu16 65535.00 DFES_OneToOne 0.00 65535.00 FORMAT "%8.2" /end CHARACTERISTIC
/begin CHARACTERISTIC DFC_CtlMsk.DFC_MOXEMM_SMU_ALM8_12_C "Behaviour control mask / Behaviour control masks of check DFC_MOXEMM_SMU_ALM8_12" VALUE 0x804D92EE Val_Wu16 65535.00 DFES_OneToOne 0.00 65535.00 FORMAT "%8.2" /end CHARACTERISTIC
/begin CHARACTERISTIC DFC_CtlMsk.DFC_MOXEMM_SMU_ALM8_16_C "Behaviour control mask / Behaviour control masks of check DFC_MOXEMM_SMU_ALM8_16" VALUE 0x804D92F0 Val_Wu16 65535.00 DFES_OneToOne 0.00 65535.00 FORMAT "%8.2" /end CHARACTERISTIC
/begin CHARACTERISTIC DFC_CtlMsk.DFC_MOXEMM_SMU_ALM8_18_C "Behaviour control mask / Behaviour control masks of check DFC_MOXEMM_SMU_ALM8_18" VALUE 0x804D92F2 Val_Wu16 65535.00 DFES_OneToOne 0.00 65535.00 FORMAT "%8.2" /end CHARACTERISTIC
/begin CHARACTERISTIC DFC_CtlMsk.DFC_MOXEMM_SMU_ALM8_2_C "Behaviour control mask / Behaviour control masks of check DFC_MOXEMM_SMU_ALM8_2" VALUE 0x804D92F4 Val_Wu16 65535.00 DFES_OneToOne 0.00 65535.00 FORMAT "%8.2" /end CHARACTERISTIC
/begin CHARACTERISTIC DFC_CtlMsk.DFC_MOXEMM_SMU_ALM8_3_C "Behaviour control mask / Behaviour control masks of check DFC_MOXEMM_SMU_ALM8_3" VALUE 0x804D92F6 Val_Wu16 65535.00 DFES_OneToOne 0.00 65535.00 FORMAT "%8.2" /end CHARACTERISTIC
/begin CHARACTERISTIC DFC_CtlMsk.DFC_MOXEMM_SMU_ALM8_31_C "Behaviour control mask / Behaviour control masks of check DFC_MOXEMM_SMU_ALM8_31" VALUE 0x804D92F8 Val_Wu16 65535.00 DFES_OneToOne 0.00 65535.00 FORMAT "%8.2" /end CHARACTERISTIC
/begin CHARACTERISTIC DFC_CtlMsk.DFC_MOXEMM_SMU_ALM8_4_C "Behaviour control mask / Behaviour control masks of check DFC_MOXEMM_SMU_ALM8_4" VALUE 0x804D92FA Val_Wu16 65535.00 DFES_OneToOne 0.00 65535.00 FORMAT "%8.2" /end CHARACTERISTIC
/begin CHARACTERISTIC DFC_CtlMsk.DFC_MOXEMM_SMU_ALM9_0_C "Behaviour control mask / Behaviour control masks of check DFC_MOXEMM_SMU_ALM9_0" VALUE 0x804D92FC Val_Wu16 65535.00 DFES_OneToOne 0.00 65535.00 FORMAT "%8.2" /end CHARACTERISTIC
/begin CHARACTERISTIC DFC_CtlMsk.DFC_MOXEMM_SMU_ALM9_15_C "Behaviour control mask / Behaviour control masks of check DFC_MOXEMM_SMU_ALM9_15" VALUE 0x804D92FE Val_Wu16 65535.00 DFES_OneToOne 0.00 65535.00 FORMAT "%8.2" /end CHARACTERISTIC
/begin CHARACTERISTIC DFC_CtlMsk.DFC_MOXEMM_SMU_ALM9_3_C "Behaviour control mask / Behaviour control masks of check DFC_MOXEMM_SMU_ALM9_3" VALUE 0x804D9300 Val_Wu16 65535.00 DFES_OneToOne 0.00 65535.00 FORMAT "%8.2" /end CHARACTERISTIC
/begin CHARACTERISTIC DFC_CtlMsk.DFC_MoCADCNTP_C "Behaviour control mask / Behaviour control masks of check DFC_MoCADCNTP" VALUE 0x804D9302 Val_Wu16 65535.00 DFES_OneToOne 0.00 65535.00 FORMAT "%8.2" /end CHARACTERISTIC
/begin CHARACTERISTIC DFC_CtlMsk.DFC_MoCADCTst_C "Behaviour control mask / Behaviour control masks of check DFC_MoCADCTst" VALUE 0x804D9304 Val_Wu16 65535.00 DFES_OneToOne 0.00 65535.00 FORMAT "%8.2" /end CHARACTERISTIC
/begin CHARACTERISTIC DFC_CtlMsk.DFC_MoCSOPICO_C "Behaviour control mask / Behaviour control masks of check DFC_MoCSOPICO" VALUE 0x804D9306 Val_Wu16 65535.00 DFES_OneToOne 0.00 65535.00 FORMAT "%8.2" /end CHARACTERISTIC
/begin CHARACTERISTIC DFC_CtlMsk.DFC_MoFAPP_C "Behaviour control mask / Behaviour control masks of check DFC_MoFAPP" VALUE 0x804D9308 Val_Wu16 65535.00 DFES_OneToOne 0.00 65535.00 FORMAT "%8.2" /end CHARACTERISTIC
/begin CHARACTERISTIC DFC_CtlMsk.DFC_MoFAirFilgPrdc_C "Behaviour control mask / Behaviour control masks of check DFC_MoFAirFilgPrdc" VALUE 0x804D930A Val_Wu16 65535.00 DFES_OneToOne 0.00 65535.00 FORMAT "%8.2" /end CHARACTERISTIC
/begin CHARACTERISTIC DFC_CtlMsk.DFC_MoFAirFlCtOffGdi_C "Behaviour control mask / Behaviour control masks of check DFC_MoFAirFlCtOffGdi" VALUE 0x804D930C Val_Wu16 65535.00 DFES_OneToOne 0.00 65535.00 FORMAT "%8.2" /end CHARACTERISTIC
/begin CHARACTERISTIC DFC_CtlMsk.DFC_MoFAirFlCylGdi_C "Behaviour control mask / Behaviour control masks of check DFC_MoFAirFlCylGdi" VALUE 0x804D930E Val_Wu16 65535.00 DFES_OneToOne 0.00 65535.00 FORMAT "%8.2" /end CHARACTERISTIC
/begin CHARACTERISTIC DFC_CtlMsk.DFC_MoFAirFlFF_C "Behaviour control mask / Behaviour control masks of check DFC_MoFAirFlFF" VALUE 0x804D9310 Val_Wu16 65535.00 DFES_OneToOne 0.00 65535.00 FORMAT "%8.2" /end CHARACTERISTIC
/begin CHARACTERISTIC DFC_CtlMsk.DFC_MoFAirFlIn_C "Behaviour control mask / Behaviour control masks of check DFC_MoFAirFlIn" VALUE 0x804D9312 Val_Wu16 65535.00 DFES_OneToOne 0.00 65535.00 FORMAT "%8.2" /end CHARACTERISTIC
/begin CHARACTERISTIC DFC_CtlMsk.DFC_MoFAirFlMixCtlGdiChkAirFl_C "Behaviour control mask / Behaviour control masks of check DFC_MoFAirFlMixCtlGdiChkAirFl" VALUE 0x804D9314 Val_Wu16 65535.00 DFES_OneToOne 0.00 65535.00 FORMAT "%8.2" /end CHARACTERISTIC
/begin CHARACTERISTIC DFC_CtlMsk.DFC_MoFAirFlMixCtlGdiChkCtrl_C "Behaviour control mask / Behaviour control masks of check DFC_MoFAirFlMixCtlGdiChkCtrl" VALUE 0x804D9316 Val_Wu16 65535.00 DFES_OneToOne 0.00 65535.00 FORMAT "%8.2" /end CHARACTERISTIC
/begin CHARACTERISTIC DFC_CtlMsk.DFC_MoFAirFlMode_C "Behaviour control mask / Behaviour control masks of check DFC_MoFAirFlMode" VALUE 0x804D9318 Val_Wu16 65535.00 DFES_OneToOne 0.00 65535.00 FORMAT "%8.2" /end CHARACTERISTIC
/begin CHARACTERISTIC DFC_CtlMsk.DFC_MoFESpd_C "Behaviour control mask / Behaviour control masks of check DFC_MoFESpd" VALUE 0x804D931A Val_Wu16 65535.00 DFES_OneToOne 0.00 65535.00 FORMAT "%8.2" /end CHARACTERISTIC
/begin CHARACTERISTIC DFC_CtlMsk.DFC_MoFIACo_C "Behaviour control mask / Behaviour control masks of check DFC_MoFIACo" VALUE 0x804D931C Val_Wu16 65535.00 DFES_OneToOne 0.00 65535.00 FORMAT "%8.2" /end CHARACTERISTIC
/begin CHARACTERISTIC DFC_CtlMsk.DFC_MoFICOL1_C "Behaviour control mask / Behaviour control masks of check DFC_MoFICOL1" VALUE 0x804D931E Val_Wu16 65535.00 DFES_OneToOne 0.00 65535.00 FORMAT "%8.2" /end CHARACTERISTIC
/begin CHARACTERISTIC DFC_CtlMsk.DFC_MoFICOL2_C "Behaviour control mask / Behaviour control masks of check DFC_MoFICOL2" VALUE 0x804D9320 Val_Wu16 65535.00 DFES_OneToOne 0.00 65535.00 FORMAT "%8.2" /end CHARACTERISTIC
/begin CHARACTERISTIC DFC_CtlMsk.DFC_MoFStrt_C "Behaviour control mask / Behaviour control masks of check DFC_MoFStrt" VALUE 0x804D9322 Val_Wu16 65535.00 DFES_OneToOne 0.00 65535.00 FORMAT "%8.2" /end CHARACTERISTIC
/begin CHARACTERISTIC DFC_CtlMsk.DFC_MoFTrqCmp_C "Behaviour control mask / Behaviour control masks of check DFC_MoFTrqCmp" VALUE 0x804D9324 Val_Wu16 65535.00 DFES_OneToOne 0.00 65535.00 FORMAT "%8.2" /end CHARACTERISTIC
/begin CHARACTERISTIC DFC_CtlMsk.DFC_MoFTrqCmpMax_C "Behaviour control mask / Behaviour control masks of check DFC_MoFTrqCmpMax" VALUE 0x804D9326 Val_Wu16 65535.00 DFES_OneToOne 0.00 65535.00 FORMAT "%8.2" /end CHARACTERISTIC
/begin CHARACTERISTIC DFC_CtlMsk.DFC_MoFTrqCmpMin_C "Behaviour control mask / Behaviour control masks of check DFC_MoFTrqCmpMin" VALUE 0x804D9328 Val_Wu16 65535.00 DFES_OneToOne 0.00 65535.00 FORMAT "%8.2" /end CHARACTERISTIC
/begin CHARACTERISTIC DFC_CtlMsk.DFC_MoFVarPostBldSel_C "Behaviour control mask / Behaviour control masks of check DFC_MoFVarPostBldSel" VALUE 0x804D932A Val_Wu16 65535.00 DFES_OneToOne 0.00 65535.00 FORMAT "%8.2" /end CHARACTERISTIC
/begin CHARACTERISTIC DFC_CtlMsk.DFC_MoXEMMHwLTMCUFW_C "Behaviour control mask / Behaviour control masks of check DFC_MoXEMMHwLTMCUFW" VALUE 0x804D932C Val_Wu16 65535.00 DFES_OneToOne 0.00 65535.00 FORMAT "%8.2" /end CHARACTERISTIC
/begin CHARACTERISTIC DFC_CtlMsk.DFC_MoXEMMHwLTMonBIST_C "Behaviour control mask / Behaviour control masks of check DFC_MoXEMMHwLTMonBIST" VALUE 0x804D932E Val_Wu16 65535.00 DFES_OneToOne 0.00 65535.00 FORMAT "%8.2" /end CHARACTERISTIC
/begin CHARACTERISTIC DFC_CtlMsk.DFC_MoXEMMHwLTRegMonTest_C "Behaviour control mask / Behaviour control masks of check DFC_MoXEMMHwLTRegMonTest" VALUE 0x804D9330 Val_Wu16 65535.00 DFES_OneToOne 0.00 65535.00 FORMAT "%8.2" /end CHARACTERISTIC
/begin CHARACTERISTIC DFC_CtlMsk.DFC_MoXEMMHwLTStbySMUAlvTest_C "Behaviour control mask / Behaviour control masks of check DFC_MoXEMMHwLTStbySMUAlvTest" VALUE 0x804D9332 Val_Wu16 65535.00 DFES_OneToOne 0.00 65535.00 FORMAT "%8.2" /end CHARACTERISTIC
/begin CHARACTERISTIC DFC_CtlMsk.DFC_MoXEMMHwLTTempSens_C "Behaviour control mask / Behaviour control masks of check DFC_MoXEMMHwLTTempSens" VALUE 0x804D9334 Val_Wu16 65535.00 DFES_OneToOne 0.00 65535.00 FORMAT "%8.2" /end CHARACTERISTIC
/begin CHARACTERISTIC DFC_CtlMsk.DFC_MoXEMMHwLTUCBCfg_C "Behaviour control mask / Behaviour control masks of check DFC_MoXEMMHwLTUCBCfg" VALUE 0x804D9336 Val_Wu16 65535.00 DFES_OneToOne 0.00 65535.00 FORMAT "%8.2" /end CHARACTERISTIC
/begin CHARACTERISTIC DFC_CtlMsk.DFC_NWSEmax_C "Behaviour control mask / Behaviour control masks of check DFC_NWSEmax" VALUE 0x804D9338 Val_Wu16 65535.00 DFES_OneToOne 0.00 65535.00 FORMAT "%8.2" /end CHARACTERISTIC
/begin CHARACTERISTIC DFC_CtlMsk.DFC_NWSmax_C "Behaviour control mask / Behaviour control masks of check DFC_NWSmax" VALUE 0x804D933A Val_Wu16 65535.00 DFES_OneToOne 0.00 65535.00 FORMAT "%8.2" /end CHARACTERISTIC
/begin CHARACTERISTIC DFC_CtlMsk.DFC_OCWDAABEActv_C "Behaviour control mask / Behaviour control masks of check DFC_OCWDAABEActv" VALUE 0x804D933C Val_Wu16 65535.00 DFES_OneToOne 0.00 65535.00 FORMAT "%8.2" /end CHARACTERISTIC
/begin CHARACTERISTIC DFC_CtlMsk.DFC_OCWDACom_C "Behaviour control mask / Behaviour control masks of check DFC_OCWDACom" VALUE 0x804D933E Val_Wu16 65535.00 DFES_OneToOne 0.00 65535.00 FORMAT "%8.2" /end CHARACTERISTIC
/begin CHARACTERISTIC DFC_CtlMsk.DFC_OCWDAErrPin_C "Behaviour control mask / Behaviour control masks of check DFC_OCWDAErrPin" VALUE 0x804D9340 Val_Wu16 65535.00 DFES_OneToOne 0.00 65535.00 FORMAT "%8.2" /end CHARACTERISTIC
/begin CHARACTERISTIC DFC_CtlMsk.DFC_OCWDAOvrVltg_C "Behaviour control mask / Behaviour control masks of check DFC_OCWDAOvrVltg" VALUE 0x804D9342 Val_Wu16 65535.00 DFES_OneToOne 0.00 65535.00 FORMAT "%8.2" /end CHARACTERISTIC
/begin CHARACTERISTIC DFC_CtlMsk.DFC_ORAmax_C "Behaviour control mask / Behaviour control masks of check DFC_ORAmax" VALUE 0x804D9344 Val_Wu16 65535.00 DFES_OneToOne 0.00 65535.00 FORMAT "%8.2" /end CHARACTERISTIC
/begin CHARACTERISTIC DFC_CtlMsk.DFC_ORAmin_C "Behaviour control mask / Behaviour control masks of check DFC_ORAmin" VALUE 0x804D9346 Val_Wu16 65535.00 DFES_OneToOne 0.00 65535.00 FORMAT "%8.2" /end CHARACTERISTIC
/begin CHARACTERISTIC DFC_CtlMsk.DFC_OilPPlaus_C "Behaviour control mask / Behaviour control masks of check DFC_OilPPlaus" VALUE 0x804D9348 Val_Wu16 65535.00 DFES_OneToOne 0.00 65535.00 FORMAT "%8.2" /end CHARACTERISTIC
/begin CHARACTERISTIC DFC_CtlMsk.DFC_PLLSUmax_C "Behaviour control mask / Behaviour control masks of check DFC_PLLSUmax" VALUE 0x804D934A Val_Wu16 65535.00 DFES_OneToOne 0.00 65535.00 FORMAT "%8.2" /end CHARACTERISTIC
/begin CHARACTERISTIC DFC_CtlMsk.DFC_PLLSUmin_C "Behaviour control mask / Behaviour control masks of check DFC_PLLSUmin" VALUE 0x804D934C Val_Wu16 65535.00 DFES_OneToOne 0.00 65535.00 FORMAT "%8.2" /end CHARACTERISTIC
/begin CHARACTERISTIC DFC_CtlMsk.DFC_PSR1max_C "Behaviour control mask / Behaviour control masks of check DFC_PSR1max" VALUE 0x804D934E Val_Wu16 65535.00 DFES_OneToOne 0.00 65535.00 FORMAT "%8.2" /end CHARACTERISTIC
/begin CHARACTERISTIC DFC_CtlMsk.DFC_PSRBmax_C "Behaviour control mask / Behaviour control masks of check DFC_PSRBmax" VALUE 0x804D9350 Val_Wu16 65535.00 DFES_OneToOne 0.00 65535.00 FORMAT "%8.2" /end CHARACTERISTIC
/begin CHARACTERISTIC DFC_CtlMsk.DFC_PSRBmin_C "Behaviour control mask / Behaviour control masks of check DFC_PSRBmin" VALUE 0x804D9352 Val_Wu16 65535.00 DFES_OneToOne 0.00 65535.00 FORMAT "%8.2" /end CHARACTERISTIC
/begin CHARACTERISTIC DFC_CtlMsk.DFC_PSRPmax_C "Behaviour control mask / Behaviour control masks of check DFC_PSRPmax" VALUE 0x804D9354 Val_Wu16 65535.00 DFES_OneToOne 0.00 65535.00 FORMAT "%8.2" /end CHARACTERISTIC
/begin CHARACTERISTIC DFC_CtlMsk.DFC_PSRPmin_C "Behaviour control mask / Behaviour control masks of check DFC_PSRPmin" VALUE 0x804D9356 Val_Wu16 65535.00 DFES_OneToOne 0.00 65535.00 FORMAT "%8.2" /end CHARACTERISTIC
/begin CHARACTERISTIC DFC_CtlMsk.DFC_PSRPsig_C "Behaviour control mask / Behaviour control masks of check DFC_PSRPsig" VALUE 0x804D9358 Val_Wu16 65535.00 DFES_OneToOne 0.00 65535.00 FORMAT "%8.2" /end CHARACTERISTIC
/begin CHARACTERISTIC DFC_CtlMsk.DFC_PSRmax_C "Behaviour control mask / Behaviour control masks of check DFC_PSRmax" VALUE 0x804D935A Val_Wu16 65535.00 DFES_OneToOne 0.00 65535.00 FORMAT "%8.2" /end CHARACTERISTIC
/begin CHARACTERISTIC DFC_CtlMsk.DFC_PUmax_C "Behaviour control mask / Behaviour control masks of check DFC_PUmax" VALUE 0x804D935C Val_Wu16 65535.00 DFES_OneToOne 0.00 65535.00 FORMAT "%8.2" /end CHARACTERISTIC
/begin CHARACTERISTIC DFC_CtlMsk.DFC_P_VSE11_OL_C "Behaviour control mask / Behaviour control masks of check DFC_P_VSE11_OL" VALUE 0x804D935E Val_Wu16 65535.00 DFES_OneToOne 0.00 65535.00 FORMAT "%8.2" /end CHARACTERISTIC
/begin CHARACTERISTIC DFC_CtlMsk.DFC_P_VSE11_SCB_C "Behaviour control mask / Behaviour control masks of check DFC_P_VSE11_SCB" VALUE 0x804D9360 Val_Wu16 65535.00 DFES_OneToOne 0.00 65535.00 FORMAT "%8.2" /end CHARACTERISTIC
/begin CHARACTERISTIC DFC_CtlMsk.DFC_P_VSE11_SCG_C "Behaviour control mask / Behaviour control masks of check DFC_P_VSE11_SCG" VALUE 0x804D9362 Val_Wu16 65535.00 DFES_OneToOne 0.00 65535.00 FORMAT "%8.2" /end CHARACTERISTIC
/begin CHARACTERISTIC DFC_CtlMsk.DFC_PhyHighAPP1_C "Behaviour control mask / Behaviour control masks of check DFC_PhyHighAPP1" VALUE 0x804D9364 Val_Wu16 65535.00 DFES_OneToOne 0.00 65535.00 FORMAT "%8.2" /end CHARACTERISTIC
/begin CHARACTERISTIC DFC_CtlMsk.DFC_PhyHighAPP2_C "Behaviour control mask / Behaviour control masks of check DFC_PhyHighAPP2" VALUE 0x804D9366 Val_Wu16 65535.00 DFES_OneToOne 0.00 65535.00 FORMAT "%8.2" /end CHARACTERISTIC
/begin CHARACTERISTIC DFC_CtlMsk.DFC_PhyLowAPP1_C "Behaviour control mask / Behaviour control masks of check DFC_PhyLowAPP1" VALUE 0x804D9368 Val_Wu16 65535.00 DFES_OneToOne 0.00 65535.00 FORMAT "%8.2" /end CHARACTERISTIC
/begin CHARACTERISTIC DFC_CtlMsk.DFC_PhyLowAPP2_C "Behaviour control mask / Behaviour control masks of check DFC_PhyLowAPP2" VALUE 0x804D936A Val_Wu16 65535.00 DFES_OneToOne 0.00 65535.00 FORMAT "%8.2" /end CHARACTERISTIC
/begin CHARACTERISTIC DFC_CtlMsk.DFC_SRCHighAPP1_C "Behaviour control mask / Behaviour control masks of check DFC_SRCHighAPP1" VALUE 0x804D936C Val_Wu16 65535.00 DFES_OneToOne 0.00 65535.00 FORMAT "%8.2" /end CHARACTERISTIC
/begin CHARACTERISTIC DFC_CtlMsk.DFC_SRCHighAPP2_C "Behaviour control mask / Behaviour control masks of check DFC_SRCHighAPP2" VALUE 0x804D936E Val_Wu16 65535.00 DFES_OneToOne 0.00 65535.00 FORMAT "%8.2" /end CHARACTERISTIC
/begin CHARACTERISTIC DFC_CtlMsk.DFC_SRCLowAPP1_C "Behaviour control mask / Behaviour control masks of check DFC_SRCLowAPP1" VALUE 0x804D9370 Val_Wu16 65535.00 DFES_OneToOne 0.00 65535.00 FORMAT "%8.2" /end CHARACTERISTIC
/begin CHARACTERISTIC DFC_CtlMsk.DFC_SRCLowAPP2_C "Behaviour control mask / Behaviour control masks of check DFC_SRCLowAPP2" VALUE 0x804D9372 Val_Wu16 65535.00 DFES_OneToOne 0.00 65535.00 FORMAT "%8.2" /end CHARACTERISTIC
/begin CHARACTERISTIC DFC_CtlMsk.DFC_SSpMon2_C "Behaviour control mask / Behaviour control masks of check DFC_SSpMon2" VALUE 0x804D9374 Val_Wu16 65535.00 DFES_OneToOne 0.00 65535.00 FORMAT "%8.2" /end CHARACTERISTIC
/begin CHARACTERISTIC DFC_CtlMsk.DFC_STHDRmax_C "Behaviour control mask / Behaviour control masks of check DFC_STHDRmax" VALUE 0x804D9376 Val_Wu16 65535.00 DFES_OneToOne 0.00 65535.00 FORMAT "%8.2" /end CHARACTERISTIC
/begin CHARACTERISTIC DFC_CtlMsk.DFC_SWReset_0_C "Behaviour control mask / Behaviour control masks of check DFC_SWReset_0" VALUE 0x804D9378 Val_Wu16 65535.00 DFES_OneToOne 0.00 65535.00 FORMAT "%8.2" /end CHARACTERISTIC
/begin CHARACTERISTIC DFC_CtlMsk.DFC_SWReset_1_C "Behaviour control mask / Behaviour control masks of check DFC_SWReset_1" VALUE 0x804D937A Val_Wu16 65535.00 DFES_OneToOne 0.00 65535.00 FORMAT "%8.2" /end CHARACTERISTIC
/begin CHARACTERISTIC DFC_CtlMsk.DFC_SWReset_2_C "Behaviour control mask / Behaviour control masks of check DFC_SWReset_2" VALUE 0x804D937C Val_Wu16 65535.00 DFES_OneToOne 0.00 65535.00 FORMAT "%8.2" /end CHARACTERISTIC
/begin CHARACTERISTIC DFC_CtlMsk.DFC_SyncAPP_C "Behaviour control mask / Behaviour control masks of check DFC_SyncAPP" VALUE 0x804D937E Val_Wu16 65535.00 DFES_OneToOne 0.00 65535.00 FORMAT "%8.2" /end CHARACTERISTIC
/begin CHARACTERISTIC DFC_CtlMsk.DFC_TANKLnpl_C "Behaviour control mask / Behaviour control masks of check DFC_TANKLnpl" VALUE 0x804D9380 Val_Wu16 65535.00 DFES_OneToOne 0.00 65535.00 FORMAT "%8.2" /end CHARACTERISTIC
/begin CHARACTERISTIC DFC_CtlMsk.DFC_TAmax_Dummy_C "Behaviour control mask / Behaviour control masks of check DFC_TAmax_Dummy" VALUE 0x804D9382 Val_Wu16 65535.00 DFES_OneToOne 0.00 65535.00 FORMAT "%8.2" /end CHARACTERISTIC
/begin CHARACTERISTIC DFC_CtlMsk.DFC_TESFmax_C "Behaviour control mask / Behaviour control masks of check DFC_TESFmax" VALUE 0x804D9384 Val_Wu16 65535.00 DFES_OneToOne 0.00 65535.00 FORMAT "%8.2" /end CHARACTERISTIC
/begin CHARACTERISTIC DFC_CtlMsk.DFC_TESGmax_C "Behaviour control mask / Behaviour control masks of check DFC_TESGmax" VALUE 0x804D9386 Val_Wu16 65535.00 DFES_OneToOne 0.00 65535.00 FORMAT "%8.2" /end CHARACTERISTIC
/begin CHARACTERISTIC DFC_CtlMsk.DFC_TKAEmax_C "Behaviour control mask / Behaviour control masks of check DFC_TKAEmax" VALUE 0x804D9388 Val_Wu16 65535.00 DFES_OneToOne 0.00 65535.00 FORMAT "%8.2" /end CHARACTERISTIC
/begin CHARACTERISTIC DFC_CtlMsk.DFC_TKAEmin_C "Behaviour control mask / Behaviour control masks of check DFC_TKAEmin" VALUE 0x804D938A Val_Wu16 65535.00 DFES_OneToOne 0.00 65535.00 FORMAT "%8.2" /end CHARACTERISTIC
/begin CHARACTERISTIC DFC_CtlMsk.DFC_TKARmax_C "Behaviour control mask / Behaviour control masks of check DFC_TKARmax" VALUE 0x804D938C Val_Wu16 65535.00 DFES_OneToOne 0.00 65535.00 FORMAT "%8.2" /end CHARACTERISTIC
/begin CHARACTERISTIC DFC_CtlMsk.DFC_TKARnpl_C "Behaviour control mask / Behaviour control masks of check DFC_TKARnpl" VALUE 0x804D938E Val_Wu16 65535.00 DFES_OneToOne 0.00 65535.00 FORMAT "%8.2" /end CHARACTERISTIC
/begin CHARACTERISTIC DFC_CtlMsk.DFC_TMmax_Dummy_C "Behaviour control mask / Behaviour control masks of check DFC_TMmax_Dummy" VALUE 0x804D9390 Val_Wu16 65535.00 DFES_OneToOne 0.00 65535.00 FORMAT "%8.2" /end CHARACTERISTIC
/begin CHARACTERISTIC DFC_CtlMsk.DFC_TUMmax_Dummy_C "Behaviour control mask / Behaviour control masks of check DFC_TUMmax_Dummy" VALUE 0x804D9392 Val_Wu16 65535.00 DFES_OneToOne 0.00 65535.00 FORMAT "%8.2" /end CHARACTERISTIC
/begin CHARACTERISTIC DFC_CtlMsk.DFC_TWCDPriCatB1_C "Behaviour control mask / Behaviour control masks of check DFC_TWCDPriCatB1" VALUE 0x804D9394 Val_Wu16 65535.00 DFES_OneToOne 0.00 65535.00 FORMAT "%8.2" /end CHARACTERISTIC
/begin CHARACTERISTIC DFC_CtlMsk.DFC_ThrVlvClsdPosnFirstOffsLrnImpoB1_C "Behaviour control mask / Behaviour control masks of check DFC_ThrVlvClsdPosnFirstOffsLrnImpoB1" VALUE 0x804D9396 Val_Wu16 65535.00 DFES_OneToOne 0.00 65535.00 FORMAT "%8.2" /end CHARACTERISTIC
/begin CHARACTERISTIC DFC_CtlMsk.DFC_ThrVlvClsdPosnOffsLrnImpoB1_C "Behaviour control mask / Behaviour control masks of check DFC_ThrVlvClsdPosnOffsLrnImpoB1" VALUE 0x804D9398 Val_Wu16 65535.00 DFES_OneToOne 0.00 65535.00 FORMAT "%8.2" /end CHARACTERISTIC
/begin CHARACTERISTIC DFC_CtlMsk.DFC_ThrVlvClsdPosnOffsLrnMaxB1_C "Behaviour control mask / Behaviour control masks of check DFC_ThrVlvClsdPosnOffsLrnMaxB1" VALUE 0x804D939A Val_Wu16 65535.00 DFES_OneToOne 0.00 65535.00 FORMAT "%8.2" /end CHARACTERISTIC
/begin CHARACTERISTIC DFC_CtlMsk.DFC_ThrVlvClsdPosnOffsLrnMinB1_C "Behaviour control mask / Behaviour control masks of check DFC_ThrVlvClsdPosnOffsLrnMinB1" VALUE 0x804D939C Val_Wu16 65535.00 DFES_OneToOne 0.00 65535.00 FORMAT "%8.2" /end CHARACTERISTIC
/begin CHARACTERISTIC DFC_CtlMsk.DFC_ThrVlvCtrlDeB1_C "Behaviour control mask / Behaviour control masks of check DFC_ThrVlvCtrlDeB1" VALUE 0x804D939E Val_Wu16 65535.00 DFES_OneToOne 0.00 65535.00 FORMAT "%8.2" /end CHARACTERISTIC
/begin CHARACTERISTIC DFC_CtlMsk.DFC_ThrVlvDycB1_C "Behaviour control mask / Behaviour control masks of check DFC_ThrVlvDycB1" VALUE 0x804D93A0 Val_Wu16 65535.00 DFES_OneToOne 0.00 65535.00 FORMAT "%8.2" /end CHARACTERISTIC
/begin CHARACTERISTIC DFC_CtlMsk.DFC_ThrVlvLimpAirPosnMaxAbsltDriftB1_C "Behaviour control mask / Behaviour control masks of check DFC_ThrVlvLimpAirPosnMaxAbsltDriftB1" VALUE 0x804D93A2 Val_Wu16 65535.00 DFES_OneToOne 0.00 65535.00 FORMAT "%8.2" /end CHARACTERISTIC
/begin CHARACTERISTIC DFC_CtlMsk.DFC_ThrVlvLimpAirPosnMaxB1_C "Behaviour control mask / Behaviour control masks of check DFC_ThrVlvLimpAirPosnMaxB1" VALUE 0x804D93A4 Val_Wu16 65535.00 DFES_OneToOne 0.00 65535.00 FORMAT "%8.2" /end CHARACTERISTIC
/begin CHARACTERISTIC DFC_CtlMsk.DFC_ThrVlvLimpAirPosnMaxRelDriftB1_C "Behaviour control mask / Behaviour control masks of check DFC_ThrVlvLimpAirPosnMaxRelDriftB1" VALUE 0x804D93A6 Val_Wu16 65535.00 DFES_OneToOne 0.00 65535.00 FORMAT "%8.2" /end CHARACTERISTIC
/begin CHARACTERISTIC DFC_CtlMsk.DFC_ThrVlvLimpAirPosnMinB1_C "Behaviour control mask / Behaviour control masks of check DFC_ThrVlvLimpAirPosnMinB1" VALUE 0x804D93A8 Val_Wu16 65535.00 DFES_OneToOne 0.00 65535.00 FORMAT "%8.2" /end CHARACTERISTIC
/begin CHARACTERISTIC DFC_CtlMsk.DFC_ThrVlvOpenLoadB1_C "Behaviour control mask / Behaviour control masks of check DFC_ThrVlvOpenLoadB1" VALUE 0x804D93AA Val_Wu16 65535.00 DFES_OneToOne 0.00 65535.00 FORMAT "%8.2" /end CHARACTERISTIC
/begin CHARACTERISTIC DFC_CtlMsk.DFC_ThrVlvOpenSprgB1_C "Behaviour control mask / Behaviour control masks of check DFC_ThrVlvOpenSprgB1" VALUE 0x804D93AC Val_Wu16 65535.00 DFES_OneToOne 0.00 65535.00 FORMAT "%8.2" /end CHARACTERISTIC
/begin CHARACTERISTIC DFC_CtlMsk.DFC_ThrVlvOpenSprgSprdB1_C "Behaviour control mask / Behaviour control masks of check DFC_ThrVlvOpenSprgSprdB1" VALUE 0x804D93AE Val_Wu16 65535.00 DFES_OneToOne 0.00 65535.00 FORMAT "%8.2" /end CHARACTERISTIC
/begin CHARACTERISTIC DFC_CtlMsk.DFC_ThrVlvOpenSprgTwnB1_C "Behaviour control mask / Behaviour control masks of check DFC_ThrVlvOpenSprgTwnB1" VALUE 0x804D93B0 Val_Wu16 65535.00 DFES_OneToOne 0.00 65535.00 FORMAT "%8.2" /end CHARACTERISTIC
/begin CHARACTERISTIC DFC_CtlMsk.DFC_ThrVlvOverTB1_C "Behaviour control mask / Behaviour control masks of check DFC_ThrVlvOverTB1" VALUE 0x804D93B2 Val_Wu16 65535.00 DFES_OneToOne 0.00 65535.00 FORMAT "%8.2" /end CHARACTERISTIC
/begin CHARACTERISTIC DFC_CtlMsk.DFC_ThrVlvRetSprgB1_C "Behaviour control mask / Behaviour control masks of check DFC_ThrVlvRetSprgB1" VALUE 0x804D93B4 Val_Wu16 65535.00 DFES_OneToOne 0.00 65535.00 FORMAT "%8.2" /end CHARACTERISTIC
/begin CHARACTERISTIC DFC_CtlMsk.DFC_ThrVlvRetSprgSprdB1_C "Behaviour control mask / Behaviour control masks of check DFC_ThrVlvRetSprgSprdB1" VALUE 0x804D93B6 Val_Wu16 65535.00 DFES_OneToOne 0.00 65535.00 FORMAT "%8.2" /end CHARACTERISTIC
/begin CHARACTERISTIC DFC_CtlMsk.DFC_ThrVlvRetSprgTwnB1_C "Behaviour control mask / Behaviour control masks of check DFC_ThrVlvRetSprgTwnB1" VALUE 0x804D93B8 Val_Wu16 65535.00 DFES_OneToOne 0.00 65535.00 FORMAT "%8.2" /end CHARACTERISTIC
/begin CHARACTERISTIC DFC_CtlMsk.DFC_ThrVlvSens1MaxB1_C "Behaviour control mask / Behaviour control masks of check DFC_ThrVlvSens1MaxB1" VALUE 0x804D93BA Val_Wu16 65535.00 DFES_OneToOne 0.00 65535.00 FORMAT "%8.2" /end CHARACTERISTIC
/begin CHARACTERISTIC DFC_CtlMsk.DFC_ThrVlvSens1NplB1_C "Behaviour control mask / Behaviour control masks of check DFC_ThrVlvSens1NplB1" VALUE 0x804D93BC Val_Wu16 65535.00 DFES_OneToOne 0.00 65535.00 FORMAT "%8.2" /end CHARACTERISTIC
/begin CHARACTERISTIC DFC_CtlMsk.DFC_ThrVlvSens2MaxB1_C "Behaviour control mask / Behaviour control masks of check DFC_ThrVlvSens2MaxB1" VALUE 0x804D93BE Val_Wu16 65535.00 DFES_OneToOne 0.00 65535.00 FORMAT "%8.2" /end CHARACTERISTIC
/begin CHARACTERISTIC DFC_CtlMsk.DFC_ThrVlvSens2MinB1_C "Behaviour control mask / Behaviour control masks of check DFC_ThrVlvSens2MinB1" VALUE 0x804D93C0 Val_Wu16 65535.00 DFES_OneToOne 0.00 65535.00 FORMAT "%8.2" /end CHARACTERISTIC
/begin CHARACTERISTIC DFC_CtlMsk.DFC_ThrVlvSens2NplB1_C "Behaviour control mask / Behaviour control masks of check DFC_ThrVlvSens2NplB1" VALUE 0x804D93C2 Val_Wu16 65535.00 DFES_OneToOne 0.00 65535.00 FORMAT "%8.2" /end CHARACTERISTIC
/begin CHARACTERISTIC DFC_CtlMsk.DFC_ThrVlvShoCircB1_C "Behaviour control mask / Behaviour control masks of check DFC_ThrVlvShoCircB1" VALUE 0x804D93C4 Val_Wu16 65535.00 DFES_OneToOne 0.00 65535.00 FORMAT "%8.2" /end CHARACTERISTIC
/begin CHARACTERISTIC DFC_CtlMsk.DFC_ThrVlvSpiErrB1_C "Behaviour control mask / Behaviour control masks of check DFC_ThrVlvSpiErrB1" VALUE 0x804D93C6 Val_Wu16 65535.00 DFES_OneToOne 0.00 65535.00 FORMAT "%8.2" /end CHARACTERISTIC
/begin CHARACTERISTIC DFC_CtlMsk.DFC_ThrvlvSens1MinB1_C "Behaviour control mask / Behaviour control masks of check DFC_ThrvlvSens1MinB1" VALUE 0x804D93C8 Val_Wu16 65535.00 DFES_OneToOne 0.00 65535.00 FORMAT "%8.2" /end CHARACTERISTIC
/begin CHARACTERISTIC DFC_CtlMsk.DFC_TiOffTBasdChkFast_C "Behaviour control mask / Behaviour control masks of check DFC_TiOffTBasdChkFast" VALUE 0x804D93CA Val_Wu16 65535.00 DFES_OneToOne 0.00 65535.00 FORMAT "%8.2" /end CHARACTERISTIC
/begin CHARACTERISTIC DFC_CtlMsk.DFC_TiOffTBasdChkSlow_C "Behaviour control mask / Behaviour control masks of check DFC_TiOffTBasdChkSlow" VALUE 0x804D93CC Val_Wu16 65535.00 DFES_OneToOne 0.00 65535.00 FORMAT "%8.2" /end CHARACTERISTIC
/begin CHARACTERISTIC DFC_CtlMsk.DFC_UEGOSnsrMntdS1B1_C "Behaviour control mask / Behaviour control masks of check DFC_UEGOSnsrMntdS1B1" VALUE 0x804D93CE Val_Wu16 65535.00 DFES_OneToOne 0.00 65535.00 FORMAT "%8.2" /end CHARACTERISTIC
/begin CHARACTERISTIC DFC_CtlMsk.DFC_VehVSig_C "Behaviour control mask / Behaviour control masks of check DFC_VehVSig" VALUE 0x804D93D0 Val_Wu16 65535.00 DFES_OneToOne 0.00 65535.00 FORMAT "%8.2" /end CHARACTERISTIC
/begin CHARACTERISTIC DFC_CtlMsk.DFC_VlvLftFbSwtIntk11SpclFail_C "Behaviour control mask / Behaviour control masks of check DFC_VlvLftFbSwtIntk11SpclFail" VALUE 0x804D93D2 Val_Wu16 65535.00 DFES_OneToOne 0.00 65535.00 FORMAT "%8.2" /end CHARACTERISTIC
/begin CHARACTERISTIC DFC_CtlMsk.DFC_VlvLftFbSwtIntk11StdFail_C "Behaviour control mask / Behaviour control masks of check DFC_VlvLftFbSwtIntk11StdFail" VALUE 0x804D93D4 Val_Wu16 65535.00 DFES_OneToOne 0.00 65535.00 FORMAT "%8.2" /end CHARACTERISTIC
/begin CHARACTERISTIC DFC_DisblMsk.DFC_Unused_C "disable mask / " VALUE 0x804F5806 Val_Wu16 65535.00 DFES_OneToOne 0.00 65535.00 FORMAT "%8.2" READ_ONLY /end CHARACTERISTIC
/begin CHARACTERISTIC DFC_DisblMsk.DFC_AAVEmax_C "disable mask / Disable masks of check DFC_AAVEmax" VALUE 0x804F5808 Val_Wu16 65535.00 DFES_OneToOne 0.00 65535.00 FORMAT "%8.2" /end CHARACTERISTIC
/begin CHARACTERISTIC DFC_DisblMsk.DFC_AAVEmin_C "disable mask / Disable masks of check DFC_AAVEmin" VALUE 0x804F580A Val_Wu16 65535.00 DFES_OneToOne 0.00 65535.00 FORMAT "%8.2" /end CHARACTERISTIC
/begin CHARACTERISTIC DFC_DisblMsk.DFC_AAVEsig_C "disable mask / Disable masks of check DFC_AAVEsig" VALUE 0x804F580C Val_Wu16 65535.00 DFES_OneToOne 0.00 65535.00 FORMAT "%8.2" /end CHARACTERISTIC
/begin CHARACTERISTIC DFC_DisblMsk.DFC_AltIOACGFailr_C "disable mask / Disable masks of check DFC_AltIOACGFailr" VALUE 0x804F580E Val_Wu16 65535.00 DFES_OneToOne 0.00 65535.00 FORMAT "%8.2" /end CHARACTERISTIC
/begin CHARACTERISTIC DFC_DisblMsk.DFC_AltIOACGHiVltg_C "disable mask / Disable masks of check DFC_AltIOACGHiVltg" VALUE 0x804F5810 Val_Wu16 65535.00 DFES_OneToOne 0.00 65535.00 FORMAT "%8.2" /end CHARACTERISTIC
/begin CHARACTERISTIC DFC_DisblMsk.DFC_AltIOACGLoVltg_C "disable mask / Disable masks of check DFC_AltIOACGLoVltg" VALUE 0x804F5812 Val_Wu16 65535.00 DFES_OneToOne 0.00 65535.00 FORMAT "%8.2" /end CHARACTERISTIC
/begin CHARACTERISTIC DFC_DisblMsk.DFC_AltIOACGTHi_C "disable mask / Disable masks of check DFC_AltIOACGTHi" VALUE 0x804F5814 Val_Wu16 65535.00 DFES_OneToOne 0.00 65535.00 FORMAT "%8.2" /end CHARACTERISTIC
/begin CHARACTERISTIC DFC_DisblMsk.DFC_AltIODConnACG_C "disable mask / Disable masks of check DFC_AltIODConnACG" VALUE 0x804F5816 Val_Wu16 65535.00 DFES_OneToOne 0.00 65535.00 FORMAT "%8.2" /end CHARACTERISTIC
/begin CHARACTERISTIC DFC_DisblMsk.DFC_BGOELWAF_C "disable mask / Disable masks of check DFC_BGOELWAF" VALUE 0x804F5818 Val_Wu16 65535.00 DFES_OneToOne 0.00 65535.00 FORMAT "%8.2" /end CHARACTERISTIC
/begin CHARACTERISTIC DFC_DisblMsk.DFC_BattUHiFailr_C "disable mask / Disable masks of check DFC_BattUHiFailr" VALUE 0x804F581A Val_Wu16 65535.00 DFES_OneToOne 0.00 65535.00 FORMAT "%8.2" /end CHARACTERISTIC
/begin CHARACTERISTIC DFC_DisblMsk.DFC_BattULoFailr_C "disable mask / Disable masks of check DFC_BattULoFailr" VALUE 0x804F581C Val_Wu16 65535.00 DFES_OneToOne 0.00 65535.00 FORMAT "%8.2" /end CHARACTERISTIC
/begin CHARACTERISTIC DFC_DisblMsk.DFC_BrkBstPDriftHiErr_C "disable mask / Disable masks of check DFC_BrkBstPDriftHiErr" VALUE 0x804F581E Val_Wu16 65535.00 DFES_OneToOne 0.00 65535.00 FORMAT "%8.2" /end CHARACTERISTIC
/begin CHARACTERISTIC DFC_DisblMsk.DFC_BrkBstPDriftLoErr_C "disable mask / Disable masks of check DFC_BrkBstPDriftLoErr" VALUE 0x804F5820 Val_Wu16 65535.00 DFES_OneToOne 0.00 65535.00 FORMAT "%8.2" /end CHARACTERISTIC
/begin CHARACTERISTIC DFC_DisblMsk.DFC_BrkBstPSnsrStuck_C "disable mask / Disable masks of check DFC_BrkBstPSnsrStuck" VALUE 0x804F5822 Val_Wu16 65535.00 DFES_OneToOne 0.00 65535.00 FORMAT "%8.2" /end CHARACTERISTIC
/begin CHARACTERISTIC DFC_DisblMsk.DFC_BrkMnSwtContOn_C "disable mask / Disable masks of check DFC_BrkMnSwtContOn" VALUE 0x804F5824 Val_Wu16 65535.00 DFES_OneToOne 0.00 65535.00 FORMAT "%8.2" /end CHARACTERISTIC
/begin CHARACTERISTIC DFC_DisblMsk.DFC_BrkMnSwtNotStp_C "disable mask / Disable masks of check DFC_BrkMnSwtNotStp" VALUE 0x804F5826 Val_Wu16 65535.00 DFES_OneToOne 0.00 65535.00 FORMAT "%8.2" /end CHARACTERISTIC
/begin CHARACTERISTIC DFC_DisblMsk.DFC_BrkNpl_C "disable mask / Disable masks of check DFC_BrkNpl" VALUE 0x804F5828 Val_Wu16 65535.00 DFES_OneToOne 0.00 65535.00 FORMAT "%8.2" /end CHARACTERISTIC
/begin CHARACTERISTIC DFC_DisblMsk.DFC_BrkRdntSwtContOn_C "disable mask / Disable masks of check DFC_BrkRdntSwtContOn" VALUE 0x804F582A Val_Wu16 65535.00 DFES_OneToOne 0.00 65535.00 FORMAT "%8.2" /end CHARACTERISTIC
/begin CHARACTERISTIC DFC_DisblMsk.DFC_BrkRdntSwtNotStp_C "disable mask / Disable masks of check DFC_BrkRdntSwtNotStp" VALUE 0x804F582C Val_Wu16 65535.00 DFES_OneToOne 0.00 65535.00 FORMAT "%8.2" /end CHARACTERISTIC
/begin CHARACTERISTIC DFC_DisblMsk.DFC_Clth3ONStuck_C "disable mask / Disable masks of check DFC_Clth3ONStuck" VALUE 0x804F582E Val_Wu16 65535.00 DFES_OneToOne 0.00 65535.00 FORMAT "%8.2" /end CHARACTERISTIC
/begin CHARACTERISTIC DFC_DisblMsk.DFC_Clth4OFFStuck_C "disable mask / Disable masks of check DFC_Clth4OFFStuck" VALUE 0x804F5830 Val_Wu16 65535.00 DFES_OneToOne 0.00 65535.00 FORMAT "%8.2" /end CHARACTERISTIC
/begin CHARACTERISTIC DFC_DisblMsk.DFC_ClthOFFStuck_C "disable mask / Disable masks of check DFC_ClthOFFStuck" VALUE 0x804F5832 Val_Wu16 65535.00 DFES_OneToOne 0.00 65535.00 FORMAT "%8.2" /end CHARACTERISTIC
/begin CHARACTERISTIC DFC_DisblMsk.DFC_ClthONStuck_C "disable mask / Disable masks of check DFC_ClthONStuck" VALUE 0x804F5834 Val_Wu16 65535.00 DFES_OneToOne 0.00 65535.00 FORMAT "%8.2" /end CHARACTERISTIC
/begin CHARACTERISTIC DFC_DisblMsk.DFC_ClthStkFailInfo_C "disable mask / Disable masks of check DFC_ClthStkFailInfo" VALUE 0x804F5836 Val_Wu16 65535.00 DFES_OneToOne 0.00 65535.00 FORMAT "%8.2" /end CHARACTERISTIC
/begin CHARACTERISTIC DFC_DisblMsk.DFC_ComACFailInfo_C "disable mask / Disable masks of check DFC_ComACFailInfo" VALUE 0x804F5838 Val_Wu16 65535.00 DFES_OneToOne 0.00 65535.00 FORMAT "%8.2" /end CHARACTERISTIC
/begin CHARACTERISTIC DFC_DisblMsk.DFC_ComATFTValErr_C "disable mask / Disable masks of check DFC_ComATFTValErr" VALUE 0x804F583A Val_Wu16 65535.00 DFES_OneToOne 0.00 65535.00 FORMAT "%8.2" /end CHARACTERISTIC
/begin CHARACTERISTIC DFC_DisblMsk.DFC_ComATMILReq_C "disable mask / Disable masks of check DFC_ComATMILReq" VALUE 0x804F583C Val_Wu16 65535.00 DFES_OneToOne 0.00 65535.00 FORMAT "%8.2" /end CHARACTERISTIC
/begin CHARACTERISTIC DFC_DisblMsk.DFC_ComAYCAChksum_C "disable mask / Disable masks of check DFC_ComAYCAChksum" VALUE 0x804F583E Val_Wu16 65535.00 DFES_OneToOne 0.00 65535.00 FORMAT "%8.2" /end CHARACTERISTIC
/begin CHARACTERISTIC DFC_DisblMsk.DFC_ComAYCARingCnt_C "disable mask / Disable masks of check DFC_ComAYCARingCnt" VALUE 0x804F5840 Val_Wu16 65535.00 DFES_OneToOne 0.00 65535.00 FORMAT "%8.2" /end CHARACTERISTIC
/begin CHARACTERISTIC DFC_DisblMsk.DFC_ComAYCATOut_C "disable mask / Disable masks of check DFC_ComAYCATOut" VALUE 0x804F5842 Val_Wu16 65535.00 DFES_OneToOne 0.00 65535.00 FORMAT "%8.2" /end CHARACTERISTIC
/begin CHARACTERISTIC DFC_DisblMsk.DFC_ComAYCDChkSum_C "disable mask / Disable masks of check DFC_ComAYCDChkSum" VALUE 0x804F5844 Val_Wu16 65535.00 DFES_OneToOne 0.00 65535.00 FORMAT "%8.2" /end CHARACTERISTIC
/begin CHARACTERISTIC DFC_DisblMsk.DFC_ComAYCDTOut_C "disable mask / Disable masks of check DFC_ComAYCDTOut" VALUE 0x804F5846 Val_Wu16 65535.00 DFES_OneToOne 0.00 65535.00 FORMAT "%8.2" /end CHARACTERISTIC
/begin CHARACTERISTIC DFC_DisblMsk.DFC_ComAYCFChksum_C "disable mask / Disable masks of check DFC_ComAYCFChksum" VALUE 0x804F5848 Val_Wu16 65535.00 DFES_OneToOne 0.00 65535.00 FORMAT "%8.2" /end CHARACTERISTIC
/begin CHARACTERISTIC DFC_DisblMsk.DFC_ComAYCFRingCnt_C "disable mask / Disable masks of check DFC_ComAYCFRingCnt" VALUE 0x804F584A Val_Wu16 65535.00 DFES_OneToOne 0.00 65535.00 FORMAT "%8.2" /end CHARACTERISTIC
/begin CHARACTERISTIC DFC_DisblMsk.DFC_ComAYCFTOut_C "disable mask / Disable masks of check DFC_ComAYCFTOut" VALUE 0x804F584C Val_Wu16 65535.00 DFES_OneToOne 0.00 65535.00 FORMAT "%8.2" /end CHARACTERISTIC
/begin CHARACTERISTIC DFC_DisblMsk.DFC_ComAYCGChksum_C "disable mask / Disable masks of check DFC_ComAYCGChksum" VALUE 0x804F584E Val_Wu16 65535.00 DFES_OneToOne 0.00 65535.00 FORMAT "%8.2" /end CHARACTERISTIC
/begin CHARACTERISTIC DFC_DisblMsk.DFC_ComAYCGRingCnt_C "disable mask / Disable masks of check DFC_ComAYCGRingCnt" VALUE 0x804F5850 Val_Wu16 65535.00 DFES_OneToOne 0.00 65535.00 FORMAT "%8.2" /end CHARACTERISTIC
/begin CHARACTERISTIC DFC_DisblMsk.DFC_ComAYCGTOut_C "disable mask / Disable masks of check DFC_ComAYCGTOut" VALUE 0x804F5852 Val_Wu16 65535.00 DFES_OneToOne 0.00 65535.00 FORMAT "%8.2" /end CHARACTERISTIC
/begin CHARACTERISTIC DFC_DisblMsk.DFC_ComAYCIChkSum_C "disable mask / Disable masks of check DFC_ComAYCIChkSum" VALUE 0x804F5854 Val_Wu16 65535.00 DFES_OneToOne 0.00 65535.00 FORMAT "%8.2" /end CHARACTERISTIC
/begin CHARACTERISTIC DFC_DisblMsk.DFC_ComAYCIRingCnt_C "disable mask / Disable masks of check DFC_ComAYCIRingCnt" VALUE 0x804F5856 Val_Wu16 65535.00 DFES_OneToOne 0.00 65535.00 FORMAT "%8.2" /end CHARACTERISTIC
/begin CHARACTERISTIC DFC_DisblMsk.DFC_ComAYCITOut_C "disable mask / Disable masks of check DFC_ComAYCITOut" VALUE 0x804F5858 Val_Wu16 65535.00 DFES_OneToOne 0.00 65535.00 FORMAT "%8.2" /end CHARACTERISTIC
/begin CHARACTERISTIC DFC_DisblMsk.DFC_ComBCM1ChkSum_C "disable mask / Disable masks of check DFC_ComBCM1ChkSum" VALUE 0x804F585A Val_Wu16 65535.00 DFES_OneToOne 0.00 65535.00 FORMAT "%8.2" /end CHARACTERISTIC
/begin CHARACTERISTIC DFC_DisblMsk.DFC_ComBCM1RingCnt_C "disable mask / Disable masks of check DFC_ComBCM1RingCnt" VALUE 0x804F585C Val_Wu16 65535.00 DFES_OneToOne 0.00 65535.00 FORMAT "%8.2" /end CHARACTERISTIC
/begin CHARACTERISTIC DFC_DisblMsk.DFC_ComBCM1TOut_C "disable mask / Disable masks of check DFC_ComBCM1TOut" VALUE 0x804F585E Val_Wu16 65535.00 DFES_OneToOne 0.00 65535.00 FORMAT "%8.2" /end CHARACTERISTIC
/begin CHARACTERISTIC DFC_DisblMsk.DFC_ComCANABusOffErr_C "disable mask / Disable masks of check DFC_ComCANABusOffErr" VALUE 0x804F5860 Val_Wu16 65535.00 DFES_OneToOne 0.00 65535.00 FORMAT "%8.2" /end CHARACTERISTIC
/begin CHARACTERISTIC DFC_DisblMsk.DFC_ComCANBBusOffErr_C "disable mask / Disable masks of check DFC_ComCANBBusOffErr" VALUE 0x804F5862 Val_Wu16 65535.00 DFES_OneToOne 0.00 65535.00 FORMAT "%8.2" /end CHARACTERISTIC
/begin CHARACTERISTIC DFC_DisblMsk.DFC_ComCANCBusOffErr_C "disable mask / Disable masks of check DFC_ComCANCBusOffErr" VALUE 0x804F5864 Val_Wu16 65535.00 DFES_OneToOne 0.00 65535.00 FORMAT "%8.2" /end CHARACTERISTIC
/begin CHARACTERISTIC DFC_DisblMsk.DFC_ComCGW1ChkSum_C "disable mask / Disable masks of check DFC_ComCGW1ChkSum" VALUE 0x804F5866 Val_Wu16 65535.00 DFES_OneToOne 0.00 65535.00 FORMAT "%8.2" /end CHARACTERISTIC
/begin CHARACTERISTIC DFC_DisblMsk.DFC_ComCGW1RingCnt_C "disable mask / Disable masks of check DFC_ComCGW1RingCnt" VALUE 0x804F5868 Val_Wu16 65535.00 DFES_OneToOne 0.00 65535.00 FORMAT "%8.2" /end CHARACTERISTIC
/begin CHARACTERISTIC DFC_DisblMsk.DFC_ComCGW1TOut_C "disable mask / Disable masks of check DFC_ComCGW1TOut" VALUE 0x804F586A Val_Wu16 65535.00 DFES_OneToOne 0.00 65535.00 FORMAT "%8.2" /end CHARACTERISTIC
/begin CHARACTERISTIC DFC_DisblMsk.DFC_ComConvBoostErr_C "disable mask / Disable masks of check DFC_ComConvBoostErr" VALUE 0x804F586C Val_Wu16 65535.00 DFES_OneToOne 0.00 65535.00 FORMAT "%8.2" /end CHARACTERISTIC
/begin CHARACTERISTIC DFC_DisblMsk.DFC_ComConvSlipErr_C "disable mask / Disable masks of check DFC_ComConvSlipErr" VALUE 0x804F586E Val_Wu16 65535.00 DFES_OneToOne 0.00 65535.00 FORMAT "%8.2" /end CHARACTERISTIC
/begin CHARACTERISTIC DFC_DisblMsk.DFC_ComDCDCPrfmncErr_C "disable mask / Disable masks of check DFC_ComDCDCPrfmncErr" VALUE 0x804F5870 Val_Wu16 65535.00 DFES_OneToOne 0.00 65535.00 FORMAT "%8.2" /end CHARACTERISTIC
/begin CHARACTERISTIC DFC_DisblMsk.DFC_ComDCDCTempWarn_C "disable mask / Disable masks of check DFC_ComDCDCTempWarn" VALUE 0x804F5872 Val_Wu16 65535.00 DFES_OneToOne 0.00 65535.00 FORMAT "%8.2" /end CHARACTERISTIC
/begin CHARACTERISTIC DFC_DisblMsk.DFC_ComEAT10Chksum_C "disable mask / Disable masks of check DFC_ComEAT10Chksum" VALUE 0x804F5874 Val_Wu16 65535.00 DFES_OneToOne 0.00 65535.00 FORMAT "%8.2" /end CHARACTERISTIC
/begin CHARACTERISTIC DFC_DisblMsk.DFC_ComEAT10RingCnt_C "disable mask / Disable masks of check DFC_ComEAT10RingCnt" VALUE 0x804F5876 Val_Wu16 65535.00 DFES_OneToOne 0.00 65535.00 FORMAT "%8.2" /end CHARACTERISTIC
/begin CHARACTERISTIC DFC_DisblMsk.DFC_ComEAT10TOut_C "disable mask / Disable masks of check DFC_ComEAT10TOut" VALUE 0x804F5878 Val_Wu16 65535.00 DFES_OneToOne 0.00 65535.00 FORMAT "%8.2" /end CHARACTERISTIC
/begin CHARACTERISTIC DFC_DisblMsk.DFC_ComEAT11ChkSum_C "disable mask / Disable masks of check DFC_ComEAT11ChkSum" VALUE 0x804F587A Val_Wu16 65535.00 DFES_OneToOne 0.00 65535.00 FORMAT "%8.2" /end CHARACTERISTIC
/begin CHARACTERISTIC DFC_DisblMsk.DFC_ComEAT11RingCnt_C "disable mask / Disable masks of check DFC_ComEAT11RingCnt" VALUE 0x804F587C Val_Wu16 65535.00 DFES_OneToOne 0.00 65535.00 FORMAT "%8.2" /end CHARACTERISTIC
/begin CHARACTERISTIC DFC_DisblMsk.DFC_ComEAT11TOut_C "disable mask / Disable masks of check DFC_ComEAT11TOut" VALUE 0x804F587E Val_Wu16 65535.00 DFES_OneToOne 0.00 65535.00 FORMAT "%8.2" /end CHARACTERISTIC
/begin CHARACTERISTIC DFC_DisblMsk.DFC_ComEAT12ChkSum_C "disable mask / Disable masks of check DFC_ComEAT12ChkSum" VALUE 0x804F5880 Val_Wu16 65535.00 DFES_OneToOne 0.00 65535.00 FORMAT "%8.2" /end CHARACTERISTIC
/begin CHARACTERISTIC DFC_DisblMsk.DFC_ComEAT12RingCnt_C "disable mask / Disable masks of check DFC_ComEAT12RingCnt" VALUE 0x804F5882 Val_Wu16 65535.00 DFES_OneToOne 0.00 65535.00 FORMAT "%8.2" /end CHARACTERISTIC
/begin CHARACTERISTIC DFC_DisblMsk.DFC_ComEAT12TOut_C "disable mask / Disable masks of check DFC_ComEAT12TOut" VALUE 0x804F5884 Val_Wu16 65535.00 DFES_OneToOne 0.00 65535.00 FORMAT "%8.2" /end CHARACTERISTIC
/begin CHARACTERISTIC DFC_DisblMsk.DFC_ComEAT13ChkSum_C "disable mask / Disable masks of check DFC_ComEAT13ChkSum" VALUE 0x804F5886 Val_Wu16 65535.00 DFES_OneToOne 0.00 65535.00 FORMAT "%8.2" /end CHARACTERISTIC
/begin CHARACTERISTIC DFC_DisblMsk.DFC_ComEAT13RingCnt_C "disable mask / Disable masks of check DFC_ComEAT13RingCnt" VALUE 0x804F5888 Val_Wu16 65535.00 DFES_OneToOne 0.00 65535.00 FORMAT "%8.2" /end CHARACTERISTIC
/begin CHARACTERISTIC DFC_DisblMsk.DFC_ComEAT13TOut_C "disable mask / Disable masks of check DFC_ComEAT13TOut" VALUE 0x804F588A Val_Wu16 65535.00 DFES_OneToOne 0.00 65535.00 FORMAT "%8.2" /end CHARACTERISTIC
/begin CHARACTERISTIC DFC_DisblMsk.DFC_ComEAT1Chksum_C "disable mask / Disable masks of check DFC_ComEAT1Chksum" VALUE 0x804F588C Val_Wu16 65535.00 DFES_OneToOne 0.00 65535.00 FORMAT "%8.2" /end CHARACTERISTIC
/begin CHARACTERISTIC DFC_DisblMsk.DFC_ComEAT1RingCnt_C "disable mask / Disable masks of check DFC_ComEAT1RingCnt" VALUE 0x804F588E Val_Wu16 65535.00 DFES_OneToOne 0.00 65535.00 FORMAT "%8.2" /end CHARACTERISTIC
/begin CHARACTERISTIC DFC_DisblMsk.DFC_ComEAT1TOut_C "disable mask / Disable masks of check DFC_ComEAT1TOut" VALUE 0x804F5890 Val_Wu16 65535.00 DFES_OneToOne 0.00 65535.00 FORMAT "%8.2" /end CHARACTERISTIC
/begin CHARACTERISTIC DFC_DisblMsk.DFC_ComEAT2ChkSum_C "disable mask / Disable masks of check DFC_ComEAT2ChkSum" VALUE 0x804F5892 Val_Wu16 65535.00 DFES_OneToOne 0.00 65535.00 FORMAT "%8.2" /end CHARACTERISTIC
/begin CHARACTERISTIC DFC_DisblMsk.DFC_ComEAT2RingCnt_C "disable mask / Disable masks of check DFC_ComEAT2RingCnt" VALUE 0x804F5894 Val_Wu16 65535.00 DFES_OneToOne 0.00 65535.00 FORMAT "%8.2" /end CHARACTERISTIC
/begin CHARACTERISTIC DFC_DisblMsk.DFC_ComEAT2TOut_C "disable mask / Disable masks of check DFC_ComEAT2TOut" VALUE 0x804F5896 Val_Wu16 65535.00 DFES_OneToOne 0.00 65535.00 FORMAT "%8.2" /end CHARACTERISTIC
/begin CHARACTERISTIC DFC_DisblMsk.DFC_ComEAT4ChkSum_C "disable mask / Disable masks of check DFC_ComEAT4ChkSum" VALUE 0x804F5898 Val_Wu16 65535.00 DFES_OneToOne 0.00 65535.00 FORMAT "%8.2" /end CHARACTERISTIC
/begin CHARACTERISTIC DFC_DisblMsk.DFC_ComEAT4RingCnt_C "disable mask / Disable masks of check DFC_ComEAT4RingCnt" VALUE 0x804F589A Val_Wu16 65535.00 DFES_OneToOne 0.00 65535.00 FORMAT "%8.2" /end CHARACTERISTIC
/begin CHARACTERISTIC DFC_DisblMsk.DFC_ComEAT4TOut_C "disable mask / Disable masks of check DFC_ComEAT4TOut" VALUE 0x804F589C Val_Wu16 65535.00 DFES_OneToOne 0.00 65535.00 FORMAT "%8.2" /end CHARACTERISTIC
/begin CHARACTERISTIC DFC_DisblMsk.DFC_ComEAT6Chksum_C "disable mask / Disable masks of check DFC_ComEAT6Chksum" VALUE 0x804F589E Val_Wu16 65535.00 DFES_OneToOne 0.00 65535.00 FORMAT "%8.2" /end CHARACTERISTIC
/begin CHARACTERISTIC DFC_DisblMsk.DFC_ComEAT6RingCnt_C "disable mask / Disable masks of check DFC_ComEAT6RingCnt" VALUE 0x804F58A0 Val_Wu16 65535.00 DFES_OneToOne 0.00 65535.00 FORMAT "%8.2" /end CHARACTERISTIC
/begin CHARACTERISTIC DFC_DisblMsk.DFC_ComEAT6TOut_C "disable mask / Disable masks of check DFC_ComEAT6TOut" VALUE 0x804F58A2 Val_Wu16 65535.00 DFES_OneToOne 0.00 65535.00 FORMAT "%8.2" /end CHARACTERISTIC
/begin CHARACTERISTIC DFC_DisblMsk.DFC_ComEAT7Chksum_C "disable mask / Disable masks of check DFC_ComEAT7Chksum" VALUE 0x804F58A4 Val_Wu16 65535.00 DFES_OneToOne 0.00 65535.00 FORMAT "%8.2" /end CHARACTERISTIC
/begin CHARACTERISTIC DFC_DisblMsk.DFC_ComEAT7RingCnt_C "disable mask / Disable masks of check DFC_ComEAT7RingCnt" VALUE 0x804F58A6 Val_Wu16 65535.00 DFES_OneToOne 0.00 65535.00 FORMAT "%8.2" /end CHARACTERISTIC
/begin CHARACTERISTIC DFC_DisblMsk.DFC_ComEAT7TOut_C "disable mask / Disable masks of check DFC_ComEAT7TOut" VALUE 0x804F58A8 Val_Wu16 65535.00 DFES_OneToOne 0.00 65535.00 FORMAT "%8.2" /end CHARACTERISTIC
/begin CHARACTERISTIC DFC_DisblMsk.DFC_ComEAT8Chksum_C "disable mask / Disable masks of check DFC_ComEAT8Chksum" VALUE 0x804F58AA Val_Wu16 65535.00 DFES_OneToOne 0.00 65535.00 FORMAT "%8.2" /end CHARACTERISTIC
/begin CHARACTERISTIC DFC_DisblMsk.DFC_ComEAT8RingCnt_C "disable mask / Disable masks of check DFC_ComEAT8RingCnt" VALUE 0x804F58AC Val_Wu16 65535.00 DFES_OneToOne 0.00 65535.00 FORMAT "%8.2" /end CHARACTERISTIC
/begin CHARACTERISTIC DFC_DisblMsk.DFC_ComEAT8TOut_C "disable mask / Disable masks of check DFC_ComEAT8TOut" VALUE 0x804F58AE Val_Wu16 65535.00 DFES_OneToOne 0.00 65535.00 FORMAT "%8.2" /end CHARACTERISTIC
/begin CHARACTERISTIC DFC_DisblMsk.DFC_ComEATAChksum_C "disable mask / Disable masks of check DFC_ComEATAChksum" VALUE 0x804F58B0 Val_Wu16 65535.00 DFES_OneToOne 0.00 65535.00 FORMAT "%8.2" /end CHARACTERISTIC
/begin CHARACTERISTIC DFC_DisblMsk.DFC_ComEATARingCnt_C "disable mask / Disable masks of check DFC_ComEATARingCnt" VALUE 0x804F58B2 Val_Wu16 65535.00 DFES_OneToOne 0.00 65535.00 FORMAT "%8.2" /end CHARACTERISTIC
/begin CHARACTERISTIC DFC_DisblMsk.DFC_ComEATATOut_C "disable mask / Disable masks of check DFC_ComEATATOut" VALUE 0x804F58B4 Val_Wu16 65535.00 DFES_OneToOne 0.00 65535.00 FORMAT "%8.2" /end CHARACTERISTIC
/begin CHARACTERISTIC DFC_DisblMsk.DFC_ComEATBChkSum_C "disable mask / Disable masks of check DFC_ComEATBChkSum" VALUE 0x804F58B6 Val_Wu16 65535.00 DFES_OneToOne 0.00 65535.00 FORMAT "%8.2" /end CHARACTERISTIC
/begin CHARACTERISTIC DFC_DisblMsk.DFC_ComEATBRingCnt_C "disable mask / Disable masks of check DFC_ComEATBRingCnt" VALUE 0x804F58B8 Val_Wu16 65535.00 DFES_OneToOne 0.00 65535.00 FORMAT "%8.2" /end CHARACTERISTIC
/begin CHARACTERISTIC DFC_DisblMsk.DFC_ComEATBTOut_C "disable mask / Disable masks of check DFC_ComEATBTOut" VALUE 0x804F58BA Val_Wu16 65535.00 DFES_OneToOne 0.00 65535.00 FORMAT "%8.2" /end CHARACTERISTIC
/begin CHARACTERISTIC DFC_DisblMsk.DFC_ComEATCChksum_C "disable mask / Disable masks of check DFC_ComEATCChksum" VALUE 0x804F58BC Val_Wu16 65535.00 DFES_OneToOne 0.00 65535.00 FORMAT "%8.2" /end CHARACTERISTIC
/begin CHARACTERISTIC DFC_DisblMsk.DFC_ComEATCRingCnt_C "disable mask / Disable masks of check DFC_ComEATCRingCnt" VALUE 0x804F58BE Val_Wu16 65535.00 DFES_OneToOne 0.00 65535.00 FORMAT "%8.2" /end CHARACTERISTIC
/begin CHARACTERISTIC DFC_DisblMsk.DFC_ComEATCTOut_C "disable mask / Disable masks of check DFC_ComEATCTOut" VALUE 0x804F58C0 Val_Wu16 65535.00 DFES_OneToOne 0.00 65535.00 FORMAT "%8.2" /end CHARACTERISTIC
/begin CHARACTERISTIC DFC_DisblMsk.DFC_ComEPBBChkSum_C "disable mask / Disable masks of check DFC_ComEPBBChkSum" VALUE 0x804F58C2 Val_Wu16 65535.00 DFES_OneToOne 0.00 65535.00 FORMAT "%8.2" /end CHARACTERISTIC
/begin CHARACTERISTIC DFC_DisblMsk.DFC_ComEPBBRingCnt_C "disable mask / Disable masks of check DFC_ComEPBBRingCnt" VALUE 0x804F58C4 Val_Wu16 65535.00 DFES_OneToOne 0.00 65535.00 FORMAT "%8.2" /end CHARACTERISTIC
/begin CHARACTERISTIC DFC_DisblMsk.DFC_ComEPBBTOut_C "disable mask / Disable masks of check DFC_ComEPBBTOut" VALUE 0x804F58C6 Val_Wu16 65535.00 DFES_OneToOne 0.00 65535.00 FORMAT "%8.2" /end CHARACTERISTIC
/begin CHARACTERISTIC DFC_DisblMsk.DFC_ComEPBChksum_C "disable mask / Disable masks of check DFC_ComEPBChksum" VALUE 0x804F58C8 Val_Wu16 65535.00 DFES_OneToOne 0.00 65535.00 FORMAT "%8.2" /end CHARACTERISTIC
/begin CHARACTERISTIC DFC_DisblMsk.DFC_ComEPBTOut_C "disable mask / Disable masks of check DFC_ComEPBTOut" VALUE 0x804F58CA Val_Wu16 65535.00 DFES_OneToOne 0.00 65535.00 FORMAT "%8.2" /end CHARACTERISTIC
/begin CHARACTERISTIC DFC_DisblMsk.DFC_ComEPBctRing_C "disable mask / Disable masks of check DFC_ComEPBctRing" VALUE 0x804F58CC Val_Wu16 65535.00 DFES_OneToOne 0.00 65535.00 FORMAT "%8.2" /end CHARACTERISTIC
/begin CHARACTERISTIC DFC_DisblMsk.DFC_ComEPS1Chksum_C "disable mask / Disable masks of check DFC_ComEPS1Chksum" VALUE 0x804F58CE Val_Wu16 65535.00 DFES_OneToOne 0.00 65535.00 FORMAT "%8.2" /end CHARACTERISTIC
/begin CHARACTERISTIC DFC_DisblMsk.DFC_ComEPS1RingCnt_C "disable mask / Disable masks of check DFC_ComEPS1RingCnt" VALUE 0x804F58D0 Val_Wu16 65535.00 DFES_OneToOne 0.00 65535.00 FORMAT "%8.2" /end CHARACTERISTIC
/begin CHARACTERISTIC DFC_DisblMsk.DFC_ComEPS1TOut_C "disable mask / Disable masks of check DFC_ComEPS1TOut" VALUE 0x804F58D2 Val_Wu16 65535.00 DFES_OneToOne 0.00 65535.00 FORMAT "%8.2" /end CHARACTERISTIC
/begin CHARACTERISTIC DFC_DisblMsk.DFC_ComEngCanRxErr_C "disable mask / Disable masks of check DFC_ComEngCanRxErr" VALUE 0x804F58D4 Val_Wu16 65535.00 DFES_OneToOne 0.00 65535.00 FORMAT "%8.2" /end CHARACTERISTIC
/begin CHARACTERISTIC DFC_DisblMsk.DFC_ComGrvySnsrErr_C "disable mask / Disable masks of check DFC_ComGrvySnsrErr" VALUE 0x804F58D6 Val_Wu16 65535.00 DFES_OneToOne 0.00 65535.00 FORMAT "%8.2" /end CHARACTERISTIC
/begin CHARACTERISTIC DFC_DisblMsk.DFC_ComGwIMG1ChkSum_C "disable mask / Disable masks of check DFC_ComGwIMG1ChkSum" VALUE 0x804F58D8 Val_Wu16 65535.00 DFES_OneToOne 0.00 65535.00 FORMAT "%8.2" /end CHARACTERISTIC
/begin CHARACTERISTIC DFC_DisblMsk.DFC_ComGwIMG1RingCnt_C "disable mask / Disable masks of check DFC_ComGwIMG1RingCnt" VALUE 0x804F58DA Val_Wu16 65535.00 DFES_OneToOne 0.00 65535.00 FORMAT "%8.2" /end CHARACTERISTIC
/begin CHARACTERISTIC DFC_DisblMsk.DFC_ComGwIMG1TOut_C "disable mask / Disable masks of check DFC_ComGwIMG1TOut" VALUE 0x804F58DC Val_Wu16 65535.00 DFES_OneToOne 0.00 65535.00 FORMAT "%8.2" /end CHARACTERISTIC
/begin CHARACTERISTIC DFC_DisblMsk.DFC_ComGwIMG3ChkSum_C "disable mask / Disable masks of check DFC_ComGwIMG3ChkSum" VALUE 0x804F58DE Val_Wu16 65535.00 DFES_OneToOne 0.00 65535.00 FORMAT "%8.2" /end CHARACTERISTIC
/begin CHARACTERISTIC DFC_DisblMsk.DFC_ComGwIMG3RingCnt_C "disable mask / Disable masks of check DFC_ComGwIMG3RingCnt" VALUE 0x804F58E0 Val_Wu16 65535.00 DFES_OneToOne 0.00 65535.00 FORMAT "%8.2" /end CHARACTERISTIC
/begin CHARACTERISTIC DFC_DisblMsk.DFC_ComGwIMG3TOut_C "disable mask / Disable masks of check DFC_ComGwIMG3TOut" VALUE 0x804F58E2 Val_Wu16 65535.00 DFES_OneToOne 0.00 65535.00 FORMAT "%8.2" /end CHARACTERISTIC
/begin CHARACTERISTIC DFC_DisblMsk.DFC_ComGwIMG4ChkSum_C "disable mask / Disable masks of check DFC_ComGwIMG4ChkSum" VALUE 0x804F58E4 Val_Wu16 65535.00 DFES_OneToOne 0.00 65535.00 FORMAT "%8.2" /end CHARACTERISTIC
/begin CHARACTERISTIC DFC_DisblMsk.DFC_ComGwIMG4RingCnt_C "disable mask / Disable masks of check DFC_ComGwIMG4RingCnt" VALUE 0x804F58E6 Val_Wu16 65535.00 DFES_OneToOne 0.00 65535.00 FORMAT "%8.2" /end CHARACTERISTIC
/begin CHARACTERISTIC DFC_DisblMsk.DFC_ComGwIMG4TOut_C "disable mask / Disable masks of check DFC_ComGwIMG4TOut" VALUE 0x804F58E8 Val_Wu16 65535.00 DFES_OneToOne 0.00 65535.00 FORMAT "%8.2" /end CHARACTERISTIC
/begin CHARACTERISTIC DFC_DisblMsk.DFC_ComGwIMG5ChkSum_C "disable mask / Disable masks of check DFC_ComGwIMG5ChkSum" VALUE 0x804F58EA Val_Wu16 65535.00 DFES_OneToOne 0.00 65535.00 FORMAT "%8.2" /end CHARACTERISTIC
/begin CHARACTERISTIC DFC_DisblMsk.DFC_ComGwIMG5RingCnt_C "disable mask / Disable masks of check DFC_ComGwIMG5RingCnt" VALUE 0x804F58EC Val_Wu16 65535.00 DFES_OneToOne 0.00 65535.00 FORMAT "%8.2" /end CHARACTERISTIC
/begin CHARACTERISTIC DFC_DisblMsk.DFC_ComGwIMG5TOut_C "disable mask / Disable masks of check DFC_ComGwIMG5TOut" VALUE 0x804F58EE Val_Wu16 65535.00 DFES_OneToOne 0.00 65535.00 FORMAT "%8.2" /end CHARACTERISTIC
/begin CHARACTERISTIC DFC_DisblMsk.DFC_ComGwIMG6ChkSum_C "disable mask / Disable masks of check DFC_ComGwIMG6ChkSum" VALUE 0x804F58F0 Val_Wu16 65535.00 DFES_OneToOne 0.00 65535.00 FORMAT "%8.2" /end CHARACTERISTIC
/begin CHARACTERISTIC DFC_DisblMsk.DFC_ComGwIMG6RingCnt_C "disable mask / Disable masks of check DFC_ComGwIMG6RingCnt" VALUE 0x804F58F2 Val_Wu16 65535.00 DFES_OneToOne 0.00 65535.00 FORMAT "%8.2" /end CHARACTERISTIC
/begin CHARACTERISTIC DFC_DisblMsk.DFC_ComGwIMG6TOut_C "disable mask / Disable masks of check DFC_ComGwIMG6TOut" VALUE 0x804F58F4 Val_Wu16 65535.00 DFES_OneToOne 0.00 65535.00 FORMAT "%8.2" /end CHARACTERISTIC
/begin CHARACTERISTIC DFC_DisblMsk.DFC_ComIDASBChksum_C "disable mask / Disable masks of check DFC_ComIDASBChksum" VALUE 0x804F58F6 Val_Wu16 65535.00 DFES_OneToOne 0.00 65535.00 FORMAT "%8.2" /end CHARACTERISTIC
/begin CHARACTERISTIC DFC_DisblMsk.DFC_ComIDASBRingCnt_C "disable mask / Disable masks of check DFC_ComIDASBRingCnt" VALUE 0x804F58F8 Val_Wu16 65535.00 DFES_OneToOne 0.00 65535.00 FORMAT "%8.2" /end CHARACTERISTIC
/begin CHARACTERISTIC DFC_DisblMsk.DFC_ComIDASBTOut_C "disable mask / Disable masks of check DFC_ComIDASBTOut" VALUE 0x804F58FA Val_Wu16 65535.00 DFES_OneToOne 0.00 65535.00 FORMAT "%8.2" /end CHARACTERISTIC
/begin CHARACTERISTIC DFC_DisblMsk.DFC_ComIMGMILReq_C "disable mask / Disable masks of check DFC_ComIMGMILReq" VALUE 0x804F58FC Val_Wu16 65535.00 DFES_OneToOne 0.00 65535.00 FORMAT "%8.2" /end CHARACTERISTIC
/begin CHARACTERISTIC DFC_DisblMsk.DFC_ComISSPrms_C "disable mask / Disable masks of check DFC_ComISSPrms" VALUE 0x804F58FE Val_Wu16 65535.00 DFES_OneToOne 0.00 65535.00 FORMAT "%8.2" /end CHARACTERISTIC
/begin CHARACTERISTIC DFC_DisblMsk.DFC_ComMETAChksum_C "disable mask / Disable masks of check DFC_ComMETAChksum" VALUE 0x804F5900 Val_Wu16 65535.00 DFES_OneToOne 0.00 65535.00 FORMAT "%8.2" /end CHARACTERISTIC
/begin CHARACTERISTIC DFC_DisblMsk.DFC_ComMETAChksumPstDrv_C "disable mask / Disable masks of check DFC_ComMETAChksumPstDrv" VALUE 0x804F5902 Val_Wu16 65535.00 DFES_OneToOne 0.00 65535.00 FORMAT "%8.2" /end CHARACTERISTIC
/begin CHARACTERISTIC DFC_DisblMsk.DFC_ComMETARingCnt_C "disable mask / Disable masks of check DFC_ComMETARingCnt" VALUE 0x804F5904 Val_Wu16 65535.00 DFES_OneToOne 0.00 65535.00 FORMAT "%8.2" /end CHARACTERISTIC
/begin CHARACTERISTIC DFC_DisblMsk.DFC_ComMETARingCntPstDrv_C "disable mask / Disable masks of check DFC_ComMETARingCntPstDrv" VALUE 0x804F5906 Val_Wu16 65535.00 DFES_OneToOne 0.00 65535.00 FORMAT "%8.2" /end CHARACTERISTIC
/begin CHARACTERISTIC DFC_DisblMsk.DFC_ComMETATOut_C "disable mask / Disable masks of check DFC_ComMETATOut" VALUE 0x804F5908 Val_Wu16 65535.00 DFES_OneToOne 0.00 65535.00 FORMAT "%8.2" /end CHARACTERISTIC
/begin CHARACTERISTIC DFC_DisblMsk.DFC_ComMETATOutPstDrv_C "disable mask / Disable masks of check DFC_ComMETATOutPstDrv" VALUE 0x804F590A Val_Wu16 65535.00 DFES_OneToOne 0.00 65535.00 FORMAT "%8.2" /end CHARACTERISTIC
/begin CHARACTERISTIC DFC_DisblMsk.DFC_ComMETCChksum_C "disable mask / Disable masks of check DFC_ComMETCChksum" VALUE 0x804F590C Val_Wu16 65535.00 DFES_OneToOne 0.00 65535.00 FORMAT "%8.2" /end CHARACTERISTIC
/begin CHARACTERISTIC DFC_DisblMsk.DFC_ComMETCRingCnt_C "disable mask / Disable masks of check DFC_ComMETCRingCnt" VALUE 0x804F590E Val_Wu16 65535.00 DFES_OneToOne 0.00 65535.00 FORMAT "%8.2" /end CHARACTERISTIC
/begin CHARACTERISTIC DFC_DisblMsk.DFC_ComMETCTOut_C "disable mask / Disable masks of check DFC_ComMETCTOut" VALUE 0x804F5910 Val_Wu16 65535.00 DFES_OneToOne 0.00 65535.00 FORMAT "%8.2" /end CHARACTERISTIC
/begin CHARACTERISTIC DFC_DisblMsk.DFC_ComMETDChksum_C "disable mask / Disable masks of check DFC_ComMETDChksum" VALUE 0x804F5912 Val_Wu16 65535.00 DFES_OneToOne 0.00 65535.00 FORMAT "%8.2" /end CHARACTERISTIC
/begin CHARACTERISTIC DFC_DisblMsk.DFC_ComMETDRingCnt_C "disable mask / Disable masks of check DFC_ComMETDRingCnt" VALUE 0x804F5914 Val_Wu16 65535.00 DFES_OneToOne 0.00 65535.00 FORMAT "%8.2" /end CHARACTERISTIC
/begin CHARACTERISTIC DFC_DisblMsk.DFC_ComMETDTOut_C "disable mask / Disable masks of check DFC_ComMETDTOut" VALUE 0x804F5916 Val_Wu16 65535.00 DFES_OneToOne 0.00 65535.00 FORMAT "%8.2" /end CHARACTERISTIC
/begin CHARACTERISTIC DFC_DisblMsk.DFC_ComMETE2Chksum_C "disable mask / Disable masks of check DFC_ComMETE2Chksum" VALUE 0x804F5918 Val_Wu16 65535.00 DFES_OneToOne 0.00 65535.00 FORMAT "%8.2" /end CHARACTERISTIC
/begin CHARACTERISTIC DFC_DisblMsk.DFC_ComMETE2RingCnt_C "disable mask / Disable masks of check DFC_ComMETE2RingCnt" VALUE 0x804F591A Val_Wu16 65535.00 DFES_OneToOne 0.00 65535.00 FORMAT "%8.2" /end CHARACTERISTIC
/begin CHARACTERISTIC DFC_DisblMsk.DFC_ComMETE2TOut_C "disable mask / Disable masks of check DFC_ComMETE2TOut" VALUE 0x804F591C Val_Wu16 65535.00 DFES_OneToOne 0.00 65535.00 FORMAT "%8.2" /end CHARACTERISTIC
/begin CHARACTERISTIC DFC_DisblMsk.DFC_ComMETFChksum_C "disable mask / Disable masks of check DFC_ComMETFChksum" VALUE 0x804F591E Val_Wu16 65535.00 DFES_OneToOne 0.00 65535.00 FORMAT "%8.2" /end CHARACTERISTIC
/begin CHARACTERISTIC DFC_DisblMsk.DFC_ComMETFRingCnt_C "disable mask / Disable masks of check DFC_ComMETFRingCnt" VALUE 0x804F5920 Val_Wu16 65535.00 DFES_OneToOne 0.00 65535.00 FORMAT "%8.2" /end CHARACTERISTIC
/begin CHARACTERISTIC DFC_DisblMsk.DFC_ComMETFTOut_C "disable mask / Disable masks of check DFC_ComMETFTOut" VALUE 0x804F5922 Val_Wu16 65535.00 DFES_OneToOne 0.00 65535.00 FORMAT "%8.2" /end CHARACTERISTIC
/begin CHARACTERISTIC DFC_DisblMsk.DFC_ComMETGChksum_C "disable mask / Disable masks of check DFC_ComMETGChksum" VALUE 0x804F5924 Val_Wu16 65535.00 DFES_OneToOne 0.00 65535.00 FORMAT "%8.2" /end CHARACTERISTIC
/begin CHARACTERISTIC DFC_DisblMsk.DFC_ComMETGRingCnt_C "disable mask / Disable masks of check DFC_ComMETGRingCnt" VALUE 0x804F5926 Val_Wu16 65535.00 DFES_OneToOne 0.00 65535.00 FORMAT "%8.2" /end CHARACTERISTIC
/begin CHARACTERISTIC DFC_DisblMsk.DFC_ComMETGTOut_C "disable mask / Disable masks of check DFC_ComMETGTOut" VALUE 0x804F5928 Val_Wu16 65535.00 DFES_OneToOne 0.00 65535.00 FORMAT "%8.2" /end CHARACTERISTIC
/begin CHARACTERISTIC DFC_DisblMsk.DFC_ComMETH2Chksum_C "disable mask / Disable masks of check DFC_ComMETH2Chksum" VALUE 0x804F592A Val_Wu16 65535.00 DFES_OneToOne 0.00 65535.00 FORMAT "%8.2" /end CHARACTERISTIC
/begin CHARACTERISTIC DFC_DisblMsk.DFC_ComMETH2RingCnt_C "disable mask / Disable masks of check DFC_ComMETH2RingCnt" VALUE 0x804F592C Val_Wu16 65535.00 DFES_OneToOne 0.00 65535.00 FORMAT "%8.2" /end CHARACTERISTIC
/begin CHARACTERISTIC DFC_DisblMsk.DFC_ComMETH2TOut_C "disable mask / Disable masks of check DFC_ComMETH2TOut" VALUE 0x804F592E Val_Wu16 65535.00 DFES_OneToOne 0.00 65535.00 FORMAT "%8.2" /end CHARACTERISTIC
/begin CHARACTERISTIC DFC_DisblMsk.DFC_ComMETHChksum_C "disable mask / Disable masks of check DFC_ComMETHChksum" VALUE 0x804F5930 Val_Wu16 65535.00 DFES_OneToOne 0.00 65535.00 FORMAT "%8.2" /end CHARACTERISTIC
/begin CHARACTERISTIC DFC_DisblMsk.DFC_ComMETHRingCnt_C "disable mask / Disable masks of check DFC_ComMETHRingCnt" VALUE 0x804F5932 Val_Wu16 65535.00 DFES_OneToOne 0.00 65535.00 FORMAT "%8.2" /end CHARACTERISTIC
/begin CHARACTERISTIC DFC_DisblMsk.DFC_ComMETHTOut_C "disable mask / Disable masks of check DFC_ComMETHTOut" VALUE 0x804F5934 Val_Wu16 65535.00 DFES_OneToOne 0.00 65535.00 FORMAT "%8.2" /end CHARACTERISTIC
/begin CHARACTERISTIC DFC_DisblMsk.DFC_ComMETIChksum_C "disable mask / Disable masks of check DFC_ComMETIChksum" VALUE 0x804F5936 Val_Wu16 65535.00 DFES_OneToOne 0.00 65535.00 FORMAT "%8.2" /end CHARACTERISTIC
/begin CHARACTERISTIC DFC_DisblMsk.DFC_ComMETIRingCnt_C "disable mask / Disable masks of check DFC_ComMETIRingCnt" VALUE 0x804F5938 Val_Wu16 65535.00 DFES_OneToOne 0.00 65535.00 FORMAT "%8.2" /end CHARACTERISTIC
/begin CHARACTERISTIC DFC_DisblMsk.DFC_ComMETITOut_C "disable mask / Disable masks of check DFC_ComMETITOut" VALUE 0x804F593A Val_Wu16 65535.00 DFES_OneToOne 0.00 65535.00 FORMAT "%8.2" /end CHARACTERISTIC
/begin CHARACTERISTIC DFC_DisblMsk.DFC_ComMETKChksum_C "disable mask / Disable masks of check DFC_ComMETKChksum" VALUE 0x804F593C Val_Wu16 65535.00 DFES_OneToOne 0.00 65535.00 FORMAT "%8.2" /end CHARACTERISTIC
/begin CHARACTERISTIC DFC_DisblMsk.DFC_ComMETKRingCnt_C "disable mask / Disable masks of check DFC_ComMETKRingCnt" VALUE 0x804F593E Val_Wu16 65535.00 DFES_OneToOne 0.00 65535.00 FORMAT "%8.2" /end CHARACTERISTIC
/begin CHARACTERISTIC DFC_DisblMsk.DFC_ComMETKTOut_C "disable mask / Disable masks of check DFC_ComMETKTOut" VALUE 0x804F5940 Val_Wu16 65535.00 DFES_OneToOne 0.00 65535.00 FORMAT "%8.2" /end CHARACTERISTIC
/begin CHARACTERISTIC DFC_DisblMsk.DFC_ComMETLChksum_C "disable mask / Disable masks of check DFC_ComMETLChksum" VALUE 0x804F5942 Val_Wu16 65535.00 DFES_OneToOne 0.00 65535.00 FORMAT "%8.2" /end CHARACTERISTIC
/begin CHARACTERISTIC DFC_DisblMsk.DFC_ComMETLRingCnt_C "disable mask / Disable masks of check DFC_ComMETLRingCnt" VALUE 0x804F5944 Val_Wu16 65535.00 DFES_OneToOne 0.00 65535.00 FORMAT "%8.2" /end CHARACTERISTIC
/begin CHARACTERISTIC DFC_DisblMsk.DFC_ComMETLTOut_C "disable mask / Disable masks of check DFC_ComMETLTOut" VALUE 0x804F5946 Val_Wu16 65535.00 DFES_OneToOne 0.00 65535.00 FORMAT "%8.2" /end CHARACTERISTIC
/begin CHARACTERISTIC DFC_DisblMsk.DFC_ComMETMChksum_C "disable mask / Disable masks of check DFC_ComMETMChksum" VALUE 0x804F5948 Val_Wu16 65535.00 DFES_OneToOne 0.00 65535.00 FORMAT "%8.2" /end CHARACTERISTIC
/begin CHARACTERISTIC DFC_DisblMsk.DFC_ComMETMRingCnt_C "disable mask / Disable masks of check DFC_ComMETMRingCnt" VALUE 0x804F594A Val_Wu16 65535.00 DFES_OneToOne 0.00 65535.00 FORMAT "%8.2" /end CHARACTERISTIC
/begin CHARACTERISTIC DFC_DisblMsk.DFC_ComMETMTOut_C "disable mask / Disable masks of check DFC_ComMETMTOut" VALUE 0x804F594C Val_Wu16 65535.00 DFES_OneToOne 0.00 65535.00 FORMAT "%8.2" /end CHARACTERISTIC
/begin CHARACTERISTIC DFC_DisblMsk.DFC_ComMETNChksum_C "disable mask / Disable masks of check DFC_ComMETNChksum" VALUE 0x804F594E Val_Wu16 65535.00 DFES_OneToOne 0.00 65535.00 FORMAT "%8.2" /end CHARACTERISTIC
/begin CHARACTERISTIC DFC_DisblMsk.DFC_ComMETNRingCnt_C "disable mask / Disable masks of check DFC_ComMETNRingCnt" VALUE 0x804F5950 Val_Wu16 65535.00 DFES_OneToOne 0.00 65535.00 FORMAT "%8.2" /end CHARACTERISTIC
/begin CHARACTERISTIC DFC_DisblMsk.DFC_ComMETNTOut_C "disable mask / Disable masks of check DFC_ComMETNTOut" VALUE 0x804F5952 Val_Wu16 65535.00 DFES_OneToOne 0.00 65535.00 FORMAT "%8.2" /end CHARACTERISTIC
/begin CHARACTERISTIC DFC_DisblMsk.DFC_ComMtrCom_C "disable mask / Disable masks of check DFC_ComMtrCom" VALUE 0x804F5954 Val_Wu16 65535.00 DFES_OneToOne 0.00 65535.00 FORMAT "%8.2" /end CHARACTERISTIC
/begin CHARACTERISTIC DFC_DisblMsk.DFC_ComPCUChkSum_C "disable mask / Disable masks of check DFC_ComPCUChkSum" VALUE 0x804F5956 Val_Wu16 65535.00 DFES_OneToOne 0.00 65535.00 FORMAT "%8.2" /end CHARACTERISTIC
/begin CHARACTERISTIC DFC_DisblMsk.DFC_ComPCURingCnt_C "disable mask / Disable masks of check DFC_ComPCURingCnt" VALUE 0x804F5958 Val_Wu16 65535.00 DFES_OneToOne 0.00 65535.00 FORMAT "%8.2" /end CHARACTERISTIC
/begin CHARACTERISTIC DFC_DisblMsk.DFC_ComPCUTOut_C "disable mask / Disable masks of check DFC_ComPCUTOut" VALUE 0x804F595A Val_Wu16 65535.00 DFES_OneToOne 0.00 65535.00 FORMAT "%8.2" /end CHARACTERISTIC
/begin CHARACTERISTIC DFC_DisblMsk.DFC_ComSRSAChksum_C "disable mask / Disable masks of check DFC_ComSRSAChksum" VALUE 0x804F595C Val_Wu16 65535.00 DFES_OneToOne 0.00 65535.00 FORMAT "%8.2" /end CHARACTERISTIC
/begin CHARACTERISTIC DFC_DisblMsk.DFC_ComSRSARingCnt_C "disable mask / Disable masks of check DFC_ComSRSARingCnt" VALUE 0x804F595E Val_Wu16 65535.00 DFES_OneToOne 0.00 65535.00 FORMAT "%8.2" /end CHARACTERISTIC
/begin CHARACTERISTIC DFC_DisblMsk.DFC_ComSRSATOut_C "disable mask / Disable masks of check DFC_ComSRSATOut" VALUE 0x804F5960 Val_Wu16 65535.00 DFES_OneToOne 0.00 65535.00 FORMAT "%8.2" /end CHARACTERISTIC
/begin CHARACTERISTIC DFC_DisblMsk.DFC_ComSRSBChksum_C "disable mask / Disable masks of check DFC_ComSRSBChksum" VALUE 0x804F5962 Val_Wu16 65535.00 DFES_OneToOne 0.00 65535.00 FORMAT "%8.2" /end CHARACTERISTIC
/begin CHARACTERISTIC DFC_DisblMsk.DFC_ComSRSBRingCnt_C "disable mask / Disable masks of check DFC_ComSRSBRingCnt" VALUE 0x804F5964 Val_Wu16 65535.00 DFES_OneToOne 0.00 65535.00 FORMAT "%8.2" /end CHARACTERISTIC
/begin CHARACTERISTIC DFC_DisblMsk.DFC_ComSRSBTOut_C "disable mask / Disable masks of check DFC_ComSRSBTOut" VALUE 0x804F5966 Val_Wu16 65535.00 DFES_OneToOne 0.00 65535.00 FORMAT "%8.2" /end CHARACTERISTIC
/begin CHARACTERISTIC DFC_DisblMsk.DFC_ComSRSChksum_C "disable mask / Disable masks of check DFC_ComSRSChksum" VALUE 0x804F5968 Val_Wu16 65535.00 DFES_OneToOne 0.00 65535.00 FORMAT "%8.2" /end CHARACTERISTIC
/begin CHARACTERISTIC DFC_DisblMsk.DFC_ComSRSErr_C "disable mask / Disable masks of check DFC_ComSRSErr" VALUE 0x804F596A Val_Wu16 65535.00 DFES_OneToOne 0.00 65535.00 FORMAT "%8.2" /end CHARACTERISTIC
/begin CHARACTERISTIC DFC_DisblMsk.DFC_ComSRSRingCnt_C "disable mask / Disable masks of check DFC_ComSRSRingCnt" VALUE 0x804F596C Val_Wu16 65535.00 DFES_OneToOne 0.00 65535.00 FORMAT "%8.2" /end CHARACTERISTIC
/begin CHARACTERISTIC DFC_DisblMsk.DFC_ComSRSTOut_C "disable mask / Disable masks of check DFC_ComSRSTOut" VALUE 0x804F596E Val_Wu16 65535.00 DFES_OneToOne 0.00 65535.00 FORMAT "%8.2" /end CHARACTERISTIC
/begin CHARACTERISTIC DFC_DisblMsk.DFC_ComVehSpdPndFltTCU_C "disable mask / Disable masks of check DFC_ComVehSpdPndFltTCU" VALUE 0x804F5970 Val_Wu16 65535.00 DFES_OneToOne 0.00 65535.00 FORMAT "%8.2" /end CHARACTERISTIC
/begin CHARACTERISTIC DFC_DisblMsk.DFC_EbsChartcCurrErr_C "disable mask / Disable masks of check DFC_EbsChartcCurrErr" VALUE 0x804F5972 Val_Wu16 65535.00 DFES_OneToOne 0.00 65535.00 FORMAT "%8.2" /end CHARACTERISTIC
/begin CHARACTERISTIC DFC_DisblMsk.DFC_EbsSelfDiagErr_C "disable mask / Disable masks of check DFC_EbsSelfDiagErr" VALUE 0x804F5974 Val_Wu16 65535.00 DFES_OneToOne 0.00 65535.00 FORMAT "%8.2" /end CHARACTERISTIC
/begin CHARACTERISTIC DFC_DisblMsk.DFC_GEVlvPhaCsersIntkB1_C "disable mask / Disable masks of check DFC_GEVlvPhaCsersIntkB1" VALUE 0x804F5976 Val_Wu16 65535.00 DFES_OneToOne 0.00 65535.00 FORMAT "%8.2" /end CHARACTERISTIC
/begin CHARACTERISTIC DFC_DisblMsk.DFC_GEVlvPhaPsOpenLoadIntkB1_C "disable mask / Disable masks of check DFC_GEVlvPhaPsOpenLoadIntkB1" VALUE 0x804F5978 Val_Wu16 65535.00 DFES_OneToOne 0.00 65535.00 FORMAT "%8.2" /end CHARACTERISTIC
/begin CHARACTERISTIC DFC_DisblMsk.DFC_GEVlvPhaPsShoToBattIntkB1_C "disable mask / Disable masks of check DFC_GEVlvPhaPsShoToBattIntkB1" VALUE 0x804F597A Val_Wu16 65535.00 DFES_OneToOne 0.00 65535.00 FORMAT "%8.2" /end CHARACTERISTIC
/begin CHARACTERISTIC DFC_DisblMsk.DFC_GEVlvPhaPsShoToGndIntkB1_C "disable mask / Disable masks of check DFC_GEVlvPhaPsShoToGndIntkB1" VALUE 0x804F597C Val_Wu16 65535.00 DFES_OneToOne 0.00 65535.00 FORMAT "%8.2" /end CHARACTERISTIC
/begin CHARACTERISTIC DFC_DisblMsk.DFC_GbxCANDigPlausErr_C "disable mask / Disable masks of check DFC_GbxCANDigPlausErr" VALUE 0x804F597E Val_Wu16 65535.00 DFES_OneToOne 0.00 65535.00 FORMAT "%8.2" /end CHARACTERISTIC
/begin CHARACTERISTIC DFC_DisblMsk.DFC_GbxNPos1SRCMax_C "disable mask / Disable masks of check DFC_GbxNPos1SRCMax" VALUE 0x804F5980 Val_Wu16 65535.00 DFES_OneToOne 0.00 65535.00 FORMAT "%8.2" /end CHARACTERISTIC
/begin CHARACTERISTIC DFC_DisblMsk.DFC_GbxNPos1SRCMin_C "disable mask / Disable masks of check DFC_GbxNPos1SRCMin" VALUE 0x804F5982 Val_Wu16 65535.00 DFES_OneToOne 0.00 65535.00 FORMAT "%8.2" /end CHARACTERISTIC
/begin CHARACTERISTIC DFC_DisblMsk.DFC_GbxNPos2SRCMax_C "disable mask / Disable masks of check DFC_GbxNPos2SRCMax" VALUE 0x804F5984 Val_Wu16 65535.00 DFES_OneToOne 0.00 65535.00 FORMAT "%8.2" /end CHARACTERISTIC
/begin CHARACTERISTIC DFC_DisblMsk.DFC_GbxNPos2SRCMin_C "disable mask / Disable masks of check DFC_GbxNPos2SRCMin" VALUE 0x804F5986 Val_Wu16 65535.00 DFES_OneToOne 0.00 65535.00 FORMAT "%8.2" /end CHARACTERISTIC
/begin CHARACTERISTIC DFC_DisblMsk.DFC_GbxNPosAlvChk_C "disable mask / Disable masks of check DFC_GbxNPosAlvChk" VALUE 0x804F5988 Val_Wu16 65535.00 DFES_OneToOne 0.00 65535.00 FORMAT "%8.2" /end CHARACTERISTIC
/begin CHARACTERISTIC DFC_DisblMsk.DFC_GbxNPosSyncErr_C "disable mask / Disable masks of check DFC_GbxNPosSyncErr" VALUE 0x804F598A Val_Wu16 65535.00 DFES_OneToOne 0.00 65535.00 FORMAT "%8.2" /end CHARACTERISTIC
/begin CHARACTERISTIC DFC_DisblMsk.DFC_HEGOS2B1HtrPsMax_C "disable mask / Disable masks of check DFC_HEGOS2B1HtrPsMax" VALUE 0x804F598C Val_Wu16 65535.00 DFES_OneToOne 0.00 65535.00 FORMAT "%8.2" /end CHARACTERISTIC
/begin CHARACTERISTIC DFC_DisblMsk.DFC_HEGOS2B1HtrPsMin_C "disable mask / Disable masks of check DFC_HEGOS2B1HtrPsMin" VALUE 0x804F598E Val_Wu16 65535.00 DFES_OneToOne 0.00 65535.00 FORMAT "%8.2" /end CHARACTERISTIC
/begin CHARACTERISTIC DFC_DisblMsk.DFC_HEGOS2B1HtrPsSig_C "disable mask / Disable masks of check DFC_HEGOS2B1HtrPsSig" VALUE 0x804F5990 Val_Wu16 65535.00 DFES_OneToOne 0.00 65535.00 FORMAT "%8.2" /end CHARACTERISTIC
/begin CHARACTERISTIC DFC_DisblMsk.DFC_LinCSErrACG_C "disable mask / Disable masks of check DFC_LinCSErrACG" VALUE 0x804F5992 Val_Wu16 65535.00 DFES_OneToOne 0.00 65535.00 FORMAT "%8.2" /end CHARACTERISTIC
/begin CHARACTERISTIC DFC_DisblMsk.DFC_LinCSErrAEV_C "disable mask / Disable masks of check DFC_LinCSErrAEV" VALUE 0x804F5994 Val_Wu16 65535.00 DFES_OneToOne 0.00 65535.00 FORMAT "%8.2" /end CHARACTERISTIC
/begin CHARACTERISTIC DFC_DisblMsk.DFC_LinCSErrDCDC_C "disable mask / Disable masks of check DFC_LinCSErrDCDC" VALUE 0x804F5996 Val_Wu16 65535.00 DFES_OneToOne 0.00 65535.00 FORMAT "%8.2" /end CHARACTERISTIC
/begin CHARACTERISTIC DFC_DisblMsk.DFC_LinCSErrEBS_C "disable mask / Disable masks of check DFC_LinCSErrEBS" VALUE 0x804F5998 Val_Wu16 65535.00 DFES_OneToOne 0.00 65535.00 FORMAT "%8.2" /end CHARACTERISTIC
/begin CHARACTERISTIC DFC_DisblMsk.DFC_LinHdrTimeoutErrACG_C "disable mask / Disable masks of check DFC_LinHdrTimeoutErrACG" VALUE 0x804F599A Val_Wu16 65535.00 DFES_OneToOne 0.00 65535.00 FORMAT "%8.2" /end CHARACTERISTIC
/begin CHARACTERISTIC DFC_DisblMsk.DFC_LinHdrTimeoutErrAEV_C "disable mask / Disable masks of check DFC_LinHdrTimeoutErrAEV" VALUE 0x804F599C Val_Wu16 65535.00 DFES_OneToOne 0.00 65535.00 FORMAT "%8.2" /end CHARACTERISTIC
/begin CHARACTERISTIC DFC_DisblMsk.DFC_LinHdrTimeoutErrDCDC_C "disable mask / Disable masks of check DFC_LinHdrTimeoutErrDCDC" VALUE 0x804F599E Val_Wu16 65535.00 DFES_OneToOne 0.00 65535.00 FORMAT "%8.2" /end CHARACTERISTIC
/begin CHARACTERISTIC DFC_DisblMsk.DFC_LinHdrTimeoutErrEBS_C "disable mask / Disable masks of check DFC_LinHdrTimeoutErrEBS" VALUE 0x804F59A0 Val_Wu16 65535.00 DFES_OneToOne 0.00 65535.00 FORMAT "%8.2" /end CHARACTERISTIC
/begin CHARACTERISTIC DFC_DisblMsk.DFC_LinMsgTimeoutErrACG_C "disable mask / Disable masks of check DFC_LinMsgTimeoutErrACG" VALUE 0x804F59A2 Val_Wu16 65535.00 DFES_OneToOne 0.00 65535.00 FORMAT "%8.2" /end CHARACTERISTIC
/begin CHARACTERISTIC DFC_DisblMsk.DFC_LinMsgTimeoutErrAEV_C "disable mask / Disable masks of check DFC_LinMsgTimeoutErrAEV" VALUE 0x804F59A4 Val_Wu16 65535.00 DFES_OneToOne 0.00 65535.00 FORMAT "%8.2" /end CHARACTERISTIC
/begin CHARACTERISTIC DFC_DisblMsk.DFC_LinMsgTimeoutErrDCDC_C "disable mask / Disable masks of check DFC_LinMsgTimeoutErrDCDC" VALUE 0x804F59A6 Val_Wu16 65535.00 DFES_OneToOne 0.00 65535.00 FORMAT "%8.2" /end CHARACTERISTIC
/begin CHARACTERISTIC DFC_DisblMsk.DFC_LinMsgTimeoutErrEBS_C "disable mask / Disable masks of check DFC_LinMsgTimeoutErrEBS" VALUE 0x804F59A8 Val_Wu16 65535.00 DFES_OneToOne 0.00 65535.00 FORMAT "%8.2" /end CHARACTERISTIC
/begin CHARACTERISTIC DFC_DisblMsk.DFC_LinNoStrtComErr_C "disable mask / Disable masks of check DFC_LinNoStrtComErr" VALUE 0x804F59AA Val_Wu16 65535.00 DFES_OneToOne 0.00 65535.00 FORMAT "%8.2" /end CHARACTERISTIC
/begin CHARACTERISTIC DFC_DisblMsk.DFC_LowPresOilP_C "disable mask / Disable masks of check DFC_LowPresOilP" VALUE 0x804F59AC Val_Wu16 65535.00 DFES_OneToOne 0.00 65535.00 FORMAT "%8.2" /end CHARACTERISTIC
/begin CHARACTERISTIC DFC_DisblMsk.DFC_MisfDetVWhlFrntLeOORHi_C "disable mask / Disable masks of check DFC_MisfDetVWhlFrntLeOORHi" VALUE 0x804F59AE Val_Wu16 65535.00 DFES_OneToOne 0.00 65535.00 FORMAT "%8.2" /end CHARACTERISTIC
/begin CHARACTERISTIC DFC_DisblMsk.DFC_MisfDetVWhlFrntLeRatyHi_C "disable mask / Disable masks of check DFC_MisfDetVWhlFrntLeRatyHi" VALUE 0x804F59B0 Val_Wu16 65535.00 DFES_OneToOne 0.00 65535.00 FORMAT "%8.2" /end CHARACTERISTIC
/begin CHARACTERISTIC DFC_DisblMsk.DFC_MisfDetVWhlFrntLeRatyLo_C "disable mask / Disable masks of check DFC_MisfDetVWhlFrntLeRatyLo" VALUE 0x804F59B2 Val_Wu16 65535.00 DFES_OneToOne 0.00 65535.00 FORMAT "%8.2" /end CHARACTERISTIC
/begin CHARACTERISTIC DFC_DisblMsk.DFC_MisfDetVWhlFrntLeStuck_C "disable mask / Disable masks of check DFC_MisfDetVWhlFrntLeStuck" VALUE 0x804F59B4 Val_Wu16 65535.00 DFES_OneToOne 0.00 65535.00 FORMAT "%8.2" /end CHARACTERISTIC
/begin CHARACTERISTIC DFC_DisblMsk.DFC_MisfDetVWhlFrntRiOORHi_C "disable mask / Disable masks of check DFC_MisfDetVWhlFrntRiOORHi" VALUE 0x804F59B6 Val_Wu16 65535.00 DFES_OneToOne 0.00 65535.00 FORMAT "%8.2" /end CHARACTERISTIC
/begin CHARACTERISTIC DFC_DisblMsk.DFC_MisfDetVWhlFrntRiRatyHi_C "disable mask / Disable masks of check DFC_MisfDetVWhlFrntRiRatyHi" VALUE 0x804F59B8 Val_Wu16 65535.00 DFES_OneToOne 0.00 65535.00 FORMAT "%8.2" /end CHARACTERISTIC
/begin CHARACTERISTIC DFC_DisblMsk.DFC_MisfDetVWhlFrntRiRatyLo_C "disable mask / Disable masks of check DFC_MisfDetVWhlFrntRiRatyLo" VALUE 0x804F59BA Val_Wu16 65535.00 DFES_OneToOne 0.00 65535.00 FORMAT "%8.2" /end CHARACTERISTIC
/begin CHARACTERISTIC DFC_DisblMsk.DFC_MisfDetVWhlFrntRiStuck_C "disable mask / Disable masks of check DFC_MisfDetVWhlFrntRiStuck" VALUE 0x804F59BC Val_Wu16 65535.00 DFES_OneToOne 0.00 65535.00 FORMAT "%8.2" /end CHARACTERISTIC
/begin CHARACTERISTIC DFC_DisblMsk.DFC_MisfDetVWhlReLeOORHi_C "disable mask / Disable masks of check DFC_MisfDetVWhlReLeOORHi" VALUE 0x804F59BE Val_Wu16 65535.00 DFES_OneToOne 0.00 65535.00 FORMAT "%8.2" /end CHARACTERISTIC
/begin CHARACTERISTIC DFC_DisblMsk.DFC_MisfDetVWhlReLeRatyHi_C "disable mask / Disable masks of check DFC_MisfDetVWhlReLeRatyHi" VALUE 0x804F59C0 Val_Wu16 65535.00 DFES_OneToOne 0.00 65535.00 FORMAT "%8.2" /end CHARACTERISTIC
/begin CHARACTERISTIC DFC_DisblMsk.DFC_MisfDetVWhlReLeRatyLo_C "disable mask / Disable masks of check DFC_MisfDetVWhlReLeRatyLo" VALUE 0x804F59C2 Val_Wu16 65535.00 DFES_OneToOne 0.00 65535.00 FORMAT "%8.2" /end CHARACTERISTIC
/begin CHARACTERISTIC DFC_DisblMsk.DFC_MisfDetVWhlReLeStuck_C "disable mask / Disable masks of check DFC_MisfDetVWhlReLeStuck" VALUE 0x804F59C4 Val_Wu16 65535.00 DFES_OneToOne 0.00 65535.00 FORMAT "%8.2" /end CHARACTERISTIC
/begin CHARACTERISTIC DFC_DisblMsk.DFC_MisfDetVWhlReRiOORHi_C "disable mask / Disable masks of check DFC_MisfDetVWhlReRiOORHi" VALUE 0x804F59C6 Val_Wu16 65535.00 DFES_OneToOne 0.00 65535.00 FORMAT "%8.2" /end CHARACTERISTIC
/begin CHARACTERISTIC DFC_DisblMsk.DFC_MisfDetVWhlReRiRatyHi_C "disable mask / Disable masks of check DFC_MisfDetVWhlReRiRatyHi" VALUE 0x804F59C8 Val_Wu16 65535.00 DFES_OneToOne 0.00 65535.00 FORMAT "%8.2" /end CHARACTERISTIC
/begin CHARACTERISTIC DFC_DisblMsk.DFC_MisfDetVWhlReRiRatyLo_C "disable mask / Disable masks of check DFC_MisfDetVWhlReRiRatyLo" VALUE 0x804F59CA Val_Wu16 65535.00 DFES_OneToOne 0.00 65535.00 FORMAT "%8.2" /end CHARACTERISTIC
/begin CHARACTERISTIC DFC_DisblMsk.DFC_MisfDetVWhlReRiStuck_C "disable mask / Disable masks of check DFC_MisfDetVWhlReRiStuck" VALUE 0x804F59CC Val_Wu16 65535.00 DFES_OneToOne 0.00 65535.00 FORMAT "%8.2" /end CHARACTERISTIC
/begin CHARACTERISTIC DFC_DisblMsk.DFC_MisfDetdVWhlFrntLePlaus_C "disable mask / Disable masks of check DFC_MisfDetdVWhlFrntLePlaus" VALUE 0x804F59CE Val_Wu16 65535.00 DFES_OneToOne 0.00 65535.00 FORMAT "%8.2" /end CHARACTERISTIC
/begin CHARACTERISTIC DFC_DisblMsk.DFC_MisfDetdVWhlFrntRiPlaus_C "disable mask / Disable masks of check DFC_MisfDetdVWhlFrntRiPlaus" VALUE 0x804F59D0 Val_Wu16 65535.00 DFES_OneToOne 0.00 65535.00 FORMAT "%8.2" /end CHARACTERISTIC
/begin CHARACTERISTIC DFC_DisblMsk.DFC_MisfDetdVWhlReLePlaus_C "disable mask / Disable masks of check DFC_MisfDetdVWhlReLePlaus" VALUE 0x804F59D2 Val_Wu16 65535.00 DFES_OneToOne 0.00 65535.00 FORMAT "%8.2" /end CHARACTERISTIC
/begin CHARACTERISTIC DFC_DisblMsk.DFC_MisfDetdVWhlReRiPlaus_C "disable mask / Disable masks of check DFC_MisfDetdVWhlReRiPlaus" VALUE 0x804F59D4 Val_Wu16 65535.00 DFES_OneToOne 0.00 65535.00 FORMAT "%8.2" /end CHARACTERISTIC
/begin CHARACTERISTIC DFC_DisblMsk.DFC_PEnvSigRngMax_C "disable mask / Disable masks of check DFC_PEnvSigRngMax" VALUE 0x804F59D6 Val_Wu16 65535.00 DFES_OneToOne 0.00 65535.00 FORMAT "%8.2" /end CHARACTERISTIC
/begin CHARACTERISTIC DFC_DisblMsk.DFC_PEnvSigRngMin_C "disable mask / Disable masks of check DFC_PEnvSigRngMin" VALUE 0x804F59D8 Val_Wu16 65535.00 DFES_OneToOne 0.00 65535.00 FORMAT "%8.2" /end CHARACTERISTIC
/begin CHARACTERISTIC DFC_DisblMsk.DFC_StmFault_C "disable mask / Disable masks of check DFC_StmFault" VALUE 0x804F59DA Val_Wu16 65535.00 DFES_OneToOne 0.00 65535.00 FORMAT "%8.2" /end CHARACTERISTIC
/begin CHARACTERISTIC DFC_DisblMsk.DFC_StrtCtOffPth_C "disable mask / Disable masks of check DFC_StrtCtOffPth" VALUE 0x804F59DC Val_Wu16 65535.00 DFES_OneToOne 0.00 65535.00 FORMAT "%8.2" /end CHARACTERISTIC
/begin CHARACTERISTIC DFC_DisblMsk.DFC_StrtCtlErr_C "disable mask / Disable masks of check DFC_StrtCtlErr" VALUE 0x804F59DE Val_Wu16 65535.00 DFES_OneToOne 0.00 65535.00 FORMAT "%8.2" /end CHARACTERISTIC
/begin CHARACTERISTIC DFC_DisblMsk.DFC_StrtFault_C "disable mask / Disable masks of check DFC_StrtFault" VALUE 0x804F59E0 Val_Wu16 65535.00 DFES_OneToOne 0.00 65535.00 FORMAT "%8.2" /end CHARACTERISTIC
/begin CHARACTERISTIC DFC_DisblMsk.DFC_StrtLckJudg1_C "disable mask / Disable masks of check DFC_StrtLckJudg1" VALUE 0x804F59E2 Val_Wu16 65535.00 DFES_OneToOne 0.00 65535.00 FORMAT "%8.2" /end CHARACTERISTIC
/begin CHARACTERISTIC DFC_DisblMsk.DFC_StrtLckJudg2_C "disable mask / Disable masks of check DFC_StrtLckJudg2" VALUE 0x804F59E4 Val_Wu16 65535.00 DFES_OneToOne 0.00 65535.00 FORMAT "%8.2" /end CHARACTERISTIC
/begin CHARACTERISTIC DFC_DisblMsk.DFC_StrtOL_C "disable mask / Disable masks of check DFC_StrtOL" VALUE 0x804F59E6 Val_Wu16 65535.00 DFES_OneToOne 0.00 65535.00 FORMAT "%8.2" /end CHARACTERISTIC
/begin CHARACTERISTIC DFC_DisblMsk.DFC_StrtOL2_C "disable mask / Disable masks of check DFC_StrtOL2" VALUE 0x804F59E8 Val_Wu16 65535.00 DFES_OneToOne 0.00 65535.00 FORMAT "%8.2" /end CHARACTERISTIC
/begin CHARACTERISTIC DFC_DisblMsk.DFC_StrtSCB_C "disable mask / Disable masks of check DFC_StrtSCB" VALUE 0x804F59EA Val_Wu16 65535.00 DFES_OneToOne 0.00 65535.00 FORMAT "%8.2" /end CHARACTERISTIC
/begin CHARACTERISTIC DFC_DisblMsk.DFC_StrtSCB2_C "disable mask / Disable masks of check DFC_StrtSCB2" VALUE 0x804F59EC Val_Wu16 65535.00 DFES_OneToOne 0.00 65535.00 FORMAT "%8.2" /end CHARACTERISTIC
/begin CHARACTERISTIC DFC_DisblMsk.DFC_StrtSCG_C "disable mask / Disable masks of check DFC_StrtSCG" VALUE 0x804F59EE Val_Wu16 65535.00 DFES_OneToOne 0.00 65535.00 FORMAT "%8.2" /end CHARACTERISTIC
/begin CHARACTERISTIC DFC_DisblMsk.DFC_StrtSCG2_C "disable mask / Disable masks of check DFC_StrtSCG2" VALUE 0x804F59F0 Val_Wu16 65535.00 DFES_OneToOne 0.00 65535.00 FORMAT "%8.2" /end CHARACTERISTIC
/begin CHARACTERISTIC DFC_DisblMsk.DFC_StrtStkRly1_C "disable mask / Disable masks of check DFC_StrtStkRly1" VALUE 0x804F59F2 Val_Wu16 65535.00 DFES_OneToOne 0.00 65535.00 FORMAT "%8.2" /end CHARACTERISTIC
/begin CHARACTERISTIC DFC_DisblMsk.DFC_StrtStkRly2_C "disable mask / Disable masks of check DFC_StrtStkRly2" VALUE 0x804F59F4 Val_Wu16 65535.00 DFES_OneToOne 0.00 65535.00 FORMAT "%8.2" /end CHARACTERISTIC
/begin CHARACTERISTIC DFC_DisblMsk.DFC_TEVEmax_C "disable mask / Disable masks of check DFC_TEVEmax" VALUE 0x804F59F6 Val_Wu16 65535.00 DFES_OneToOne 0.00 65535.00 FORMAT "%8.2" /end CHARACTERISTIC
/begin CHARACTERISTIC DFC_DisblMsk.DFC_TEVEmin_C "disable mask / Disable masks of check DFC_TEVEmin" VALUE 0x804F59F8 Val_Wu16 65535.00 DFES_OneToOne 0.00 65535.00 FORMAT "%8.2" /end CHARACTERISTIC
/begin CHARACTERISTIC DFC_DisblMsk.DFC_TEVEsig_C "disable mask / Disable masks of check DFC_TEVEsig" VALUE 0x804F59FA Val_Wu16 65535.00 DFES_OneToOne 0.00 65535.00 FORMAT "%8.2" /end CHARACTERISTIC
/begin CHARACTERISTIC DFC_DisblMsk.DFC_UegoHeatrPrfmncLoS1B1_C "disable mask / Disable masks of check DFC_UegoHeatrPrfmncLoS1B1" VALUE 0x804F59FC Val_Wu16 65535.00 DFES_OneToOne 0.00 65535.00 FORMAT "%8.2" /end CHARACTERISTIC
/begin CHARACTERISTIC DFC_DisblMsk.DFC_VehVAllPlaus_C "disable mask / Disable masks of check DFC_VehVAllPlaus" VALUE 0x804F59FE Val_Wu16 65535.00 DFES_OneToOne 0.00 65535.00 FORMAT "%8.2" /end CHARACTERISTIC
/begin CHARACTERISTIC DFC_DisblMsk.DFC_VehVNCSnsrElecFailr_C "disable mask / Disable masks of check DFC_VehVNCSnsrElecFailr" VALUE 0x804F5A00 Val_Wu16 65535.00 DFES_OneToOne 0.00 65535.00 FORMAT "%8.2" /end CHARACTERISTIC
/begin CHARACTERISTIC DFC_DisblMsk.DFC_VehVPlausCan_C "disable mask / Disable masks of check DFC_VehVPlausCan" VALUE 0x804F5A02 Val_Wu16 65535.00 DFES_OneToOne 0.00 65535.00 FORMAT "%8.2" /end CHARACTERISTIC
/begin CHARACTERISTIC DFC_DisblMsk.DFC_VehVPlausFco_C "disable mask / Disable masks of check DFC_VehVPlausFco" VALUE 0x804F5A04 Val_Wu16 65535.00 DFES_OneToOne 0.00 65535.00 FORMAT "%8.2" /end CHARACTERISTIC
/begin CHARACTERISTIC DFC_DisblMsk.DFC_VehVPlausPwr_C "disable mask / Disable masks of check DFC_VehVPlausPwr" VALUE 0x804F5A06 Val_Wu16 65535.00 DFES_OneToOne 0.00 65535.00 FORMAT "%8.2" /end CHARACTERISTIC
/begin CHARACTERISTIC DFC_DisblMsk.DFC_VehVPlausV2N_C "disable mask / Disable masks of check DFC_VehVPlausV2N" VALUE 0x804F5A08 Val_Wu16 65535.00 DFES_OneToOne 0.00 65535.00 FORMAT "%8.2" /end CHARACTERISTIC
/begin CHARACTERISTIC DFC_DisblMsk.DFC_VehVSpdSnsrAElecFailr_C "disable mask / Disable masks of check DFC_VehVSpdSnsrAElecFailr" VALUE 0x804F5A0A Val_Wu16 65535.00 DFES_OneToOne 0.00 65535.00 FORMAT "%8.2" /end CHARACTERISTIC
/begin CHARACTERISTIC DFC_DisblMsk.DFC_VehVSpdSnsrBElecFailr_C "disable mask / Disable masks of check DFC_VehVSpdSnsrBElecFailr" VALUE 0x804F5A0C Val_Wu16 65535.00 DFES_OneToOne 0.00 65535.00 FORMAT "%8.2" /end CHARACTERISTIC
/begin CHARACTERISTIC DFC_DisblMsk.DFC_ClthMax_C "disable mask / Disable masks of check DFC_ClthMax" VALUE 0x804F5A0E Val_Wu16 65535.00 DFES_OneToOne 0.00 65535.00 FORMAT "%8.2" /end CHARACTERISTIC
/begin CHARACTERISTIC DFC_DisblMsk.DFC_IgnClPs_DevComErr_C "disable mask / Disable masks of check DFC_IgnClPs_DevComErr" VALUE 0x804F5A10 Val_Wu16 65535.00 DFES_OneToOne 0.00 65535.00 FORMAT "%8.2" /end CHARACTERISTIC
/begin CHARACTERISTIC DFC_DisblMsk.DFC_IgnClPs_LineOl_0_C "disable mask / Disable masks of check DFC_IgnClPs_LineOl_0" VALUE 0x804F5A12 Val_Wu16 65535.00 DFES_OneToOne 0.00 65535.00 FORMAT "%8.2" /end CHARACTERISTIC
/begin CHARACTERISTIC DFC_DisblMsk.DFC_IgnClPs_LineOl_1_C "disable mask / Disable masks of check DFC_IgnClPs_LineOl_1" VALUE 0x804F5A14 Val_Wu16 65535.00 DFES_OneToOne 0.00 65535.00 FORMAT "%8.2" /end CHARACTERISTIC
/begin CHARACTERISTIC DFC_DisblMsk.DFC_IgnClPs_LineOl_2_C "disable mask / Disable masks of check DFC_IgnClPs_LineOl_2" VALUE 0x804F5A16 Val_Wu16 65535.00 DFES_OneToOne 0.00 65535.00 FORMAT "%8.2" /end CHARACTERISTIC
/begin CHARACTERISTIC DFC_DisblMsk.DFC_IgnClPs_LineOl_3_C "disable mask / Disable masks of check DFC_IgnClPs_LineOl_3" VALUE 0x804F5A18 Val_Wu16 65535.00 DFES_OneToOne 0.00 65535.00 FORMAT "%8.2" /end CHARACTERISTIC
/begin CHARACTERISTIC DFC_DisblMsk.DFC_IgnClPs_LineScb_0_C "disable mask / Disable masks of check DFC_IgnClPs_LineScb_0" VALUE 0x804F5A1A Val_Wu16 65535.00 DFES_OneToOne 0.00 65535.00 FORMAT "%8.2" /end CHARACTERISTIC
/begin CHARACTERISTIC DFC_DisblMsk.DFC_IgnClPs_LineScb_1_C "disable mask / Disable masks of check DFC_IgnClPs_LineScb_1" VALUE 0x804F5A1C Val_Wu16 65535.00 DFES_OneToOne 0.00 65535.00 FORMAT "%8.2" /end CHARACTERISTIC
/begin CHARACTERISTIC DFC_DisblMsk.DFC_IgnClPs_LineScb_2_C "disable mask / Disable masks of check DFC_IgnClPs_LineScb_2" VALUE 0x804F5A1E Val_Wu16 65535.00 DFES_OneToOne 0.00 65535.00 FORMAT "%8.2" /end CHARACTERISTIC
/begin CHARACTERISTIC DFC_DisblMsk.DFC_IgnClPs_LineScb_3_C "disable mask / Disable masks of check DFC_IgnClPs_LineScb_3" VALUE 0x804F5A20 Val_Wu16 65535.00 DFES_OneToOne 0.00 65535.00 FORMAT "%8.2" /end CHARACTERISTIC
/begin CHARACTERISTIC DFC_DisblMsk.DFC_IgnClPs_LineScg_0_C "disable mask / Disable masks of check DFC_IgnClPs_LineScg_0" VALUE 0x804F5A22 Val_Wu16 65535.00 DFES_OneToOne 0.00 65535.00 FORMAT "%8.2" /end CHARACTERISTIC
/begin CHARACTERISTIC DFC_DisblMsk.DFC_IgnClPs_LineScg_1_C "disable mask / Disable masks of check DFC_IgnClPs_LineScg_1" VALUE 0x804F5A24 Val_Wu16 65535.00 DFES_OneToOne 0.00 65535.00 FORMAT "%8.2" /end CHARACTERISTIC
/begin CHARACTERISTIC DFC_DisblMsk.DFC_IgnClPs_LineScg_2_C "disable mask / Disable masks of check DFC_IgnClPs_LineScg_2" VALUE 0x804F5A26 Val_Wu16 65535.00 DFES_OneToOne 0.00 65535.00 FORMAT "%8.2" /end CHARACTERISTIC
/begin CHARACTERISTIC DFC_DisblMsk.DFC_IgnClPs_LineScg_3_C "disable mask / Disable masks of check DFC_IgnClPs_LineScg_3" VALUE 0x804F5A28 Val_Wu16 65535.00 DFES_OneToOne 0.00 65535.00 FORMAT "%8.2" /end CHARACTERISTIC
/begin CHARACTERISTIC DFC_DisblMsk.DFC_KRVEKOEVAB_C "disable mask / Disable masks of check DFC_KRVEKOEVAB" VALUE 0x804F5A2A Val_Wu16 65535.00 DFES_OneToOne 0.00 65535.00 FORMAT "%8.2" /end CHARACTERISTIC
/begin CHARACTERISTIC DFC_DisblMsk.DFC_KRVEKOEVAB0_C "disable mask / Disable masks of check DFC_KRVEKOEVAB0" VALUE 0x804F5A2C Val_Wu16 65535.00 DFES_OneToOne 0.00 65535.00 FORMAT "%8.2" /end CHARACTERISTIC
/begin CHARACTERISTIC DFC_DisblMsk.DFC_KRVEKOEVAB1_C "disable mask / Disable masks of check DFC_KRVEKOEVAB1" VALUE 0x804F5A2E Val_Wu16 65535.00 DFES_OneToOne 0.00 65535.00 FORMAT "%8.2" /end CHARACTERISTIC
/begin CHARACTERISTIC DFC_DisblMsk.DFC_KRVEKOEVAB2_C "disable mask / Disable masks of check DFC_KRVEKOEVAB2" VALUE 0x804F5A30 Val_Wu16 65535.00 DFES_OneToOne 0.00 65535.00 FORMAT "%8.2" /end CHARACTERISTIC
/begin CHARACTERISTIC DFC_DisblMsk.DFC_KRVEKOEVAB3_C "disable mask / Disable masks of check DFC_KRVEKOEVAB3" VALUE 0x804F5A32 Val_Wu16 65535.00 DFES_OneToOne 0.00 65535.00 FORMAT "%8.2" /end CHARACTERISTIC
/begin CHARACTERISTIC DFC_DisblMsk.DFC_UegoSigEcuAsicS1B1_C "disable mask / Disable masks of check DFC_UegoSigEcuAsicS1B1" VALUE 0x804F5A34 Val_Wu16 65535.00 DFES_OneToOne 0.00 65535.00 FORMAT "%8.2" /end CHARACTERISTIC
/begin CHARACTERISTIC DFC_DisblMsk.DFC_UegoSigEcuComS1B1_C "disable mask / Disable masks of check DFC_UegoSigEcuComS1B1" VALUE 0x804F5A36 Val_Wu16 65535.00 DFES_OneToOne 0.00 65535.00 FORMAT "%8.2" /end CHARACTERISTIC
/begin CHARACTERISTIC DFC_DisblMsk.DFC_UegoSigSnsrS1B1_C "disable mask / Disable masks of check DFC_UegoSigSnsrS1B1" VALUE 0x804F5A38 Val_Wu16 65535.00 DFES_OneToOne 0.00 65535.00 FORMAT "%8.2" /end CHARACTERISTIC
/begin CHARACTERISTIC DFC_DisblMsk.DFC_UegoSigWireOlApesS1B1_C "disable mask / Disable masks of check DFC_UegoSigWireOlApesS1B1" VALUE 0x804F5A3A Val_Wu16 65535.00 DFES_OneToOne 0.00 65535.00 FORMAT "%8.2" /end CHARACTERISTIC
/begin CHARACTERISTIC DFC_DisblMsk.DFC_UegoSigWireOlIpeS1B1_C "disable mask / Disable masks of check DFC_UegoSigWireOlIpeS1B1" VALUE 0x804F5A3C Val_Wu16 65535.00 DFES_OneToOne 0.00 65535.00 FORMAT "%8.2" /end CHARACTERISTIC
/begin CHARACTERISTIC DFC_DisblMsk.DFC_UegoSigWireOlReS1B1_C "disable mask / Disable masks of check DFC_UegoSigWireOlReS1B1" VALUE 0x804F5A3E Val_Wu16 65535.00 DFES_OneToOne 0.00 65535.00 FORMAT "%8.2" /end CHARACTERISTIC
/begin CHARACTERISTIC DFC_DisblMsk.DFC_UegoSigWireRCmpS1B1_C "disable mask / Disable masks of check DFC_UegoSigWireRCmpS1B1" VALUE 0x804F5A40 Val_Wu16 65535.00 DFES_OneToOne 0.00 65535.00 FORMAT "%8.2" /end CHARACTERISTIC
/begin CHARACTERISTIC DFC_DisblMsk.DFC_UegoSigWireScbS1B1_C "disable mask / Disable masks of check DFC_UegoSigWireScbS1B1" VALUE 0x804F5A42 Val_Wu16 65535.00 DFES_OneToOne 0.00 65535.00 FORMAT "%8.2" /end CHARACTERISTIC
/begin CHARACTERISTIC DFC_DisblMsk.DFC_UegoSigWireScgS1B1_C "disable mask / Disable masks of check DFC_UegoSigWireScgS1B1" VALUE 0x804F5A44 Val_Wu16 65535.00 DFES_OneToOne 0.00 65535.00 FORMAT "%8.2" /end CHARACTERISTIC
/begin CHARACTERISTIC DFC_DisblMsk.DFC_AfsPhyRngHiB1_C "disable mask / Disable masks of check DFC_AfsPhyRngHiB1" VALUE 0x804F5A46 Val_Wu16 65535.00 DFES_OneToOne 0.00 65535.00 FORMAT "%8.2" /end CHARACTERISTIC
/begin CHARACTERISTIC DFC_DisblMsk.DFC_AfsPhyRngLoB1_C "disable mask / Disable masks of check DFC_AfsPhyRngLoB1" VALUE 0x804F5A48 Val_Wu16 65535.00 DFES_OneToOne 0.00 65535.00 FORMAT "%8.2" /end CHARACTERISTIC
/begin CHARACTERISTIC DFC_DisblMsk.DFC_AirCCmprOL_C "disable mask / Disable masks of check DFC_AirCCmprOL" VALUE 0x804F5A4A Val_Wu16 65535.00 DFES_OneToOne 0.00 65535.00 FORMAT "%8.2" /end CHARACTERISTIC
/begin CHARACTERISTIC DFC_DisblMsk.DFC_AirCCmprOvrTemp_C "disable mask / Disable masks of check DFC_AirCCmprOvrTemp" VALUE 0x804F5A4C Val_Wu16 65535.00 DFES_OneToOne 0.00 65535.00 FORMAT "%8.2" /end CHARACTERISTIC
/begin CHARACTERISTIC DFC_DisblMsk.DFC_AirCCmprSCB_C "disable mask / Disable masks of check DFC_AirCCmprSCB" VALUE 0x804F5A4E Val_Wu16 65535.00 DFES_OneToOne 0.00 65535.00 FORMAT "%8.2" /end CHARACTERISTIC
/begin CHARACTERISTIC DFC_DisblMsk.DFC_AirCCmprSCG_C "disable mask / Disable masks of check DFC_AirCCmprSCG" VALUE 0x804F5A50 Val_Wu16 65535.00 DFES_OneToOne 0.00 65535.00 FORMAT "%8.2" /end CHARACTERISTIC
/begin CHARACTERISTIC DFC_DisblMsk.DFC_AltErr_C "disable mask / Disable masks of check DFC_AltErr" VALUE 0x804F5A52 Val_Wu16 65535.00 DFES_OneToOne 0.00 65535.00 FORMAT "%8.2" /end CHARACTERISTIC
/begin CHARACTERISTIC DFC_DisblMsk.DFC_BattUSRCMax_C "disable mask / Disable masks of check DFC_BattUSRCMax" VALUE 0x804F5A54 Val_Wu16 65535.00 DFES_OneToOne 0.00 65535.00 FORMAT "%8.2" /end CHARACTERISTIC
/begin CHARACTERISTIC DFC_DisblMsk.DFC_BattUSRCMin_C "disable mask / Disable masks of check DFC_BattUSRCMin" VALUE 0x804F5A56 Val_Wu16 65535.00 DFES_OneToOne 0.00 65535.00 FORMAT "%8.2" /end CHARACTERISTIC
/begin CHARACTERISTIC DFC_DisblMsk.DFC_ComChksTCU1_C "disable mask / Disable masks of check DFC_ComChksTCU1" VALUE 0x804F5A58 Val_Wu16 65535.00 DFES_OneToOne 0.00 65535.00 FORMAT "%8.2" /end CHARACTERISTIC
/begin CHARACTERISTIC DFC_DisblMsk.DFC_ComChksTCU11_C "disable mask / Disable masks of check DFC_ComChksTCU11" VALUE 0x804F5A5A Val_Wu16 65535.00 DFES_OneToOne 0.00 65535.00 FORMAT "%8.2" /end CHARACTERISTIC
/begin CHARACTERISTIC DFC_DisblMsk.DFC_ComChksTCU12_C "disable mask / Disable masks of check DFC_ComChksTCU12" VALUE 0x804F5A5C Val_Wu16 65535.00 DFES_OneToOne 0.00 65535.00 FORMAT "%8.2" /end CHARACTERISTIC
/begin CHARACTERISTIC DFC_DisblMsk.DFC_ComChksTCU13_C "disable mask / Disable masks of check DFC_ComChksTCU13" VALUE 0x804F5A5E Val_Wu16 65535.00 DFES_OneToOne 0.00 65535.00 FORMAT "%8.2" /end CHARACTERISTIC
/begin CHARACTERISTIC DFC_DisblMsk.DFC_ComChksTCU2_C "disable mask / Disable masks of check DFC_ComChksTCU2" VALUE 0x804F5A60 Val_Wu16 65535.00 DFES_OneToOne 0.00 65535.00 FORMAT "%8.2" /end CHARACTERISTIC
/begin CHARACTERISTIC DFC_DisblMsk.DFC_ComChksTCU3_C "disable mask / Disable masks of check DFC_ComChksTCU3" VALUE 0x804F5A62 Val_Wu16 65535.00 DFES_OneToOne 0.00 65535.00 FORMAT "%8.2" /end CHARACTERISTIC
/begin CHARACTERISTIC DFC_DisblMsk.DFC_ComChksTCU4_C "disable mask / Disable masks of check DFC_ComChksTCU4" VALUE 0x804F5A64 Val_Wu16 65535.00 DFES_OneToOne 0.00 65535.00 FORMAT "%8.2" /end CHARACTERISTIC
/begin CHARACTERISTIC DFC_DisblMsk.DFC_ComCntTCU1_C "disable mask / Disable masks of check DFC_ComCntTCU1" VALUE 0x804F5A66 Val_Wu16 65535.00 DFES_OneToOne 0.00 65535.00 FORMAT "%8.2" /end CHARACTERISTIC
/begin CHARACTERISTIC DFC_DisblMsk.DFC_ComCntTCU11_C "disable mask / Disable masks of check DFC_ComCntTCU11" VALUE 0x804F5A68 Val_Wu16 65535.00 DFES_OneToOne 0.00 65535.00 FORMAT "%8.2" /end CHARACTERISTIC
/begin CHARACTERISTIC DFC_DisblMsk.DFC_ComCntTCU12_C "disable mask / Disable masks of check DFC_ComCntTCU12" VALUE 0x804F5A6A Val_Wu16 65535.00 DFES_OneToOne 0.00 65535.00 FORMAT "%8.2" /end CHARACTERISTIC
/begin CHARACTERISTIC DFC_DisblMsk.DFC_ComCntTCU13_C "disable mask / Disable masks of check DFC_ComCntTCU13" VALUE 0x804F5A6C Val_Wu16 65535.00 DFES_OneToOne 0.00 65535.00 FORMAT "%8.2" /end CHARACTERISTIC
/begin CHARACTERISTIC DFC_DisblMsk.DFC_ComCntTCU2_C "disable mask / Disable masks of check DFC_ComCntTCU2" VALUE 0x804F5A6E Val_Wu16 65535.00 DFES_OneToOne 0.00 65535.00 FORMAT "%8.2" /end CHARACTERISTIC
/begin CHARACTERISTIC DFC_DisblMsk.DFC_ComCntTCU3_C "disable mask / Disable masks of check DFC_ComCntTCU3" VALUE 0x804F5A70 Val_Wu16 65535.00 DFES_OneToOne 0.00 65535.00 FORMAT "%8.2" /end CHARACTERISTIC
/begin CHARACTERISTIC DFC_DisblMsk.DFC_ComCntTCU4_C "disable mask / Disable masks of check DFC_ComCntTCU4" VALUE 0x804F5A72 Val_Wu16 65535.00 DFES_OneToOne 0.00 65535.00 FORMAT "%8.2" /end CHARACTERISTIC
/begin CHARACTERISTIC DFC_DisblMsk.DFC_ComTOutTCU01_C "disable mask / Disable masks of check DFC_ComTOutTCU01" VALUE 0x804F5A74 Val_Wu16 65535.00 DFES_OneToOne 0.00 65535.00 FORMAT "%8.2" /end CHARACTERISTIC
/begin CHARACTERISTIC DFC_DisblMsk.DFC_ComTOutTCU02_C "disable mask / Disable masks of check DFC_ComTOutTCU02" VALUE 0x804F5A76 Val_Wu16 65535.00 DFES_OneToOne 0.00 65535.00 FORMAT "%8.2" /end CHARACTERISTIC
/begin CHARACTERISTIC DFC_DisblMsk.DFC_ComTOutTCU1_C "disable mask / Disable masks of check DFC_ComTOutTCU1" VALUE 0x804F5A78 Val_Wu16 65535.00 DFES_OneToOne 0.00 65535.00 FORMAT "%8.2" /end CHARACTERISTIC
/begin CHARACTERISTIC DFC_DisblMsk.DFC_ComTOutTCU11_C "disable mask / Disable masks of check DFC_ComTOutTCU11" VALUE 0x804F5A7A Val_Wu16 65535.00 DFES_OneToOne 0.00 65535.00 FORMAT "%8.2" /end CHARACTERISTIC
/begin CHARACTERISTIC DFC_DisblMsk.DFC_ComTOutTCU12_C "disable mask / Disable masks of check DFC_ComTOutTCU12" VALUE 0x804F5A7C Val_Wu16 65535.00 DFES_OneToOne 0.00 65535.00 FORMAT "%8.2" /end CHARACTERISTIC
/begin CHARACTERISTIC DFC_DisblMsk.DFC_ComTOutTCU13_C "disable mask / Disable masks of check DFC_ComTOutTCU13" VALUE 0x804F5A7E Val_Wu16 65535.00 DFES_OneToOne 0.00 65535.00 FORMAT "%8.2" /end CHARACTERISTIC
/begin CHARACTERISTIC DFC_DisblMsk.DFC_ComTOutTCU14_C "disable mask / Disable masks of check DFC_ComTOutTCU14" VALUE 0x804F5A80 Val_Wu16 65535.00 DFES_OneToOne 0.00 65535.00 FORMAT "%8.2" /end CHARACTERISTIC
/begin CHARACTERISTIC DFC_DisblMsk.DFC_ComTOutTCU2_C "disable mask / Disable masks of check DFC_ComTOutTCU2" VALUE 0x804F5A82 Val_Wu16 65535.00 DFES_OneToOne 0.00 65535.00 FORMAT "%8.2" /end CHARACTERISTIC
/begin CHARACTERISTIC DFC_DisblMsk.DFC_ComTOutTCU3_C "disable mask / Disable masks of check DFC_ComTOutTCU3" VALUE 0x804F5A84 Val_Wu16 65535.00 DFES_OneToOne 0.00 65535.00 FORMAT "%8.2" /end CHARACTERISTIC
/begin CHARACTERISTIC DFC_DisblMsk.DFC_ComTOutTCU4_C "disable mask / Disable masks of check DFC_ComTOutTCU4" VALUE 0x804F5A86 Val_Wu16 65535.00 DFES_OneToOne 0.00 65535.00 FORMAT "%8.2" /end CHARACTERISTIC
/begin CHARACTERISTIC DFC_DisblMsk.DFC_DevLibBattUHi_C "disable mask / Disable masks of check DFC_DevLibBattUHi" VALUE 0x804F5A88 Val_Wu16 65535.00 DFES_OneToOne 0.00 65535.00 FORMAT "%8.2" /end CHARACTERISTIC
/begin CHARACTERISTIC DFC_DisblMsk.DFC_DevLibBattULo_C "disable mask / Disable masks of check DFC_DevLibBattULo" VALUE 0x804F5A8A Val_Wu16 65535.00 DFES_OneToOne 0.00 65535.00 FORMAT "%8.2" /end CHARACTERISTIC
/begin CHARACTERISTIC DFC_DisblMsk.DFC_EGRVlvFailSafeActv_C "disable mask / Disable masks of check DFC_EGRVlvFailSafeActv" VALUE 0x804F5A8C Val_Wu16 65535.00 DFES_OneToOne 0.00 65535.00 FORMAT "%8.2" /end CHARACTERISTIC
/begin CHARACTERISTIC DFC_DisblMsk.DFC_EGRVlvGovDvtCld_C "disable mask / Disable masks of check DFC_EGRVlvGovDvtCld" VALUE 0x804F5A8E Val_Wu16 65535.00 DFES_OneToOne 0.00 65535.00 FORMAT "%8.2" /end CHARACTERISTIC
/begin CHARACTERISTIC DFC_DisblMsk.DFC_EGRVlvPhysSRCMax_C "disable mask / Disable masks of check DFC_EGRVlvPhysSRCMax" VALUE 0x804F5A90 Val_Wu16 65535.00 DFES_OneToOne 0.00 65535.00 FORMAT "%8.2" /end CHARACTERISTIC
/begin CHARACTERISTIC DFC_DisblMsk.DFC_EGRVlvPhysSRCMin_C "disable mask / Disable masks of check DFC_EGRVlvPhysSRCMin" VALUE 0x804F5A92 Val_Wu16 65535.00 DFES_OneToOne 0.00 65535.00 FORMAT "%8.2" /end CHARACTERISTIC
/begin CHARACTERISTIC DFC_DisblMsk.DFC_FanDIOOL_0_C "disable mask / Disable masks of check DFC_FanDIOOL_0" VALUE 0x804F5A94 Val_Wu16 65535.00 DFES_OneToOne 0.00 65535.00 FORMAT "%8.2" /end CHARACTERISTIC
/begin CHARACTERISTIC DFC_DisblMsk.DFC_FanDIOOL_1_C "disable mask / Disable masks of check DFC_FanDIOOL_1" VALUE 0x804F5A96 Val_Wu16 65535.00 DFES_OneToOne 0.00 65535.00 FORMAT "%8.2" /end CHARACTERISTIC
/begin CHARACTERISTIC DFC_DisblMsk.DFC_FanDIOOvrTemp_0_C "disable mask / Disable masks of check DFC_FanDIOOvrTemp_0" VALUE 0x804F5A98 Val_Wu16 65535.00 DFES_OneToOne 0.00 65535.00 FORMAT "%8.2" /end CHARACTERISTIC
/begin CHARACTERISTIC DFC_DisblMsk.DFC_FanDIOOvrTemp_1_C "disable mask / Disable masks of check DFC_FanDIOOvrTemp_1" VALUE 0x804F5A9A Val_Wu16 65535.00 DFES_OneToOne 0.00 65535.00 FORMAT "%8.2" /end CHARACTERISTIC
/begin CHARACTERISTIC DFC_DisblMsk.DFC_FanDIOSCB_0_C "disable mask / Disable masks of check DFC_FanDIOSCB_0" VALUE 0x804F5A9C Val_Wu16 65535.00 DFES_OneToOne 0.00 65535.00 FORMAT "%8.2" /end CHARACTERISTIC
/begin CHARACTERISTIC DFC_DisblMsk.DFC_FanDIOSCB_1_C "disable mask / Disable masks of check DFC_FanDIOSCB_1" VALUE 0x804F5A9E Val_Wu16 65535.00 DFES_OneToOne 0.00 65535.00 FORMAT "%8.2" /end CHARACTERISTIC
/begin CHARACTERISTIC DFC_DisblMsk.DFC_FanDIOSCG_0_C "disable mask / Disable masks of check DFC_FanDIOSCG_0" VALUE 0x804F5AA0 Val_Wu16 65535.00 DFES_OneToOne 0.00 65535.00 FORMAT "%8.2" /end CHARACTERISTIC
/begin CHARACTERISTIC DFC_DisblMsk.DFC_FanDIOSCG_1_C "disable mask / Disable masks of check DFC_FanDIOSCG_1" VALUE 0x804F5AA2 Val_Wu16 65535.00 DFES_OneToOne 0.00 65535.00 FORMAT "%8.2" /end CHARACTERISTIC
/begin CHARACTERISTIC DFC_DisblMsk.DFC_MRlyDcOL_C "disable mask / Disable masks of check DFC_MRlyDcOL" VALUE 0x804F5AA4 Val_Wu16 65535.00 DFES_OneToOne 0.00 65535.00 FORMAT "%8.2" /end CHARACTERISTIC
/begin CHARACTERISTIC DFC_DisblMsk.DFC_MRlyDcSCB_C "disable mask / Disable masks of check DFC_MRlyDcSCB" VALUE 0x804F5AA6 Val_Wu16 65535.00 DFES_OneToOne 0.00 65535.00 FORMAT "%8.2" /end CHARACTERISTIC
/begin CHARACTERISTIC DFC_DisblMsk.DFC_MRlyDcSCG_C "disable mask / Disable masks of check DFC_MRlyDcSCG" VALUE 0x804F5AA8 Val_Wu16 65535.00 DFES_OneToOne 0.00 65535.00 FORMAT "%8.2" /end CHARACTERISTIC
/begin CHARACTERISTIC DFC_DisblMsk.DFC_PSPOL_C "disable mask / Disable masks of check DFC_PSPOL" VALUE 0x804F5AAA Val_Wu16 65535.00 DFES_OneToOne 0.00 65535.00 FORMAT "%8.2" /end CHARACTERISTIC
/begin CHARACTERISTIC DFC_DisblMsk.DFC_PSPOvrTemp_C "disable mask / Disable masks of check DFC_PSPOvrTemp" VALUE 0x804F5AAC Val_Wu16 65535.00 DFES_OneToOne 0.00 65535.00 FORMAT "%8.2" /end CHARACTERISTIC
/begin CHARACTERISTIC DFC_DisblMsk.DFC_PSPSCB_C "disable mask / Disable masks of check DFC_PSPSCB" VALUE 0x804F5AAE Val_Wu16 65535.00 DFES_OneToOne 0.00 65535.00 FORMAT "%8.2" /end CHARACTERISTIC
/begin CHARACTERISTIC DFC_DisblMsk.DFC_PSPSCG_C "disable mask / Disable masks of check DFC_PSPSCG" VALUE 0x804F5AB0 Val_Wu16 65535.00 DFES_OneToOne 0.00 65535.00 FORMAT "%8.2" /end CHARACTERISTIC
/begin CHARACTERISTIC DFC_DisblMsk.DFC_T50Err_C "disable mask / Disable masks of check DFC_T50Err" VALUE 0x804F5AB2 Val_Wu16 65535.00 DFES_OneToOne 0.00 65535.00 FORMAT "%8.2" /end CHARACTERISTIC
/begin CHARACTERISTIC DFC_DisblMsk.DFC_ThrVlvLoBattB1_C "disable mask / Disable masks of check DFC_ThrVlvLoBattB1" VALUE 0x804F5AB4 Val_Wu16 65535.00 DFES_OneToOne 0.00 65535.00 FORMAT "%8.2" /end CHARACTERISTIC
/begin CHARACTERISTIC DFC_DisblMsk.DFC_UegoSigOperPlausS1B1_C "disable mask / Disable masks of check DFC_UegoSigOperPlausS1B1" VALUE 0x804F5AB6 Val_Wu16 65535.00 DFES_OneToOne 0.00 65535.00 FORMAT "%8.2" /end CHARACTERISTIC
/begin CHARACTERISTIC DFC_DisblMsk.DFC_VehVPhysRngHi_C "disable mask / Disable masks of check DFC_VehVPhysRngHi" VALUE 0x804F5AB8 Val_Wu16 65535.00 DFES_OneToOne 0.00 65535.00 FORMAT "%8.2" /end CHARACTERISTIC
/begin CHARACTERISTIC DFC_DisblMsk.DFC_VehVSclOutOL_C "disable mask / Disable masks of check DFC_VehVSclOutOL" VALUE 0x804F5ABA Val_Wu16 65535.00 DFES_OneToOne 0.00 65535.00 FORMAT "%8.2" /end CHARACTERISTIC
/begin CHARACTERISTIC DFC_DisblMsk.DFC_VehVSclOutOT_C "disable mask / Disable masks of check DFC_VehVSclOutOT" VALUE 0x804F5ABC Val_Wu16 65535.00 DFES_OneToOne 0.00 65535.00 FORMAT "%8.2" /end CHARACTERISTIC
/begin CHARACTERISTIC DFC_DisblMsk.DFC_VehVSclOutSCB_C "disable mask / Disable masks of check DFC_VehVSclOutSCB" VALUE 0x804F5ABE Val_Wu16 65535.00 DFES_OneToOne 0.00 65535.00 FORMAT "%8.2" /end CHARACTERISTIC
/begin CHARACTERISTIC DFC_DisblMsk.DFC_VehVSclOutSCG_C "disable mask / Disable masks of check DFC_VehVSclOutSCG" VALUE 0x804F5AC0 Val_Wu16 65535.00 DFES_OneToOne 0.00 65535.00 FORMAT "%8.2" /end CHARACTERISTIC
/begin CHARACTERISTIC DFC_DisblMsk.DFC_VehVSigFL_C "disable mask / Disable masks of check DFC_VehVSigFL" VALUE 0x804F5AC2 Val_Wu16 65535.00 DFES_OneToOne 0.00 65535.00 FORMAT "%8.2" /end CHARACTERISTIC
/begin CHARACTERISTIC DFC_DisblMsk.DFC_VehVSigFR_C "disable mask / Disable masks of check DFC_VehVSigFR" VALUE 0x804F5AC4 Val_Wu16 65535.00 DFES_OneToOne 0.00 65535.00 FORMAT "%8.2" /end CHARACTERISTIC
/begin CHARACTERISTIC DFC_DisblMsk.DFC_VehVSigRL_C "disable mask / Disable masks of check DFC_VehVSigRL" VALUE 0x804F5AC6 Val_Wu16 65535.00 DFES_OneToOne 0.00 65535.00 FORMAT "%8.2" /end CHARACTERISTIC
/begin CHARACTERISTIC DFC_DisblMsk.DFC_VehVSigRR_C "disable mask / Disable masks of check DFC_VehVSigRR" VALUE 0x804F5AC8 Val_Wu16 65535.00 DFES_OneToOne 0.00 65535.00 FORMAT "%8.2" /end CHARACTERISTIC
/begin CHARACTERISTIC DFC_DisblMsk.DFC_VehVSnsrARngHi_C "disable mask / Disable masks of check DFC_VehVSnsrARngHi" VALUE 0x804F5ACA Val_Wu16 65535.00 DFES_OneToOne 0.00 65535.00 FORMAT "%8.2" /end CHARACTERISTIC
/begin CHARACTERISTIC DFC_DisblMsk.DFC_VehVSnsrBRngHi_C "disable mask / Disable masks of check DFC_VehVSnsrBRngHi" VALUE 0x804F5ACC Val_Wu16 65535.00 DFES_OneToOne 0.00 65535.00 FORMAT "%8.2" /end CHARACTERISTIC
/begin CHARACTERISTIC DFC_DisblMsk.DFC_VehVSpdRtyDiag_C "disable mask / Disable masks of check DFC_VehVSpdRtyDiag" VALUE 0x804F5ACE Val_Wu16 65535.00 DFES_OneToOne 0.00 65535.00 FORMAT "%8.2" /end CHARACTERISTIC
/begin CHARACTERISTIC DFC_DisblMsk.DFC_DHFHD_C "disable mask / Disable masks of check DFC_DHFHD" VALUE 0x804F5AD0 Val_Wu16 65535.00 DFES_OneToOne 0.00 65535.00 FORMAT "%8.2" /end CHARACTERISTIC
/begin CHARACTERISTIC DFC_DisblMsk.DFC_InjVlv_DI_DcDc_C "disable mask / Disable masks of check DFC_InjVlv_DI_DcDc" VALUE 0x804F5AD2 Val_Wu16 65535.00 DFES_OneToOne 0.00 65535.00 FORMAT "%8.2" /end CHARACTERISTIC
/begin CHARACTERISTIC DFC_DisblMsk.DFC_InjVlv_DI_NoLd_0_C "disable mask / Disable masks of check DFC_InjVlv_DI_NoLd_0" VALUE 0x804F5AD4 Val_Wu16 65535.00 DFES_OneToOne 0.00 65535.00 FORMAT "%8.2" /end CHARACTERISTIC
/begin CHARACTERISTIC DFC_DisblMsk.DFC_InjVlv_DI_NoLd_1_C "disable mask / Disable masks of check DFC_InjVlv_DI_NoLd_1" VALUE 0x804F5AD6 Val_Wu16 65535.00 DFES_OneToOne 0.00 65535.00 FORMAT "%8.2" /end CHARACTERISTIC
/begin CHARACTERISTIC DFC_DisblMsk.DFC_InjVlv_DI_NoLd_2_C "disable mask / Disable masks of check DFC_InjVlv_DI_NoLd_2" VALUE 0x804F5AD8 Val_Wu16 65535.00 DFES_OneToOne 0.00 65535.00 FORMAT "%8.2" /end CHARACTERISTIC
/begin CHARACTERISTIC DFC_DisblMsk.DFC_InjVlv_DI_NoLd_3_C "disable mask / Disable masks of check DFC_InjVlv_DI_NoLd_3" VALUE 0x804F5ADA Val_Wu16 65535.00 DFES_OneToOne 0.00 65535.00 FORMAT "%8.2" /end CHARACTERISTIC
/begin CHARACTERISTIC DFC_DisblMsk.DFC_InjVlv_DI_ScBnk_0_C "disable mask / Disable masks of check DFC_InjVlv_DI_ScBnk_0" VALUE 0x804F5ADC Val_Wu16 65535.00 DFES_OneToOne 0.00 65535.00 FORMAT "%8.2" /end CHARACTERISTIC
/begin CHARACTERISTIC DFC_DisblMsk.DFC_InjVlv_DI_ScBnk_1_C "disable mask / Disable masks of check DFC_InjVlv_DI_ScBnk_1" VALUE 0x804F5ADE Val_Wu16 65535.00 DFES_OneToOne 0.00 65535.00 FORMAT "%8.2" /end CHARACTERISTIC
/begin CHARACTERISTIC DFC_DisblMsk.DFC_InjVlv_DI_ScBnk_2_C "disable mask / Disable masks of check DFC_InjVlv_DI_ScBnk_2" VALUE 0x804F5AE0 Val_Wu16 65535.00 DFES_OneToOne 0.00 65535.00 FORMAT "%8.2" /end CHARACTERISTIC
/begin CHARACTERISTIC DFC_DisblMsk.DFC_InjVlv_DI_ScBnk_3_C "disable mask / Disable masks of check DFC_InjVlv_DI_ScBnk_3" VALUE 0x804F5AE2 Val_Wu16 65535.00 DFES_OneToOne 0.00 65535.00 FORMAT "%8.2" /end CHARACTERISTIC
/begin CHARACTERISTIC DFC_DisblMsk.DFC_InjVlv_DI_ScCyl_0_C "disable mask / Disable masks of check DFC_InjVlv_DI_ScCyl_0" VALUE 0x804F5AE4 Val_Wu16 65535.00 DFES_OneToOne 0.00 65535.00 FORMAT "%8.2" /end CHARACTERISTIC
/begin CHARACTERISTIC DFC_DisblMsk.DFC_InjVlv_DI_ScCyl_1_C "disable mask / Disable masks of check DFC_InjVlv_DI_ScCyl_1" VALUE 0x804F5AE6 Val_Wu16 65535.00 DFES_OneToOne 0.00 65535.00 FORMAT "%8.2" /end CHARACTERISTIC
/begin CHARACTERISTIC DFC_DisblMsk.DFC_InjVlv_DI_ScCyl_2_C "disable mask / Disable masks of check DFC_InjVlv_DI_ScCyl_2" VALUE 0x804F5AE8 Val_Wu16 65535.00 DFES_OneToOne 0.00 65535.00 FORMAT "%8.2" /end CHARACTERISTIC
/begin CHARACTERISTIC DFC_DisblMsk.DFC_InjVlv_DI_ScCyl_3_C "disable mask / Disable masks of check DFC_InjVlv_DI_ScCyl_3" VALUE 0x804F5AEA Val_Wu16 65535.00 DFES_OneToOne 0.00 65535.00 FORMAT "%8.2" /end CHARACTERISTIC
/begin CHARACTERISTIC DFC_DisblMsk.DFC_InjVlv_DI_ScHsLs_0_C "disable mask / Disable masks of check DFC_InjVlv_DI_ScHsLs_0" VALUE 0x804F5AEC Val_Wu16 65535.00 DFES_OneToOne 0.00 65535.00 FORMAT "%8.2" /end CHARACTERISTIC
/begin CHARACTERISTIC DFC_DisblMsk.DFC_InjVlv_DI_ScHsLs_1_C "disable mask / Disable masks of check DFC_InjVlv_DI_ScHsLs_1" VALUE 0x804F5AEE Val_Wu16 65535.00 DFES_OneToOne 0.00 65535.00 FORMAT "%8.2" /end CHARACTERISTIC
/begin CHARACTERISTIC DFC_DisblMsk.DFC_InjVlv_DI_ScHsLs_2_C "disable mask / Disable masks of check DFC_InjVlv_DI_ScHsLs_2" VALUE 0x804F5AF0 Val_Wu16 65535.00 DFES_OneToOne 0.00 65535.00 FORMAT "%8.2" /end CHARACTERISTIC
/begin CHARACTERISTIC DFC_DisblMsk.DFC_InjVlv_DI_ScHsLs_3_C "disable mask / Disable masks of check DFC_InjVlv_DI_ScHsLs_3" VALUE 0x804F5AF2 Val_Wu16 65535.00 DFES_OneToOne 0.00 65535.00 FORMAT "%8.2" /end CHARACTERISTIC
/begin CHARACTERISTIC DFC_DisblMsk.DFC_MfPsDiaOpenLoad1_C "disable mask / Disable masks of check DFC_MfPsDiaOpenLoad1" VALUE 0x804F5AF4 Val_Wu16 65535.00 DFES_OneToOne 0.00 65535.00 FORMAT "%8.2" /end CHARACTERISTIC
/begin CHARACTERISTIC DFC_DisblMsk.DFC_MfPsDiaScHiS1_C "disable mask / Disable masks of check DFC_MfPsDiaScHiS1" VALUE 0x804F5AF6 Val_Wu16 65535.00 DFES_OneToOne 0.00 65535.00 FORMAT "%8.2" /end CHARACTERISTIC
/begin CHARACTERISTIC DFC_DisblMsk.DFC_MfPsDiaScHiSLowS1_C "disable mask / Disable masks of check DFC_MfPsDiaScHiSLowS1" VALUE 0x804F5AF8 Val_Wu16 65535.00 DFES_OneToOne 0.00 65535.00 FORMAT "%8.2" /end CHARACTERISTIC
/begin CHARACTERISTIC DFC_DisblMsk.DFC_MfPsDiaScLowS1_C "disable mask / Disable masks of check DFC_MfPsDiaScLowS1" VALUE 0x804F5AFA Val_Wu16 65535.00 DFES_OneToOne 0.00 65535.00 FORMAT "%8.2" /end CHARACTERISTIC
/begin CHARACTERISTIC DFC_DisblMsk.DFC_ACEvpTPhysRngHi_C "disable mask / Disable masks of check DFC_ACEvpTPhysRngHi" VALUE 0x804F5AFC Val_Wu16 65535.00 DFES_OneToOne 0.00 65535.00 FORMAT "%8.2" /end CHARACTERISTIC
/begin CHARACTERISTIC DFC_DisblMsk.DFC_ACEvpTPhysRngLo_C "disable mask / Disable masks of check DFC_ACEvpTPhysRngLo" VALUE 0x804F5AFE Val_Wu16 65535.00 DFES_OneToOne 0.00 65535.00 FORMAT "%8.2" /end CHARACTERISTIC
/begin CHARACTERISTIC DFC_DisblMsk.DFC_ACEvpTSRCMax_C "disable mask / Disable masks of check DFC_ACEvpTSRCMax" VALUE 0x804F5B00 Val_Wu16 65535.00 DFES_OneToOne 0.00 65535.00 FORMAT "%8.2" /end CHARACTERISTIC
/begin CHARACTERISTIC DFC_DisblMsk.DFC_ACEvpTSRCMin_C "disable mask / Disable masks of check DFC_ACEvpTSRCMin" VALUE 0x804F5B02 Val_Wu16 65535.00 DFES_OneToOne 0.00 65535.00 FORMAT "%8.2" /end CHARACTERISTIC
/begin CHARACTERISTIC DFC_DisblMsk.DFC_AfsRawSigRngHiB1_C "disable mask / Disable masks of check DFC_AfsRawSigRngHiB1" VALUE 0x804F5B04 Val_Wu16 65535.00 DFES_OneToOne 0.00 65535.00 FORMAT "%8.2" /end CHARACTERISTIC
/begin CHARACTERISTIC DFC_DisblMsk.DFC_AfsRawSigRngLoB1_C "disable mask / Disable masks of check DFC_AfsRawSigRngLoB1" VALUE 0x804F5B06 Val_Wu16 65535.00 DFES_OneToOne 0.00 65535.00 FORMAT "%8.2" /end CHARACTERISTIC
/begin CHARACTERISTIC DFC_DisblMsk.DFC_AfsSnsrErrB1_C "disable mask / Disable masks of check DFC_AfsSnsrErrB1" VALUE 0x804F5B08 Val_Wu16 65535.00 DFES_OneToOne 0.00 65535.00 FORMAT "%8.2" /end CHARACTERISTIC
/begin CHARACTERISTIC DFC_DisblMsk.DFC_AirCClntPAnaSRCMax_C "disable mask / Disable masks of check DFC_AirCClntPAnaSRCMax" VALUE 0x804F5B0A Val_Wu16 65535.00 DFES_OneToOne 0.00 65535.00 FORMAT "%8.2" /end CHARACTERISTIC
/begin CHARACTERISTIC DFC_DisblMsk.DFC_AirCClntPAnaSRCMin_C "disable mask / Disable masks of check DFC_AirCClntPAnaSRCMin" VALUE 0x804F5B0C Val_Wu16 65535.00 DFES_OneToOne 0.00 65535.00 FORMAT "%8.2" /end CHARACTERISTIC
/begin CHARACTERISTIC DFC_DisblMsk.DFC_AirCSwtNpl_C "disable mask / Disable masks of check DFC_AirCSwtNpl" VALUE 0x804F5B0E Val_Wu16 65535.00 DFES_OneToOne 0.00 65535.00 FORMAT "%8.2" /end CHARACTERISTIC
/begin CHARACTERISTIC DFC_DisblMsk.DFC_AirCSwtSig_C "disable mask / Disable masks of check DFC_AirCSwtSig" VALUE 0x804F5B10 Val_Wu16 65535.00 DFES_OneToOne 0.00 65535.00 FORMAT "%8.2" /end CHARACTERISTIC
/begin CHARACTERISTIC DFC_DisblMsk.DFC_Brk_C "disable mask / Disable masks of check DFC_Brk" VALUE 0x804F5B12 Val_Wu16 65535.00 DFES_OneToOne 0.00 65535.00 FORMAT "%8.2" /end CHARACTERISTIC
/begin CHARACTERISTIC DFC_DisblMsk.DFC_BrkBstSensSCB_C "disable mask / Disable masks of check DFC_BrkBstSensSCB" VALUE 0x804F5B14 Val_Wu16 65535.00 DFES_OneToOne 0.00 65535.00 FORMAT "%8.2" /end CHARACTERISTIC
/begin CHARACTERISTIC DFC_DisblMsk.DFC_BrkBstSensSCG_C "disable mask / Disable masks of check DFC_BrkBstSensSCG" VALUE 0x804F5B16 Val_Wu16 65535.00 DFES_OneToOne 0.00 65535.00 FORMAT "%8.2" /end CHARACTERISTIC
/begin CHARACTERISTIC DFC_DisblMsk.DFC_BrkSig_C "disable mask / Disable masks of check DFC_BrkSig" VALUE 0x804F5B18 Val_Wu16 65535.00 DFES_OneToOne 0.00 65535.00 FORMAT "%8.2" /end CHARACTERISTIC
/begin CHARACTERISTIC DFC_DisblMsk.DFC_ClthSig_C "disable mask / Disable masks of check DFC_ClthSig" VALUE 0x804F5B1A Val_Wu16 65535.00 DFES_OneToOne 0.00 65535.00 FORMAT "%8.2" /end CHARACTERISTIC
/begin CHARACTERISTIC DFC_DisblMsk.DFC_EGRVlvCurrLim_C "disable mask / Disable masks of check DFC_EGRVlvCurrLim" VALUE 0x804F5B1C Val_Wu16 65535.00 DFES_OneToOne 0.00 65535.00 FORMAT "%8.2" /end CHARACTERISTIC
/begin CHARACTERISTIC DFC_DisblMsk.DFC_EGRVlvOL_C "disable mask / Disable masks of check DFC_EGRVlvOL" VALUE 0x804F5B1E Val_Wu16 65535.00 DFES_OneToOne 0.00 65535.00 FORMAT "%8.2" /end CHARACTERISTIC
/begin CHARACTERISTIC DFC_DisblMsk.DFC_EGRVlvOvrTemp_C "disable mask / Disable masks of check DFC_EGRVlvOvrTemp" VALUE 0x804F5B20 Val_Wu16 65535.00 DFES_OneToOne 0.00 65535.00 FORMAT "%8.2" /end CHARACTERISTIC
/begin CHARACTERISTIC DFC_DisblMsk.DFC_EGRVlvSCB_C "disable mask / Disable masks of check DFC_EGRVlvSCB" VALUE 0x804F5B22 Val_Wu16 65535.00 DFES_OneToOne 0.00 65535.00 FORMAT "%8.2" /end CHARACTERISTIC
/begin CHARACTERISTIC DFC_DisblMsk.DFC_EGRVlvSCG_C "disable mask / Disable masks of check DFC_EGRVlvSCG" VALUE 0x804F5B24 Val_Wu16 65535.00 DFES_OneToOne 0.00 65535.00 FORMAT "%8.2" /end CHARACTERISTIC
/begin CHARACTERISTIC DFC_DisblMsk.DFC_EGRVlvSRCMax_C "disable mask / Disable masks of check DFC_EGRVlvSRCMax" VALUE 0x804F5B26 Val_Wu16 65535.00 DFES_OneToOne 0.00 65535.00 FORMAT "%8.2" /end CHARACTERISTIC
/begin CHARACTERISTIC DFC_DisblMsk.DFC_EGRVlvSRCMin_C "disable mask / Disable masks of check DFC_EGRVlvSRCMin" VALUE 0x804F5B28 Val_Wu16 65535.00 DFES_OneToOne 0.00 65535.00 FORMAT "%8.2" /end CHARACTERISTIC
/begin CHARACTERISTIC DFC_DisblMsk.DFC_HLSDemOvhtEngLim_C "disable mask / Disable masks of check DFC_HLSDemOvhtEngLim" VALUE 0x804F5B2A Val_Wu16 65535.00 DFES_OneToOne 0.00 65535.00 FORMAT "%8.2" /end CHARACTERISTIC
/begin CHARACTERISTIC DFC_DisblMsk.DFC_OilPSwmpSRCMax_C "disable mask / Disable masks of check DFC_OilPSwmpSRCMax" VALUE 0x804F5B2C Val_Wu16 65535.00 DFES_OneToOne 0.00 65535.00 FORMAT "%8.2" /end CHARACTERISTIC
/begin CHARACTERISTIC DFC_DisblMsk.DFC_OilPSwmpSRCMin_C "disable mask / Disable masks of check DFC_OilPSwmpSRCMin" VALUE 0x804F5B2E Val_Wu16 65535.00 DFES_OneToOne 0.00 65535.00 FORMAT "%8.2" /end CHARACTERISTIC
/begin CHARACTERISTIC DFC_DisblMsk.DFC_PIntkVUsLineHiB1_C "disable mask / Disable masks of check DFC_PIntkVUsLineHiB1" VALUE 0x804F5B30 Val_Wu16 65535.00 DFES_OneToOne 0.00 65535.00 FORMAT "%8.2" /end CHARACTERISTIC
/begin CHARACTERISTIC DFC_DisblMsk.DFC_PIntkVUsLineLoB1_C "disable mask / Disable masks of check DFC_PIntkVUsLineLoB1" VALUE 0x804F5B32 Val_Wu16 65535.00 DFES_OneToOne 0.00 65535.00 FORMAT "%8.2" /end CHARACTERISTIC
/begin CHARACTERISTIC DFC_DisblMsk.DFC_VehVPhysRngLo_C "disable mask / Disable masks of check DFC_VehVPhysRngLo" VALUE 0x804F5B34 Val_Wu16 65535.00 DFES_OneToOne 0.00 65535.00 FORMAT "%8.2" /end CHARACTERISTIC
/begin CHARACTERISTIC DFC_DisblMsk.DFC_VehVSigCan_C "disable mask / Disable masks of check DFC_VehVSigCan" VALUE 0x804F5B36 Val_Wu16 65535.00 DFES_OneToOne 0.00 65535.00 FORMAT "%8.2" /end CHARACTERISTIC
/begin CHARACTERISTIC DFC_DisblMsk.DFC_VehVSigCanSafe_C "disable mask / Disable masks of check DFC_VehVSigCanSafe" VALUE 0x804F5B38 Val_Wu16 65535.00 DFES_OneToOne 0.00 65535.00 FORMAT "%8.2" /end CHARACTERISTIC
/begin CHARACTERISTIC DFC_DisblMsk.DFC_VlvLftFbOilPSnsrIntk11SRCMax_C "disable mask / Disable masks of check DFC_VlvLftFbOilPSnsrIntk11SRCMax" VALUE 0x804F5B3A Val_Wu16 65535.00 DFES_OneToOne 0.00 65535.00 FORMAT "%8.2" /end CHARACTERISTIC
/begin CHARACTERISTIC DFC_DisblMsk.DFC_VlvLftFbOilPSnsrIntk11SRCMin_C "disable mask / Disable masks of check DFC_VlvLftFbOilPSnsrIntk11SRCMin" VALUE 0x804F5B3C Val_Wu16 65535.00 DFES_OneToOne 0.00 65535.00 FORMAT "%8.2" /end CHARACTERISTIC
/begin CHARACTERISTIC DFC_DisblMsk.DFC_ClthNpl_C "disable mask / Disable masks of check DFC_ClthNpl" VALUE 0x804F5B3E Val_Wu16 65535.00 DFES_OneToOne 0.00 65535.00 FORMAT "%8.2" /end CHARACTERISTIC
/begin CHARACTERISTIC DFC_DisblMsk.DFC_GbxPNPosnDrvCdn_C "disable mask / Disable masks of check DFC_GbxPNPosnDrvCdn" VALUE 0x804F5B40 Val_Wu16 65535.00 DFES_OneToOne 0.00 65535.00 FORMAT "%8.2" /end CHARACTERISTIC
/begin CHARACTERISTIC DFC_DisblMsk.DFC_GbxPNPosnPlausy_C "disable mask / Disable masks of check DFC_GbxPNPosnPlausy" VALUE 0x804F5B42 Val_Wu16 65535.00 DFES_OneToOne 0.00 65535.00 FORMAT "%8.2" /end CHARACTERISTIC
/begin CHARACTERISTIC DFC_DisblMsk.DFC_AfsSigErrLineHiB1_C "disable mask / Disable masks of check DFC_AfsSigErrLineHiB1" VALUE 0x804F5B44 Val_Wu16 65535.00 DFES_OneToOne 0.00 65535.00 FORMAT "%8.2" /end CHARACTERISTIC
/begin CHARACTERISTIC DFC_DisblMsk.DFC_AfsSigErrLineLoB1_C "disable mask / Disable masks of check DFC_AfsSigErrLineLoB1" VALUE 0x804F5B46 Val_Wu16 65535.00 DFES_OneToOne 0.00 65535.00 FORMAT "%8.2" /end CHARACTERISTIC
/begin CHARACTERISTIC DFC_DisblMsk.DFC_PEnvCcMax_C "disable mask / Disable masks of check DFC_PEnvCcMax" VALUE 0x804F5B48 Val_Wu16 65535.00 DFES_OneToOne 0.00 65535.00 FORMAT "%8.2" /end CHARACTERISTIC
/begin CHARACTERISTIC DFC_DisblMsk.DFC_PEnvCcMin_C "disable mask / Disable masks of check DFC_PEnvCcMin" VALUE 0x804F5B4A Val_Wu16 65535.00 DFES_OneToOne 0.00 65535.00 FORMAT "%8.2" /end CHARACTERISTIC
/begin CHARACTERISTIC DFC_DisblMsk.DFC_PEnvRngChkMax_C "disable mask / Disable masks of check DFC_PEnvRngChkMax" VALUE 0x804F5B4C Val_Wu16 65535.00 DFES_OneToOne 0.00 65535.00 FORMAT "%8.2" /end CHARACTERISTIC
/begin CHARACTERISTIC DFC_DisblMsk.DFC_PEnvRngChkMin_C "disable mask / Disable masks of check DFC_PEnvRngChkMin" VALUE 0x804F5B4E Val_Wu16 65535.00 DFES_OneToOne 0.00 65535.00 FORMAT "%8.2" /end CHARACTERISTIC
/begin CHARACTERISTIC DFC_DisblMsk.DFC_PEnvSnsrPlaus_C "disable mask / Disable masks of check DFC_PEnvSnsrPlaus" VALUE 0x804F5B50 Val_Wu16 65535.00 DFES_OneToOne 0.00 65535.00 FORMAT "%8.2" /end CHARACTERISTIC
/begin CHARACTERISTIC DFC_DisblMsk.DFC_UEGOHeatrRlyPsOLS1B1_C "disable mask / Disable masks of check DFC_UEGOHeatrRlyPsOLS1B1" VALUE 0x804F5B52 Val_Wu16 65535.00 DFES_OneToOne 0.00 65535.00 FORMAT "%8.2" /end CHARACTERISTIC
/begin CHARACTERISTIC DFC_DisblMsk.DFC_UEGOHeatrRlyPsSCBS1B1_C "disable mask / Disable masks of check DFC_UEGOHeatrRlyPsSCBS1B1" VALUE 0x804F5B54 Val_Wu16 65535.00 DFES_OneToOne 0.00 65535.00 FORMAT "%8.2" /end CHARACTERISTIC
/begin CHARACTERISTIC DFC_DisblMsk.DFC_UEGOHeatrRlyPsSCGS1B1_C "disable mask / Disable masks of check DFC_UEGOHeatrRlyPsSCGS1B1" VALUE 0x804F5B56 Val_Wu16 65535.00 DFES_OneToOne 0.00 65535.00 FORMAT "%8.2" /end CHARACTERISTIC
/begin CHARACTERISTIC DFC_DisblMsk.DFC_UegoHeatrWireOlS1B1_C "disable mask / Disable masks of check DFC_UegoHeatrWireOlS1B1" VALUE 0x804F5B58 Val_Wu16 65535.00 DFES_OneToOne 0.00 65535.00 FORMAT "%8.2" /end CHARACTERISTIC
/begin CHARACTERISTIC DFC_DisblMsk.DFC_UegoHeatrWireScbS1B1_C "disable mask / Disable masks of check DFC_UegoHeatrWireScbS1B1" VALUE 0x804F5B5A Val_Wu16 65535.00 DFES_OneToOne 0.00 65535.00 FORMAT "%8.2" /end CHARACTERISTIC
/begin CHARACTERISTIC DFC_DisblMsk.DFC_UegoHeatrWireScgS1B1_C "disable mask / Disable masks of check DFC_UegoHeatrWireScgS1B1" VALUE 0x804F5B5C Val_Wu16 65535.00 DFES_OneToOne 0.00 65535.00 FORMAT "%8.2" /end CHARACTERISTIC
/begin CHARACTERISTIC DFC_DisblMsk.DFC_KnDetSens1PortAMax_C "disable mask / Disable masks of check DFC_KnDetSens1PortAMax" VALUE 0x804F5B5E Val_Wu16 65535.00 DFES_OneToOne 0.00 65535.00 FORMAT "%8.2" /end CHARACTERISTIC
/begin CHARACTERISTIC DFC_DisblMsk.DFC_KnDetSens1PortAMin_C "disable mask / Disable masks of check DFC_KnDetSens1PortAMin" VALUE 0x804F5B60 Val_Wu16 65535.00 DFES_OneToOne 0.00 65535.00 FORMAT "%8.2" /end CHARACTERISTIC
/begin CHARACTERISTIC DFC_DisblMsk.DFC_KnDetSens1PortBMax_C "disable mask / Disable masks of check DFC_KnDetSens1PortBMax" VALUE 0x804F5B62 Val_Wu16 65535.00 DFES_OneToOne 0.00 65535.00 FORMAT "%8.2" /end CHARACTERISTIC
/begin CHARACTERISTIC DFC_DisblMsk.DFC_KnDetSens1PortBMin_C "disable mask / Disable masks of check DFC_KnDetSens1PortBMin" VALUE 0x804F5B64 Val_Wu16 65535.00 DFES_OneToOne 0.00 65535.00 FORMAT "%8.2" /end CHARACTERISTIC
/begin CHARACTERISTIC DFC_DisblMsk.DFC_Clth2ONStuck_C "disable mask / Disable masks of check DFC_Clth2ONStuck" VALUE 0x804F5B66 Val_Wu16 65535.00 DFES_OneToOne 0.00 65535.00 FORMAT "%8.2" /end CHARACTERISTIC
/begin FUNCTION DFC "30000.33.0_1.1.0Diagnostic Fault Check"
 /begin DEF_CHARACTERISTIC DFC_CtlMsk.DFC_DSUmax_C DFC_CtlMsk.DFC_DiagCpv1DteskLoLoadStuckClsd_C DFC_CtlMsk.DFC_DiagCpv1DteskLoLoadStuckOpen_C DFC_CtlMsk.DFC_EGRVlvDrftClsd_C DFC_CtlMsk.DFC_EGRVlvDrftOpn_C DFC_CtlMsk.DFC_EGRVlvJamVlvClsd_C DFC_CtlMsk.DFC_EGRVlvJamVlvOpn_C DFC_CtlMsk.DFC_EGRVlvSprgBrk_C DFC_CtlMsk.DFC_EGRVlvTempMdlEEPErr_C DFC_CtlMsk.DFC_EGRVlvTmpErr_C DFC_CtlMsk.DFC_EGSDUS2B1LtrDly_C DFC_CtlMsk.DFC_EGSDUS2B1LtrPT1_C DFC_CtlMsk.DFC_EGSDUS2B1RtlDly_C DFC_CtlMsk.DFC_EGSDUS2B1RtlPT1_C DFC_CtlMsk.DFC_EGSDUS2B1TarLean_C DFC_CtlMsk.DFC_EGSDUS2B1TarRich_C DFC_CtlMsk.DFC_EONVmax_C DFC_CtlMsk.DFC_ETAKHLmax_C DFC_CtlMsk.DFC_ETAKHTmax_C DFC_CtlMsk.DFC_ETHSEmax_C DFC_CtlMsk.DFC_ETHSEmin_C DFC_CtlMsk.DFC_ETHSFmax_C DFC_CtlMsk.DFC_ETHSFmin_C DFC_CtlMsk.DFC_ETHSFsig_C DFC_CtlMsk.DFC_ETHSNPWmax_C DFC_CtlMsk.DFC_ETHSNPWmin_C DFC_CtlMsk.DFC_ETHSNPWsig_C DFC_CtlMsk.DFC_ETHSPLnpl_C DFC_CtlMsk.DFC_ETHSTPLnpl_C DFC_CtlMsk.DFC_EngICO_C DFC_CtlMsk.DFC_EngPrtOvrSpdMon_C DFC_CtlMsk.DFC_EpmCaSI1ErrSig_C DFC_CtlMsk.DFC_EpmCaSI1MntErr_C DFC_CtlMsk.DFC_EpmCaSI1NoSigMax_C DFC_CtlMsk.DFC_EpmCaSI1NoSigMin_C DFC_CtlMsk.DFC_EpmCaSI1OfsErr_C DFC_CtlMsk.DFC_EpmCrSDGI_C DFC_CtlMsk.DFC_EpmCrSErrSig_C DFC_CtlMsk.DFC_EpmCrSNoSig_C DFC_CtlMsk.DFC_EtaEngIdleNonCsers_C DFC_CtlMsk.DFC_EtaEngPtlNonCsers_C DFC_CtlMsk.DFC_FRAmax_C DFC_CtlMsk.DFC_FRAmin_C DFC_CtlMsk.DFC_FSTEmax_C DFC_CtlMsk.DFC_FSTEmin_C DFC_CtlMsk.DFC_FSTRmax_C DFC_CtlMsk.DFC_FSTRmin_C DFC_CtlMsk.DFC_FSTRnpl_C DFC_CtlMsk.DFC_FSTmax_C DFC_CtlMsk.DFC_FTDLAmax_C DFC_CtlMsk.DFC_FTDLAmin_C DFC_CtlMsk.DFC_FuPHiSnsrEleclmax_C DFC_CtlMsk.DFC_FuPHiSnsrEleclmin_C DFC_CtlMsk.DFC_FuPHiSnsrEleclnpl_C DFC_CtlMsk.DFC_FuPHiSnsrURngMax_C DFC_CtlMsk.DFC_FuPHiSnsrURngMin_C DFC_CtlMsk.DFC_FuSnsrPhyRngMaxErr_C DFC_CtlMsk.DFC_FuSnsrPhyRngMinErr_C DFC_CtlMsk.DFC_GEVlvLockPinDiagIntkB1_C DFC_CtlMsk.DFC_GEVlvPhaSlowIntkB1_C DFC_CtlMsk.DFC_GEVlvPhaTargIntkB1_C DFC_CtlMsk.DFC_GbxRvsSwtStk_C DFC_CtlMsk.DFC_HDRKHmax_C DFC_CtlMsk.DFC_HDRKHmin_C DFC_CtlMsk.DFC_HDRPLmax_C DFC_CtlMsk.DFC_HDRPLmin_C DFC_CtlMsk.DFC_HDRmax_C DFC_CtlMsk.DFC_HDRmin_C DFC_CtlMsk.DFC_HEGOS2B1ElecMax_C DFC_CtlMsk.DFC_HEGOS2B1ElecMin_C DFC_CtlMsk.DFC_HEGOS2B1ElecSig_C DFC_CtlMsk.DFC_HEGOS2B1HtgNpl_C DFC_CtlMsk.DFC_HEV00max_C DFC_CtlMsk.DFC_HEV01max_C DFC_CtlMsk.DFC_HEV02max_C DFC_CtlMsk.DFC_HEV03max_C DFC_CtlMsk.DFC_HEVE0max_C DFC_CtlMsk.DFC_HEVE1max_C DFC_CtlMsk.DFC_HFMmax_C DFC_CtlMsk.DFC_HiPSysHiPMaxLimExcdd_C DFC_CtlMsk.DFC_IVGdiCtlCvoErrMax_0_C DFC_CtlMsk.DFC_IVGdiCtlCvoErrMax_1_C DFC_CtlMsk.DFC_IVGdiCtlCvoErrMax_2_C DFC_CtlMsk.DFC_IVGdiCtlCvoErrMax_3_C DFC_CtlMsk.DFC_IVGdiCtlCvoErrMin_0_C DFC_CtlMsk.DFC_IVGdiCtlCvoErrMin_1_C DFC_CtlMsk.DFC_IVGdiCtlCvoErrMin_2_C DFC_CtlMsk.DFC_IVGdiCtlCvoErrMin_3_C DFC_CtlMsk.DFC_IVGdiCtlCvoErrMinMax_C DFC_CtlMsk.DFC_IVGdiCtlCvoSigPlausErrSmrCdn_C DFC_CtlMsk.DFC_IVGdiCtl_CvoErr_C DFC_CtlMsk.DFC_IVGdiCtl_CvoSigPlaus_0_C DFC_CtlMsk.DFC_IVGdiCtl_CvoSigPlaus_1_C DFC_CtlMsk.DFC_IVGdiCtl_CvoSigPlaus_2_C DFC_CtlMsk.DFC_IVGdiCtl_CvoSigPlaus_3_C DFC_CtlMsk.DFC_IntkAirTAirFltDsCrssMax_C DFC_CtlMsk.DFC_IntkAirTAirFltDsCrssMin_C DFC_CtlMsk.DFC_IntkAirTAirFltDsHSCMax_C DFC_CtlMsk.DFC_IntkAirTAirFltDsImps_C DFC_CtlMsk.DFC_IntkAirTAirFltDsPRCMax_C DFC_CtlMsk.DFC_IntkAirTAirFltDsPRCMin_C DFC_CtlMsk.DFC_IntkAirTAirFltDsSRCMax_C DFC_CtlMsk.DFC_IntkAirTAirFltDsSRCMin_C DFC_CtlMsk.DFC_IntkAirTAirFltDsSTC_C DFC_CtlMsk.DFC_IntkAirTIntkMnfldCrssMax_C DFC_CtlMsk.DFC_IntkAirTIntkMnfldCrssMin_C DFC_CtlMsk.DFC_IntkAirTIntkMnfldHSCMax_C DFC_CtlMsk.DFC_IntkAirTIntkMnfldImps_C DFC_CtlMsk.DFC_IntkAirTIntkMnfldPRCMax_C DFC_CtlMsk.DFC_IntkAirTIntkMnfldPRCMin_C DFC_CtlMsk.DFC_IntkAirTIntkMnfldSRCMax_C DFC_CtlMsk.DFC_IntkAirTIntkMnfldSRCMin_C DFC_CtlMsk.DFC_IntkAirTIntkMnfldSTC_C DFC_CtlMsk.DFC_KRREGRLMX_C DFC_CtlMsk.DFC_KRVEKOCVLCI_C DFC_CtlMsk.DFC_KRVEKOENCHMT_C DFC_CtlMsk.DFC_KRVEKOENCHMT0_C DFC_CtlMsk.DFC_KRVEKOENCHMT1_C DFC_CtlMsk.DFC_KRVEKOENCHMT2_C DFC_CtlMsk.DFC_KRVEKOENCHMT3_C DFC_CtlMsk.DFC_KRVEKOENCHMT4_C DFC_CtlMsk.DFC_KRVEKOENCHMT5_C DFC_CtlMsk.DFC_KRVEKOENCHMT6_C DFC_CtlMsk.DFC_KRVEKOENCHMT7_C DFC_CtlMsk.DFC_KRVEKORLMX_C DFC_CtlMsk.DFC_KRVEKORLMXL_C DFC_CtlMsk.DFC_KS1max_C DFC_CtlMsk.DFC_KS1min_C DFC_CtlMsk.DFC_LMmax_C DFC_CtlMsk.DFC_LZSRnpl_C DFC_CtlMsk.DFC_LamDynDiagS1B1_C DFC_CtlMsk.DFC_LeakIntkMnfldEmiInfl_C DFC_CtlMsk.DFC_LinFrameErrDCDC_C DFC_CtlMsk.DFC_LinOverrunErrDCDC_C DFC_CtlMsk.DFC_MD00max_C DFC_CtlMsk.DFC_MDBmax_C DFC_CtlMsk.DFC_MDCat_C DFC_CtlMsk.DFC_MDCatCrit_C DFC_CtlMsk.DFC_MDCatCurr_C DFC_CtlMsk.DFC_MDCyl_0_C DFC_CtlMsk.DFC_MDCyl_1_C DFC_CtlMsk.DFC_MDCyl_2_C DFC_CtlMsk.DFC_MDCyl_3_C DFC_CtlMsk.DFC_MDEmi_C DFC_CtlMsk.DFC_MDEmiStrt_C DFC_CtlMsk.DFC_MDFco_C DFC_CtlMsk.DFC_MDMpl_C DFC_CtlMsk.DFC_MDSegTiAdpn_C DFC_CtlMsk.DFC_MDmax_C DFC_CtlMsk.DFC_MFuOilMax_C DFC_CtlMsk.DFC_MOXEMM_SMU_ALM0_0_C DFC_CtlMsk.DFC_MOXEMM_SMU_ALM0_1_C DFC_CtlMsk.DFC_MOXEMM_SMU_ALM0_10_C DFC_CtlMsk.DFC_MOXEMM_SMU_ALM0_11_C DFC_CtlMsk.DFC_MOXEMM_SMU_ALM0_13_C DFC_CtlMsk.DFC_MOXEMM_SMU_ALM0_14_C DFC_CtlMsk.DFC_MOXEMM_SMU_ALM0_2_C DFC_CtlMsk.DFC_MOXEMM_SMU_ALM0_22_C DFC_CtlMsk.DFC_MOXEMM_SMU_ALM0_23_C DFC_CtlMsk.DFC_MOXEMM_SMU_ALM0_4_C DFC_CtlMsk.DFC_MOXEMM_SMU_ALM0_5_C DFC_CtlMsk.DFC_MOXEMM_SMU_ALM0_7_C DFC_CtlMsk.DFC_MOXEMM_SMU_ALM0_8_C DFC_CtlMsk.DFC_MOXEMM_SMU_ALM10_16_C DFC_CtlMsk.DFC_MOXEMM_SMU_ALM10_17_C DFC_CtlMsk.DFC_MOXEMM_SMU_ALM10_21_C DFC_CtlMsk.DFC_MOXEMM_SMU_ALM11_0_C DFC_CtlMsk.DFC_MOXEMM_SMU_ALM11_1_C DFC_CtlMsk.DFC_MOXEMM_SMU_ALM11_2_C DFC_CtlMsk.DFC_MOXEMM_SMU_ALM11_3_C DFC_CtlMsk.DFC_MOXEMM_SMU_ALM11_4_C DFC_CtlMsk.DFC_MOXEMM_SMU_ALM11_5_C DFC_CtlMsk.DFC_MOXEMM_SMU_ALM11_8_C DFC_CtlMsk.DFC_MOXEMM_SMU_ALM11_9_C DFC_CtlMsk.DFC_MOXEMM_SMU_ALM1_0_C DFC_CtlMsk.DFC_MOXEMM_SMU_ALM1_1_C DFC_CtlMsk.DFC_MOXEMM_SMU_ALM1_10_C DFC_CtlMsk.DFC_MOXEMM_SMU_ALM1_11_C DFC_CtlMsk.DFC_MOXEMM_SMU_ALM1_13_C DFC_CtlMsk.DFC_MOXEMM_SMU_ALM1_14_C DFC_CtlMsk.DFC_MOXEMM_SMU_ALM1_2_C DFC_CtlMsk.DFC_MOXEMM_SMU_ALM1_22_C DFC_CtlMsk.DFC_MOXEMM_SMU_ALM1_23_C DFC_CtlMsk.DFC_MOXEMM_SMU_ALM1_4_C DFC_CtlMsk.DFC_MOXEMM_SMU_ALM1_5_C DFC_CtlMsk.DFC_MOXEMM_SMU_ALM1_7_C DFC_CtlMsk.DFC_MOXEMM_SMU_ALM1_8_C DFC_CtlMsk.DFC_MOXEMM_SMU_ALM21_0_C DFC_CtlMsk.DFC_MOXEMM_SMU_ALM21_16_C DFC_CtlMsk.DFC_MOXEMM_SMU_ALM21_3_C DFC_CtlMsk.DFC_MOXEMM_SMU_ALM2_1_C DFC_CtlMsk.DFC_MOXEMM_SMU_ALM2_10_C DFC_CtlMsk.DFC_MOXEMM_SMU_ALM2_11_C DFC_CtlMsk.DFC_MOXEMM_SMU_ALM2_13_C DFC_CtlMsk.DFC_MOXEMM_SMU_ALM2_14_C DFC_CtlMsk.DFC_MOXEMM_SMU_ALM2_22_C DFC_CtlMsk.DFC_MOXEMM_SMU_ALM2_23_C DFC_CtlMsk.DFC_MOXEMM_SMU_ALM2_4_C DFC_CtlMsk.DFC_MOXEMM_SMU_ALM2_5_C DFC_CtlMsk.DFC_MOXEMM_SMU_ALM2_7_C DFC_CtlMsk.DFC_MOXEMM_SMU_ALM2_8_C DFC_CtlMsk.DFC_MOXEMM_SMU_ALM6_0_C DFC_CtlMsk.DFC_MOXEMM_SMU_ALM6_11_C DFC_CtlMsk.DFC_MOXEMM_SMU_ALM6_12_C DFC_CtlMsk.DFC_MOXEMM_SMU_ALM6_14_C DFC_CtlMsk.DFC_MOXEMM_SMU_ALM6_15_C DFC_CtlMsk.DFC_MOXEMM_SMU_ALM6_17_C DFC_CtlMsk.DFC_MOXEMM_SMU_ALM6_18_C DFC_CtlMsk.DFC_MOXEMM_SMU_ALM6_20_C DFC_CtlMsk.DFC_MOXEMM_SMU_ALM6_21_C DFC_CtlMsk.DFC_MOXEMM_SMU_ALM6_25_C DFC_CtlMsk.DFC_MOXEMM_SMU_ALM6_4_C DFC_CtlMsk.DFC_MOXEMM_SMU_ALM6_5_C DFC_CtlMsk.DFC_MOXEMM_SMU_ALM6_7_C DFC_CtlMsk.DFC_MOXEMM_SMU_ALM6_8_C DFC_CtlMsk.DFC_MOXEMM_SMU_ALM7_1_C DFC_CtlMsk.DFC_MOXEMM_SMU_ALM7_12_C DFC_CtlMsk.DFC_MOXEMM_SMU_ALM7_13_C DFC_CtlMsk.DFC_MOXEMM_SMU_ALM7_14_C DFC_CtlMsk.DFC_MOXEMM_SMU_ALM7_15_C DFC_CtlMsk.DFC_MOXEMM_SMU_ALM7_16_C DFC_CtlMsk.DFC_MOXEMM_SMU_ALM7_17_C DFC_CtlMsk.DFC_MOXEMM_SMU_ALM7_2_C DFC_CtlMsk.DFC_MOXEMM_SMU_ALM7_20_C DFC_CtlMsk.DFC_MOXEMM_SMU_ALM7_25_C DFC_CtlMsk.DFC_MOXEMM_SMU_ALM7_26_C DFC_CtlMsk.DFC_MOXEMM_SMU_ALM7_28_C DFC_CtlMsk.DFC_MOXEMM_SMU_ALM7_29_C DFC_CtlMsk.DFC_MOXEMM_SMU_ALM7_30_C DFC_CtlMsk.DFC_MOXEMM_SMU_ALM7_31_C DFC_CtlMsk.DFC_MOXEMM_SMU_ALM8_0_C DFC_CtlMsk.DFC_MOXEMM_SMU_ALM8_1_C DFC_CtlMsk.DFC_MOXEMM_SMU_ALM8_10_C DFC_CtlMsk.DFC_MOXEMM_SMU_ALM8_11_C DFC_CtlMsk.DFC_MOXEMM_SMU_ALM8_12_C DFC_CtlMsk.DFC_MOXEMM_SMU_ALM8_16_C DFC_CtlMsk.DFC_MOXEMM_SMU_ALM8_18_C DFC_CtlMsk.DFC_MOXEMM_SMU_ALM8_2_C DFC_CtlMsk.DFC_MOXEMM_SMU_ALM8_3_C DFC_CtlMsk.DFC_MOXEMM_SMU_ALM8_31_C DFC_CtlMsk.DFC_MOXEMM_SMU_ALM8_4_C DFC_CtlMsk.DFC_MOXEMM_SMU_ALM9_0_C DFC_CtlMsk.DFC_MOXEMM_SMU_ALM9_15_C DFC_CtlMsk.DFC_MOXEMM_SMU_ALM9_3_C DFC_CtlMsk.DFC_MoCADCNTP_C DFC_CtlMsk.DFC_MoCADCTst_C DFC_CtlMsk.DFC_MoCSOPICO_C DFC_CtlMsk.DFC_MoFAPP_C DFC_CtlMsk.DFC_MoFAirFilgPrdc_C DFC_CtlMsk.DFC_MoFAirFlCtOffGdi_C DFC_CtlMsk.DFC_MoFAirFlCylGdi_C DFC_CtlMsk.DFC_MoFAirFlFF_C DFC_CtlMsk.DFC_MoFAirFlIn_C DFC_CtlMsk.DFC_MoFAirFlMixCtlGdiChkAirFl_C DFC_CtlMsk.DFC_MoFAirFlMixCtlGdiChkCtrl_C DFC_CtlMsk.DFC_MoFAirFlMode_C DFC_CtlMsk.DFC_MoFESpd_C DFC_CtlMsk.DFC_MoFIACo_C DFC_CtlMsk.DFC_MoFICOL1_C DFC_CtlMsk.DFC_MoFICOL2_C DFC_CtlMsk.DFC_MoFStrt_C DFC_CtlMsk.DFC_MoFTrqCmp_C DFC_CtlMsk.DFC_MoFTrqCmpMax_C DFC_CtlMsk.DFC_MoFTrqCmpMin_C DFC_CtlMsk.DFC_MoFVarPostBldSel_C DFC_CtlMsk.DFC_MoXEMMHwLTMCUFW_C DFC_CtlMsk.DFC_MoXEMMHwLTMonBIST_C DFC_CtlMsk.DFC_MoXEMMHwLTRegMonTest_C DFC_CtlMsk.DFC_MoXEMMHwLTStbySMUAlvTest_C DFC_CtlMsk.DFC_MoXEMMHwLTTempSens_C DFC_CtlMsk.DFC_MoXEMMHwLTUCBCfg_C DFC_CtlMsk.DFC_NWSEmax_C DFC_CtlMsk.DFC_NWSmax_C DFC_CtlMsk.DFC_OCWDAABEActv_C DFC_CtlMsk.DFC_OCWDACom_C DFC_CtlMsk.DFC_OCWDAErrPin_C DFC_CtlMsk.DFC_OCWDAOvrVltg_C DFC_CtlMsk.DFC_ORAmax_C DFC_CtlMsk.DFC_ORAmin_C DFC_CtlMsk.DFC_OilPPlaus_C DFC_CtlMsk.DFC_PLLSUmax_C DFC_CtlMsk.DFC_PLLSUmin_C DFC_CtlMsk.DFC_PSR1max_C DFC_CtlMsk.DFC_PSRBmax_C DFC_CtlMsk.DFC_PSRBmin_C DFC_CtlMsk.DFC_PSRPmax_C DFC_CtlMsk.DFC_PSRPmin_C DFC_CtlMsk.DFC_PSRPsig_C DFC_CtlMsk.DFC_PSRmax_C DFC_CtlMsk.DFC_PUmax_C DFC_CtlMsk.DFC_P_VSE11_OL_C DFC_CtlMsk.DFC_P_VSE11_SCB_C DFC_CtlMsk.DFC_P_VSE11_SCG_C DFC_CtlMsk.DFC_PhyHighAPP1_C DFC_CtlMsk.DFC_PhyHighAPP2_C DFC_CtlMsk.DFC_PhyLowAPP1_C DFC_CtlMsk.DFC_PhyLowAPP2_C DFC_CtlMsk.DFC_SRCHighAPP1_C DFC_CtlMsk.DFC_SRCHighAPP2_C DFC_CtlMsk.DFC_SRCLowAPP1_C DFC_CtlMsk.DFC_SRCLowAPP2_C DFC_CtlMsk.DFC_SSpMon2_C DFC_CtlMsk.DFC_STHDRmax_C DFC_CtlMsk.DFC_SWReset_0_C DFC_CtlMsk.DFC_SWReset_1_C DFC_CtlMsk.DFC_SWReset_2_C DFC_CtlMsk.DFC_SyncAPP_C DFC_CtlMsk.DFC_TANKLnpl_C DFC_CtlMsk.DFC_TAmax_Dummy_C DFC_CtlMsk.DFC_TESFmax_C DFC_CtlMsk.DFC_TESGmax_C DFC_CtlMsk.DFC_TKAEmax_C DFC_CtlMsk.DFC_TKAEmin_C DFC_CtlMsk.DFC_TKARmax_C DFC_CtlMsk.DFC_TKARnpl_C DFC_CtlMsk.DFC_TMmax_Dummy_C DFC_CtlMsk.DFC_TUMmax_Dummy_C DFC_CtlMsk.DFC_TWCDPriCatB1_C DFC_CtlMsk.DFC_ThrVlvClsdPosnFirstOffsLrnImpoB1_C DFC_CtlMsk.DFC_ThrVlvClsdPosnOffsLrnImpoB1_C DFC_CtlMsk.DFC_ThrVlvClsdPosnOffsLrnMaxB1_C DFC_CtlMsk.DFC_ThrVlvClsdPosnOffsLrnMinB1_C DFC_CtlMsk.DFC_ThrVlvCtrlDeB1_C DFC_CtlMsk.DFC_ThrVlvDycB1_C DFC_CtlMsk.DFC_ThrVlvLimpAirPosnMaxAbsltDriftB1_C DFC_CtlMsk.DFC_ThrVlvLimpAirPosnMaxB1_C DFC_CtlMsk.DFC_ThrVlvLimpAirPosnMaxRelDriftB1_C DFC_CtlMsk.DFC_ThrVlvLimpAirPosnMinB1_C DFC_CtlMsk.DFC_ThrVlvOpenLoadB1_C DFC_CtlMsk.DFC_ThrVlvOpenSprgB1_C DFC_CtlMsk.DFC_ThrVlvOpenSprgSprdB1_C DFC_CtlMsk.DFC_ThrVlvOpenSprgTwnB1_C DFC_CtlMsk.DFC_ThrVlvOverTB1_C DFC_CtlMsk.DFC_ThrVlvRetSprgB1_C DFC_CtlMsk.DFC_ThrVlvRetSprgSprdB1_C DFC_CtlMsk.DFC_ThrVlvRetSprgTwnB1_C DFC_CtlMsk.DFC_ThrVlvSens1MaxB1_C DFC_CtlMsk.DFC_ThrVlvSens1NplB1_C DFC_CtlMsk.DFC_ThrVlvSens2MaxB1_C DFC_CtlMsk.DFC_ThrVlvSens2MinB1_C DFC_CtlMsk.DFC_ThrVlvSens2NplB1_C DFC_CtlMsk.DFC_ThrVlvShoCircB1_C DFC_CtlMsk.DFC_ThrVlvSpiErrB1_C DFC_CtlMsk.DFC_ThrvlvSens1MinB1_C DFC_CtlMsk.DFC_TiOffTBasdChkFast_C DFC_CtlMsk.DFC_TiOffTBasdChkSlow_C DFC_CtlMsk.DFC_UEGOSnsrMntdS1B1_C DFC_CtlMsk.DFC_VehVSig_C DFC_CtlMsk.DFC_VlvLftFbSwtIntk11SpclFail_C DFC_CtlMsk.DFC_VlvLftFbSwtIntk11StdFail_C DFC_DisblMsk.DFC_Unused_C DFC_DisblMsk.DFC_AAVEmax_C DFC_DisblMsk.DFC_AAVEmin_C DFC_DisblMsk.DFC_AAVEsig_C DFC_DisblMsk.DFC_AltIOACGFailr_C DFC_DisblMsk.DFC_AltIOACGHiVltg_C DFC_DisblMsk.DFC_AltIOACGLoVltg_C DFC_DisblMsk.DFC_AltIOACGTHi_C DFC_DisblMsk.DFC_AltIODConnACG_C DFC_DisblMsk.DFC_BGOELWAF_C DFC_DisblMsk.DFC_BattUHiFailr_C DFC_DisblMsk.DFC_BattULoFailr_C DFC_DisblMsk.DFC_BrkBstPDriftHiErr_C DFC_DisblMsk.DFC_BrkBstPDriftLoErr_C DFC_DisblMsk.DFC_BrkBstPSnsrStuck_C DFC_DisblMsk.DFC_BrkMnSwtContOn_C DFC_DisblMsk.DFC_BrkMnSwtNotStp_C DFC_DisblMsk.DFC_BrkNpl_C DFC_DisblMsk.DFC_BrkRdntSwtContOn_C DFC_DisblMsk.DFC_BrkRdntSwtNotStp_C DFC_DisblMsk.DFC_Clth3ONStuck_C DFC_DisblMsk.DFC_Clth4OFFStuck_C DFC_DisblMsk.DFC_ClthOFFStuck_C DFC_DisblMsk.DFC_ClthONStuck_C DFC_DisblMsk.DFC_ClthStkFailInfo_C DFC_DisblMsk.DFC_ComACFailInfo_C DFC_DisblMsk.DFC_ComATFTValErr_C DFC_DisblMsk.DFC_ComATMILReq_C DFC_DisblMsk.DFC_ComAYCAChksum_C DFC_DisblMsk.DFC_ComAYCARingCnt_C DFC_DisblMsk.DFC_ComAYCATOut_C DFC_DisblMsk.DFC_ComAYCDChkSum_C DFC_DisblMsk.DFC_ComAYCDTOut_C DFC_DisblMsk.DFC_ComAYCFChksum_C DFC_DisblMsk.DFC_ComAYCFRingCnt_C DFC_DisblMsk.DFC_ComAYCFTOut_C DFC_DisblMsk.DFC_ComAYCGChksum_C DFC_DisblMsk.DFC_ComAYCGRingCnt_C DFC_DisblMsk.DFC_ComAYCGTOut_C DFC_DisblMsk.DFC_ComAYCIChkSum_C DFC_DisblMsk.DFC_ComAYCIRingCnt_C DFC_DisblMsk.DFC_ComAYCITOut_C DFC_DisblMsk.DFC_ComBCM1ChkSum_C DFC_DisblMsk.DFC_ComBCM1RingCnt_C DFC_DisblMsk.DFC_ComBCM1TOut_C DFC_DisblMsk.DFC_ComCANABusOffErr_C DFC_DisblMsk.DFC_ComCANBBusOffErr_C DFC_DisblMsk.DFC_ComCANCBusOffErr_C DFC_DisblMsk.DFC_ComCGW1ChkSum_C DFC_DisblMsk.DFC_ComCGW1RingCnt_C DFC_DisblMsk.DFC_ComCGW1TOut_C DFC_DisblMsk.DFC_ComConvBoostErr_C DFC_DisblMsk.DFC_ComConvSlipErr_C DFC_DisblMsk.DFC_ComDCDCPrfmncErr_C DFC_DisblMsk.DFC_ComDCDCTempWarn_C DFC_DisblMsk.DFC_ComEAT10Chksum_C DFC_DisblMsk.DFC_ComEAT10RingCnt_C DFC_DisblMsk.DFC_ComEAT10TOut_C DFC_DisblMsk.DFC_ComEAT11ChkSum_C DFC_DisblMsk.DFC_ComEAT11RingCnt_C DFC_DisblMsk.DFC_ComEAT11TOut_C DFC_DisblMsk.DFC_ComEAT12ChkSum_C DFC_DisblMsk.DFC_ComEAT12RingCnt_C DFC_DisblMsk.DFC_ComEAT12TOut_C DFC_DisblMsk.DFC_ComEAT13ChkSum_C DFC_DisblMsk.DFC_ComEAT13RingCnt_C DFC_DisblMsk.DFC_ComEAT13TOut_C DFC_DisblMsk.DFC_ComEAT1Chksum_C DFC_DisblMsk.DFC_ComEAT1RingCnt_C DFC_DisblMsk.DFC_ComEAT1TOut_C DFC_DisblMsk.DFC_ComEAT2ChkSum_C DFC_DisblMsk.DFC_ComEAT2RingCnt_C DFC_DisblMsk.DFC_ComEAT2TOut_C DFC_DisblMsk.DFC_ComEAT4ChkSum_C DFC_DisblMsk.DFC_ComEAT4RingCnt_C DFC_DisblMsk.DFC_ComEAT4TOut_C DFC_DisblMsk.DFC_ComEAT6Chksum_C DFC_DisblMsk.DFC_ComEAT6RingCnt_C DFC_DisblMsk.DFC_ComEAT6TOut_C DFC_DisblMsk.DFC_ComEAT7Chksum_C DFC_DisblMsk.DFC_ComEAT7RingCnt_C DFC_DisblMsk.DFC_ComEAT7TOut_C DFC_DisblMsk.DFC_ComEAT8Chksum_C DFC_DisblMsk.DFC_ComEAT8RingCnt_C DFC_DisblMsk.DFC_ComEAT8TOut_C DFC_DisblMsk.DFC_ComEATAChksum_C DFC_DisblMsk.DFC_ComEATARingCnt_C DFC_DisblMsk.DFC_ComEATATOut_C DFC_DisblMsk.DFC_ComEATBChkSum_C DFC_DisblMsk.DFC_ComEATBRingCnt_C DFC_DisblMsk.DFC_ComEATBTOut_C DFC_DisblMsk.DFC_ComEATCChksum_C DFC_DisblMsk.DFC_ComEATCRingCnt_C DFC_DisblMsk.DFC_ComEATCTOut_C DFC_DisblMsk.DFC_ComEPBBChkSum_C DFC_DisblMsk.DFC_ComEPBBRingCnt_C DFC_DisblMsk.DFC_ComEPBBTOut_C DFC_DisblMsk.DFC_ComEPBChksum_C DFC_DisblMsk.DFC_ComEPBTOut_C DFC_DisblMsk.DFC_ComEPBctRing_C DFC_DisblMsk.DFC_ComEPS1Chksum_C DFC_DisblMsk.DFC_ComEPS1RingCnt_C DFC_DisblMsk.DFC_ComEPS1TOut_C DFC_DisblMsk.DFC_ComEngCanRxErr_C DFC_DisblMsk.DFC_ComGrvySnsrErr_C DFC_DisblMsk.DFC_ComGwIMG1ChkSum_C DFC_DisblMsk.DFC_ComGwIMG1RingCnt_C DFC_DisblMsk.DFC_ComGwIMG1TOut_C DFC_DisblMsk.DFC_ComGwIMG3ChkSum_C DFC_DisblMsk.DFC_ComGwIMG3RingCnt_C DFC_DisblMsk.DFC_ComGwIMG3TOut_C DFC_DisblMsk.DFC_ComGwIMG4ChkSum_C DFC_DisblMsk.DFC_ComGwIMG4RingCnt_C DFC_DisblMsk.DFC_ComGwIMG4TOut_C DFC_DisblMsk.DFC_ComGwIMG5ChkSum_C DFC_DisblMsk.DFC_ComGwIMG5RingCnt_C DFC_DisblMsk.DFC_ComGwIMG5TOut_C DFC_DisblMsk.DFC_ComGwIMG6ChkSum_C DFC_DisblMsk.DFC_ComGwIMG6RingCnt_C DFC_DisblMsk.DFC_ComGwIMG6TOut_C DFC_DisblMsk.DFC_ComIDASBChksum_C DFC_DisblMsk.DFC_ComIDASBRingCnt_C DFC_DisblMsk.DFC_ComIDASBTOut_C DFC_DisblMsk.DFC_ComIMGMILReq_C DFC_DisblMsk.DFC_ComISSPrms_C DFC_DisblMsk.DFC_ComMETAChksum_C DFC_DisblMsk.DFC_ComMETAChksumPstDrv_C DFC_DisblMsk.DFC_ComMETARingCnt_C DFC_DisblMsk.DFC_ComMETARingCntPstDrv_C DFC_DisblMsk.DFC_ComMETATOut_C DFC_DisblMsk.DFC_ComMETATOutPstDrv_C DFC_DisblMsk.DFC_ComMETCChksum_C DFC_DisblMsk.DFC_ComMETCRingCnt_C DFC_DisblMsk.DFC_ComMETCTOut_C DFC_DisblMsk.DFC_ComMETDChksum_C DFC_DisblMsk.DFC_ComMETDRingCnt_C DFC_DisblMsk.DFC_ComMETDTOut_C DFC_DisblMsk.DFC_ComMETE2Chksum_C DFC_DisblMsk.DFC_ComMETE2RingCnt_C DFC_DisblMsk.DFC_ComMETE2TOut_C DFC_DisblMsk.DFC_ComMETFChksum_C DFC_DisblMsk.DFC_ComMETFRingCnt_C DFC_DisblMsk.DFC_ComMETFTOut_C DFC_DisblMsk.DFC_ComMETGChksum_C DFC_DisblMsk.DFC_ComMETGRingCnt_C DFC_DisblMsk.DFC_ComMETGTOut_C DFC_DisblMsk.DFC_ComMETH2Chksum_C DFC_DisblMsk.DFC_ComMETH2RingCnt_C DFC_DisblMsk.DFC_ComMETH2TOut_C DFC_DisblMsk.DFC_ComMETHChksum_C DFC_DisblMsk.DFC_ComMETHRingCnt_C DFC_DisblMsk.DFC_ComMETHTOut_C DFC_DisblMsk.DFC_ComMETIChksum_C DFC_DisblMsk.DFC_ComMETIRingCnt_C DFC_DisblMsk.DFC_ComMETITOut_C DFC_DisblMsk.DFC_ComMETKChksum_C DFC_DisblMsk.DFC_ComMETKRingCnt_C DFC_DisblMsk.DFC_ComMETKTOut_C DFC_DisblMsk.DFC_ComMETLChksum_C DFC_DisblMsk.DFC_ComMETLRingCnt_C DFC_DisblMsk.DFC_ComMETLTOut_C DFC_DisblMsk.DFC_ComMETMChksum_C DFC_DisblMsk.DFC_ComMETMRingCnt_C DFC_DisblMsk.DFC_ComMETMTOut_C DFC_DisblMsk.DFC_ComMETNChksum_C DFC_DisblMsk.DFC_ComMETNRingCnt_C DFC_DisblMsk.DFC_ComMETNTOut_C DFC_DisblMsk.DFC_ComMtrCom_C DFC_DisblMsk.DFC_ComPCUChkSum_C DFC_DisblMsk.DFC_ComPCURingCnt_C DFC_DisblMsk.DFC_ComPCUTOut_C DFC_DisblMsk.DFC_ComSRSAChksum_C DFC_DisblMsk.DFC_ComSRSARingCnt_C DFC_DisblMsk.DFC_ComSRSATOut_C DFC_DisblMsk.DFC_ComSRSBChksum_C DFC_DisblMsk.DFC_ComSRSBRingCnt_C DFC_DisblMsk.DFC_ComSRSBTOut_C DFC_DisblMsk.DFC_ComSRSChksum_C DFC_DisblMsk.DFC_ComSRSErr_C DFC_DisblMsk.DFC_ComSRSRingCnt_C DFC_DisblMsk.DFC_ComSRSTOut_C DFC_DisblMsk.DFC_ComVehSpdPndFltTCU_C DFC_DisblMsk.DFC_EbsChartcCurrErr_C DFC_DisblMsk.DFC_EbsSelfDiagErr_C DFC_DisblMsk.DFC_GEVlvPhaCsersIntkB1_C DFC_DisblMsk.DFC_GEVlvPhaPsOpenLoadIntkB1_C DFC_DisblMsk.DFC_GEVlvPhaPsShoToBattIntkB1_C DFC_DisblMsk.DFC_GEVlvPhaPsShoToGndIntkB1_C DFC_DisblMsk.DFC_GbxCANDigPlausErr_C DFC_DisblMsk.DFC_GbxNPos1SRCMax_C DFC_DisblMsk.DFC_GbxNPos1SRCMin_C DFC_DisblMsk.DFC_GbxNPos2SRCMax_C DFC_DisblMsk.DFC_GbxNPos2SRCMin_C DFC_DisblMsk.DFC_GbxNPosAlvChk_C DFC_DisblMsk.DFC_GbxNPosSyncErr_C DFC_DisblMsk.DFC_HEGOS2B1HtrPsMax_C DFC_DisblMsk.DFC_HEGOS2B1HtrPsMin_C DFC_DisblMsk.DFC_HEGOS2B1HtrPsSig_C DFC_DisblMsk.DFC_LinCSErrACG_C DFC_DisblMsk.DFC_LinCSErrAEV_C DFC_DisblMsk.DFC_LinCSErrDCDC_C DFC_DisblMsk.DFC_LinCSErrEBS_C DFC_DisblMsk.DFC_LinHdrTimeoutErrACG_C DFC_DisblMsk.DFC_LinHdrTimeoutErrAEV_C DFC_DisblMsk.DFC_LinHdrTimeoutErrDCDC_C DFC_DisblMsk.DFC_LinHdrTimeoutErrEBS_C DFC_DisblMsk.DFC_LinMsgTimeoutErrACG_C DFC_DisblMsk.DFC_LinMsgTimeoutErrAEV_C DFC_DisblMsk.DFC_LinMsgTimeoutErrDCDC_C DFC_DisblMsk.DFC_LinMsgTimeoutErrEBS_C DFC_DisblMsk.DFC_LinNoStrtComErr_C DFC_DisblMsk.DFC_LowPresOilP_C DFC_DisblMsk.DFC_MisfDetVWhlFrntLeOORHi_C DFC_DisblMsk.DFC_MisfDetVWhlFrntLeRatyHi_C DFC_DisblMsk.DFC_MisfDetVWhlFrntLeRatyLo_C DFC_DisblMsk.DFC_MisfDetVWhlFrntLeStuck_C DFC_DisblMsk.DFC_MisfDetVWhlFrntRiOORHi_C DFC_DisblMsk.DFC_MisfDetVWhlFrntRiRatyHi_C DFC_DisblMsk.DFC_MisfDetVWhlFrntRiRatyLo_C DFC_DisblMsk.DFC_MisfDetVWhlFrntRiStuck_C DFC_DisblMsk.DFC_MisfDetVWhlReLeOORHi_C DFC_DisblMsk.DFC_MisfDetVWhlReLeRatyHi_C DFC_DisblMsk.DFC_MisfDetVWhlReLeRatyLo_C DFC_DisblMsk.DFC_MisfDetVWhlReLeStuck_C DFC_DisblMsk.DFC_MisfDetVWhlReRiOORHi_C DFC_DisblMsk.DFC_MisfDetVWhlReRiRatyHi_C DFC_DisblMsk.DFC_MisfDetVWhlReRiRatyLo_C DFC_DisblMsk.DFC_MisfDetVWhlReRiStuck_C DFC_DisblMsk.DFC_MisfDetdVWhlFrntLePlaus_C DFC_DisblMsk.DFC_MisfDetdVWhlFrntRiPlaus_C DFC_DisblMsk.DFC_MisfDetdVWhlReLePlaus_C DFC_DisblMsk.DFC_MisfDetdVWhlReRiPlaus_C DFC_DisblMsk.DFC_PEnvSigRngMax_C DFC_DisblMsk.DFC_PEnvSigRngMin_C DFC_DisblMsk.DFC_StmFault_C DFC_DisblMsk.DFC_StrtCtOffPth_C DFC_DisblMsk.DFC_StrtCtlErr_C DFC_DisblMsk.DFC_StrtFault_C DFC_DisblMsk.DFC_StrtLckJudg1_C DFC_DisblMsk.DFC_StrtLckJudg2_C DFC_DisblMsk.DFC_StrtOL_C DFC_DisblMsk.DFC_StrtOL2_C DFC_DisblMsk.DFC_StrtSCB_C DFC_DisblMsk.DFC_StrtSCB2_C DFC_DisblMsk.DFC_StrtSCG_C DFC_DisblMsk.DFC_StrtSCG2_C DFC_DisblMsk.DFC_StrtStkRly1_C DFC_DisblMsk.DFC_StrtStkRly2_C DFC_DisblMsk.DFC_TEVEmax_C DFC_DisblMsk.DFC_TEVEmin_C DFC_DisblMsk.DFC_TEVEsig_C DFC_DisblMsk.DFC_UegoHeatrPrfmncLoS1B1_C DFC_DisblMsk.DFC_VehVAllPlaus_C DFC_DisblMsk.DFC_VehVNCSnsrElecFailr_C DFC_DisblMsk.DFC_VehVPlausCan_C DFC_DisblMsk.DFC_VehVPlausFco_C DFC_DisblMsk.DFC_VehVPlausPwr_C DFC_DisblMsk.DFC_VehVPlausV2N_C DFC_DisblMsk.DFC_VehVSpdSnsrAElecFailr_C DFC_DisblMsk.DFC_VehVSpdSnsrBElecFailr_C DFC_DisblMsk.DFC_ClthMax_C DFC_DisblMsk.DFC_IgnClPs_DevComErr_C DFC_DisblMsk.DFC_IgnClPs_LineOl_0_C DFC_DisblMsk.DFC_IgnClPs_LineOl_1_C DFC_DisblMsk.DFC_IgnClPs_LineOl_2_C DFC_DisblMsk.DFC_IgnClPs_LineOl_3_C DFC_DisblMsk.DFC_IgnClPs_LineScb_0_C DFC_DisblMsk.DFC_IgnClPs_LineScb_1_C DFC_DisblMsk.DFC_IgnClPs_LineScb_2_C DFC_DisblMsk.DFC_IgnClPs_LineScb_3_C DFC_DisblMsk.DFC_IgnClPs_LineScg_0_C DFC_DisblMsk.DFC_IgnClPs_LineScg_1_C DFC_DisblMsk.DFC_IgnClPs_LineScg_2_C DFC_DisblMsk.DFC_IgnClPs_LineScg_3_C DFC_DisblMsk.DFC_KRVEKOEVAB_C DFC_DisblMsk.DFC_KRVEKOEVAB0_C DFC_DisblMsk.DFC_KRVEKOEVAB1_C DFC_DisblMsk.DFC_KRVEKOEVAB2_C DFC_DisblMsk.DFC_KRVEKOEVAB3_C DFC_DisblMsk.DFC_UegoSigEcuAsicS1B1_C DFC_DisblMsk.DFC_UegoSigEcuComS1B1_C DFC_DisblMsk.DFC_UegoSigSnsrS1B1_C DFC_DisblMsk.DFC_UegoSigWireOlApesS1B1_C DFC_DisblMsk.DFC_UegoSigWireOlIpeS1B1_C DFC_DisblMsk.DFC_UegoSigWireOlReS1B1_C DFC_DisblMsk.DFC_UegoSigWireRCmpS1B1_C DFC_DisblMsk.DFC_UegoSigWireScbS1B1_C DFC_DisblMsk.DFC_UegoSigWireScgS1B1_C DFC_DisblMsk.DFC_AfsPhyRngHiB1_C DFC_DisblMsk.DFC_AfsPhyRngLoB1_C DFC_DisblMsk.DFC_AirCCmprOL_C DFC_DisblMsk.DFC_AirCCmprOvrTemp_C DFC_DisblMsk.DFC_AirCCmprSCB_C DFC_DisblMsk.DFC_AirCCmprSCG_C DFC_DisblMsk.DFC_AltErr_C DFC_DisblMsk.DFC_BattUSRCMax_C DFC_DisblMsk.DFC_BattUSRCMin_C DFC_DisblMsk.DFC_ComChksTCU1_C DFC_DisblMsk.DFC_ComChksTCU11_C DFC_DisblMsk.DFC_ComChksTCU12_C DFC_DisblMsk.DFC_ComChksTCU13_C DFC_DisblMsk.DFC_ComChksTCU2_C DFC_DisblMsk.DFC_ComChksTCU3_C DFC_DisblMsk.DFC_ComChksTCU4_C DFC_DisblMsk.DFC_ComCntTCU1_C DFC_DisblMsk.DFC_ComCntTCU11_C DFC_DisblMsk.DFC_ComCntTCU12_C DFC_DisblMsk.DFC_ComCntTCU13_C DFC_DisblMsk.DFC_ComCntTCU2_C DFC_DisblMsk.DFC_ComCntTCU3_C DFC_DisblMsk.DFC_ComCntTCU4_C DFC_DisblMsk.DFC_ComTOutTCU01_C DFC_DisblMsk.DFC_ComTOutTCU02_C DFC_DisblMsk.DFC_ComTOutTCU1_C DFC_DisblMsk.DFC_ComTOutTCU11_C DFC_DisblMsk.DFC_ComTOutTCU12_C DFC_DisblMsk.DFC_ComTOutTCU13_C DFC_DisblMsk.DFC_ComTOutTCU14_C DFC_DisblMsk.DFC_ComTOutTCU2_C DFC_DisblMsk.DFC_ComTOutTCU3_C DFC_DisblMsk.DFC_ComTOutTCU4_C DFC_DisblMsk.DFC_DevLibBattUHi_C DFC_DisblMsk.DFC_DevLibBattULo_C DFC_DisblMsk.DFC_EGRVlvFailSafeActv_C DFC_DisblMsk.DFC_EGRVlvGovDvtCld_C DFC_DisblMsk.DFC_EGRVlvPhysSRCMax_C DFC_DisblMsk.DFC_EGRVlvPhysSRCMin_C DFC_DisblMsk.DFC_FanDIOOL_0_C DFC_DisblMsk.DFC_FanDIOOL_1_C DFC_DisblMsk.DFC_FanDIOOvrTemp_0_C DFC_DisblMsk.DFC_FanDIOOvrTemp_1_C DFC_DisblMsk.DFC_FanDIOSCB_0_C DFC_DisblMsk.DFC_FanDIOSCB_1_C DFC_DisblMsk.DFC_FanDIOSCG_0_C DFC_DisblMsk.DFC_FanDIOSCG_1_C DFC_DisblMsk.DFC_MRlyDcOL_C DFC_DisblMsk.DFC_MRlyDcSCB_C DFC_DisblMsk.DFC_MRlyDcSCG_C DFC_DisblMsk.DFC_PSPOL_C DFC_DisblMsk.DFC_PSPOvrTemp_C DFC_DisblMsk.DFC_PSPSCB_C DFC_DisblMsk.DFC_PSPSCG_C DFC_DisblMsk.DFC_T50Err_C DFC_DisblMsk.DFC_ThrVlvLoBattB1_C DFC_DisblMsk.DFC_UegoSigOperPlausS1B1_C DFC_DisblMsk.DFC_VehVPhysRngHi_C DFC_DisblMsk.DFC_VehVSclOutOL_C DFC_DisblMsk.DFC_VehVSclOutOT_C DFC_DisblMsk.DFC_VehVSclOutSCB_C DFC_DisblMsk.DFC_VehVSclOutSCG_C DFC_DisblMsk.DFC_VehVSigFL_C DFC_DisblMsk.DFC_VehVSigFR_C DFC_DisblMsk.DFC_VehVSigRL_C DFC_DisblMsk.DFC_VehVSigRR_C DFC_DisblMsk.DFC_VehVSnsrARngHi_C DFC_DisblMsk.DFC_VehVSnsrBRngHi_C DFC_DisblMsk.DFC_VehVSpdRtyDiag_C DFC_DisblMsk.DFC_DHFHD_C DFC_DisblMsk.DFC_InjVlv_DI_DcDc_C DFC_DisblMsk.DFC_InjVlv_DI_NoLd_0_C DFC_DisblMsk.DFC_InjVlv_DI_NoLd_1_C DFC_DisblMsk.DFC_InjVlv_DI_NoLd_2_C DFC_DisblMsk.DFC_InjVlv_DI_NoLd_3_C DFC_DisblMsk.DFC_InjVlv_DI_ScBnk_0_C DFC_DisblMsk.DFC_InjVlv_DI_ScBnk_1_C DFC_DisblMsk.DFC_InjVlv_DI_ScBnk_2_C DFC_DisblMsk.DFC_InjVlv_DI_ScBnk_3_C DFC_DisblMsk.DFC_InjVlv_DI_ScCyl_0_C DFC_DisblMsk.DFC_InjVlv_DI_ScCyl_1_C DFC_DisblMsk.DFC_InjVlv_DI_ScCyl_2_C DFC_DisblMsk.DFC_InjVlv_DI_ScCyl_3_C DFC_DisblMsk.DFC_InjVlv_DI_ScHsLs_0_C DFC_DisblMsk.DFC_InjVlv_DI_ScHsLs_1_C DFC_DisblMsk.DFC_InjVlv_DI_ScHsLs_2_C DFC_DisblMsk.DFC_InjVlv_DI_ScHsLs_3_C DFC_DisblMsk.DFC_MfPsDiaOpenLoad1_C DFC_DisblMsk.DFC_MfPsDiaScHiS1_C DFC_DisblMsk.DFC_MfPsDiaScHiSLowS1_C DFC_DisblMsk.DFC_MfPsDiaScLowS1_C DFC_DisblMsk.DFC_ACEvpTPhysRngHi_C DFC_DisblMsk.DFC_ACEvpTPhysRngLo_C DFC_DisblMsk.DFC_ACEvpTSRCMax_C DFC_DisblMsk.DFC_ACEvpTSRCMin_C DFC_DisblMsk.DFC_AfsRawSigRngHiB1_C DFC_DisblMsk.DFC_AfsRawSigRngLoB1_C DFC_DisblMsk.DFC_AfsSnsrErrB1_C DFC_DisblMsk.DFC_AirCClntPAnaSRCMax_C DFC_DisblMsk.DFC_AirCClntPAnaSRCMin_C DFC_DisblMsk.DFC_AirCSwtNpl_C DFC_DisblMsk.DFC_AirCSwtSig_C DFC_DisblMsk.DFC_Brk_C DFC_DisblMsk.DFC_BrkBstSensSCB_C DFC_DisblMsk.DFC_BrkBstSensSCG_C DFC_DisblMsk.DFC_BrkSig_C DFC_DisblMsk.DFC_ClthSig_C DFC_DisblMsk.DFC_EGRVlvCurrLim_C DFC_DisblMsk.DFC_EGRVlvOL_C DFC_DisblMsk.DFC_EGRVlvOvrTemp_C DFC_DisblMsk.DFC_EGRVlvSCB_C DFC_DisblMsk.DFC_EGRVlvSCG_C DFC_DisblMsk.DFC_EGRVlvSRCMax_C DFC_DisblMsk.DFC_EGRVlvSRCMin_C DFC_DisblMsk.DFC_HLSDemOvhtEngLim_C DFC_DisblMsk.DFC_OilPSwmpSRCMax_C DFC_DisblMsk.DFC_OilPSwmpSRCMin_C DFC_DisblMsk.DFC_PIntkVUsLineHiB1_C DFC_DisblMsk.DFC_PIntkVUsLineLoB1_C DFC_DisblMsk.DFC_VehVPhysRngLo_C DFC_DisblMsk.DFC_VehVSigCan_C DFC_DisblMsk.DFC_VehVSigCanSafe_C DFC_DisblMsk.DFC_VlvLftFbOilPSnsrIntk11SRCMax_C DFC_DisblMsk.DFC_VlvLftFbOilPSnsrIntk11SRCMin_C DFC_DisblMsk.DFC_ClthNpl_C DFC_DisblMsk.DFC_GbxPNPosnDrvCdn_C DFC_DisblMsk.DFC_GbxPNPosnPlausy_C DFC_DisblMsk.DFC_AfsSigErrLineHiB1_C DFC_DisblMsk.DFC_AfsSigErrLineLoB1_C DFC_DisblMsk.DFC_PEnvCcMax_C DFC_DisblMsk.DFC_PEnvCcMin_C DFC_DisblMsk.DFC_PEnvRngChkMax_C DFC_DisblMsk.DFC_PEnvRngChkMin_C DFC_DisblMsk.DFC_PEnvSnsrPlaus_C DFC_DisblMsk.DFC_UEGOHeatrRlyPsOLS1B1_C DFC_DisblMsk.DFC_UEGOHeatrRlyPsSCBS1B1_C DFC_DisblMsk.DFC_UEGOHeatrRlyPsSCGS1B1_C DFC_DisblMsk.DFC_UegoHeatrWireOlS1B1_C DFC_DisblMsk.DFC_UegoHeatrWireScbS1B1_C DFC_DisblMsk.DFC_UegoHeatrWireScgS1B1_C DFC_DisblMsk.DFC_KnDetSens1PortAMax_C DFC_DisblMsk.DFC_KnDetSens1PortAMin_C DFC_DisblMsk.DFC_KnDetSens1PortBMax_C DFC_DisblMsk.DFC_KnDetSens1PortBMin_C DFC_DisblMsk.DFC_Clth2ONStuck_C /end DEF_CHARACTERISTIC
 FUNCTION_VERSION "30000.33.0_1.1.0" /end FUNCTION
/begin COMPU_METHOD DFES_OneToOne "" RAT_FUNC "%6.2" "-" COEFFS 0 1 0 0 0 1 /end COMPU_METHOD
/begin RECORD_LAYOUT Val_Wu16 FNC_VALUES 1 UWORD COLUMN_DIR DIRECT /end RECORD_LAYOUT
/end MODULE
/end PROJECT
