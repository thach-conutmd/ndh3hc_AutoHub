ASAP2_VERSION 1 60
/begin PROJECT MG1CS022 "MG1CS022"
/begin HEADER "" VERSION "MG1CS022_62XSC_V037_TPROT" PROJECT_NO MG1CS022 /end HEADER
/begin MODULE DIM ""
/begin MOD_COMMON "" BYTE_ORDER MSB_LAST ALIGNMENT_BYTE 1 ALIGNMENT_WORD 2 ALIGNMENT_LONG 4 ALIGNMENT_INT64 4 ALIGNMENT_FLOAT32_IEEE 4 ALIGNMENT_FLOAT64_IEEE 4 DATA_SIZE 32 /end MOD_COMMON
/begin CHARACTERISTIC DDRC_DurDeb.Com_tiCntTCU1DebDef_C "debouncing parameter / Duration of defect debouncing for check DFC_ComCntTCU1" VALUE 0x804D8742 Val_Wu16 655350.0 DDRCTime_ms 0.00 655350.0 FORMAT "%8.1" /end CHARACTERISTIC
/begin CHARACTERISTIC DDRC_DurDeb.Com_tiCntTCU11DebOk_C "debouncing parameter / Duration of healing debouncing for check DFC_ComCntTCU11" VALUE 0x804D8744 Val_Wu16 655350.0 DDRCTime_ms 0.00 655350.0 FORMAT "%8.1" /end CHARACTERISTIC
/begin CHARACTERISTIC DDRC_DurDeb.Com_tiCntTCU11DebDef_C "debouncing parameter / Duration of defect debouncing for check DFC_ComCntTCU11" VALUE 0x804D8746 Val_Wu16 655350.0 DDRCTime_ms 0.00 655350.0 FORMAT "%8.1" /end CHARACTERISTIC
/begin CHARACTERISTIC DDRC_DurDeb.Com_tiCntTCU12DebOk_C "debouncing parameter / Duration of healing debouncing for check DFC_ComCntTCU12" VALUE 0x804D8748 Val_Wu16 655350.0 DDRCTime_ms 0.00 655350.0 FORMAT "%8.1" /end CHARACTERISTIC
/begin CHARACTERISTIC DDRC_DurDeb.Com_tiCntTCU12DebDef_C "debouncing parameter / Duration of defect debouncing for check DFC_ComCntTCU12" VALUE 0x804D874A Val_Wu16 655350.0 DDRCTime_ms 0.00 655350.0 FORMAT "%8.1" /end CHARACTERISTIC
/begin CHARACTERISTIC DDRC_DurDeb.Com_tiCntTCU13DebOk_C "debouncing parameter / Duration of healing debouncing for check DFC_ComCntTCU13" VALUE 0x804D874C Val_Wu16 655350.0 DDRCTime_ms 0.00 655350.0 FORMAT "%8.1" /end CHARACTERISTIC
/begin CHARACTERISTIC DDRC_DurDeb.Com_tiCntTCU13DebDef_C "debouncing parameter / Duration of defect debouncing for check DFC_ComCntTCU13" VALUE 0x804D874E Val_Wu16 655350.0 DDRCTime_ms 0.00 655350.0 FORMAT "%8.1" /end CHARACTERISTIC
/begin CHARACTERISTIC DDRC_DurDeb.Com_tiCntTCU2DebOk_C "debouncing parameter / Duration of healing debouncing for check DFC_ComCntTCU2" VALUE 0x804D8750 Val_Wu16 655350.0 DDRCTime_ms 0.00 655350.0 FORMAT "%8.1" /end CHARACTERISTIC
/begin CHARACTERISTIC DDRC_DurDeb.Com_tiCntTCU2DebDef_C "debouncing parameter / Duration of defect debouncing for check DFC_ComCntTCU2" VALUE 0x804D8752 Val_Wu16 655350.0 DDRCTime_ms 0.00 655350.0 FORMAT "%8.1" /end CHARACTERISTIC
/begin CHARACTERISTIC DDRC_DurDeb.Com_tiCntTCU3DebOk_C "debouncing parameter / Duration of healing debouncing for check DFC_ComCntTCU3" VALUE 0x804D8754 Val_Wu16 655350.0 DDRCTime_ms 0.00 655350.0 FORMAT "%8.1" /end CHARACTERISTIC
/begin CHARACTERISTIC DDRC_DurDeb.Com_tiCntTCU3DebDef_C "debouncing parameter / Duration of defect debouncing for check DFC_ComCntTCU3" VALUE 0x804D8756 Val_Wu16 655350.0 DDRCTime_ms 0.00 655350.0 FORMAT "%8.1" /end CHARACTERISTIC
/begin CHARACTERISTIC DDRC_DurDeb.Com_tiCntTCU4DebOk_C "debouncing parameter / Duration of healing debouncing for check DFC_ComCntTCU4" VALUE 0x804D8758 Val_Wu16 655350.0 DDRCTime_ms 0.00 655350.0 FORMAT "%8.1" /end CHARACTERISTIC
/begin CHARACTERISTIC DDRC_DurDeb.Com_tiCntTCU4DebDef_C "debouncing parameter / Duration of defect debouncing for check DFC_ComCntTCU4" VALUE 0x804D875A Val_Wu16 655350.0 DDRCTime_ms 0.00 655350.0 FORMAT "%8.1" /end CHARACTERISTIC
/begin CHARACTERISTIC DDRC_DurDeb.Com_tiTOutTCU01DebOk_C "debouncing parameter / Duration of healing debouncing for check DFC_ComTOutTCU01" VALUE 0x804D875C Val_Wu16 655350.0 DDRCTime_ms 0.00 655350.0 FORMAT "%8.1" /end CHARACTERISTIC
/begin CHARACTERISTIC DDRC_DurDeb.Com_tiTOutTCU01DebDef_C "debouncing parameter / Duration of defect debouncing for check DFC_ComTOutTCU01" VALUE 0x804D875E Val_Wu16 655350.0 DDRCTime_ms 0.00 655350.0 FORMAT "%8.1" /end CHARACTERISTIC
/begin CHARACTERISTIC DDRC_DurDeb.Com_tiTOutTCU02DebOk_C "debouncing parameter / Duration of healing debouncing for check DFC_ComTOutTCU02" VALUE 0x804D8760 Val_Wu16 655350.0 DDRCTime_ms 0.00 655350.0 FORMAT "%8.1" /end CHARACTERISTIC
/begin CHARACTERISTIC DDRC_DurDeb.Com_tiTOutTCU02DebDef_C "debouncing parameter / Duration of defect debouncing for check DFC_ComTOutTCU02" VALUE 0x804D8762 Val_Wu16 655350.0 DDRCTime_ms 0.00 655350.0 FORMAT "%8.1" /end CHARACTERISTIC
/begin CHARACTERISTIC DDRC_DurDeb.Com_tiTOutTCU1DebOk_C "debouncing parameter / Duration of healing debouncing for check DFC_ComTOutTCU1" VALUE 0x804D8764 Val_Wu16 655350.0 DDRCTime_ms 0.00 655350.0 FORMAT "%8.1" /end CHARACTERISTIC
/begin CHARACTERISTIC DDRC_DurDeb.Com_tiTOutTCU1DebDef_C "debouncing parameter / Duration of defect debouncing for check DFC_ComTOutTCU1" VALUE 0x804D8766 Val_Wu16 655350.0 DDRCTime_ms 0.00 655350.0 FORMAT "%8.1" /end CHARACTERISTIC
/begin CHARACTERISTIC DDRC_DurDeb.Com_tiTOutTCU11DebOk_C "debouncing parameter / Duration of healing debouncing for check DFC_ComTOutTCU11" VALUE 0x804D8768 Val_Wu16 655350.0 DDRCTime_ms 0.00 655350.0 FORMAT "%8.1" /end CHARACTERISTIC
/begin CHARACTERISTIC DDRC_DurDeb.Com_tiTOutTCU11DebDef_C "debouncing parameter / Duration of defect debouncing for check DFC_ComTOutTCU11" VALUE 0x804D876A Val_Wu16 655350.0 DDRCTime_ms 0.00 655350.0 FORMAT "%8.1" /end CHARACTERISTIC
/begin CHARACTERISTIC DDRC_DurDeb.Com_tiTOutTCU12DebOk_C "debouncing parameter / Duration of healing debouncing for check DFC_ComTOutTCU12" VALUE 0x804D876C Val_Wu16 655350.0 DDRCTime_ms 0.00 655350.0 FORMAT "%8.1" /end CHARACTERISTIC
/begin CHARACTERISTIC DDRC_DurDeb.Com_tiTOutTCU12DebDef_C "debouncing parameter / Duration of defect debouncing for check DFC_ComTOutTCU12" VALUE 0x804D876E Val_Wu16 655350.0 DDRCTime_ms 0.00 655350.0 FORMAT "%8.1" /end CHARACTERISTIC
/begin CHARACTERISTIC DDRC_DurDeb.Com_tiTOutTCU13DebOk_C "debouncing parameter / Duration of healing debouncing for check DFC_ComTOutTCU13" VALUE 0x804D8770 Val_Wu16 655350.0 DDRCTime_ms 0.00 655350.0 FORMAT "%8.1" /end CHARACTERISTIC
/begin CHARACTERISTIC DDRC_DurDeb.Com_tiTOutTCU13DebDef_C "debouncing parameter / Duration of defect debouncing for check DFC_ComTOutTCU13" VALUE 0x804D8772 Val_Wu16 655350.0 DDRCTime_ms 0.00 655350.0 FORMAT "%8.1" /end CHARACTERISTIC
/begin CHARACTERISTIC DDRC_DurDeb.Com_tiTOutTCU14DebOk_C "debouncing parameter / Duration of healing debouncing for check DFC_ComTOutTCU14" VALUE 0x804D8774 Val_Wu16 655350.0 DDRCTime_ms 0.00 655350.0 FORMAT "%8.1" /end CHARACTERISTIC
/begin CHARACTERISTIC DDRC_DurDeb.Com_tiTOutTCU14DebDef_C "debouncing parameter / Duration of defect debouncing for check DFC_ComTOutTCU14" VALUE 0x804D8776 Val_Wu16 655350.0 DDRCTime_ms 0.00 655350.0 FORMAT "%8.1" /end CHARACTERISTIC
/begin CHARACTERISTIC DDRC_DurDeb.Com_tiTOutTCU2DebOk_C "debouncing parameter / Duration of healing debouncing for check DFC_ComTOutTCU2" VALUE 0x804D8778 Val_Wu16 655350.0 DDRCTime_ms 0.00 655350.0 FORMAT "%8.1" /end CHARACTERISTIC
/begin CHARACTERISTIC DDRC_DurDeb.Com_tiTOutTCU2DebDef_C "debouncing parameter / Duration of defect debouncing for check DFC_ComTOutTCU2" VALUE 0x804D877A Val_Wu16 655350.0 DDRCTime_ms 0.00 655350.0 FORMAT "%8.1" /end CHARACTERISTIC
/begin CHARACTERISTIC DDRC_DurDeb.Com_tiTOutTCU3DebOk_C "debouncing parameter / Duration of healing debouncing for check DFC_ComTOutTCU3" VALUE 0x804D877C Val_Wu16 655350.0 DDRCTime_ms 0.00 655350.0 FORMAT "%8.1" /end CHARACTERISTIC
/begin CHARACTERISTIC DDRC_DurDeb.Com_tiTOutTCU3DebDef_C "debouncing parameter / Duration of defect debouncing for check DFC_ComTOutTCU3" VALUE 0x804D877E Val_Wu16 655350.0 DDRCTime_ms 0.00 655350.0 FORMAT "%8.1" /end CHARACTERISTIC
/begin CHARACTERISTIC DDRC_DurDeb.Com_tiTOutTCU4DebOk_C "debouncing parameter / Duration of healing debouncing for check DFC_ComTOutTCU4" VALUE 0x804D8780 Val_Wu16 655350.0 DDRCTime_ms 0.00 655350.0 FORMAT "%8.1" /end CHARACTERISTIC
/begin CHARACTERISTIC DDRC_DurDeb.Com_tiTOutTCU4DebDef_C "debouncing parameter / Duration of defect debouncing for check DFC_ComTOutTCU4" VALUE 0x804D8782 Val_Wu16 655350.0 DDRCTime_ms 0.00 655350.0 FORMAT "%8.1" /end CHARACTERISTIC
/begin CHARACTERISTIC DDRC_DurDeb.DevLib_tiBattUHiDebOk_C "debouncing parameter / Duration of healing debouncing for check DFC_DevLibBattUHi" VALUE 0x804D8784 Val_Wu16 655350.0 DDRCTime_ms 0.00 655350.0 FORMAT "%8.1" /end CHARACTERISTIC
/begin CHARACTERISTIC DDRC_DurDeb.DevLib_tiBattUHiDebDef_C "debouncing parameter / Duration of defect debouncing for check DFC_DevLibBattUHi" VALUE 0x804D8786 Val_Wu16 655350.0 DDRCTime_ms 0.00 655350.0 FORMAT "%8.1" /end CHARACTERISTIC
/begin CHARACTERISTIC DDRC_DurDeb.DevLib_tiBattULoDebOk_C "debouncing parameter / Duration of healing debouncing for check DFC_DevLibBattULo" VALUE 0x804D8788 Val_Wu16 655350.0 DDRCTime_ms 0.00 655350.0 FORMAT "%8.1" /end CHARACTERISTIC
/begin CHARACTERISTIC DDRC_DurDeb.DevLib_tiBattULoDebDef_C "debouncing parameter / Duration of defect debouncing for check DFC_DevLibBattULo" VALUE 0x804D878A Val_Wu16 655350.0 DDRCTime_ms 0.00 655350.0 FORMAT "%8.1" /end CHARACTERISTIC
/begin CHARACTERISTIC DDRC_DurDeb.EGRVlv_tiFailSafeActvDebOk_C "debouncing parameter / Duration of healing debouncing for check DFC_EGRVlvFailSafeActv" VALUE 0x804D878C Val_Wu16 655350.0 DDRCTime_ms 0.00 655350.0 FORMAT "%8.1" /end CHARACTERISTIC
/begin CHARACTERISTIC DDRC_DurDeb.EGRVlv_tiFailSafeActvDebDef_C "debouncing parameter / Duration of defect debouncing for check DFC_EGRVlvFailSafeActv" VALUE 0x804D878E Val_Wu16 655350.0 DDRCTime_ms 0.00 655350.0 FORMAT "%8.1" /end CHARACTERISTIC
/begin CHARACTERISTIC DDRC_DurDeb.EGRVlv_tiGovDvtCldDebOk_C "debouncing parameter / Duration of healing debouncing for check DFC_EGRVlvGovDvtCld" VALUE 0x804D8790 Val_Wu16 655350.0 DDRCTime_ms 0.00 655350.0 FORMAT "%8.1" /end CHARACTERISTIC
/begin CHARACTERISTIC DDRC_DurDeb.EGRVlv_tiGovDvtCldDebDef_C "debouncing parameter / Duration of defect debouncing for check DFC_EGRVlvGovDvtCld" VALUE 0x804D8792 Val_Wu16 655350.0 DDRCTime_ms 0.00 655350.0 FORMAT "%8.1" /end CHARACTERISTIC
/begin CHARACTERISTIC DDRC_DurDeb.EGRVlv_tiPhysSRCMaxDebOk_C "debouncing parameter / Duration of healing debouncing for check DFC_EGRVlvPhysSRCMax" VALUE 0x804D8794 Val_Wu16 655350.0 DDRCTime_ms 0.00 655350.0 FORMAT "%8.1" /end CHARACTERISTIC
/begin CHARACTERISTIC DDRC_DurDeb.EGRVlv_tiPhysSRCMaxDebDef_C "debouncing parameter / Duration of defect debouncing for check DFC_EGRVlvPhysSRCMax" VALUE 0x804D8796 Val_Wu16 655350.0 DDRCTime_ms 0.00 655350.0 FORMAT "%8.1" /end CHARACTERISTIC
/begin CHARACTERISTIC DDRC_DurDeb.EGRVlv_tiPhysSRCMinDebOk_C "debouncing parameter / Duration of healing debouncing for check DFC_EGRVlvPhysSRCMin" VALUE 0x804D8798 Val_Wu16 655350.0 DDRCTime_ms 0.00 655350.0 FORMAT "%8.1" /end CHARACTERISTIC
/begin CHARACTERISTIC DDRC_DurDeb.EGRVlv_tiPhysSRCMinDebDef_C "debouncing parameter / Duration of defect debouncing for check DFC_EGRVlvPhysSRCMin" VALUE 0x804D879A Val_Wu16 655350.0 DDRCTime_ms 0.00 655350.0 FORMAT "%8.1" /end CHARACTERISTIC
/begin CHARACTERISTIC DDRC_DurDeb.Fan_tiDIOOLDebOk_C "debouncing parameter / Duration of healing debouncing for check DFC_FanDIOOL" VALUE 0x804D879C Val_Wu16 655350.0 DDRCTime_ms 0.00 655350.0 FORMAT "%8.1" /end CHARACTERISTIC
/begin CHARACTERISTIC DDRC_DurDeb.Fan_tiDIOOLDebDef_C "debouncing parameter / Duration of defect debouncing for check DFC_FanDIOOL" VALUE 0x804D879E Val_Wu16 655350.0 DDRCTime_ms 0.00 655350.0 FORMAT "%8.1" /end CHARACTERISTIC
/begin CHARACTERISTIC DDRC_DurDeb.Fan_tiDIOOvrTempDebOk_C "debouncing parameter / Duration of healing debouncing for check DFC_FanDIOOvrTemp" VALUE 0x804D87A0 Val_Wu16 655350.0 DDRCTime_ms 0.00 655350.0 FORMAT "%8.1" /end CHARACTERISTIC
/begin CHARACTERISTIC DDRC_DurDeb.Fan_tiDIOOvrTempDebDef_C "debouncing parameter / Duration of defect debouncing for check DFC_FanDIOOvrTemp" VALUE 0x804D87A2 Val_Wu16 655350.0 DDRCTime_ms 0.00 655350.0 FORMAT "%8.1" /end CHARACTERISTIC
/begin CHARACTERISTIC DDRC_DurDeb.Fan_tiDIOSCBDebOk_C "debouncing parameter / Duration of healing debouncing for check DFC_FanDIOSCB" VALUE 0x804D87A4 Val_Wu16 655350.0 DDRCTime_ms 0.00 655350.0 FORMAT "%8.1" /end CHARACTERISTIC
/begin CHARACTERISTIC DDRC_DurDeb.Fan_tiDIOSCBDebDef_C "debouncing parameter / Duration of defect debouncing for check DFC_FanDIOSCB" VALUE 0x804D87A6 Val_Wu16 655350.0 DDRCTime_ms 0.00 655350.0 FORMAT "%8.1" /end CHARACTERISTIC
/begin CHARACTERISTIC DDRC_DurDeb.Fan_tiDIOSCGDebOk_C "debouncing parameter / Duration of healing debouncing for check DFC_FanDIOSCG" VALUE 0x804D87A8 Val_Wu16 655350.0 DDRCTime_ms 0.00 655350.0 FORMAT "%8.1" /end CHARACTERISTIC
/begin CHARACTERISTIC DDRC_DurDeb.Fan_tiDIOSCGDebDef_C "debouncing parameter / Duration of defect debouncing for check DFC_FanDIOSCG" VALUE 0x804D87AA Val_Wu16 655350.0 DDRCTime_ms 0.00 655350.0 FORMAT "%8.1" /end CHARACTERISTIC
/begin CHARACTERISTIC DDRC_DurDeb.MRlyDcOL_tisigOLDebOk_C "debouncing parameter / Duration of healing debouncing for check DFC_MRlyDcOL" VALUE 0x804D87AC Val_Wu16 655350.0 DDRCTime_ms 0.00 655350.0 FORMAT "%8.1" /end CHARACTERISTIC
/begin CHARACTERISTIC DDRC_DurDeb.MRlyDcOL_tisigOLDebDef_C "debouncing parameter / Duration of defect debouncing for check DFC_MRlyDcOL" VALUE 0x804D87AE Val_Wu16 655350.0 DDRCTime_ms 0.00 655350.0 FORMAT "%8.1" /end CHARACTERISTIC
/begin CHARACTERISTIC DDRC_DurDeb.MRlyDcSCB_tisigSCBDebOk_C "debouncing parameter / Duration of healing debouncing for check DFC_MRlyDcSCB" VALUE 0x804D87B0 Val_Wu16 655350.0 DDRCTime_ms 0.00 655350.0 FORMAT "%8.1" /end CHARACTERISTIC
/begin CHARACTERISTIC DDRC_DurDeb.MRlyDcSCB_tisigSCBDebDef_C "debouncing parameter / Duration of defect debouncing for check DFC_MRlyDcSCB" VALUE 0x804D87B2 Val_Wu16 655350.0 DDRCTime_ms 0.00 655350.0 FORMAT "%8.1" /end CHARACTERISTIC
/begin CHARACTERISTIC DDRC_DurDeb.MRlyDcSCG_tisigSCGDebOk_C "debouncing parameter / Duration of healing debouncing for check DFC_MRlyDcSCG" VALUE 0x804D87B4 Val_Wu16 655350.0 DDRCTime_ms 0.00 655350.0 FORMAT "%8.1" /end CHARACTERISTIC
/begin CHARACTERISTIC DDRC_DurDeb.MRlyDcSCG_tisigSCGDebDef_C "debouncing parameter / Duration of defect debouncing for check DFC_MRlyDcSCG" VALUE 0x804D87B6 Val_Wu16 655350.0 DDRCTime_ms 0.00 655350.0 FORMAT "%8.1" /end CHARACTERISTIC
/begin CHARACTERISTIC DDRC_DurDeb.PSP_tiOLDebOk_C "debouncing parameter / Duration of healing debouncing for check DFC_PSPOL" VALUE 0x804D87B8 Val_Wu16 655350.0 DDRCTime_ms 0.00 655350.0 FORMAT "%8.1" /end CHARACTERISTIC
/begin CHARACTERISTIC DDRC_DurDeb.PSP_tiOLDebDef_C "debouncing parameter / Duration of defect debouncing for check DFC_PSPOL" VALUE 0x804D87BA Val_Wu16 655350.0 DDRCTime_ms 0.00 655350.0 FORMAT "%8.1" /end CHARACTERISTIC
/begin CHARACTERISTIC DDRC_DurDeb.PSP_tiOvrTempDebOk_C "debouncing parameter / Duration of healing debouncing for check DFC_PSPOvrTemp" VALUE 0x804D87BC Val_Wu16 655350.0 DDRCTime_ms 0.00 655350.0 FORMAT "%8.1" /end CHARACTERISTIC
/begin CHARACTERISTIC DDRC_DurDeb.PSP_tiOvrTempDebDef_C "debouncing parameter / Duration of defect debouncing for check DFC_PSPOvrTemp" VALUE 0x804D87BE Val_Wu16 655350.0 DDRCTime_ms 0.00 655350.0 FORMAT "%8.1" /end CHARACTERISTIC
/begin CHARACTERISTIC DDRC_DurDeb.PSP_tiSCBDebOk_C "debouncing parameter / Duration of healing debouncing for check DFC_PSPSCB" VALUE 0x804D87C0 Val_Wu16 655350.0 DDRCTime_ms 0.00 655350.0 FORMAT "%8.1" /end CHARACTERISTIC
/begin CHARACTERISTIC DDRC_DurDeb.PSP_tiSCBDebDef_C "debouncing parameter / Duration of defect debouncing for check DFC_PSPSCB" VALUE 0x804D87C2 Val_Wu16 655350.0 DDRCTime_ms 0.00 655350.0 FORMAT "%8.1" /end CHARACTERISTIC
/begin CHARACTERISTIC DDRC_DurDeb.PSP_tiSCGDebOk_C "debouncing parameter / Duration of healing debouncing for check DFC_PSPSCG" VALUE 0x804D87C4 Val_Wu16 655350.0 DDRCTime_ms 0.00 655350.0 FORMAT "%8.1" /end CHARACTERISTIC
/begin CHARACTERISTIC DDRC_DurDeb.PSP_tiSCGDebDef_C "debouncing parameter / Duration of defect debouncing for check DFC_PSPSCG" VALUE 0x804D87C6 Val_Wu16 655350.0 DDRCTime_ms 0.00 655350.0 FORMAT "%8.1" /end CHARACTERISTIC
/begin CHARACTERISTIC DDRC_DurDeb.T50_tiErrDebOk_C "debouncing parameter / Duration of healing debouncing for check DFC_T50Err" VALUE 0x804D87C8 Val_Wu16 655350.0 DDRCTime_ms 0.00 655350.0 FORMAT "%8.1" /end CHARACTERISTIC
/begin CHARACTERISTIC DDRC_DurDeb.T50_tiErrDebDef_C "debouncing parameter / Duration of defect debouncing for check DFC_T50Err" VALUE 0x804D87CA Val_Wu16 655350.0 DDRCTime_ms 0.00 655350.0 FORMAT "%8.1" /end CHARACTERISTIC
/begin CHARACTERISTIC DDRC_DurDeb.ThrVlv_tiLoBattB1DebOk_C "debouncing parameter / Duration of healing debouncing for check DFC_ThrVlvLoBattB1" VALUE 0x804D87CC Val_Wu16 655350.0 DDRCTime_ms 0.00 655350.0 FORMAT "%8.1" /end CHARACTERISTIC
/begin CHARACTERISTIC DDRC_DurDeb.ThrVlv_tiLoBattB1DebDef_C "debouncing parameter / Duration of defect debouncing for check DFC_ThrVlvLoBattB1" VALUE 0x804D87CE Val_Wu16 655350.0 DDRCTime_ms 0.00 655350.0 FORMAT "%8.1" /end CHARACTERISTIC
/begin CHARACTERISTIC DDRC_DurDeb.UEGO_tiOperPlausDebOk_C "debouncing parameter / Duration of healing debouncing for check DFC_UegoSigOperPlausS1B1" VALUE 0x804D87D0 Val_Wu16 655350.0 DDRCTime_ms 0.00 655350.0 FORMAT "%8.1" /end CHARACTERISTIC
/begin CHARACTERISTIC DDRC_DurDeb.UEGO_tiOperPlausDebDef_C "debouncing parameter / Duration of defect debouncing for check DFC_UegoSigOperPlausS1B1" VALUE 0x804D87D2 Val_Wu16 655350.0 DDRCTime_ms 0.00 655350.0 FORMAT "%8.1" /end CHARACTERISTIC
/begin CHARACTERISTIC DDRC_DurDeb.VehV_tiCANSigFLDebOk_C "debouncing parameter / Duration of healing debouncing for check DFC_VehVSigFL" VALUE 0x804D87D4 Val_Wu16 655350.0 DDRCTime_ms 0.00 655350.0 FORMAT "%8.1" /end CHARACTERISTIC
/begin CHARACTERISTIC DDRC_DurDeb.VehV_tiCANSigFLDebDef_C "debouncing parameter / Duration of defect debouncing for check DFC_VehVSigFL" VALUE 0x804D87D6 Val_Wu16 655350.0 DDRCTime_ms 0.00 655350.0 FORMAT "%8.1" /end CHARACTERISTIC
/begin CHARACTERISTIC DDRC_DurDeb.VehV_tiCANSigFRDebOk_C "debouncing parameter / Duration of healing debouncing for check DFC_VehVSigFR" VALUE 0x804D87D8 Val_Wu16 655350.0 DDRCTime_ms 0.00 655350.0 FORMAT "%8.1" /end CHARACTERISTIC
/begin CHARACTERISTIC DDRC_DurDeb.VehV_tiCANSigFRDebDef_C "debouncing parameter / Duration of defect debouncing for check DFC_VehVSigFR" VALUE 0x804D87DA Val_Wu16 655350.0 DDRCTime_ms 0.00 655350.0 FORMAT "%8.1" /end CHARACTERISTIC
/begin CHARACTERISTIC DDRC_DurDeb.VehV_tiCANSigRLDebOk_C "debouncing parameter / Duration of healing debouncing for check DFC_VehVSigRL" VALUE 0x804D87DC Val_Wu16 655350.0 DDRCTime_ms 0.00 655350.0 FORMAT "%8.1" /end CHARACTERISTIC
/begin CHARACTERISTIC DDRC_DurDeb.VehV_tiCANSigRLDebDef_C "debouncing parameter / Duration of defect debouncing for check DFC_VehVSigRL" VALUE 0x804D87DE Val_Wu16 655350.0 DDRCTime_ms 0.00 655350.0 FORMAT "%8.1" /end CHARACTERISTIC
/begin CHARACTERISTIC DDRC_DurDeb.VehV_tiCANSigRRDebOk_C "debouncing parameter / Duration of healing debouncing for check DFC_VehVSigRR" VALUE 0x804D87E0 Val_Wu16 655350.0 DDRCTime_ms 0.00 655350.0 FORMAT "%8.1" /end CHARACTERISTIC
/begin CHARACTERISTIC DDRC_DurDeb.VehV_tiCANSigRRDebDef_C "debouncing parameter / Duration of defect debouncing for check DFC_VehVSigRR" VALUE 0x804D87E2 Val_Wu16 655350.0 DDRCTime_ms 0.00 655350.0 FORMAT "%8.1" /end CHARACTERISTIC
/begin CHARACTERISTIC DDRC_DurDeb.VehV_tiOLDebOk_C "debouncing parameter / Duration of healing debouncing for check DFC_VehVSclOutOL" VALUE 0x804D87E4 Val_Wu16 655350.0 DDRCTime_ms 0.00 655350.0 FORMAT "%8.1" /end CHARACTERISTIC
/begin CHARACTERISTIC DDRC_DurDeb.VehV_tiOLDebDef_C "debouncing parameter / Duration of defect debouncing for check DFC_VehVSclOutOL" VALUE 0x804D87E6 Val_Wu16 655350.0 DDRCTime_ms 0.00 655350.0 FORMAT "%8.1" /end CHARACTERISTIC
/begin CHARACTERISTIC DDRC_DurDeb.VehV_tiOTDebOk_C "debouncing parameter / Duration of healing debouncing for check DFC_VehVSclOutOT" VALUE 0x804D87E8 Val_Wu16 655350.0 DDRCTime_ms 0.00 655350.0 FORMAT "%8.1" /end CHARACTERISTIC
/begin CHARACTERISTIC DDRC_DurDeb.VehV_tiOTDebDef_C "debouncing parameter / Duration of defect debouncing for check DFC_VehVSclOutOT" VALUE 0x804D87EA Val_Wu16 655350.0 DDRCTime_ms 0.00 655350.0 FORMAT "%8.1" /end CHARACTERISTIC
/begin CHARACTERISTIC DDRC_DurDeb.VehV_tiPhysRngHiDebOk_C "debouncing parameter / Duration of healing debouncing for check DFC_VehVPhysRngHi" VALUE 0x804D87EC Val_Wu16 655350.0 DDRCTime_ms 0.00 655350.0 FORMAT "%8.1" /end CHARACTERISTIC
/begin CHARACTERISTIC DDRC_DurDeb.VehV_tiPhysRngHiDebDef_C "debouncing parameter / Duration of defect debouncing for check DFC_VehVPhysRngHi" VALUE 0x804D87EE Val_Wu16 655350.0 DDRCTime_ms 0.00 655350.0 FORMAT "%8.1" /end CHARACTERISTIC
/begin CHARACTERISTIC DDRC_DurDeb.VehV_tiSCBDebOk_C "debouncing parameter / Duration of healing debouncing for check DFC_VehVSclOutSCB" VALUE 0x804D87F0 Val_Wu16 655350.0 DDRCTime_ms 0.00 655350.0 FORMAT "%8.1" /end CHARACTERISTIC
/begin CHARACTERISTIC DDRC_DurDeb.VehV_tiSCBDebDef_C "debouncing parameter / Duration of defect debouncing for check DFC_VehVSclOutSCB" VALUE 0x804D87F2 Val_Wu16 655350.0 DDRCTime_ms 0.00 655350.0 FORMAT "%8.1" /end CHARACTERISTIC
/begin CHARACTERISTIC DDRC_DurDeb.VehV_tiSCGDebOk_C "debouncing parameter / Duration of healing debouncing for check DFC_VehVSclOutSCG" VALUE 0x804D87F4 Val_Wu16 655350.0 DDRCTime_ms 0.00 655350.0 FORMAT "%8.1" /end CHARACTERISTIC
/begin CHARACTERISTIC DDRC_DurDeb.VehV_tiSCGDebDef_C "debouncing parameter / Duration of defect debouncing for check DFC_VehVSclOutSCG" VALUE 0x804D87F6 Val_Wu16 655350.0 DDRCTime_ms 0.00 655350.0 FORMAT "%8.1" /end CHARACTERISTIC
/begin CHARACTERISTIC DDRC_DurDeb.VehV_tiSnsrARngHiDebOk_C "debouncing parameter / Duration of healing debouncing for check DFC_VehVSnsrARngHi" VALUE 0x804D87F8 Val_Wu16 655350.0 DDRCTime_ms 0.00 655350.0 FORMAT "%8.1" /end CHARACTERISTIC
/begin CHARACTERISTIC DDRC_DurDeb.VehV_tiSnsrARngHiDebDef_C "debouncing parameter / Duration of defect debouncing for check DFC_VehVSnsrARngHi" VALUE 0x804D87FA Val_Wu16 655350.0 DDRCTime_ms 0.00 655350.0 FORMAT "%8.1" /end CHARACTERISTIC
/begin CHARACTERISTIC DDRC_DurDeb.VehV_tiSnsrBRngHiDebOk_C "debouncing parameter / Duration of healing debouncing for check DFC_VehVSnsrBRngHi" VALUE 0x804D87FC Val_Wu16 655350.0 DDRCTime_ms 0.00 655350.0 FORMAT "%8.1" /end CHARACTERISTIC
/begin CHARACTERISTIC DDRC_DurDeb.VehV_tiSnsrBRngHiDebDef_C "debouncing parameter / Duration of defect debouncing for check DFC_VehVSnsrBRngHi" VALUE 0x804D87FE Val_Wu16 655350.0 DDRCTime_ms 0.00 655350.0 FORMAT "%8.1" /end CHARACTERISTIC
/begin CHARACTERISTIC DDRC_DurDeb.VehV_tiSpdRtyDiagDebOk_C "debouncing parameter / Duration of healing debouncing for check DFC_VehVSpdRtyDiag" VALUE 0x804D8800 Val_Wu16 655350.0 DDRCTime_ms 0.00 655350.0 FORMAT "%8.1" /end CHARACTERISTIC
/begin CHARACTERISTIC DDRC_DurDeb.VehV_tiSpdRtyDiagDebDef_C "debouncing parameter / Duration of defect debouncing for check DFC_VehVSpdRtyDiag" VALUE 0x804D8802 Val_Wu16 655350.0 DDRCTime_ms 0.00 655350.0 FORMAT "%8.1" /end CHARACTERISTIC
/begin CHARACTERISTIC DDRC_DurDeb.DDHFHD_numDhfDebDef_CDebOk_C "debouncing parameter / Duration of healing debouncing for check DFC_DHFHD" VALUE 0x804D8804 Val_Wu16 65535.00 OneToOne 0.00 65535.00 FORMAT "%8.2" /end CHARACTERISTIC
/begin CHARACTERISTIC DDRC_DurDeb.DDHFHD_numDhfDebDef_CDebDef_C "debouncing parameter / Duration of defect debouncing for check DFC_DHFHD" VALUE 0x804D8806 Val_Wu16 65535.00 OneToOne 0.00 65535.00 FORMAT "%8.2" /end CHARACTERISTIC
/begin CHARACTERISTIC DDRC_DurDeb.InjVlv_numDcDcDebOk_C "debouncing parameter / Duration of healing debouncing for check DFC_InjVlv_DI_DcDc" VALUE 0x804D8808 Val_Wu16 65535.00 OneToOne 0.00 65535.00 FORMAT "%8.2" /end CHARACTERISTIC
/begin CHARACTERISTIC DDRC_DurDeb.InjVlv_numDcDcDebDef_C "debouncing parameter / Duration of defect debouncing for check DFC_InjVlv_DI_DcDc" VALUE 0x804D880A Val_Wu16 65535.00 OneToOne 0.00 65535.00 FORMAT "%8.2" /end CHARACTERISTIC
/begin CHARACTERISTIC DDRC_DurDeb.InjVlv_numNoLdDebOk_C "debouncing parameter / Duration of healing debouncing for check DFC_InjVlv_DI_NoLd" VALUE 0x804D880C Val_Wu16 65535.00 OneToOne 0.00 65535.00 FORMAT "%8.2" /end CHARACTERISTIC
/begin CHARACTERISTIC DDRC_DurDeb.InjVlv_numNoLdDebDef_C "debouncing parameter / Duration of defect debouncing for check DFC_InjVlv_DI_NoLd" VALUE 0x804D880E Val_Wu16 65535.00 OneToOne 0.00 65535.00 FORMAT "%8.2" /end CHARACTERISTIC
/begin CHARACTERISTIC DDRC_DurDeb.InjVlv_numScBnkDebOk_C "debouncing parameter / Duration of healing debouncing for check DFC_InjVlv_DI_ScBnk" VALUE 0x804D8810 Val_Wu16 65535.00 OneToOne 0.00 65535.00 FORMAT "%8.2" /end CHARACTERISTIC
/begin CHARACTERISTIC DDRC_DurDeb.InjVlv_numScBnkDebDef_C "debouncing parameter / Duration of defect debouncing for check DFC_InjVlv_DI_ScBnk" VALUE 0x804D8812 Val_Wu16 65535.00 OneToOne 0.00 65535.00 FORMAT "%8.2" /end CHARACTERISTIC
/begin CHARACTERISTIC DDRC_DurDeb.InjVlv_numScCylDebOk_C "debouncing parameter / Duration of healing debouncing for check DFC_InjVlv_DI_ScCyl" VALUE 0x804D8814 Val_Wu16 65535.00 OneToOne 0.00 65535.00 FORMAT "%8.2" /end CHARACTERISTIC
/begin CHARACTERISTIC DDRC_DurDeb.InjVlv_numScCylDebDef_C "debouncing parameter / Duration of defect debouncing for check DFC_InjVlv_DI_ScCyl" VALUE 0x804D8816 Val_Wu16 65535.00 OneToOne 0.00 65535.00 FORMAT "%8.2" /end CHARACTERISTIC
/begin CHARACTERISTIC DDRC_DurDeb.InjVlv_numScHsLsDebOk_C "debouncing parameter / Duration of healing debouncing for check DFC_InjVlv_DI_ScHsLs" VALUE 0x804D8818 Val_Wu16 65535.00 OneToOne 0.00 65535.00 FORMAT "%8.2" /end CHARACTERISTIC
/begin CHARACTERISTIC DDRC_DurDeb.InjVlv_numScHsLsDebDef_C "debouncing parameter / Duration of defect debouncing for check DFC_InjVlv_DI_ScHsLs" VALUE 0x804D881A Val_Wu16 65535.00 OneToOne 0.00 65535.00 FORMAT "%8.2" /end CHARACTERISTIC
/begin CHARACTERISTIC DDRC_DurDeb.MfPsDia_numOpenLoadDebOk_C "debouncing parameter / Duration of healing debouncing for check DFC_MfPsDiaOpenLoad1" VALUE 0x804D881C Val_Wu16 65535.00 OneToOne 0.00 65535.00 FORMAT "%8.2" /end CHARACTERISTIC
/begin CHARACTERISTIC DDRC_DurDeb.MfPsDia_numOpenLoadDebDef_C "debouncing parameter / Duration of defect debouncing for check DFC_MfPsDiaOpenLoad1" VALUE 0x804D881E Val_Wu16 65535.00 OneToOne 0.00 65535.00 FORMAT "%8.2" /end CHARACTERISTIC
/begin CHARACTERISTIC DDRC_DurDeb.MfPsDia_numScHiSDebOk_C "debouncing parameter / Duration of healing debouncing for check DFC_MfPsDiaScHiS1" VALUE 0x804D8820 Val_Wu16 65535.00 OneToOne 0.00 65535.00 FORMAT "%8.2" /end CHARACTERISTIC
/begin CHARACTERISTIC DDRC_DurDeb.MfPsDia_numScHiSDebDef_C "debouncing parameter / Duration of defect debouncing for check DFC_MfPsDiaScHiS1" VALUE 0x804D8822 Val_Wu16 65535.00 OneToOne 0.00 65535.00 FORMAT "%8.2" /end CHARACTERISTIC
/begin CHARACTERISTIC DDRC_DurDeb.MfPsDia_numScHiSLowSDebOk_C "debouncing parameter / Duration of healing debouncing for check DFC_MfPsDiaScHiSLowS1" VALUE 0x804D8824 Val_Wu16 65535.00 OneToOne 0.00 65535.00 FORMAT "%8.2" /end CHARACTERISTIC
/begin CHARACTERISTIC DDRC_DurDeb.MfPsDia_numScHiSLowSDebDef_C "debouncing parameter / Duration of defect debouncing for check DFC_MfPsDiaScHiSLowS1" VALUE 0x804D8826 Val_Wu16 65535.00 OneToOne 0.00 65535.00 FORMAT "%8.2" /end CHARACTERISTIC
/begin CHARACTERISTIC DDRC_DurDeb.MfPsDia_numScLowSDebOk_C "debouncing parameter / Duration of healing debouncing for check DFC_MfPsDiaScLowS1" VALUE 0x804D8828 Val_Wu16 65535.00 OneToOne 0.00 65535.00 FORMAT "%8.2" /end CHARACTERISTIC
/begin CHARACTERISTIC DDRC_DurDeb.MfPsDia_numScLowSDebDef_C "debouncing parameter / Duration of defect debouncing for check DFC_MfPsDiaScLowS1" VALUE 0x804D882A Val_Wu16 65535.00 OneToOne 0.00 65535.00 FORMAT "%8.2" /end CHARACTERISTIC
/begin CHARACTERISTIC DDRC_DurDeb.ACEvpT_tiPhysRngHiDebOk_C "debouncing parameter / Duration of healing debouncing for check DFC_ACEvpTPhysRngHi" VALUE 0x804D882C Val_Wu16 655350.0 DDRCTime_ms 0.00 655350.0 FORMAT "%8.1" /end CHARACTERISTIC
/begin CHARACTERISTIC DDRC_DurDeb.ACEvpT_tiPhysRngHiDebDef_C "debouncing parameter / Duration of defect debouncing for check DFC_ACEvpTPhysRngHi" VALUE 0x804D882E Val_Wu16 655350.0 DDRCTime_ms 0.00 655350.0 FORMAT "%8.1" /end CHARACTERISTIC
/begin CHARACTERISTIC DDRC_DurDeb.ACEvpT_tiPhysRngLoDebOk_C "debouncing parameter / Duration of healing debouncing for check DFC_ACEvpTPhysRngLo" VALUE 0x804D8830 Val_Wu16 655350.0 DDRCTime_ms 0.00 655350.0 FORMAT "%8.1" /end CHARACTERISTIC
/begin CHARACTERISTIC DDRC_DurDeb.ACEvpT_tiPhysRngLoDebDef_C "debouncing parameter / Duration of defect debouncing for check DFC_ACEvpTPhysRngLo" VALUE 0x804D8832 Val_Wu16 655350.0 DDRCTime_ms 0.00 655350.0 FORMAT "%8.1" /end CHARACTERISTIC
/begin CHARACTERISTIC DDRC_DurDeb.ACEvpT_tiSRCMaxDebOk_C "debouncing parameter / Duration of healing debouncing for check DFC_ACEvpTSRCMax" VALUE 0x804D8834 Val_Wu16 655350.0 DDRCTime_ms 0.00 655350.0 FORMAT "%8.1" /end CHARACTERISTIC
/begin CHARACTERISTIC DDRC_DurDeb.ACEvpT_tiSRCMaxDebDef_C "debouncing parameter / Duration of defect debouncing for check DFC_ACEvpTSRCMax" VALUE 0x804D8836 Val_Wu16 655350.0 DDRCTime_ms 0.00 655350.0 FORMAT "%8.1" /end CHARACTERISTIC
/begin CHARACTERISTIC DDRC_DurDeb.ACEvpT_tiSRCMinDebOk_C "debouncing parameter / Duration of healing debouncing for check DFC_ACEvpTSRCMin" VALUE 0x804D8838 Val_Wu16 655350.0 DDRCTime_ms 0.00 655350.0 FORMAT "%8.1" /end CHARACTERISTIC
/begin CHARACTERISTIC DDRC_DurDeb.ACEvpT_tiSRCMinDebDef_C "debouncing parameter / Duration of defect debouncing for check DFC_ACEvpTSRCMin" VALUE 0x804D883A Val_Wu16 655350.0 DDRCTime_ms 0.00 655350.0 FORMAT "%8.1" /end CHARACTERISTIC
/begin CHARACTERISTIC DDRC_DurDeb.AFS_tiRawSigRngHiB1DebOk_C "debouncing parameter / Duration of healing debouncing for check DFC_AfsRawSigRngHiB1" VALUE 0x804D883C Val_Wu16 655350.0 DDRCTime_ms 0.00 655350.0 FORMAT "%8.1" /end CHARACTERISTIC
/begin CHARACTERISTIC DDRC_DurDeb.AFS_tiRawSigRngHiB1DebDef_C "debouncing parameter / Duration of defect debouncing for check DFC_AfsRawSigRngHiB1" VALUE 0x804D883E Val_Wu16 655350.0 DDRCTime_ms 0.00 655350.0 FORMAT "%8.1" /end CHARACTERISTIC
/begin CHARACTERISTIC DDRC_DurDeb.AFS_tiRawSigRngLoB1DebOk_C "debouncing parameter / Duration of healing debouncing for check DFC_AfsRawSigRngLoB1" VALUE 0x804D8840 Val_Wu16 655350.0 DDRCTime_ms 0.00 655350.0 FORMAT "%8.1" /end CHARACTERISTIC
/begin CHARACTERISTIC DDRC_DurDeb.AFS_tiRawSigRngLoB1DebDef_C "debouncing parameter / Duration of defect debouncing for check DFC_AfsRawSigRngLoB1" VALUE 0x804D8842 Val_Wu16 655350.0 DDRCTime_ms 0.00 655350.0 FORMAT "%8.1" /end CHARACTERISTIC
/begin CHARACTERISTIC DDRC_DurDeb.AFS_tiSnsrErrB1DebOk_C "debouncing parameter / Duration of healing debouncing for check DFC_AfsSnsrErrB1" VALUE 0x804D8844 Val_Wu16 655350.0 DDRCTime_ms 0.00 655350.0 FORMAT "%8.1" /end CHARACTERISTIC
/begin CHARACTERISTIC DDRC_DurDeb.AFS_tiSnsrErrB1DebDef_C "debouncing parameter / Duration of defect debouncing for check DFC_AfsSnsrErrB1" VALUE 0x804D8846 Val_Wu16 655350.0 DDRCTime_ms 0.00 655350.0 FORMAT "%8.1" /end CHARACTERISTIC
/begin CHARACTERISTIC DDRC_DurDeb.AirC_tiClntSRCMaxDebOk_C "debouncing parameter / Duration of healing debouncing for check DFC_AirCClntPAnaSRCMax" VALUE 0x804D8848 Val_Wu16 655350.0 DDRCTime_ms 0.00 655350.0 FORMAT "%8.1" /end CHARACTERISTIC
/begin CHARACTERISTIC DDRC_DurDeb.AirC_tiClntSRCMaxDebDef_C "debouncing parameter / Duration of defect debouncing for check DFC_AirCClntPAnaSRCMax" VALUE 0x804D884A Val_Wu16 655350.0 DDRCTime_ms 0.00 655350.0 FORMAT "%8.1" /end CHARACTERISTIC
/begin CHARACTERISTIC DDRC_DurDeb.AirC_tiClntSRCMinDebOk_C "debouncing parameter / Duration of healing debouncing for check DFC_AirCClntPAnaSRCMin" VALUE 0x804D884C Val_Wu16 655350.0 DDRCTime_ms 0.00 655350.0 FORMAT "%8.1" /end CHARACTERISTIC
/begin CHARACTERISTIC DDRC_DurDeb.AirC_tiClntSRCMinDebDef_C "debouncing parameter / Duration of defect debouncing for check DFC_AirCClntPAnaSRCMin" VALUE 0x804D884E Val_Wu16 655350.0 DDRCTime_ms 0.00 655350.0 FORMAT "%8.1" /end CHARACTERISTIC
/begin CHARACTERISTIC DDRC_DurDeb.AirC_tiSwtNplDebOk_C "debouncing parameter / Duration of healing debouncing for check DFC_AirCSwtNpl" VALUE 0x804D8850 Val_Wu16 655350.0 DDRCTime_ms 0.00 655350.0 FORMAT "%8.1" /end CHARACTERISTIC
/begin CHARACTERISTIC DDRC_DurDeb.AirC_tiSwtNplDebDef_C "debouncing parameter / Duration of defect debouncing for check DFC_AirCSwtNpl" VALUE 0x804D8852 Val_Wu16 655350.0 DDRCTime_ms 0.00 655350.0 FORMAT "%8.1" /end CHARACTERISTIC
/begin CHARACTERISTIC DDRC_DurDeb.AirC_tiSwtSigDebOk_C "debouncing parameter / Duration of healing debouncing for check DFC_AirCSwtSig" VALUE 0x804D8854 Val_Wu16 655350.0 DDRCTime_ms 0.00 655350.0 FORMAT "%8.1" /end CHARACTERISTIC
/begin CHARACTERISTIC DDRC_DurDeb.AirC_tiSwtSigDebDef_C "debouncing parameter / Duration of defect debouncing for check DFC_AirCSwtSig" VALUE 0x804D8856 Val_Wu16 655350.0 DDRCTime_ms 0.00 655350.0 FORMAT "%8.1" /end CHARACTERISTIC
/begin CHARACTERISTIC DDRC_DurDeb.BrkBstP_tiSCBDebOk_C "debouncing parameter / Duration of healing debouncing for check DFC_BrkBstSensSCB" VALUE 0x804D8858 Val_Wu16 655350.0 DDRCTime_ms 0.00 655350.0 FORMAT "%8.1" /end CHARACTERISTIC
/begin CHARACTERISTIC DDRC_DurDeb.BrkBstP_tiSCBDebDef_C "debouncing parameter / Duration of defect debouncing for check DFC_BrkBstSensSCB" VALUE 0x804D885A Val_Wu16 655350.0 DDRCTime_ms 0.00 655350.0 FORMAT "%8.1" /end CHARACTERISTIC
/begin CHARACTERISTIC DDRC_DurDeb.BrkBstP_tiSCGDebOk_C "debouncing parameter / Duration of healing debouncing for check DFC_BrkBstSensSCG" VALUE 0x804D885C Val_Wu16 655350.0 DDRCTime_ms 0.00 655350.0 FORMAT "%8.1" /end CHARACTERISTIC
/begin CHARACTERISTIC DDRC_DurDeb.BrkBstP_tiSCGDebDef_C "debouncing parameter / Duration of defect debouncing for check DFC_BrkBstSensSCG" VALUE 0x804D885E Val_Wu16 655350.0 DDRCTime_ms 0.00 655350.0 FORMAT "%8.1" /end CHARACTERISTIC
/begin CHARACTERISTIC DDRC_DurDeb.Brk_tiDebOk_C "debouncing parameter / Duration of healing debouncing for check DFC_Brk" VALUE 0x804D8860 Val_Wu16 655350.0 DDRCTime_ms 0.00 655350.0 FORMAT "%8.1" /end CHARACTERISTIC
/begin CHARACTERISTIC DDRC_DurDeb.Brk_tiDebDef_C "debouncing parameter / Duration of defect debouncing for check DFC_Brk" VALUE 0x804D8862 Val_Wu16 655350.0 DDRCTime_ms 0.00 655350.0 FORMAT "%8.1" /end CHARACTERISTIC
/begin CHARACTERISTIC DDRC_DurDeb.Brk_tiSigDebOk_C "debouncing parameter / Duration of healing debouncing for check DFC_BrkSig" VALUE 0x804D8864 Val_Wu16 655350.0 DDRCTime_ms 0.00 655350.0 FORMAT "%8.1" /end CHARACTERISTIC
/begin CHARACTERISTIC DDRC_DurDeb.Brk_tiSigDebDef_C "debouncing parameter / Duration of defect debouncing for check DFC_BrkSig" VALUE 0x804D8866 Val_Wu16 655350.0 DDRCTime_ms 0.00 655350.0 FORMAT "%8.1" /end CHARACTERISTIC
/begin CHARACTERISTIC DDRC_DurDeb.Clth_tiSigDebOk_C "debouncing parameter / Duration of healing debouncing for check DFC_ClthSig" VALUE 0x804D8868 Val_Wu16 655350.0 DDRCTime_ms 0.00 655350.0 FORMAT "%8.1" /end CHARACTERISTIC
/begin CHARACTERISTIC DDRC_DurDeb.Clth_tiSigDebDef_C "debouncing parameter / Duration of defect debouncing for check DFC_ClthSig" VALUE 0x804D886A Val_Wu16 655350.0 DDRCTime_ms 0.00 655350.0 FORMAT "%8.1" /end CHARACTERISTIC
/begin CHARACTERISTIC DDRC_DurDeb.EGRVlv_tiCurrLimDebOk_C "debouncing parameter / Duration of healing debouncing for check DFC_EGRVlvCurrLim" VALUE 0x804D886C Val_Wu16 655350.0 DDRCTime_ms 0.00 655350.0 FORMAT "%8.1" /end CHARACTERISTIC
/begin CHARACTERISTIC DDRC_DurDeb.EGRVlv_tiCurrLimDebDef_C "debouncing parameter / Duration of defect debouncing for check DFC_EGRVlvCurrLim" VALUE 0x804D886E Val_Wu16 655350.0 DDRCTime_ms 0.00 655350.0 FORMAT "%8.1" /end CHARACTERISTIC
/begin CHARACTERISTIC DDRC_DurDeb.EGRVlv_tiOLDebOk_C "debouncing parameter / Duration of healing debouncing for check DFC_EGRVlvOL" VALUE 0x804D8870 Val_Wu16 655350.0 DDRCTime_ms 0.00 655350.0 FORMAT "%8.1" /end CHARACTERISTIC
/begin CHARACTERISTIC DDRC_DurDeb.EGRVlv_tiOLDebDef_C "debouncing parameter / Duration of defect debouncing for check DFC_EGRVlvOL" VALUE 0x804D8872 Val_Wu16 655350.0 DDRCTime_ms 0.00 655350.0 FORMAT "%8.1" /end CHARACTERISTIC
/begin CHARACTERISTIC DDRC_DurDeb.EGRVlv_tiOvrTempDebOk_C "debouncing parameter / Duration of healing debouncing for check DFC_EGRVlvOvrTemp" VALUE 0x804D8874 Val_Wu16 655350.0 DDRCTime_ms 0.00 655350.0 FORMAT "%8.1" /end CHARACTERISTIC
/begin CHARACTERISTIC DDRC_DurDeb.EGRVlv_tiOvrTempDebDef_C "debouncing parameter / Duration of defect debouncing for check DFC_EGRVlvOvrTemp" VALUE 0x804D8876 Val_Wu16 655350.0 DDRCTime_ms 0.00 655350.0 FORMAT "%8.1" /end CHARACTERISTIC
/begin CHARACTERISTIC DDRC_DurDeb.EGRVlv_tiSCBDebOk_C "debouncing parameter / Duration of healing debouncing for check DFC_EGRVlvSCB" VALUE 0x804D8878 Val_Wu16 655350.0 DDRCTime_ms 0.00 655350.0 FORMAT "%8.1" /end CHARACTERISTIC
/begin CHARACTERISTIC DDRC_DurDeb.EGRVlv_tiSCBDebDef_C "debouncing parameter / Duration of defect debouncing for check DFC_EGRVlvSCB" VALUE 0x804D887A Val_Wu16 655350.0 DDRCTime_ms 0.00 655350.0 FORMAT "%8.1" /end CHARACTERISTIC
/begin CHARACTERISTIC DDRC_DurDeb.EGRVlv_tiSCGDebOk_C "debouncing parameter / Duration of healing debouncing for check DFC_EGRVlvSCG" VALUE 0x804D887C Val_Wu16 655350.0 DDRCTime_ms 0.00 655350.0 FORMAT "%8.1" /end CHARACTERISTIC
/begin CHARACTERISTIC DDRC_DurDeb.EGRVlv_tiSCGDebDef_C "debouncing parameter / Duration of defect debouncing for check DFC_EGRVlvSCG" VALUE 0x804D887E Val_Wu16 655350.0 DDRCTime_ms 0.00 655350.0 FORMAT "%8.1" /end CHARACTERISTIC
/begin CHARACTERISTIC DDRC_DurDeb.EGRVlv_tiSRCMaxDebOk_C "debouncing parameter / Duration of healing debouncing for check DFC_EGRVlvSRCMax" VALUE 0x804D8880 Val_Wu16 655350.0 DDRCTime_ms 0.00 655350.0 FORMAT "%8.1" /end CHARACTERISTIC
/begin CHARACTERISTIC DDRC_DurDeb.EGRVlv_tiSRCMaxDebDef_C "debouncing parameter / Duration of defect debouncing for check DFC_EGRVlvSRCMax" VALUE 0x804D8882 Val_Wu16 655350.0 DDRCTime_ms 0.00 655350.0 FORMAT "%8.1" /end CHARACTERISTIC
/begin CHARACTERISTIC DDRC_DurDeb.EGRVlv_tiSRCMinDebOk_C "debouncing parameter / Duration of healing debouncing for check DFC_EGRVlvSRCMin" VALUE 0x804D8884 Val_Wu16 655350.0 DDRCTime_ms 0.00 655350.0 FORMAT "%8.1" /end CHARACTERISTIC
/begin CHARACTERISTIC DDRC_DurDeb.EGRVlv_tiSRCMinDebDef_C "debouncing parameter / Duration of defect debouncing for check DFC_EGRVlvSRCMin" VALUE 0x804D8886 Val_Wu16 655350.0 DDRCTime_ms 0.00 655350.0 FORMAT "%8.1" /end CHARACTERISTIC
/begin CHARACTERISTIC DDRC_DurDeb.HLSDem_tiOvhtDebOk_C "debouncing parameter / Duration of healing debouncing for check DFC_HLSDemOvhtEngLim" VALUE 0x804D8888 Val_Wu16 655350.0 DDRCTime_ms 0.00 655350.0 FORMAT "%8.1" /end CHARACTERISTIC
/begin CHARACTERISTIC DDRC_DurDeb.HLSDem_tiOvhtDebDef_C "debouncing parameter / Duration of defect debouncing for check DFC_HLSDemOvhtEngLim" VALUE 0x804D888A Val_Wu16 655350.0 DDRCTime_ms 0.00 655350.0 FORMAT "%8.1" /end CHARACTERISTIC
/begin CHARACTERISTIC DDRC_DurDeb.Oil_tiSRCMaxPSwmpDebOk_C "debouncing parameter / Duration of healing debouncing for check DFC_OilPSwmpSRCMax" VALUE 0x804D888C Val_Wu16 655350.0 DDRCTime_ms 0.00 655350.0 FORMAT "%8.1" /end CHARACTERISTIC
/begin CHARACTERISTIC DDRC_DurDeb.Oil_tiSRCMaxPSwmpDebDef_C "debouncing parameter / Duration of defect debouncing for check DFC_OilPSwmpSRCMax" VALUE 0x804D888E Val_Wu16 655350.0 DDRCTime_ms 0.00 655350.0 FORMAT "%8.1" /end CHARACTERISTIC
/begin CHARACTERISTIC DDRC_DurDeb.Oil_tiSRCMinPSwmpDebOk_C "debouncing parameter / Duration of healing debouncing for check DFC_OilPSwmpSRCMin" VALUE 0x804D8890 Val_Wu16 655350.0 DDRCTime_ms 0.00 655350.0 FORMAT "%8.1" /end CHARACTERISTIC
/begin CHARACTERISTIC DDRC_DurDeb.Oil_tiSRCMinPSwmpDebDef_C "debouncing parameter / Duration of defect debouncing for check DFC_OilPSwmpSRCMin" VALUE 0x804D8892 Val_Wu16 655350.0 DDRCTime_ms 0.00 655350.0 FORMAT "%8.1" /end CHARACTERISTIC
/begin CHARACTERISTIC DDRC_DurDeb.PIntkVUs_tiLineHiB1DebOk_C "debouncing parameter / Duration of healing debouncing for check DFC_PIntkVUsLineHiB1" VALUE 0x804D8894 Val_Wu16 655350.0 DDRCTime_ms 0.00 655350.0 FORMAT "%8.1" /end CHARACTERISTIC
/begin CHARACTERISTIC DDRC_DurDeb.PIntkVUs_tiLineHiB1DebDef_C "debouncing parameter / Duration of defect debouncing for check DFC_PIntkVUsLineHiB1" VALUE 0x804D8896 Val_Wu16 655350.0 DDRCTime_ms 0.00 655350.0 FORMAT "%8.1" /end CHARACTERISTIC
/begin CHARACTERISTIC DDRC_DurDeb.PIntkVUs_tiLineLoB1DebOk_C "debouncing parameter / Duration of healing debouncing for check DFC_PIntkVUsLineLoB1" VALUE 0x804D8898 Val_Wu16 655350.0 DDRCTime_ms 0.00 655350.0 FORMAT "%8.1" /end CHARACTERISTIC
/begin CHARACTERISTIC DDRC_DurDeb.PIntkVUs_tiLineLoB1DebDef_C "debouncing parameter / Duration of defect debouncing for check DFC_PIntkVUsLineLoB1" VALUE 0x804D889A Val_Wu16 655350.0 DDRCTime_ms 0.00 655350.0 FORMAT "%8.1" /end CHARACTERISTIC
/begin CHARACTERISTIC DDRC_DurDeb.VehV_tiPhysRngLoDebOk_C "debouncing parameter / Duration of healing debouncing for check DFC_VehVPhysRngLo" VALUE 0x804D889C Val_Wu16 655350.0 DDRCTime_ms 0.00 655350.0 FORMAT "%8.1" /end CHARACTERISTIC
/begin CHARACTERISTIC DDRC_DurDeb.VehV_tiPhysRngLoDebDef_C "debouncing parameter / Duration of defect debouncing for check DFC_VehVPhysRngLo" VALUE 0x804D889E Val_Wu16 655350.0 DDRCTime_ms 0.00 655350.0 FORMAT "%8.1" /end CHARACTERISTIC
/begin CHARACTERISTIC DDRC_DurDeb.VehV_tiSigCanDebOk_C "debouncing parameter / Duration of healing debouncing for check DFC_VehVSigCan" VALUE 0x804D88A0 Val_Wu16 655350.0 DDRCTime_ms 0.00 655350.0 FORMAT "%8.1" /end CHARACTERISTIC
/begin CHARACTERISTIC DDRC_DurDeb.VehV_tiSigCanDebDef_C "debouncing parameter / Duration of defect debouncing for check DFC_VehVSigCan" VALUE 0x804D88A2 Val_Wu16 655350.0 DDRCTime_ms 0.00 655350.0 FORMAT "%8.1" /end CHARACTERISTIC
/begin CHARACTERISTIC DDRC_DurDeb.VehV_tiSigCanSafeDebOk_C "debouncing parameter / Duration of healing debouncing for check DFC_VehVSigCanSafe" VALUE 0x804D88A4 Val_Wu16 655350.0 DDRCTime_ms 0.00 655350.0 FORMAT "%8.1" /end CHARACTERISTIC
/begin CHARACTERISTIC DDRC_DurDeb.VehV_tiSigCanSafeDebDef_C "debouncing parameter / Duration of defect debouncing for check DFC_VehVSigCanSafe" VALUE 0x804D88A6 Val_Wu16 655350.0 DDRCTime_ms 0.00 655350.0 FORMAT "%8.1" /end CHARACTERISTIC
/begin CHARACTERISTIC DDRC_DurDeb.VlvLft_tiSRCMaxOilPSnsrIntk11DebOk_C "debouncing parameter / Duration of healing debouncing for check DFC_VlvLftFbOilPSnsrIntk11SRCMax" VALUE 0x804D88A8 Val_Wu16 655350.0 DDRCTime_ms 0.00 655350.0 FORMAT "%8.1" /end CHARACTERISTIC
/begin CHARACTERISTIC DDRC_DurDeb.VlvLft_tiSRCMaxOilPSnsrIntk11DebDef_C "debouncing parameter / Duration of defect debouncing for check DFC_VlvLftFbOilPSnsrIntk11SRCMax" VALUE 0x804D88AA Val_Wu16 655350.0 DDRCTime_ms 0.00 655350.0 FORMAT "%8.1" /end CHARACTERISTIC
/begin CHARACTERISTIC DDRC_DurDeb.VlvLft_tiSRCMinOilPSnsrIntk11DebOk_C "debouncing parameter / Duration of healing debouncing for check DFC_VlvLftFbOilPSnsrIntk11SRCMin" VALUE 0x804D88AC Val_Wu16 655350.0 DDRCTime_ms 0.00 655350.0 FORMAT "%8.1" /end CHARACTERISTIC
/begin CHARACTERISTIC DDRC_DurDeb.VlvLft_tiSRCMinOilPSnsrIntk11DebDef_C "debouncing parameter / Duration of defect debouncing for check DFC_VlvLftFbOilPSnsrIntk11SRCMin" VALUE 0x804D88AE Val_Wu16 655350.0 DDRCTime_ms 0.00 655350.0 FORMAT "%8.1" /end CHARACTERISTIC
/begin CHARACTERISTIC DDRC_DurDeb.Clth_numPlaDebOk_C "debouncing parameter / Duration of healing debouncing for check DFC_ClthNpl" VALUE 0x804D88B0 Val_Wu16 65535.00 OneToOne 0.00 65535.00 FORMAT "%8.2" /end CHARACTERISTIC
/begin CHARACTERISTIC DDRC_DurDeb.Clth_numPlaDebDef_C "debouncing parameter / Duration of defect debouncing for check DFC_ClthNpl" VALUE 0x804D88B2 Val_Wu16 65535.00 OneToOne 0.00 65535.00 FORMAT "%8.2" /end CHARACTERISTIC
/begin CHARACTERISTIC DDRC_DurDeb.Gbx_numPNPosnDrvCdnDebOk_C "debouncing parameter / Duration of healing debouncing for check DFC_GbxPNPosnDrvCdn" VALUE 0x804D88B4 Val_Wu16 65535.00 OneToOne 0.00 65535.00 FORMAT "%8.2" /end CHARACTERISTIC
/begin CHARACTERISTIC DDRC_DurDeb.Gbx_numPNPosnDrvCdnDebDef_C "debouncing parameter / Duration of defect debouncing for check DFC_GbxPNPosnDrvCdn" VALUE 0x804D88B6 Val_Wu16 65535.00 OneToOne 0.00 65535.00 FORMAT "%8.2" /end CHARACTERISTIC
/begin CHARACTERISTIC DDRC_DurDeb.Gbx_numPNPosnPlausyDebOk_C "debouncing parameter / Duration of healing debouncing for check DFC_GbxPNPosnPlausy" VALUE 0x804D88B8 Val_Wu16 65535.00 OneToOne 0.00 65535.00 FORMAT "%8.2" /end CHARACTERISTIC
/begin CHARACTERISTIC DDRC_DurDeb.Gbx_numPNPosnPlausyDebDef_C "debouncing parameter / Duration of defect debouncing for check DFC_GbxPNPosnPlausy" VALUE 0x804D88BA Val_Wu16 65535.00 OneToOne 0.00 65535.00 FORMAT "%8.2" /end CHARACTERISTIC
/begin CHARACTERISTIC DDRC_DurDeb.AltIO_tiACGFailrDebOk_C "debouncing parameter / Duration of healing debouncing for check DFC_AltIOACGFailr" VALUE 0x804D88BC Val_Wu16 655350.0 DDRCTime_ms 0.00 655350.0 FORMAT "%8.1" /end CHARACTERISTIC
/begin CHARACTERISTIC DDRC_DurDeb.AltIO_tiACGFailrDebDef_C "debouncing parameter / Duration of defect debouncing for check DFC_AltIOACGFailr" VALUE 0x804D88BE Val_Wu16 655350.0 DDRCTime_ms 0.00 655350.0 FORMAT "%8.1" /end CHARACTERISTIC
/begin CHARACTERISTIC DDRC_DurDeb.AltIO_tiACGHiVltgDebOk_C "debouncing parameter / Duration of healing debouncing for check DFC_AltIOACGHiVltg" VALUE 0x804D88C0 Val_Wu16 655350.0 DDRCTime_ms 0.00 655350.0 FORMAT "%8.1" /end CHARACTERISTIC
/begin CHARACTERISTIC DDRC_DurDeb.AltIO_tiACGHiVltgDebDef_C "debouncing parameter / Duration of defect debouncing for check DFC_AltIOACGHiVltg" VALUE 0x804D88C2 Val_Wu16 655350.0 DDRCTime_ms 0.00 655350.0 FORMAT "%8.1" /end CHARACTERISTIC
/begin CHARACTERISTIC DDRC_DurDeb.AltIO_tiACGLoVltgDebOk_C "debouncing parameter / Duration of healing debouncing for check DFC_AltIOACGLoVltg" VALUE 0x804D88C4 Val_Wu16 655350.0 DDRCTime_ms 0.00 655350.0 FORMAT "%8.1" /end CHARACTERISTIC
/begin CHARACTERISTIC DDRC_DurDeb.AltIO_tiACGLoVltgDebDef_C "debouncing parameter / Duration of defect debouncing for check DFC_AltIOACGLoVltg" VALUE 0x804D88C6 Val_Wu16 655350.0 DDRCTime_ms 0.00 655350.0 FORMAT "%8.1" /end CHARACTERISTIC
/begin CHARACTERISTIC DDRC_DurDeb.AltIO_tiACGTHiDebOk_C "debouncing parameter / Duration of healing debouncing for check DFC_AltIOACGTHi" VALUE 0x804D88C8 Val_Wu16 655350.0 DDRCTime_ms 0.00 655350.0 FORMAT "%8.1" /end CHARACTERISTIC
/begin CHARACTERISTIC DDRC_DurDeb.AltIO_tiACGTHiDebDef_C "debouncing parameter / Duration of defect debouncing for check DFC_AltIOACGTHi" VALUE 0x804D88CA Val_Wu16 655350.0 DDRCTime_ms 0.00 655350.0 FORMAT "%8.1" /end CHARACTERISTIC
/begin CHARACTERISTIC DDRC_DurDeb.AltIO_tiDConnACGDebOk_C "debouncing parameter / Duration of healing debouncing for check DFC_AltIODConnACG" VALUE 0x804D88CC Val_Wu16 655350.0 DDRCTime_ms 0.00 655350.0 FORMAT "%8.1" /end CHARACTERISTIC
/begin CHARACTERISTIC DDRC_DurDeb.AltIO_tiDConnACGDebDef_C "debouncing parameter / Duration of defect debouncing for check DFC_AltIODConnACG" VALUE 0x804D88CE Val_Wu16 655350.0 DDRCTime_ms 0.00 655350.0 FORMAT "%8.1" /end CHARACTERISTIC
/begin CHARACTERISTIC DDRC_DurDeb.BattU_tiHiFailrDebOk_C "debouncing parameter / Duration of healing debouncing for check DFC_BattUHiFailr" VALUE 0x804D88D0 Val_Wu16 655350.0 DDRCTime_ms 0.00 655350.0 FORMAT "%8.1" /end CHARACTERISTIC
/begin CHARACTERISTIC DDRC_DurDeb.BattU_tiHiFailrDebDef_C "debouncing parameter / Duration of defect debouncing for check DFC_BattUHiFailr" VALUE 0x804D88D2 Val_Wu16 655350.0 DDRCTime_ms 0.00 655350.0 FORMAT "%8.1" /end CHARACTERISTIC
/begin CHARACTERISTIC DDRC_DurDeb.BattU_tiLoFailrDebOk_C "debouncing parameter / Duration of healing debouncing for check DFC_BattULoFailr" VALUE 0x804D88D4 Val_Wu16 655350.0 DDRCTime_ms 0.00 655350.0 FORMAT "%8.1" /end CHARACTERISTIC
/begin CHARACTERISTIC DDRC_DurDeb.BattU_tiLoFailrDebDef_C "debouncing parameter / Duration of defect debouncing for check DFC_BattULoFailr" VALUE 0x804D88D6 Val_Wu16 655350.0 DDRCTime_ms 0.00 655350.0 FORMAT "%8.1" /end CHARACTERISTIC
/begin CHARACTERISTIC DDRC_DurDeb.BrkBstP_tiDriftHiErrDebOk_C "debouncing parameter / Duration of healing debouncing for check DFC_BrkBstPDriftHiErr" VALUE 0x804D88D8 Val_Wu16 655350.0 DDRCTime_ms 0.00 655350.0 FORMAT "%8.1" /end CHARACTERISTIC
/begin CHARACTERISTIC DDRC_DurDeb.BrkBstP_tiDriftHiErrDebDef_C "debouncing parameter / Duration of defect debouncing for check DFC_BrkBstPDriftHiErr" VALUE 0x804D88DA Val_Wu16 655350.0 DDRCTime_ms 0.00 655350.0 FORMAT "%8.1" /end CHARACTERISTIC
/begin CHARACTERISTIC DDRC_DurDeb.BrkBstP_tiDriftLoErrDebOk_C "debouncing parameter / Duration of healing debouncing for check DFC_BrkBstPDriftLoErr" VALUE 0x804D88DC Val_Wu16 655350.0 DDRCTime_ms 0.00 655350.0 FORMAT "%8.1" /end CHARACTERISTIC
/begin CHARACTERISTIC DDRC_DurDeb.BrkBstP_tiDriftLoErrDebDef_C "debouncing parameter / Duration of defect debouncing for check DFC_BrkBstPDriftLoErr" VALUE 0x804D88DE Val_Wu16 655350.0 DDRCTime_ms 0.00 655350.0 FORMAT "%8.1" /end CHARACTERISTIC
/begin CHARACTERISTIC DDRC_DurDeb.BrkBstP_tiSnsrStuckDebOk_C "debouncing parameter / Duration of healing debouncing for check DFC_BrkBstPSnsrStuck" VALUE 0x804D88E0 Val_Wu16 655350.0 DDRCTime_ms 0.00 655350.0 FORMAT "%8.1" /end CHARACTERISTIC
/begin CHARACTERISTIC DDRC_DurDeb.BrkBstP_tiSnsrStuckDebDef_C "debouncing parameter / Duration of defect debouncing for check DFC_BrkBstPSnsrStuck" VALUE 0x804D88E2 Val_Wu16 655350.0 DDRCTime_ms 0.00 655350.0 FORMAT "%8.1" /end CHARACTERISTIC
/begin CHARACTERISTIC DDRC_DurDeb.Brk_tiMnSwtContOnDebOk_C "debouncing parameter / Duration of healing debouncing for check DFC_BrkMnSwtContOn" VALUE 0x804D88E4 Val_Wu16 655350.0 DDRCTime_ms 0.00 655350.0 FORMAT "%8.1" /end CHARACTERISTIC
/begin CHARACTERISTIC DDRC_DurDeb.Brk_tiMnSwtContOnDebDef_C "debouncing parameter / Duration of defect debouncing for check DFC_BrkMnSwtContOn" VALUE 0x804D88E6 Val_Wu16 655350.0 DDRCTime_ms 0.00 655350.0 FORMAT "%8.1" /end CHARACTERISTIC
/begin CHARACTERISTIC DDRC_DurDeb.Brk_tiMnSwtNotStpDebOk_C "debouncing parameter / Duration of healing debouncing for check DFC_BrkMnSwtNotStp" VALUE 0x804D88E8 Val_Wu16 655350.0 DDRCTime_ms 0.00 655350.0 FORMAT "%8.1" /end CHARACTERISTIC
/begin CHARACTERISTIC DDRC_DurDeb.Brk_tiMnSwtNotStpDebDef_C "debouncing parameter / Duration of defect debouncing for check DFC_BrkMnSwtNotStp" VALUE 0x804D88EA Val_Wu16 655350.0 DDRCTime_ms 0.00 655350.0 FORMAT "%8.1" /end CHARACTERISTIC
/begin CHARACTERISTIC DDRC_DurDeb.Brk_tiPlaDebOk_C "debouncing parameter / Duration of healing debouncing for check DFC_BrkNpl" VALUE 0x804D88EC Val_Wu16 655350.0 DDRCTime_ms 0.00 655350.0 FORMAT "%8.1" /end CHARACTERISTIC
/begin CHARACTERISTIC DDRC_DurDeb.Brk_tiPlaDebDef_C "debouncing parameter / Duration of defect debouncing for check DFC_BrkNpl" VALUE 0x804D88EE Val_Wu16 655350.0 DDRCTime_ms 0.00 655350.0 FORMAT "%8.1" /end CHARACTERISTIC
/begin CHARACTERISTIC DDRC_DurDeb.Brk_tiRdntSwtContOnDebOk_C "debouncing parameter / Duration of healing debouncing for check DFC_BrkRdntSwtContOn" VALUE 0x804D88F0 Val_Wu16 655350.0 DDRCTime_ms 0.00 655350.0 FORMAT "%8.1" /end CHARACTERISTIC
/begin CHARACTERISTIC DDRC_DurDeb.Brk_tiRdntSwtContOnDebDef_C "debouncing parameter / Duration of defect debouncing for check DFC_BrkRdntSwtContOn" VALUE 0x804D88F2 Val_Wu16 655350.0 DDRCTime_ms 0.00 655350.0 FORMAT "%8.1" /end CHARACTERISTIC
/begin CHARACTERISTIC DDRC_DurDeb.Brk_tiRdntSwtNotStpDebOk_C "debouncing parameter / Duration of healing debouncing for check DFC_BrkRdntSwtNotStp" VALUE 0x804D88F4 Val_Wu16 655350.0 DDRCTime_ms 0.00 655350.0 FORMAT "%8.1" /end CHARACTERISTIC
/begin CHARACTERISTIC DDRC_DurDeb.Brk_tiRdntSwtNotStpDebDef_C "debouncing parameter / Duration of defect debouncing for check DFC_BrkRdntSwtNotStp" VALUE 0x804D88F6 Val_Wu16 655350.0 DDRCTime_ms 0.00 655350.0 FORMAT "%8.1" /end CHARACTERISTIC
/begin CHARACTERISTIC DDRC_DurDeb.Clth_tiClth3ONStuckDebOk_C "debouncing parameter / Duration of healing debouncing for check DFC_Clth3ONStuck" VALUE 0x804D88F8 Val_Wu16 655350.0 DDRCTime_ms 0.00 655350.0 FORMAT "%8.1" /end CHARACTERISTIC
/begin CHARACTERISTIC DDRC_DurDeb.Clth_tiClth3ONStuckDebDef_C "debouncing parameter / Duration of defect debouncing for check DFC_Clth3ONStuck" VALUE 0x804D88FA Val_Wu16 655350.0 DDRCTime_ms 0.00 655350.0 FORMAT "%8.1" /end CHARACTERISTIC
/begin CHARACTERISTIC DDRC_DurDeb.Clth_tiClth4OFFStuckDebOk_C "debouncing parameter / Duration of healing debouncing for check DFC_Clth4OFFStuck" VALUE 0x804D88FC Val_Wu16 655350.0 DDRCTime_ms 0.00 655350.0 FORMAT "%8.1" /end CHARACTERISTIC
/begin CHARACTERISTIC DDRC_DurDeb.Clth_tiClth4OFFStuckDebDef_C "debouncing parameter / Duration of defect debouncing for check DFC_Clth4OFFStuck" VALUE 0x804D88FE Val_Wu16 655350.0 DDRCTime_ms 0.00 655350.0 FORMAT "%8.1" /end CHARACTERISTIC
/begin CHARACTERISTIC DDRC_DurDeb.Clth_tiClthOFFStuckDebOk_C "debouncing parameter / Duration of healing debouncing for check DFC_ClthOFFStuck" VALUE 0x804D8900 Val_Wu16 655350.0 DDRCTime_ms 0.00 655350.0 FORMAT "%8.1" /end CHARACTERISTIC
/begin CHARACTERISTIC DDRC_DurDeb.Clth_tiClthOFFStuckDebDef_C "debouncing parameter / Duration of defect debouncing for check DFC_ClthOFFStuck" VALUE 0x804D8902 Val_Wu16 655350.0 DDRCTime_ms 0.00 655350.0 FORMAT "%8.1" /end CHARACTERISTIC
/begin CHARACTERISTIC DDRC_DurDeb.Clth_tiClthONStuckDebOk_C "debouncing parameter / Duration of healing debouncing for check DFC_ClthONStuck" VALUE 0x804D8904 Val_Wu16 655350.0 DDRCTime_ms 0.00 655350.0 FORMAT "%8.1" /end CHARACTERISTIC
/begin CHARACTERISTIC DDRC_DurDeb.Clth_tiClthONStuckDebDef_C "debouncing parameter / Duration of defect debouncing for check DFC_ClthONStuck" VALUE 0x804D8906 Val_Wu16 655350.0 DDRCTime_ms 0.00 655350.0 FORMAT "%8.1" /end CHARACTERISTIC
/begin CHARACTERISTIC DDRC_DurDeb.Clth_tiClthStkFailInfoDebOk_C "debouncing parameter / Duration of healing debouncing for check DFC_ClthStkFailInfo" VALUE 0x804D8908 Val_Wu16 655350.0 DDRCTime_ms 0.00 655350.0 FORMAT "%8.1" /end CHARACTERISTIC
/begin CHARACTERISTIC DDRC_DurDeb.Clth_tiClthStkFailInfoDebDef_C "debouncing parameter / Duration of defect debouncing for check DFC_ClthStkFailInfo" VALUE 0x804D890A Val_Wu16 655350.0 DDRCTime_ms 0.00 655350.0 FORMAT "%8.1" /end CHARACTERISTIC
/begin CHARACTERISTIC DDRC_DurDeb.Com_tiACFailInfoDebOk_C "debouncing parameter / Duration of healing debouncing for check DFC_ComACFailInfo" VALUE 0x804D890C Val_Wu16 655350.0 DDRCTime_ms 0.00 655350.0 FORMAT "%8.1" /end CHARACTERISTIC
/begin CHARACTERISTIC DDRC_DurDeb.Com_tiACFailInfoDebDef_C "debouncing parameter / Duration of defect debouncing for check DFC_ComACFailInfo" VALUE 0x804D890E Val_Wu16 655350.0 DDRCTime_ms 0.00 655350.0 FORMAT "%8.1" /end CHARACTERISTIC
/begin CHARACTERISTIC DDRC_DurDeb.Com_tiATFTValErrDebOk_C "debouncing parameter / Duration of healing debouncing for check DFC_ComATFTValErr" VALUE 0x804D8910 Val_Wu16 655350.0 DDRCTime_ms 0.00 655350.0 FORMAT "%8.1" /end CHARACTERISTIC
/begin CHARACTERISTIC DDRC_DurDeb.Com_tiATFTValErrDebDef_C "debouncing parameter / Duration of defect debouncing for check DFC_ComATFTValErr" VALUE 0x804D8912 Val_Wu16 655350.0 DDRCTime_ms 0.00 655350.0 FORMAT "%8.1" /end CHARACTERISTIC
/begin CHARACTERISTIC DDRC_DurDeb.Com_tiATMILReqDebOk_C "debouncing parameter / Duration of healing debouncing for check DFC_ComATMILReq" VALUE 0x804D8914 Val_Wu16 655350.0 DDRCTime_ms 0.00 655350.0 FORMAT "%8.1" /end CHARACTERISTIC
/begin CHARACTERISTIC DDRC_DurDeb.Com_tiATMILReqDebDef_C "debouncing parameter / Duration of defect debouncing for check DFC_ComATMILReq" VALUE 0x804D8916 Val_Wu16 655350.0 DDRCTime_ms 0.00 655350.0 FORMAT "%8.1" /end CHARACTERISTIC
/begin CHARACTERISTIC DDRC_DurDeb.Com_tiAYCAChksumDebOk_C "debouncing parameter / Duration of healing debouncing for check DFC_ComAYCAChksum" VALUE 0x804D8918 Val_Wu16 655350.0 DDRCTime_ms 0.00 655350.0 FORMAT "%8.1" /end CHARACTERISTIC
/begin CHARACTERISTIC DDRC_DurDeb.Com_tiAYCAChksumDebDef_C "debouncing parameter / Duration of defect debouncing for check DFC_ComAYCAChksum" VALUE 0x804D891A Val_Wu16 655350.0 DDRCTime_ms 0.00 655350.0 FORMAT "%8.1" /end CHARACTERISTIC
/begin CHARACTERISTIC DDRC_DurDeb.Com_tiAYCARingCntDebOk_C "debouncing parameter / Duration of healing debouncing for check DFC_ComAYCARingCnt" VALUE 0x804D891C Val_Wu16 655350.0 DDRCTime_ms 0.00 655350.0 FORMAT "%8.1" /end CHARACTERISTIC
/begin CHARACTERISTIC DDRC_DurDeb.Com_tiAYCARingCntDebDef_C "debouncing parameter / Duration of defect debouncing for check DFC_ComAYCARingCnt" VALUE 0x804D891E Val_Wu16 655350.0 DDRCTime_ms 0.00 655350.0 FORMAT "%8.1" /end CHARACTERISTIC
/begin CHARACTERISTIC DDRC_DurDeb.Com_tiAYCATOutDebOk_C "debouncing parameter / Duration of healing debouncing for check DFC_ComAYCATOut" VALUE 0x804D8920 Val_Wu16 655350.0 DDRCTime_ms 0.00 655350.0 FORMAT "%8.1" /end CHARACTERISTIC
/begin CHARACTERISTIC DDRC_DurDeb.Com_tiAYCATOutDebDef_C "debouncing parameter / Duration of defect debouncing for check DFC_ComAYCATOut" VALUE 0x804D8922 Val_Wu16 655350.0 DDRCTime_ms 0.00 655350.0 FORMAT "%8.1" /end CHARACTERISTIC
/begin CHARACTERISTIC DDRC_DurDeb.Com_tiAYCDChkSumDebOk_C "debouncing parameter / Duration of healing debouncing for check DFC_ComAYCDChkSum" VALUE 0x804D8924 Val_Wu16 655350.0 DDRCTime_ms 0.00 655350.0 FORMAT "%8.1" /end CHARACTERISTIC
/begin CHARACTERISTIC DDRC_DurDeb.Com_tiAYCDChkSumDebDef_C "debouncing parameter / Duration of defect debouncing for check DFC_ComAYCDChkSum" VALUE 0x804D8926 Val_Wu16 655350.0 DDRCTime_ms 0.00 655350.0 FORMAT "%8.1" /end CHARACTERISTIC
/begin CHARACTERISTIC DDRC_DurDeb.Com_tiAYCDTOutDebOk_C "debouncing parameter / Duration of healing debouncing for check DFC_ComAYCDTOut" VALUE 0x804D8928 Val_Wu16 655350.0 DDRCTime_ms 0.00 655350.0 FORMAT "%8.1" /end CHARACTERISTIC
/begin CHARACTERISTIC DDRC_DurDeb.Com_tiAYCDTOutDebDef_C "debouncing parameter / Duration of defect debouncing for check DFC_ComAYCDTOut" VALUE 0x804D892A Val_Wu16 655350.0 DDRCTime_ms 0.00 655350.0 FORMAT "%8.1" /end CHARACTERISTIC
/begin CHARACTERISTIC DDRC_DurDeb.Com_tiAYCFChksumDebOk_C "debouncing parameter / Duration of healing debouncing for check DFC_ComAYCFChksum" VALUE 0x804D892C Val_Wu16 655350.0 DDRCTime_ms 0.00 655350.0 FORMAT "%8.1" /end CHARACTERISTIC
/begin CHARACTERISTIC DDRC_DurDeb.Com_tiAYCFChksumDebDef_C "debouncing parameter / Duration of defect debouncing for check DFC_ComAYCFChksum" VALUE 0x804D892E Val_Wu16 655350.0 DDRCTime_ms 0.00 655350.0 FORMAT "%8.1" /end CHARACTERISTIC
/begin CHARACTERISTIC DDRC_DurDeb.Com_tiAYCFRingCntDebOk_C "debouncing parameter / Duration of healing debouncing for check DFC_ComAYCFRingCnt" VALUE 0x804D8930 Val_Wu16 655350.0 DDRCTime_ms 0.00 655350.0 FORMAT "%8.1" /end CHARACTERISTIC
/begin CHARACTERISTIC DDRC_DurDeb.Com_tiAYCFRingCntDebDef_C "debouncing parameter / Duration of defect debouncing for check DFC_ComAYCFRingCnt" VALUE 0x804D8932 Val_Wu16 655350.0 DDRCTime_ms 0.00 655350.0 FORMAT "%8.1" /end CHARACTERISTIC
/begin CHARACTERISTIC DDRC_DurDeb.Com_tiAYCFTOutDebOk_C "debouncing parameter / Duration of healing debouncing for check DFC_ComAYCFTOut" VALUE 0x804D8934 Val_Wu16 655350.0 DDRCTime_ms 0.00 655350.0 FORMAT "%8.1" /end CHARACTERISTIC
/begin CHARACTERISTIC DDRC_DurDeb.Com_tiAYCFTOutDebDef_C "debouncing parameter / Duration of defect debouncing for check DFC_ComAYCFTOut" VALUE 0x804D8936 Val_Wu16 655350.0 DDRCTime_ms 0.00 655350.0 FORMAT "%8.1" /end CHARACTERISTIC
/begin CHARACTERISTIC DDRC_DurDeb.Com_tiAYCGChksumDebOk_C "debouncing parameter / Duration of healing debouncing for check DFC_ComAYCGChksum" VALUE 0x804D8938 Val_Wu16 655350.0 DDRCTime_ms 0.00 655350.0 FORMAT "%8.1" /end CHARACTERISTIC
/begin CHARACTERISTIC DDRC_DurDeb.Com_tiAYCGChksumDebDef_C "debouncing parameter / Duration of defect debouncing for check DFC_ComAYCGChksum" VALUE 0x804D893A Val_Wu16 655350.0 DDRCTime_ms 0.00 655350.0 FORMAT "%8.1" /end CHARACTERISTIC
/begin CHARACTERISTIC DDRC_DurDeb.Com_tiAYCGRingCntDebOk_C "debouncing parameter / Duration of healing debouncing for check DFC_ComAYCGRingCnt" VALUE 0x804D893C Val_Wu16 655350.0 DDRCTime_ms 0.00 655350.0 FORMAT "%8.1" /end CHARACTERISTIC
/begin CHARACTERISTIC DDRC_DurDeb.Com_tiAYCGRingCntDebDef_C "debouncing parameter / Duration of defect debouncing for check DFC_ComAYCGRingCnt" VALUE 0x804D893E Val_Wu16 655350.0 DDRCTime_ms 0.00 655350.0 FORMAT "%8.1" /end CHARACTERISTIC
/begin CHARACTERISTIC DDRC_DurDeb.Com_tiAYCGTOutDebOk_C "debouncing parameter / Duration of healing debouncing for check DFC_ComAYCGTOut" VALUE 0x804D8940 Val_Wu16 655350.0 DDRCTime_ms 0.00 655350.0 FORMAT "%8.1" /end CHARACTERISTIC
/begin CHARACTERISTIC DDRC_DurDeb.Com_tiAYCGTOutDebDef_C "debouncing parameter / Duration of defect debouncing for check DFC_ComAYCGTOut" VALUE 0x804D8942 Val_Wu16 655350.0 DDRCTime_ms 0.00 655350.0 FORMAT "%8.1" /end CHARACTERISTIC
/begin CHARACTERISTIC DDRC_DurDeb.Com_tiAYCIChkSumDebOk_C "debouncing parameter / Duration of healing debouncing for check DFC_ComAYCIChkSum" VALUE 0x804D8944 Val_Wu16 655350.0 DDRCTime_ms 0.00 655350.0 FORMAT "%8.1" /end CHARACTERISTIC
/begin CHARACTERISTIC DDRC_DurDeb.Com_tiAYCIChkSumDebDef_C "debouncing parameter / Duration of defect debouncing for check DFC_ComAYCIChkSum" VALUE 0x804D8946 Val_Wu16 655350.0 DDRCTime_ms 0.00 655350.0 FORMAT "%8.1" /end CHARACTERISTIC
/begin CHARACTERISTIC DDRC_DurDeb.Com_tiAYCIRingCntDebOk_C "debouncing parameter / Duration of healing debouncing for check DFC_ComAYCIRingCnt" VALUE 0x804D8948 Val_Wu16 655350.0 DDRCTime_ms 0.00 655350.0 FORMAT "%8.1" /end CHARACTERISTIC
/begin CHARACTERISTIC DDRC_DurDeb.Com_tiAYCIRingCntDebDef_C "debouncing parameter / Duration of defect debouncing for check DFC_ComAYCIRingCnt" VALUE 0x804D894A Val_Wu16 655350.0 DDRCTime_ms 0.00 655350.0 FORMAT "%8.1" /end CHARACTERISTIC
/begin CHARACTERISTIC DDRC_DurDeb.Com_tiAYCITOutDebOk_C "debouncing parameter / Duration of healing debouncing for check DFC_ComAYCITOut" VALUE 0x804D894C Val_Wu16 655350.0 DDRCTime_ms 0.00 655350.0 FORMAT "%8.1" /end CHARACTERISTIC
/begin CHARACTERISTIC DDRC_DurDeb.Com_tiAYCITOutDebDef_C "debouncing parameter / Duration of defect debouncing for check DFC_ComAYCITOut" VALUE 0x804D894E Val_Wu16 655350.0 DDRCTime_ms 0.00 655350.0 FORMAT "%8.1" /end CHARACTERISTIC
/begin CHARACTERISTIC DDRC_DurDeb.Com_tiBCM1ChkSumDebOk_C "debouncing parameter / Duration of healing debouncing for check DFC_ComBCM1ChkSum" VALUE 0x804D8950 Val_Wu16 655350.0 DDRCTime_ms 0.00 655350.0 FORMAT "%8.1" /end CHARACTERISTIC
/begin CHARACTERISTIC DDRC_DurDeb.Com_tiBCM1ChkSumDebDef_C "debouncing parameter / Duration of defect debouncing for check DFC_ComBCM1ChkSum" VALUE 0x804D8952 Val_Wu16 655350.0 DDRCTime_ms 0.00 655350.0 FORMAT "%8.1" /end CHARACTERISTIC
/begin CHARACTERISTIC DDRC_DurDeb.Com_tiBCM1RingCntDebOk_C "debouncing parameter / Duration of healing debouncing for check DFC_ComBCM1RingCnt" VALUE 0x804D8954 Val_Wu16 655350.0 DDRCTime_ms 0.00 655350.0 FORMAT "%8.1" /end CHARACTERISTIC
/begin CHARACTERISTIC DDRC_DurDeb.Com_tiBCM1RingCntDebDef_C "debouncing parameter / Duration of defect debouncing for check DFC_ComBCM1RingCnt" VALUE 0x804D8956 Val_Wu16 655350.0 DDRCTime_ms 0.00 655350.0 FORMAT "%8.1" /end CHARACTERISTIC
/begin CHARACTERISTIC DDRC_DurDeb.Com_tiBCM1TOutDebOk_C "debouncing parameter / Duration of healing debouncing for check DFC_ComBCM1TOut" VALUE 0x804D8958 Val_Wu16 655350.0 DDRCTime_ms 0.00 655350.0 FORMAT "%8.1" /end CHARACTERISTIC
/begin CHARACTERISTIC DDRC_DurDeb.Com_tiBCM1TOutDebDef_C "debouncing parameter / Duration of defect debouncing for check DFC_ComBCM1TOut" VALUE 0x804D895A Val_Wu16 655350.0 DDRCTime_ms 0.00 655350.0 FORMAT "%8.1" /end CHARACTERISTIC
/begin CHARACTERISTIC DDRC_DurDeb.Com_tiCANABusOffErrDebOk_C "debouncing parameter / Duration of healing debouncing for check DFC_ComCANABusOffErr" VALUE 0x804D895C Val_Wu16 655350.0 DDRCTime_ms 0.00 655350.0 FORMAT "%8.1" /end CHARACTERISTIC
/begin CHARACTERISTIC DDRC_DurDeb.Com_tiCANABusOffErrDebDef_C "debouncing parameter / Duration of defect debouncing for check DFC_ComCANABusOffErr" VALUE 0x804D895E Val_Wu16 655350.0 DDRCTime_ms 0.00 655350.0 FORMAT "%8.1" /end CHARACTERISTIC
/begin CHARACTERISTIC DDRC_DurDeb.Com_tiCANBBusOffErrDebOk_C "debouncing parameter / Duration of healing debouncing for check DFC_ComCANBBusOffErr" VALUE 0x804D8960 Val_Wu16 655350.0 DDRCTime_ms 0.00 655350.0 FORMAT "%8.1" /end CHARACTERISTIC
/begin CHARACTERISTIC DDRC_DurDeb.Com_tiCANBBusOffErrDebDef_C "debouncing parameter / Duration of defect debouncing for check DFC_ComCANBBusOffErr" VALUE 0x804D8962 Val_Wu16 655350.0 DDRCTime_ms 0.00 655350.0 FORMAT "%8.1" /end CHARACTERISTIC
/begin CHARACTERISTIC DDRC_DurDeb.Com_tiCANCBusOffErrDebOk_C "debouncing parameter / Duration of healing debouncing for check DFC_ComCANCBusOffErr" VALUE 0x804D8964 Val_Wu16 655350.0 DDRCTime_ms 0.00 655350.0 FORMAT "%8.1" /end CHARACTERISTIC
/begin CHARACTERISTIC DDRC_DurDeb.Com_tiCANCBusOffErrDebDef_C "debouncing parameter / Duration of defect debouncing for check DFC_ComCANCBusOffErr" VALUE 0x804D8966 Val_Wu16 655350.0 DDRCTime_ms 0.00 655350.0 FORMAT "%8.1" /end CHARACTERISTIC
/begin CHARACTERISTIC DDRC_DurDeb.Com_tiCGW1ChkSumDebOk_C "debouncing parameter / Duration of healing debouncing for check DFC_ComCGW1ChkSum" VALUE 0x804D8968 Val_Wu16 655350.0 DDRCTime_ms 0.00 655350.0 FORMAT "%8.1" /end CHARACTERISTIC
/begin CHARACTERISTIC DDRC_DurDeb.Com_tiCGW1ChkSumDebDef_C "debouncing parameter / Duration of defect debouncing for check DFC_ComCGW1ChkSum" VALUE 0x804D896A Val_Wu16 655350.0 DDRCTime_ms 0.00 655350.0 FORMAT "%8.1" /end CHARACTERISTIC
/begin CHARACTERISTIC DDRC_DurDeb.Com_tiCGW1TOutDebOk_C "debouncing parameter / Duration of healing debouncing for check DFC_ComCGW1TOut" VALUE 0x804D896C Val_Wu16 655350.0 DDRCTime_ms 0.00 655350.0 FORMAT "%8.1" /end CHARACTERISTIC
/begin CHARACTERISTIC DDRC_DurDeb.Com_tiCGW1TOutDebDef_C "debouncing parameter / Duration of defect debouncing for check DFC_ComCGW1TOut" VALUE 0x804D896E Val_Wu16 655350.0 DDRCTime_ms 0.00 655350.0 FORMAT "%8.1" /end CHARACTERISTIC
/begin CHARACTERISTIC DDRC_DurDeb.Com_tiCGW1ctRingDebOk_C "debouncing parameter / Duration of healing debouncing for check DFC_ComCGW1RingCnt" VALUE 0x804D8970 Val_Wu16 655350.0 DDRCTime_ms 0.00 655350.0 FORMAT "%8.1" /end CHARACTERISTIC
/begin CHARACTERISTIC DDRC_DurDeb.Com_tiCGW1ctRingDebDef_C "debouncing parameter / Duration of defect debouncing for check DFC_ComCGW1RingCnt" VALUE 0x804D8972 Val_Wu16 655350.0 DDRCTime_ms 0.00 655350.0 FORMAT "%8.1" /end CHARACTERISTIC
/begin CHARACTERISTIC DDRC_DurDeb.Com_tiConvBoostErrDebOk_C "debouncing parameter / Duration of healing debouncing for check DFC_ComConvBoostErr" VALUE 0x804D8974 Val_Wu16 655350.0 DDRCTime_ms 0.00 655350.0 FORMAT "%8.1" /end CHARACTERISTIC
/begin CHARACTERISTIC DDRC_DurDeb.Com_tiConvBoostErrDebDef_C "debouncing parameter / Duration of defect debouncing for check DFC_ComConvBoostErr" VALUE 0x804D8976 Val_Wu16 655350.0 DDRCTime_ms 0.00 655350.0 FORMAT "%8.1" /end CHARACTERISTIC
/begin CHARACTERISTIC DDRC_DurDeb.Com_tiConvSlipErrDebOk_C "debouncing parameter / Duration of healing debouncing for check DFC_ComConvSlipErr" VALUE 0x804D8978 Val_Wu16 655350.0 DDRCTime_ms 0.00 655350.0 FORMAT "%8.1" /end CHARACTERISTIC
/begin CHARACTERISTIC DDRC_DurDeb.Com_tiConvSlipErrDebDef_C "debouncing parameter / Duration of defect debouncing for check DFC_ComConvSlipErr" VALUE 0x804D897A Val_Wu16 655350.0 DDRCTime_ms 0.00 655350.0 FORMAT "%8.1" /end CHARACTERISTIC
/begin CHARACTERISTIC DDRC_DurDeb.Com_tiDCDCPrfmncErrDebOk_C "debouncing parameter / Duration of healing debouncing for check DFC_ComDCDCPrfmncErr" VALUE 0x804D897C Val_Wu16 655350.0 DDRCTime_ms 0.00 655350.0 FORMAT "%8.1" /end CHARACTERISTIC
/begin CHARACTERISTIC DDRC_DurDeb.Com_tiDCDCPrfmncErrDebDef_C "debouncing parameter / Duration of defect debouncing for check DFC_ComDCDCPrfmncErr" VALUE 0x804D897E Val_Wu16 655350.0 DDRCTime_ms 0.00 655350.0 FORMAT "%8.1" /end CHARACTERISTIC
/begin CHARACTERISTIC DDRC_DurDeb.Com_tiDCDCTempWarnDebOk_C "debouncing parameter / Duration of healing debouncing for check DFC_ComDCDCTempWarn" VALUE 0x804D8980 Val_Wu16 655350.0 DDRCTime_ms 0.00 655350.0 FORMAT "%8.1" /end CHARACTERISTIC
/begin CHARACTERISTIC DDRC_DurDeb.Com_tiDCDCTempWarnDebDef_C "debouncing parameter / Duration of defect debouncing for check DFC_ComDCDCTempWarn" VALUE 0x804D8982 Val_Wu16 655350.0 DDRCTime_ms 0.00 655350.0 FORMAT "%8.1" /end CHARACTERISTIC
/begin CHARACTERISTIC DDRC_DurDeb.Com_tiEAT10ChkSumDebOk_C "debouncing parameter / Duration of healing debouncing for check DFC_ComEAT10Chksum" VALUE 0x804D8984 Val_Wu16 655350.0 DDRCTime_ms 0.00 655350.0 FORMAT "%8.1" /end CHARACTERISTIC
/begin CHARACTERISTIC DDRC_DurDeb.Com_tiEAT10ChkSumDebDef_C "debouncing parameter / Duration of defect debouncing for check DFC_ComEAT10Chksum" VALUE 0x804D8986 Val_Wu16 655350.0 DDRCTime_ms 0.00 655350.0 FORMAT "%8.1" /end CHARACTERISTIC
/begin CHARACTERISTIC DDRC_DurDeb.Com_tiEAT10RingCntDebOk_C "debouncing parameter / Duration of healing debouncing for check DFC_ComEAT10RingCnt" VALUE 0x804D8988 Val_Wu16 655350.0 DDRCTime_ms 0.00 655350.0 FORMAT "%8.1" /end CHARACTERISTIC
/begin CHARACTERISTIC DDRC_DurDeb.Com_tiEAT10RingCntDebDef_C "debouncing parameter / Duration of defect debouncing for check DFC_ComEAT10RingCnt" VALUE 0x804D898A Val_Wu16 655350.0 DDRCTime_ms 0.00 655350.0 FORMAT "%8.1" /end CHARACTERISTIC
/begin CHARACTERISTIC DDRC_DurDeb.Com_tiEAT10TOutDebOk_C "debouncing parameter / Duration of healing debouncing for check DFC_ComEAT10TOut" VALUE 0x804D898C Val_Wu16 655350.0 DDRCTime_ms 0.00 655350.0 FORMAT "%8.1" /end CHARACTERISTIC
/begin CHARACTERISTIC DDRC_DurDeb.Com_tiEAT10TOutDebDef_C "debouncing parameter / Duration of defect debouncing for check DFC_ComEAT10TOut" VALUE 0x804D898E Val_Wu16 655350.0 DDRCTime_ms 0.00 655350.0 FORMAT "%8.1" /end CHARACTERISTIC
/begin CHARACTERISTIC DDRC_DurDeb.Com_tiEAT11ChkSumDebOk_C "debouncing parameter / Duration of healing debouncing for check DFC_ComEAT11ChkSum" VALUE 0x804D8990 Val_Wu16 655350.0 DDRCTime_ms 0.00 655350.0 FORMAT "%8.1" /end CHARACTERISTIC
/begin CHARACTERISTIC DDRC_DurDeb.Com_tiEAT11ChkSumDebDef_C "debouncing parameter / Duration of defect debouncing for check DFC_ComEAT11ChkSum" VALUE 0x804D8992 Val_Wu16 655350.0 DDRCTime_ms 0.00 655350.0 FORMAT "%8.1" /end CHARACTERISTIC
/begin CHARACTERISTIC DDRC_DurDeb.Com_tiEAT11RingCntDebOk_C "debouncing parameter / Duration of healing debouncing for check DFC_ComEAT11RingCnt" VALUE 0x804D8994 Val_Wu16 655350.0 DDRCTime_ms 0.00 655350.0 FORMAT "%8.1" /end CHARACTERISTIC
/begin CHARACTERISTIC DDRC_DurDeb.Com_tiEAT11RingCntDebDef_C "debouncing parameter / Duration of defect debouncing for check DFC_ComEAT11RingCnt" VALUE 0x804D8996 Val_Wu16 655350.0 DDRCTime_ms 0.00 655350.0 FORMAT "%8.1" /end CHARACTERISTIC
/begin CHARACTERISTIC DDRC_DurDeb.Com_tiEAT11TOutDebOk_C "debouncing parameter / Duration of healing debouncing for check DFC_ComEAT11TOut" VALUE 0x804D8998 Val_Wu16 655350.0 DDRCTime_ms 0.00 655350.0 FORMAT "%8.1" /end CHARACTERISTIC
/begin CHARACTERISTIC DDRC_DurDeb.Com_tiEAT11TOutDebDef_C "debouncing parameter / Duration of defect debouncing for check DFC_ComEAT11TOut" VALUE 0x804D899A Val_Wu16 655350.0 DDRCTime_ms 0.00 655350.0 FORMAT "%8.1" /end CHARACTERISTIC
/begin CHARACTERISTIC DDRC_DurDeb.Com_tiEAT12ChkSumDebOk_C "debouncing parameter / Duration of healing debouncing for check DFC_ComEAT12ChkSum" VALUE 0x804D899C Val_Wu16 655350.0 DDRCTime_ms 0.00 655350.0 FORMAT "%8.1" /end CHARACTERISTIC
/begin CHARACTERISTIC DDRC_DurDeb.Com_tiEAT12ChkSumDebDef_C "debouncing parameter / Duration of defect debouncing for check DFC_ComEAT12ChkSum" VALUE 0x804D899E Val_Wu16 655350.0 DDRCTime_ms 0.00 655350.0 FORMAT "%8.1" /end CHARACTERISTIC
/begin CHARACTERISTIC DDRC_DurDeb.Com_tiEAT12RingCntDebOk_C "debouncing parameter / Duration of healing debouncing for check DFC_ComEAT12RingCnt" VALUE 0x804D89A0 Val_Wu16 655350.0 DDRCTime_ms 0.00 655350.0 FORMAT "%8.1" /end CHARACTERISTIC
/begin CHARACTERISTIC DDRC_DurDeb.Com_tiEAT12RingCntDebDef_C "debouncing parameter / Duration of defect debouncing for check DFC_ComEAT12RingCnt" VALUE 0x804D89A2 Val_Wu16 655350.0 DDRCTime_ms 0.00 655350.0 FORMAT "%8.1" /end CHARACTERISTIC
/begin CHARACTERISTIC DDRC_DurDeb.Com_tiEAT12TOutDebOk_C "debouncing parameter / Duration of healing debouncing for check DFC_ComEAT12TOut" VALUE 0x804D89A4 Val_Wu16 655350.0 DDRCTime_ms 0.00 655350.0 FORMAT "%8.1" /end CHARACTERISTIC
/begin CHARACTERISTIC DDRC_DurDeb.Com_tiEAT12TOutDebDef_C "debouncing parameter / Duration of defect debouncing for check DFC_ComEAT12TOut" VALUE 0x804D89A6 Val_Wu16 655350.0 DDRCTime_ms 0.00 655350.0 FORMAT "%8.1" /end CHARACTERISTIC
/begin CHARACTERISTIC DDRC_DurDeb.Com_tiEAT13ChkSumDebOk_C "debouncing parameter / Duration of healing debouncing for check DFC_ComEAT13ChkSum" VALUE 0x804D89A8 Val_Wu16 655350.0 DDRCTime_ms 0.00 655350.0 FORMAT "%8.1" /end CHARACTERISTIC
/begin CHARACTERISTIC DDRC_DurDeb.Com_tiEAT13ChkSumDebDef_C "debouncing parameter / Duration of defect debouncing for check DFC_ComEAT13ChkSum" VALUE 0x804D89AA Val_Wu16 655350.0 DDRCTime_ms 0.00 655350.0 FORMAT "%8.1" /end CHARACTERISTIC
/begin CHARACTERISTIC DDRC_DurDeb.Com_tiEAT13RingCntDebOk_C "debouncing parameter / Duration of healing debouncing for check DFC_ComEAT13RingCnt" VALUE 0x804D89AC Val_Wu16 655350.0 DDRCTime_ms 0.00 655350.0 FORMAT "%8.1" /end CHARACTERISTIC
/begin CHARACTERISTIC DDRC_DurDeb.Com_tiEAT13RingCntDebDef_C "debouncing parameter / Duration of defect debouncing for check DFC_ComEAT13RingCnt" VALUE 0x804D89AE Val_Wu16 655350.0 DDRCTime_ms 0.00 655350.0 FORMAT "%8.1" /end CHARACTERISTIC
/begin CHARACTERISTIC DDRC_DurDeb.Com_tiEAT13TOutDebOk_C "debouncing parameter / Duration of healing debouncing for check DFC_ComEAT13TOut" VALUE 0x804D89B0 Val_Wu16 655350.0 DDRCTime_ms 0.00 655350.0 FORMAT "%8.1" /end CHARACTERISTIC
/begin CHARACTERISTIC DDRC_DurDeb.Com_tiEAT13TOutDebDef_C "debouncing parameter / Duration of defect debouncing for check DFC_ComEAT13TOut" VALUE 0x804D89B2 Val_Wu16 655350.0 DDRCTime_ms 0.00 655350.0 FORMAT "%8.1" /end CHARACTERISTIC
/begin CHARACTERISTIC DDRC_DurDeb.Com_tiEAT1ChksumDebOk_C "debouncing parameter / Duration of healing debouncing for check DFC_ComEAT1Chksum" VALUE 0x804D89B4 Val_Wu16 655350.0 DDRCTime_ms 0.00 655350.0 FORMAT "%8.1" /end CHARACTERISTIC
/begin CHARACTERISTIC DDRC_DurDeb.Com_tiEAT1ChksumDebDef_C "debouncing parameter / Duration of defect debouncing for check DFC_ComEAT1Chksum" VALUE 0x804D89B6 Val_Wu16 655350.0 DDRCTime_ms 0.00 655350.0 FORMAT "%8.1" /end CHARACTERISTIC
/begin CHARACTERISTIC DDRC_DurDeb.Com_tiEAT1RingCntDebOk_C "debouncing parameter / Duration of healing debouncing for check DFC_ComEAT1RingCnt" VALUE 0x804D89B8 Val_Wu16 655350.0 DDRCTime_ms 0.00 655350.0 FORMAT "%8.1" /end CHARACTERISTIC
/begin CHARACTERISTIC DDRC_DurDeb.Com_tiEAT1RingCntDebDef_C "debouncing parameter / Duration of defect debouncing for check DFC_ComEAT1RingCnt" VALUE 0x804D89BA Val_Wu16 655350.0 DDRCTime_ms 0.00 655350.0 FORMAT "%8.1" /end CHARACTERISTIC
/begin CHARACTERISTIC DDRC_DurDeb.Com_tiEAT1TOutDebOk_C "debouncing parameter / Duration of healing debouncing for check DFC_ComEAT1TOut" VALUE 0x804D89BC Val_Wu16 655350.0 DDRCTime_ms 0.00 655350.0 FORMAT "%8.1" /end CHARACTERISTIC
/begin CHARACTERISTIC DDRC_DurDeb.Com_tiEAT1TOutDebDef_C "debouncing parameter / Duration of defect debouncing for check DFC_ComEAT1TOut" VALUE 0x804D89BE Val_Wu16 655350.0 DDRCTime_ms 0.00 655350.0 FORMAT "%8.1" /end CHARACTERISTIC
/begin CHARACTERISTIC DDRC_DurDeb.Com_tiEAT2ChksumDebOk_C "debouncing parameter / Duration of healing debouncing for check DFC_ComEAT2ChkSum" VALUE 0x804D89C0 Val_Wu16 655350.0 DDRCTime_ms 0.00 655350.0 FORMAT "%8.1" /end CHARACTERISTIC
/begin CHARACTERISTIC DDRC_DurDeb.Com_tiEAT2ChksumDebDef_C "debouncing parameter / Duration of defect debouncing for check DFC_ComEAT2ChkSum" VALUE 0x804D89C2 Val_Wu16 655350.0 DDRCTime_ms 0.00 655350.0 FORMAT "%8.1" /end CHARACTERISTIC
/begin CHARACTERISTIC DDRC_DurDeb.Com_tiEAT2RingCntDebOk_C "debouncing parameter / Duration of healing debouncing for check DFC_ComEAT2RingCnt" VALUE 0x804D89C4 Val_Wu16 655350.0 DDRCTime_ms 0.00 655350.0 FORMAT "%8.1" /end CHARACTERISTIC
/begin CHARACTERISTIC DDRC_DurDeb.Com_tiEAT2RingCntDebDef_C "debouncing parameter / Duration of defect debouncing for check DFC_ComEAT2RingCnt" VALUE 0x804D89C6 Val_Wu16 655350.0 DDRCTime_ms 0.00 655350.0 FORMAT "%8.1" /end CHARACTERISTIC
/begin CHARACTERISTIC DDRC_DurDeb.Com_tiEAT2TOutDebOk_C "debouncing parameter / Duration of healing debouncing for check DFC_ComEAT2TOut" VALUE 0x804D89C8 Val_Wu16 655350.0 DDRCTime_ms 0.00 655350.0 FORMAT "%8.1" /end CHARACTERISTIC
/begin CHARACTERISTIC DDRC_DurDeb.Com_tiEAT2TOutDebDef_C "debouncing parameter / Duration of defect debouncing for check DFC_ComEAT2TOut" VALUE 0x804D89CA Val_Wu16 655350.0 DDRCTime_ms 0.00 655350.0 FORMAT "%8.1" /end CHARACTERISTIC
/begin CHARACTERISTIC DDRC_DurDeb.Com_tiEAT4ChksumDebOk_C "debouncing parameter / Duration of healing debouncing for check DFC_ComEAT4ChkSum" VALUE 0x804D89CC Val_Wu16 655350.0 DDRCTime_ms 0.00 655350.0 FORMAT "%8.1" /end CHARACTERISTIC
/begin CHARACTERISTIC DDRC_DurDeb.Com_tiEAT4ChksumDebDef_C "debouncing parameter / Duration of defect debouncing for check DFC_ComEAT4ChkSum" VALUE 0x804D89CE Val_Wu16 655350.0 DDRCTime_ms 0.00 655350.0 FORMAT "%8.1" /end CHARACTERISTIC
/begin CHARACTERISTIC DDRC_DurDeb.Com_tiEAT4RingCntDebOk_C "debouncing parameter / Duration of healing debouncing for check DFC_ComEAT4RingCnt" VALUE 0x804D89D0 Val_Wu16 655350.0 DDRCTime_ms 0.00 655350.0 FORMAT "%8.1" /end CHARACTERISTIC
/begin CHARACTERISTIC DDRC_DurDeb.Com_tiEAT4RingCntDebDef_C "debouncing parameter / Duration of defect debouncing for check DFC_ComEAT4RingCnt" VALUE 0x804D89D2 Val_Wu16 655350.0 DDRCTime_ms 0.00 655350.0 FORMAT "%8.1" /end CHARACTERISTIC
/begin CHARACTERISTIC DDRC_DurDeb.Com_tiEAT4TOutDebOk_C "debouncing parameter / Duration of healing debouncing for check DFC_ComEAT4TOut" VALUE 0x804D89D4 Val_Wu16 655350.0 DDRCTime_ms 0.00 655350.0 FORMAT "%8.1" /end CHARACTERISTIC
/begin CHARACTERISTIC DDRC_DurDeb.Com_tiEAT4TOutDebDef_C "debouncing parameter / Duration of defect debouncing for check DFC_ComEAT4TOut" VALUE 0x804D89D6 Val_Wu16 655350.0 DDRCTime_ms 0.00 655350.0 FORMAT "%8.1" /end CHARACTERISTIC
/begin CHARACTERISTIC DDRC_DurDeb.Com_tiEAT6ChkSumDebOk_C "debouncing parameter / Duration of healing debouncing for check DFC_ComEAT6Chksum" VALUE 0x804D89D8 Val_Wu16 655350.0 DDRCTime_ms 0.00 655350.0 FORMAT "%8.1" /end CHARACTERISTIC
/begin CHARACTERISTIC DDRC_DurDeb.Com_tiEAT6ChkSumDebDef_C "debouncing parameter / Duration of defect debouncing for check DFC_ComEAT6Chksum" VALUE 0x804D89DA Val_Wu16 655350.0 DDRCTime_ms 0.00 655350.0 FORMAT "%8.1" /end CHARACTERISTIC
/begin CHARACTERISTIC DDRC_DurDeb.Com_tiEAT6RingCntDebOk_C "debouncing parameter / Duration of healing debouncing for check DFC_ComEAT6RingCnt" VALUE 0x804D89DC Val_Wu16 655350.0 DDRCTime_ms 0.00 655350.0 FORMAT "%8.1" /end CHARACTERISTIC
/begin CHARACTERISTIC DDRC_DurDeb.Com_tiEAT6RingCntDebDef_C "debouncing parameter / Duration of defect debouncing for check DFC_ComEAT6RingCnt" VALUE 0x804D89DE Val_Wu16 655350.0 DDRCTime_ms 0.00 655350.0 FORMAT "%8.1" /end CHARACTERISTIC
/begin CHARACTERISTIC DDRC_DurDeb.Com_tiEAT6TOutDebOk_C "debouncing parameter / Duration of healing debouncing for check DFC_ComEAT6TOut" VALUE 0x804D89E0 Val_Wu16 655350.0 DDRCTime_ms 0.00 655350.0 FORMAT "%8.1" /end CHARACTERISTIC
/begin CHARACTERISTIC DDRC_DurDeb.Com_tiEAT6TOutDebDef_C "debouncing parameter / Duration of defect debouncing for check DFC_ComEAT6TOut" VALUE 0x804D89E2 Val_Wu16 655350.0 DDRCTime_ms 0.00 655350.0 FORMAT "%8.1" /end CHARACTERISTIC
/begin CHARACTERISTIC DDRC_DurDeb.Com_tiEAT7ChkSumDebOk_C "debouncing parameter / Duration of healing debouncing for check DFC_ComEAT7Chksum" VALUE 0x804D89E4 Val_Wu16 655350.0 DDRCTime_ms 0.00 655350.0 FORMAT "%8.1" /end CHARACTERISTIC
/begin CHARACTERISTIC DDRC_DurDeb.Com_tiEAT7ChkSumDebDef_C "debouncing parameter / Duration of defect debouncing for check DFC_ComEAT7Chksum" VALUE 0x804D89E6 Val_Wu16 655350.0 DDRCTime_ms 0.00 655350.0 FORMAT "%8.1" /end CHARACTERISTIC
/begin CHARACTERISTIC DDRC_DurDeb.Com_tiEAT7RingCntDebOk_C "debouncing parameter / Duration of healing debouncing for check DFC_ComEAT7RingCnt" VALUE 0x804D89E8 Val_Wu16 655350.0 DDRCTime_ms 0.00 655350.0 FORMAT "%8.1" /end CHARACTERISTIC
/begin CHARACTERISTIC DDRC_DurDeb.Com_tiEAT7RingCntDebDef_C "debouncing parameter / Duration of defect debouncing for check DFC_ComEAT7RingCnt" VALUE 0x804D89EA Val_Wu16 655350.0 DDRCTime_ms 0.00 655350.0 FORMAT "%8.1" /end CHARACTERISTIC
/begin CHARACTERISTIC DDRC_DurDeb.Com_tiEAT7TOutDebOk_C "debouncing parameter / Duration of healing debouncing for check DFC_ComEAT7TOut" VALUE 0x804D89EC Val_Wu16 655350.0 DDRCTime_ms 0.00 655350.0 FORMAT "%8.1" /end CHARACTERISTIC
/begin CHARACTERISTIC DDRC_DurDeb.Com_tiEAT7TOutDebDef_C "debouncing parameter / Duration of defect debouncing for check DFC_ComEAT7TOut" VALUE 0x804D89EE Val_Wu16 655350.0 DDRCTime_ms 0.00 655350.0 FORMAT "%8.1" /end CHARACTERISTIC
/begin CHARACTERISTIC DDRC_DurDeb.Com_tiEAT8ChkSumDebOk_C "debouncing parameter / Duration of healing debouncing for check DFC_ComEAT8Chksum" VALUE 0x804D89F0 Val_Wu16 655350.0 DDRCTime_ms 0.00 655350.0 FORMAT "%8.1" /end CHARACTERISTIC
/begin CHARACTERISTIC DDRC_DurDeb.Com_tiEAT8ChkSumDebDef_C "debouncing parameter / Duration of defect debouncing for check DFC_ComEAT8Chksum" VALUE 0x804D89F2 Val_Wu16 655350.0 DDRCTime_ms 0.00 655350.0 FORMAT "%8.1" /end CHARACTERISTIC
/begin CHARACTERISTIC DDRC_DurDeb.Com_tiEAT8RingCntDebOk_C "debouncing parameter / Duration of healing debouncing for check DFC_ComEAT8RingCnt" VALUE 0x804D89F4 Val_Wu16 655350.0 DDRCTime_ms 0.00 655350.0 FORMAT "%8.1" /end CHARACTERISTIC
/begin CHARACTERISTIC DDRC_DurDeb.Com_tiEAT8RingCntDebDef_C "debouncing parameter / Duration of defect debouncing for check DFC_ComEAT8RingCnt" VALUE 0x804D89F6 Val_Wu16 655350.0 DDRCTime_ms 0.00 655350.0 FORMAT "%8.1" /end CHARACTERISTIC
/begin CHARACTERISTIC DDRC_DurDeb.Com_tiEAT8TOutDebOk_C "debouncing parameter / Duration of healing debouncing for check DFC_ComEAT8TOut" VALUE 0x804D89F8 Val_Wu16 655350.0 DDRCTime_ms 0.00 655350.0 FORMAT "%8.1" /end CHARACTERISTIC
/begin CHARACTERISTIC DDRC_DurDeb.Com_tiEAT8TOutDebDef_C "debouncing parameter / Duration of defect debouncing for check DFC_ComEAT8TOut" VALUE 0x804D89FA Val_Wu16 655350.0 DDRCTime_ms 0.00 655350.0 FORMAT "%8.1" /end CHARACTERISTIC
/begin CHARACTERISTIC DDRC_DurDeb.Com_tiEATAChkSumDebOk_C "debouncing parameter / Duration of healing debouncing for check DFC_ComEATAChksum" VALUE 0x804D89FC Val_Wu16 655350.0 DDRCTime_ms 0.00 655350.0 FORMAT "%8.1" /end CHARACTERISTIC
/begin CHARACTERISTIC DDRC_DurDeb.Com_tiEATAChkSumDebDef_C "debouncing parameter / Duration of defect debouncing for check DFC_ComEATAChksum" VALUE 0x804D89FE Val_Wu16 655350.0 DDRCTime_ms 0.00 655350.0 FORMAT "%8.1" /end CHARACTERISTIC
/begin CHARACTERISTIC DDRC_DurDeb.Com_tiEATARingCntDebOk_C "debouncing parameter / Duration of healing debouncing for check DFC_ComEATARingCnt" VALUE 0x804D8A00 Val_Wu16 655350.0 DDRCTime_ms 0.00 655350.0 FORMAT "%8.1" /end CHARACTERISTIC
/begin CHARACTERISTIC DDRC_DurDeb.Com_tiEATARingCntDebDef_C "debouncing parameter / Duration of defect debouncing for check DFC_ComEATARingCnt" VALUE 0x804D8A02 Val_Wu16 655350.0 DDRCTime_ms 0.00 655350.0 FORMAT "%8.1" /end CHARACTERISTIC
/begin CHARACTERISTIC DDRC_DurDeb.Com_tiEATATOutDebOk_C "debouncing parameter / Duration of healing debouncing for check DFC_ComEATATOut" VALUE 0x804D8A04 Val_Wu16 655350.0 DDRCTime_ms 0.00 655350.0 FORMAT "%8.1" /end CHARACTERISTIC
/begin CHARACTERISTIC DDRC_DurDeb.Com_tiEATATOutDebDef_C "debouncing parameter / Duration of defect debouncing for check DFC_ComEATATOut" VALUE 0x804D8A06 Val_Wu16 655350.0 DDRCTime_ms 0.00 655350.0 FORMAT "%8.1" /end CHARACTERISTIC
/begin CHARACTERISTIC DDRC_DurDeb.Com_tiEATBChksumDebOk_C "debouncing parameter / Duration of healing debouncing for check DFC_ComEATBChkSum" VALUE 0x804D8A08 Val_Wu16 655350.0 DDRCTime_ms 0.00 655350.0 FORMAT "%8.1" /end CHARACTERISTIC
/begin CHARACTERISTIC DDRC_DurDeb.Com_tiEATBChksumDebDef_C "debouncing parameter / Duration of defect debouncing for check DFC_ComEATBChkSum" VALUE 0x804D8A0A Val_Wu16 655350.0 DDRCTime_ms 0.00 655350.0 FORMAT "%8.1" /end CHARACTERISTIC
/begin CHARACTERISTIC DDRC_DurDeb.Com_tiEATBRingCntDebOk_C "debouncing parameter / Duration of healing debouncing for check DFC_ComEATBRingCnt" VALUE 0x804D8A0C Val_Wu16 655350.0 DDRCTime_ms 0.00 655350.0 FORMAT "%8.1" /end CHARACTERISTIC
/begin CHARACTERISTIC DDRC_DurDeb.Com_tiEATBRingCntDebDef_C "debouncing parameter / Duration of defect debouncing for check DFC_ComEATBRingCnt" VALUE 0x804D8A0E Val_Wu16 655350.0 DDRCTime_ms 0.00 655350.0 FORMAT "%8.1" /end CHARACTERISTIC
/begin CHARACTERISTIC DDRC_DurDeb.Com_tiEATBTOutDebOk_C "debouncing parameter / Duration of healing debouncing for check DFC_ComEATBTOut" VALUE 0x804D8A10 Val_Wu16 655350.0 DDRCTime_ms 0.00 655350.0 FORMAT "%8.1" /end CHARACTERISTIC
/begin CHARACTERISTIC DDRC_DurDeb.Com_tiEATBTOutDebDef_C "debouncing parameter / Duration of defect debouncing for check DFC_ComEATBTOut" VALUE 0x804D8A12 Val_Wu16 655350.0 DDRCTime_ms 0.00 655350.0 FORMAT "%8.1" /end CHARACTERISTIC
/begin CHARACTERISTIC DDRC_DurDeb.Com_tiEATCChkSumDebOk_C "debouncing parameter / Duration of healing debouncing for check DFC_ComEATCChksum" VALUE 0x804D8A14 Val_Wu16 655350.0 DDRCTime_ms 0.00 655350.0 FORMAT "%8.1" /end CHARACTERISTIC
/begin CHARACTERISTIC DDRC_DurDeb.Com_tiEATCChkSumDebDef_C "debouncing parameter / Duration of defect debouncing for check DFC_ComEATCChksum" VALUE 0x804D8A16 Val_Wu16 655350.0 DDRCTime_ms 0.00 655350.0 FORMAT "%8.1" /end CHARACTERISTIC
/begin CHARACTERISTIC DDRC_DurDeb.Com_tiEATCRingCntDebOk_C "debouncing parameter / Duration of healing debouncing for check DFC_ComEATCRingCnt" VALUE 0x804D8A18 Val_Wu16 655350.0 DDRCTime_ms 0.00 655350.0 FORMAT "%8.1" /end CHARACTERISTIC
/begin CHARACTERISTIC DDRC_DurDeb.Com_tiEATCRingCntDebDef_C "debouncing parameter / Duration of defect debouncing for check DFC_ComEATCRingCnt" VALUE 0x804D8A1A Val_Wu16 655350.0 DDRCTime_ms 0.00 655350.0 FORMAT "%8.1" /end CHARACTERISTIC
/begin CHARACTERISTIC DDRC_DurDeb.Com_tiEATCTOutDebOk_C "debouncing parameter / Duration of healing debouncing for check DFC_ComEATCTOut" VALUE 0x804D8A1C Val_Wu16 655350.0 DDRCTime_ms 0.00 655350.0 FORMAT "%8.1" /end CHARACTERISTIC
/begin CHARACTERISTIC DDRC_DurDeb.Com_tiEATCTOutDebDef_C "debouncing parameter / Duration of defect debouncing for check DFC_ComEATCTOut" VALUE 0x804D8A1E Val_Wu16 655350.0 DDRCTime_ms 0.00 655350.0 FORMAT "%8.1" /end CHARACTERISTIC
/begin CHARACTERISTIC DDRC_DurDeb.Com_tiEPBBChkSumDebOk_C "debouncing parameter / Duration of healing debouncing for check DFC_ComEPBBChkSum" VALUE 0x804D8A20 Val_Wu16 655350.0 DDRCTime_ms 0.00 655350.0 FORMAT "%8.1" /end CHARACTERISTIC
/begin CHARACTERISTIC DDRC_DurDeb.Com_tiEPBBChkSumDebDef_C "debouncing parameter / Duration of defect debouncing for check DFC_ComEPBBChkSum" VALUE 0x804D8A22 Val_Wu16 655350.0 DDRCTime_ms 0.00 655350.0 FORMAT "%8.1" /end CHARACTERISTIC
/begin CHARACTERISTIC DDRC_DurDeb.Com_tiEPBBRingCntDebOk_C "debouncing parameter / Duration of healing debouncing for check DFC_ComEPBBRingCnt" VALUE 0x804D8A24 Val_Wu16 655350.0 DDRCTime_ms 0.00 655350.0 FORMAT "%8.1" /end CHARACTERISTIC
/begin CHARACTERISTIC DDRC_DurDeb.Com_tiEPBBRingCntDebDef_C "debouncing parameter / Duration of defect debouncing for check DFC_ComEPBBRingCnt" VALUE 0x804D8A26 Val_Wu16 655350.0 DDRCTime_ms 0.00 655350.0 FORMAT "%8.1" /end CHARACTERISTIC
/begin CHARACTERISTIC DDRC_DurDeb.Com_tiEPBBTOutDebOk_C "debouncing parameter / Duration of healing debouncing for check DFC_ComEPBBTOut" VALUE 0x804D8A28 Val_Wu16 655350.0 DDRCTime_ms 0.00 655350.0 FORMAT "%8.1" /end CHARACTERISTIC
/begin CHARACTERISTIC DDRC_DurDeb.Com_tiEPBBTOutDebDef_C "debouncing parameter / Duration of defect debouncing for check DFC_ComEPBBTOut" VALUE 0x804D8A2A Val_Wu16 655350.0 DDRCTime_ms 0.00 655350.0 FORMAT "%8.1" /end CHARACTERISTIC
/begin CHARACTERISTIC DDRC_DurDeb.Com_tiEPBChkSumDebOk_C "debouncing parameter / Duration of healing debouncing for check DFC_ComEPBChksum" VALUE 0x804D8A2C Val_Wu16 655350.0 DDRCTime_ms 0.00 655350.0 FORMAT "%8.1" /end CHARACTERISTIC
/begin CHARACTERISTIC DDRC_DurDeb.Com_tiEPBChkSumDebDef_C "debouncing parameter / Duration of defect debouncing for check DFC_ComEPBChksum" VALUE 0x804D8A2E Val_Wu16 655350.0 DDRCTime_ms 0.00 655350.0 FORMAT "%8.1" /end CHARACTERISTIC
/begin CHARACTERISTIC DDRC_DurDeb.Com_tiEPBTOutDebOk_C "debouncing parameter / Duration of healing debouncing for check DFC_ComEPBTOut" VALUE 0x804D8A30 Val_Wu16 655350.0 DDRCTime_ms 0.00 655350.0 FORMAT "%8.1" /end CHARACTERISTIC
/begin CHARACTERISTIC DDRC_DurDeb.Com_tiEPBTOutDebDef_C "debouncing parameter / Duration of defect debouncing for check DFC_ComEPBTOut" VALUE 0x804D8A32 Val_Wu16 655350.0 DDRCTime_ms 0.00 655350.0 FORMAT "%8.1" /end CHARACTERISTIC
/begin CHARACTERISTIC DDRC_DurDeb.Com_tiEPBctRingDebOk_C "debouncing parameter / Duration of healing debouncing for check DFC_ComEPBctRing" VALUE 0x804D8A34 Val_Wu16 655350.0 DDRCTime_ms 0.00 655350.0 FORMAT "%8.1" /end CHARACTERISTIC
/begin CHARACTERISTIC DDRC_DurDeb.Com_tiEPBctRingDebDef_C "debouncing parameter / Duration of defect debouncing for check DFC_ComEPBctRing" VALUE 0x804D8A36 Val_Wu16 655350.0 DDRCTime_ms 0.00 655350.0 FORMAT "%8.1" /end CHARACTERISTIC
/begin CHARACTERISTIC DDRC_DurDeb.Com_tiEPS1ChksumDebOk_C "debouncing parameter / Duration of healing debouncing for check DFC_ComEPS1Chksum" VALUE 0x804D8A38 Val_Wu16 655350.0 DDRCTime_ms 0.00 655350.0 FORMAT "%8.1" /end CHARACTERISTIC
/begin CHARACTERISTIC DDRC_DurDeb.Com_tiEPS1ChksumDebDef_C "debouncing parameter / Duration of defect debouncing for check DFC_ComEPS1Chksum" VALUE 0x804D8A3A Val_Wu16 655350.0 DDRCTime_ms 0.00 655350.0 FORMAT "%8.1" /end CHARACTERISTIC
/begin CHARACTERISTIC DDRC_DurDeb.Com_tiEPS1RingCntDebOk_C "debouncing parameter / Duration of healing debouncing for check DFC_ComEPS1RingCnt" VALUE 0x804D8A3C Val_Wu16 655350.0 DDRCTime_ms 0.00 655350.0 FORMAT "%8.1" /end CHARACTERISTIC
/begin CHARACTERISTIC DDRC_DurDeb.Com_tiEPS1RingCntDebDef_C "debouncing parameter / Duration of defect debouncing for check DFC_ComEPS1RingCnt" VALUE 0x804D8A3E Val_Wu16 655350.0 DDRCTime_ms 0.00 655350.0 FORMAT "%8.1" /end CHARACTERISTIC
/begin CHARACTERISTIC DDRC_DurDeb.Com_tiEPS1TOutDebOk_C "debouncing parameter / Duration of healing debouncing for check DFC_ComEPS1TOut" VALUE 0x804D8A40 Val_Wu16 655350.0 DDRCTime_ms 0.00 655350.0 FORMAT "%8.1" /end CHARACTERISTIC
/begin CHARACTERISTIC DDRC_DurDeb.Com_tiEPS1TOutDebDef_C "debouncing parameter / Duration of defect debouncing for check DFC_ComEPS1TOut" VALUE 0x804D8A42 Val_Wu16 655350.0 DDRCTime_ms 0.00 655350.0 FORMAT "%8.1" /end CHARACTERISTIC
/begin CHARACTERISTIC DDRC_DurDeb.Com_tiEngCanRxErrDebOk_C "debouncing parameter / Duration of healing debouncing for check DFC_ComEngCanRxErr" VALUE 0x804D8A44 Val_Wu16 655350.0 DDRCTime_ms 0.00 655350.0 FORMAT "%8.1" /end CHARACTERISTIC
/begin CHARACTERISTIC DDRC_DurDeb.Com_tiEngCanRxErrDebDef_C "debouncing parameter / Duration of defect debouncing for check DFC_ComEngCanRxErr" VALUE 0x804D8A46 Val_Wu16 655350.0 DDRCTime_ms 0.00 655350.0 FORMAT "%8.1" /end CHARACTERISTIC
/begin CHARACTERISTIC DDRC_DurDeb.Com_tiGrvySnsrErrDebOk_C "debouncing parameter / Duration of healing debouncing for check DFC_ComGrvySnsrErr" VALUE 0x804D8A48 Val_Wu16 655350.0 DDRCTime_ms 0.00 655350.0 FORMAT "%8.1" /end CHARACTERISTIC
/begin CHARACTERISTIC DDRC_DurDeb.Com_tiGrvySnsrErrDebDef_C "debouncing parameter / Duration of defect debouncing for check DFC_ComGrvySnsrErr" VALUE 0x804D8A4A Val_Wu16 655350.0 DDRCTime_ms 0.00 655350.0 FORMAT "%8.1" /end CHARACTERISTIC
/begin CHARACTERISTIC DDRC_DurDeb.Com_tiGwIMG1ChkSumDebOk_C "debouncing parameter / Duration of healing debouncing for check DFC_ComGwIMG1ChkSum" VALUE 0x804D8A4C Val_Wu16 655350.0 DDRCTime_ms 0.00 655350.0 FORMAT "%8.1" /end CHARACTERISTIC
/begin CHARACTERISTIC DDRC_DurDeb.Com_tiGwIMG1ChkSumDebDef_C "debouncing parameter / Duration of defect debouncing for check DFC_ComGwIMG1ChkSum" VALUE 0x804D8A4E Val_Wu16 655350.0 DDRCTime_ms 0.00 655350.0 FORMAT "%8.1" /end CHARACTERISTIC
/begin CHARACTERISTIC DDRC_DurDeb.Com_tiGwIMG1RingCntDebOk_C "debouncing parameter / Duration of healing debouncing for check DFC_ComGwIMG1RingCnt" VALUE 0x804D8A50 Val_Wu16 655350.0 DDRCTime_ms 0.00 655350.0 FORMAT "%8.1" /end CHARACTERISTIC
/begin CHARACTERISTIC DDRC_DurDeb.Com_tiGwIMG1RingCntDebDef_C "debouncing parameter / Duration of defect debouncing for check DFC_ComGwIMG1RingCnt" VALUE 0x804D8A52 Val_Wu16 655350.0 DDRCTime_ms 0.00 655350.0 FORMAT "%8.1" /end CHARACTERISTIC
/begin CHARACTERISTIC DDRC_DurDeb.Com_tiGwIMG1TOutDebOk_C "debouncing parameter / Duration of healing debouncing for check DFC_ComGwIMG1TOut" VALUE 0x804D8A54 Val_Wu16 655350.0 DDRCTime_ms 0.00 655350.0 FORMAT "%8.1" /end CHARACTERISTIC
/begin CHARACTERISTIC DDRC_DurDeb.Com_tiGwIMG1TOutDebDef_C "debouncing parameter / Duration of defect debouncing for check DFC_ComGwIMG1TOut" VALUE 0x804D8A56 Val_Wu16 655350.0 DDRCTime_ms 0.00 655350.0 FORMAT "%8.1" /end CHARACTERISTIC
/begin CHARACTERISTIC DDRC_DurDeb.Com_tiGwIMG3ChkSumDebOk_C "debouncing parameter / Duration of healing debouncing for check DFC_ComGwIMG3ChkSum" VALUE 0x804D8A58 Val_Wu16 655350.0 DDRCTime_ms 0.00 655350.0 FORMAT "%8.1" /end CHARACTERISTIC
/begin CHARACTERISTIC DDRC_DurDeb.Com_tiGwIMG3ChkSumDebDef_C "debouncing parameter / Duration of defect debouncing for check DFC_ComGwIMG3ChkSum" VALUE 0x804D8A5A Val_Wu16 655350.0 DDRCTime_ms 0.00 655350.0 FORMAT "%8.1" /end CHARACTERISTIC
/begin CHARACTERISTIC DDRC_DurDeb.Com_tiGwIMG3RingCntDebOk_C "debouncing parameter / Duration of healing debouncing for check DFC_ComGwIMG3RingCnt" VALUE 0x804D8A5C Val_Wu16 655350.0 DDRCTime_ms 0.00 655350.0 FORMAT "%8.1" /end CHARACTERISTIC
/begin CHARACTERISTIC DDRC_DurDeb.Com_tiGwIMG3RingCntDebDef_C "debouncing parameter / Duration of defect debouncing for check DFC_ComGwIMG3RingCnt" VALUE 0x804D8A5E Val_Wu16 655350.0 DDRCTime_ms 0.00 655350.0 FORMAT "%8.1" /end CHARACTERISTIC
/begin CHARACTERISTIC DDRC_DurDeb.Com_tiGwIMG3TOutDebOk_C "debouncing parameter / Duration of healing debouncing for check DFC_ComGwIMG3TOut" VALUE 0x804D8A60 Val_Wu16 655350.0 DDRCTime_ms 0.00 655350.0 FORMAT "%8.1" /end CHARACTERISTIC
/begin CHARACTERISTIC DDRC_DurDeb.Com_tiGwIMG3TOutDebDef_C "debouncing parameter / Duration of defect debouncing for check DFC_ComGwIMG3TOut" VALUE 0x804D8A62 Val_Wu16 655350.0 DDRCTime_ms 0.00 655350.0 FORMAT "%8.1" /end CHARACTERISTIC
/begin CHARACTERISTIC DDRC_DurDeb.Com_tiGwIMG4ChkSumDebOk_C "debouncing parameter / Duration of healing debouncing for check DFC_ComGwIMG4ChkSum" VALUE 0x804D8A64 Val_Wu16 655350.0 DDRCTime_ms 0.00 655350.0 FORMAT "%8.1" /end CHARACTERISTIC
/begin CHARACTERISTIC DDRC_DurDeb.Com_tiGwIMG4ChkSumDebDef_C "debouncing parameter / Duration of defect debouncing for check DFC_ComGwIMG4ChkSum" VALUE 0x804D8A66 Val_Wu16 655350.0 DDRCTime_ms 0.00 655350.0 FORMAT "%8.1" /end CHARACTERISTIC
/begin CHARACTERISTIC DDRC_DurDeb.Com_tiGwIMG4RingCntDebOk_C "debouncing parameter / Duration of healing debouncing for check DFC_ComGwIMG4RingCnt" VALUE 0x804D8A68 Val_Wu16 655350.0 DDRCTime_ms 0.00 655350.0 FORMAT "%8.1" /end CHARACTERISTIC
/begin CHARACTERISTIC DDRC_DurDeb.Com_tiGwIMG4RingCntDebDef_C "debouncing parameter / Duration of defect debouncing for check DFC_ComGwIMG4RingCnt" VALUE 0x804D8A6A Val_Wu16 655350.0 DDRCTime_ms 0.00 655350.0 FORMAT "%8.1" /end CHARACTERISTIC
/begin CHARACTERISTIC DDRC_DurDeb.Com_tiGwIMG4TOutDebOk_C "debouncing parameter / Duration of healing debouncing for check DFC_ComGwIMG4TOut" VALUE 0x804D8A6C Val_Wu16 655350.0 DDRCTime_ms 0.00 655350.0 FORMAT "%8.1" /end CHARACTERISTIC
/begin CHARACTERISTIC DDRC_DurDeb.Com_tiGwIMG4TOutDebDef_C "debouncing parameter / Duration of defect debouncing for check DFC_ComGwIMG4TOut" VALUE 0x804D8A6E Val_Wu16 655350.0 DDRCTime_ms 0.00 655350.0 FORMAT "%8.1" /end CHARACTERISTIC
/begin CHARACTERISTIC DDRC_DurDeb.Com_tiGwIMG5ChkSumDebOk_C "debouncing parameter / Duration of healing debouncing for check DFC_ComGwIMG5ChkSum" VALUE 0x804D8A70 Val_Wu16 655350.0 DDRCTime_ms 0.00 655350.0 FORMAT "%8.1" /end CHARACTERISTIC
/begin CHARACTERISTIC DDRC_DurDeb.Com_tiGwIMG5ChkSumDebDef_C "debouncing parameter / Duration of defect debouncing for check DFC_ComGwIMG5ChkSum" VALUE 0x804D8A72 Val_Wu16 655350.0 DDRCTime_ms 0.00 655350.0 FORMAT "%8.1" /end CHARACTERISTIC
/begin CHARACTERISTIC DDRC_DurDeb.Com_tiGwIMG5RingCntDebOk_C "debouncing parameter / Duration of healing debouncing for check DFC_ComGwIMG5RingCnt" VALUE 0x804D8A74 Val_Wu16 655350.0 DDRCTime_ms 0.00 655350.0 FORMAT "%8.1" /end CHARACTERISTIC
/begin CHARACTERISTIC DDRC_DurDeb.Com_tiGwIMG5RingCntDebDef_C "debouncing parameter / Duration of defect debouncing for check DFC_ComGwIMG5RingCnt" VALUE 0x804D8A76 Val_Wu16 655350.0 DDRCTime_ms 0.00 655350.0 FORMAT "%8.1" /end CHARACTERISTIC
/begin CHARACTERISTIC DDRC_DurDeb.Com_tiGwIMG5TOutDebOk_C "debouncing parameter / Duration of healing debouncing for check DFC_ComGwIMG5TOut" VALUE 0x804D8A78 Val_Wu16 655350.0 DDRCTime_ms 0.00 655350.0 FORMAT "%8.1" /end CHARACTERISTIC
/begin CHARACTERISTIC DDRC_DurDeb.Com_tiGwIMG5TOutDebDef_C "debouncing parameter / Duration of defect debouncing for check DFC_ComGwIMG5TOut" VALUE 0x804D8A7A Val_Wu16 655350.0 DDRCTime_ms 0.00 655350.0 FORMAT "%8.1" /end CHARACTERISTIC
/begin CHARACTERISTIC DDRC_DurDeb.Com_tiGwIMG6ChkSumDebOk_C "debouncing parameter / Duration of healing debouncing for check DFC_ComGwIMG6ChkSum" VALUE 0x804D8A7C Val_Wu16 655350.0 DDRCTime_ms 0.00 655350.0 FORMAT "%8.1" /end CHARACTERISTIC
/begin CHARACTERISTIC DDRC_DurDeb.Com_tiGwIMG6ChkSumDebDef_C "debouncing parameter / Duration of defect debouncing for check DFC_ComGwIMG6ChkSum" VALUE 0x804D8A7E Val_Wu16 655350.0 DDRCTime_ms 0.00 655350.0 FORMAT "%8.1" /end CHARACTERISTIC
/begin CHARACTERISTIC DDRC_DurDeb.Com_tiGwIMG6RingCntDebOk_C "debouncing parameter / Duration of healing debouncing for check DFC_ComGwIMG6RingCnt" VALUE 0x804D8A80 Val_Wu16 655350.0 DDRCTime_ms 0.00 655350.0 FORMAT "%8.1" /end CHARACTERISTIC
/begin CHARACTERISTIC DDRC_DurDeb.Com_tiGwIMG6RingCntDebDef_C "debouncing parameter / Duration of defect debouncing for check DFC_ComGwIMG6RingCnt" VALUE 0x804D8A82 Val_Wu16 655350.0 DDRCTime_ms 0.00 655350.0 FORMAT "%8.1" /end CHARACTERISTIC
/begin CHARACTERISTIC DDRC_DurDeb.Com_tiGwIMG6TOutDebOk_C "debouncing parameter / Duration of healing debouncing for check DFC_ComGwIMG6TOut" VALUE 0x804D8A84 Val_Wu16 655350.0 DDRCTime_ms 0.00 655350.0 FORMAT "%8.1" /end CHARACTERISTIC
/begin CHARACTERISTIC DDRC_DurDeb.Com_tiGwIMG6TOutDebDef_C "debouncing parameter / Duration of defect debouncing for check DFC_ComGwIMG6TOut" VALUE 0x804D8A86 Val_Wu16 655350.0 DDRCTime_ms 0.00 655350.0 FORMAT "%8.1" /end CHARACTERISTIC
/begin CHARACTERISTIC DDRC_DurDeb.Com_tiIDASBChkSumDebOk_C "debouncing parameter / Duration of healing debouncing for check DFC_ComIDASBChksum" VALUE 0x804D8A88 Val_Wu16 655350.0 DDRCTime_ms 0.00 655350.0 FORMAT "%8.1" /end CHARACTERISTIC
/begin CHARACTERISTIC DDRC_DurDeb.Com_tiIDASBChkSumDebDef_C "debouncing parameter / Duration of defect debouncing for check DFC_ComIDASBChksum" VALUE 0x804D8A8A Val_Wu16 655350.0 DDRCTime_ms 0.00 655350.0 FORMAT "%8.1" /end CHARACTERISTIC
/begin CHARACTERISTIC DDRC_DurDeb.Com_tiIDASBRingCntDebOk_C "debouncing parameter / Duration of healing debouncing for check DFC_ComIDASBRingCnt" VALUE 0x804D8A8C Val_Wu16 655350.0 DDRCTime_ms 0.00 655350.0 FORMAT "%8.1" /end CHARACTERISTIC
/begin CHARACTERISTIC DDRC_DurDeb.Com_tiIDASBRingCntDebDef_C "debouncing parameter / Duration of defect debouncing for check DFC_ComIDASBRingCnt" VALUE 0x804D8A8E Val_Wu16 655350.0 DDRCTime_ms 0.00 655350.0 FORMAT "%8.1" /end CHARACTERISTIC
/begin CHARACTERISTIC DDRC_DurDeb.Com_tiIDASBTOutDebOk_C "debouncing parameter / Duration of healing debouncing for check DFC_ComIDASBTOut" VALUE 0x804D8A90 Val_Wu16 655350.0 DDRCTime_ms 0.00 655350.0 FORMAT "%8.1" /end CHARACTERISTIC
/begin CHARACTERISTIC DDRC_DurDeb.Com_tiIDASBTOutDebDef_C "debouncing parameter / Duration of defect debouncing for check DFC_ComIDASBTOut" VALUE 0x804D8A92 Val_Wu16 655350.0 DDRCTime_ms 0.00 655350.0 FORMAT "%8.1" /end CHARACTERISTIC
/begin CHARACTERISTIC DDRC_DurDeb.Com_tiIMGMILReqDebOk_C "debouncing parameter / Duration of healing debouncing for check DFC_ComIMGMILReq" VALUE 0x804D8A94 Val_Wu16 655350.0 DDRCTime_ms 0.00 655350.0 FORMAT "%8.1" /end CHARACTERISTIC
/begin CHARACTERISTIC DDRC_DurDeb.Com_tiIMGMILReqDebDef_C "debouncing parameter / Duration of defect debouncing for check DFC_ComIMGMILReq" VALUE 0x804D8A96 Val_Wu16 655350.0 DDRCTime_ms 0.00 655350.0 FORMAT "%8.1" /end CHARACTERISTIC
/begin CHARACTERISTIC DDRC_DurDeb.Com_tiISSPrmsDebOk_C "debouncing parameter / Duration of healing debouncing for check DFC_ComISSPrms" VALUE 0x804D8A98 Val_Wu16 655350.0 DDRCTime_ms 0.00 655350.0 FORMAT "%8.1" /end CHARACTERISTIC
/begin CHARACTERISTIC DDRC_DurDeb.Com_tiISSPrmsDebDef_C "debouncing parameter / Duration of defect debouncing for check DFC_ComISSPrms" VALUE 0x804D8A9A Val_Wu16 655350.0 DDRCTime_ms 0.00 655350.0 FORMAT "%8.1" /end CHARACTERISTIC
/begin CHARACTERISTIC DDRC_DurDeb.Com_tiMETACSumDebOk_C "debouncing parameter / Duration of healing debouncing for check DFC_ComMETAChksum" VALUE 0x804D8A9C Val_Wu16 655350.0 DDRCTime_ms 0.00 655350.0 FORMAT "%8.1" /end CHARACTERISTIC
/begin CHARACTERISTIC DDRC_DurDeb.Com_tiMETACSumDebDef_C "debouncing parameter / Duration of defect debouncing for check DFC_ComMETAChksum" VALUE 0x804D8A9E Val_Wu16 655350.0 DDRCTime_ms 0.00 655350.0 FORMAT "%8.1" /end CHARACTERISTIC
/begin CHARACTERISTIC DDRC_DurDeb.Com_tiMETACSumPstDrvDebOk_C "debouncing parameter / Duration of healing debouncing for check DFC_ComMETAChksumPstDrv" VALUE 0x804D8AA0 Val_Wu16 655350.0 DDRCTime_ms 0.00 655350.0 FORMAT "%8.1" /end CHARACTERISTIC
/begin CHARACTERISTIC DDRC_DurDeb.Com_tiMETACSumPstDrvDebDef_C "debouncing parameter / Duration of defect debouncing for check DFC_ComMETAChksumPstDrv" VALUE 0x804D8AA2 Val_Wu16 655350.0 DDRCTime_ms 0.00 655350.0 FORMAT "%8.1" /end CHARACTERISTIC
/begin CHARACTERISTIC DDRC_DurDeb.Com_tiMETARingCntrPstDrvDebOk_C "debouncing parameter / Duration of healing debouncing for check DFC_ComMETARingCntPstDrv" VALUE 0x804D8AA4 Val_Wu16 655350.0 DDRCTime_ms 0.00 655350.0 FORMAT "%8.1" /end CHARACTERISTIC
/begin CHARACTERISTIC DDRC_DurDeb.Com_tiMETARingCntrPstDrvDebDef_C "debouncing parameter / Duration of defect debouncing for check DFC_ComMETARingCntPstDrv" VALUE 0x804D8AA6 Val_Wu16 655350.0 DDRCTime_ms 0.00 655350.0 FORMAT "%8.1" /end CHARACTERISTIC
/begin CHARACTERISTIC DDRC_DurDeb.Com_tiMETAToutPstDrvDebOk_C "debouncing parameter / Duration of healing debouncing for check DFC_ComMETATOutPstDrv" VALUE 0x804D8AA8 Val_Wu16 655350.0 DDRCTime_ms 0.00 655350.0 FORMAT "%8.1" /end CHARACTERISTIC
/begin CHARACTERISTIC DDRC_DurDeb.Com_tiMETAToutPstDrvDebDef_C "debouncing parameter / Duration of defect debouncing for check DFC_ComMETATOutPstDrv" VALUE 0x804D8AAA Val_Wu16 655350.0 DDRCTime_ms 0.00 655350.0 FORMAT "%8.1" /end CHARACTERISTIC
/begin CHARACTERISTIC DDRC_DurDeb.Com_tiMETActRingDebOk_C "debouncing parameter / Duration of healing debouncing for check DFC_ComMETARingCnt" VALUE 0x804D8AAC Val_Wu16 655350.0 DDRCTime_ms 0.00 655350.0 FORMAT "%8.1" /end CHARACTERISTIC
/begin CHARACTERISTIC DDRC_DurDeb.Com_tiMETActRingDebDef_C "debouncing parameter / Duration of defect debouncing for check DFC_ComMETARingCnt" VALUE 0x804D8AAE Val_Wu16 655350.0 DDRCTime_ms 0.00 655350.0 FORMAT "%8.1" /end CHARACTERISTIC
/begin CHARACTERISTIC DDRC_DurDeb.Com_tiMETAtiDebDebOk_C "debouncing parameter / Duration of healing debouncing for check DFC_ComMETATOut" VALUE 0x804D8AB0 Val_Wu16 655350.0 DDRCTime_ms 0.00 655350.0 FORMAT "%8.1" /end CHARACTERISTIC
/begin CHARACTERISTIC DDRC_DurDeb.Com_tiMETAtiDebDebDef_C "debouncing parameter / Duration of defect debouncing for check DFC_ComMETATOut" VALUE 0x804D8AB2 Val_Wu16 655350.0 DDRCTime_ms 0.00 655350.0 FORMAT "%8.1" /end CHARACTERISTIC
/begin CHARACTERISTIC DDRC_DurDeb.Com_tiMETCCSumDebOk_C "debouncing parameter / Duration of healing debouncing for check DFC_ComMETCChksum" VALUE 0x804D8AB4 Val_Wu16 655350.0 DDRCTime_ms 0.00 655350.0 FORMAT "%8.1" /end CHARACTERISTIC
/begin CHARACTERISTIC DDRC_DurDeb.Com_tiMETCCSumDebDef_C "debouncing parameter / Duration of defect debouncing for check DFC_ComMETCChksum" VALUE 0x804D8AB6 Val_Wu16 655350.0 DDRCTime_ms 0.00 655350.0 FORMAT "%8.1" /end CHARACTERISTIC
/begin CHARACTERISTIC DDRC_DurDeb.Com_tiMETCctRingDebOk_C "debouncing parameter / Duration of healing debouncing for check DFC_ComMETCRingCnt" VALUE 0x804D8AB8 Val_Wu16 655350.0 DDRCTime_ms 0.00 655350.0 FORMAT "%8.1" /end CHARACTERISTIC
/begin CHARACTERISTIC DDRC_DurDeb.Com_tiMETCctRingDebDef_C "debouncing parameter / Duration of defect debouncing for check DFC_ComMETCRingCnt" VALUE 0x804D8ABA Val_Wu16 655350.0 DDRCTime_ms 0.00 655350.0 FORMAT "%8.1" /end CHARACTERISTIC
/begin CHARACTERISTIC DDRC_DurDeb.Com_tiMETCtiDebDebOk_C "debouncing parameter / Duration of healing debouncing for check DFC_ComMETCTOut" VALUE 0x804D8ABC Val_Wu16 655350.0 DDRCTime_ms 0.00 655350.0 FORMAT "%8.1" /end CHARACTERISTIC
/begin CHARACTERISTIC DDRC_DurDeb.Com_tiMETCtiDebDebDef_C "debouncing parameter / Duration of defect debouncing for check DFC_ComMETCTOut" VALUE 0x804D8ABE Val_Wu16 655350.0 DDRCTime_ms 0.00 655350.0 FORMAT "%8.1" /end CHARACTERISTIC
/begin CHARACTERISTIC DDRC_DurDeb.Com_tiMETDCSumDebOk_C "debouncing parameter / Duration of healing debouncing for check DFC_ComMETDChksum" VALUE 0x804D8AC0 Val_Wu16 655350.0 DDRCTime_ms 0.00 655350.0 FORMAT "%8.1" /end CHARACTERISTIC
/begin CHARACTERISTIC DDRC_DurDeb.Com_tiMETDCSumDebDef_C "debouncing parameter / Duration of defect debouncing for check DFC_ComMETDChksum" VALUE 0x804D8AC2 Val_Wu16 655350.0 DDRCTime_ms 0.00 655350.0 FORMAT "%8.1" /end CHARACTERISTIC
/begin CHARACTERISTIC DDRC_DurDeb.Com_tiMETDctRingDebOk_C "debouncing parameter / Duration of healing debouncing for check DFC_ComMETDRingCnt" VALUE 0x804D8AC4 Val_Wu16 655350.0 DDRCTime_ms 0.00 655350.0 FORMAT "%8.1" /end CHARACTERISTIC
/begin CHARACTERISTIC DDRC_DurDeb.Com_tiMETDctRingDebDef_C "debouncing parameter / Duration of defect debouncing for check DFC_ComMETDRingCnt" VALUE 0x804D8AC6 Val_Wu16 655350.0 DDRCTime_ms 0.00 655350.0 FORMAT "%8.1" /end CHARACTERISTIC
/begin CHARACTERISTIC DDRC_DurDeb.Com_tiMETDtiDebDebOk_C "debouncing parameter / Duration of healing debouncing for check DFC_ComMETDTOut" VALUE 0x804D8AC8 Val_Wu16 655350.0 DDRCTime_ms 0.00 655350.0 FORMAT "%8.1" /end CHARACTERISTIC
/begin CHARACTERISTIC DDRC_DurDeb.Com_tiMETDtiDebDebDef_C "debouncing parameter / Duration of defect debouncing for check DFC_ComMETDTOut" VALUE 0x804D8ACA Val_Wu16 655350.0 DDRCTime_ms 0.00 655350.0 FORMAT "%8.1" /end CHARACTERISTIC
/begin CHARACTERISTIC DDRC_DurDeb.Com_tiMETE2CSumDebOk_C "debouncing parameter / Duration of healing debouncing for check DFC_ComMETE2Chksum" VALUE 0x804D8ACC Val_Wu16 655350.0 DDRCTime_ms 0.00 655350.0 FORMAT "%8.1" /end CHARACTERISTIC
/begin CHARACTERISTIC DDRC_DurDeb.Com_tiMETE2CSumDebDef_C "debouncing parameter / Duration of defect debouncing for check DFC_ComMETE2Chksum" VALUE 0x804D8ACE Val_Wu16 655350.0 DDRCTime_ms 0.00 655350.0 FORMAT "%8.1" /end CHARACTERISTIC
/begin CHARACTERISTIC DDRC_DurDeb.Com_tiMETE2ctRingDebOk_C "debouncing parameter / Duration of healing debouncing for check DFC_ComMETE2RingCnt" VALUE 0x804D8AD0 Val_Wu16 655350.0 DDRCTime_ms 0.00 655350.0 FORMAT "%8.1" /end CHARACTERISTIC
/begin CHARACTERISTIC DDRC_DurDeb.Com_tiMETE2ctRingDebDef_C "debouncing parameter / Duration of defect debouncing for check DFC_ComMETE2RingCnt" VALUE 0x804D8AD2 Val_Wu16 655350.0 DDRCTime_ms 0.00 655350.0 FORMAT "%8.1" /end CHARACTERISTIC
/begin CHARACTERISTIC DDRC_DurDeb.Com_tiMETE2tiDebDebOk_C "debouncing parameter / Duration of healing debouncing for check DFC_ComMETE2TOut" VALUE 0x804D8AD4 Val_Wu16 655350.0 DDRCTime_ms 0.00 655350.0 FORMAT "%8.1" /end CHARACTERISTIC
/begin CHARACTERISTIC DDRC_DurDeb.Com_tiMETE2tiDebDebDef_C "debouncing parameter / Duration of defect debouncing for check DFC_ComMETE2TOut" VALUE 0x804D8AD6 Val_Wu16 655350.0 DDRCTime_ms 0.00 655350.0 FORMAT "%8.1" /end CHARACTERISTIC
/begin CHARACTERISTIC DDRC_DurDeb.Com_tiMETFChksumDebOk_C "debouncing parameter / Duration of healing debouncing for check DFC_ComMETFChksum" VALUE 0x804D8AD8 Val_Wu16 655350.0 DDRCTime_ms 0.00 655350.0 FORMAT "%8.1" /end CHARACTERISTIC
/begin CHARACTERISTIC DDRC_DurDeb.Com_tiMETFChksumDebDef_C "debouncing parameter / Duration of defect debouncing for check DFC_ComMETFChksum" VALUE 0x804D8ADA Val_Wu16 655350.0 DDRCTime_ms 0.00 655350.0 FORMAT "%8.1" /end CHARACTERISTIC
/begin CHARACTERISTIC DDRC_DurDeb.Com_tiMETFRingCntDebOk_C "debouncing parameter / Duration of healing debouncing for check DFC_ComMETFRingCnt" VALUE 0x804D8ADC Val_Wu16 655350.0 DDRCTime_ms 0.00 655350.0 FORMAT "%8.1" /end CHARACTERISTIC
/begin CHARACTERISTIC DDRC_DurDeb.Com_tiMETFRingCntDebDef_C "debouncing parameter / Duration of defect debouncing for check DFC_ComMETFRingCnt" VALUE 0x804D8ADE Val_Wu16 655350.0 DDRCTime_ms 0.00 655350.0 FORMAT "%8.1" /end CHARACTERISTIC
/begin CHARACTERISTIC DDRC_DurDeb.Com_tiMETFTOutDebOk_C "debouncing parameter / Duration of healing debouncing for check DFC_ComMETFTOut" VALUE 0x804D8AE0 Val_Wu16 655350.0 DDRCTime_ms 0.00 655350.0 FORMAT "%8.1" /end CHARACTERISTIC
/begin CHARACTERISTIC DDRC_DurDeb.Com_tiMETFTOutDebDef_C "debouncing parameter / Duration of defect debouncing for check DFC_ComMETFTOut" VALUE 0x804D8AE2 Val_Wu16 655350.0 DDRCTime_ms 0.00 655350.0 FORMAT "%8.1" /end CHARACTERISTIC
/begin CHARACTERISTIC DDRC_DurDeb.Com_tiMETGCSumDebOk_C "debouncing parameter / Duration of healing debouncing for check DFC_ComMETGChksum" VALUE 0x804D8AE4 Val_Wu16 655350.0 DDRCTime_ms 0.00 655350.0 FORMAT "%8.1" /end CHARACTERISTIC
/begin CHARACTERISTIC DDRC_DurDeb.Com_tiMETGCSumDebDef_C "debouncing parameter / Duration of defect debouncing for check DFC_ComMETGChksum" VALUE 0x804D8AE6 Val_Wu16 655350.0 DDRCTime_ms 0.00 655350.0 FORMAT "%8.1" /end CHARACTERISTIC
/begin CHARACTERISTIC DDRC_DurDeb.Com_tiMETGctRingDebOk_C "debouncing parameter / Duration of healing debouncing for check DFC_ComMETGRingCnt" VALUE 0x804D8AE8 Val_Wu16 655350.0 DDRCTime_ms 0.00 655350.0 FORMAT "%8.1" /end CHARACTERISTIC
/begin CHARACTERISTIC DDRC_DurDeb.Com_tiMETGctRingDebDef_C "debouncing parameter / Duration of defect debouncing for check DFC_ComMETGRingCnt" VALUE 0x804D8AEA Val_Wu16 655350.0 DDRCTime_ms 0.00 655350.0 FORMAT "%8.1" /end CHARACTERISTIC
/begin CHARACTERISTIC DDRC_DurDeb.Com_tiMETGtiDebDebOk_C "debouncing parameter / Duration of healing debouncing for check DFC_ComMETGTOut" VALUE 0x804D8AEC Val_Wu16 655350.0 DDRCTime_ms 0.00 655350.0 FORMAT "%8.1" /end CHARACTERISTIC
/begin CHARACTERISTIC DDRC_DurDeb.Com_tiMETGtiDebDebDef_C "debouncing parameter / Duration of defect debouncing for check DFC_ComMETGTOut" VALUE 0x804D8AEE Val_Wu16 655350.0 DDRCTime_ms 0.00 655350.0 FORMAT "%8.1" /end CHARACTERISTIC
/begin CHARACTERISTIC DDRC_DurDeb.Com_tiMETH2CSumDebOk_C "debouncing parameter / Duration of healing debouncing for check DFC_ComMETH2Chksum" VALUE 0x804D8AF0 Val_Wu16 655350.0 DDRCTime_ms 0.00 655350.0 FORMAT "%8.1" /end CHARACTERISTIC
/begin CHARACTERISTIC DDRC_DurDeb.Com_tiMETH2CSumDebDef_C "debouncing parameter / Duration of defect debouncing for check DFC_ComMETH2Chksum" VALUE 0x804D8AF2 Val_Wu16 655350.0 DDRCTime_ms 0.00 655350.0 FORMAT "%8.1" /end CHARACTERISTIC
/begin CHARACTERISTIC DDRC_DurDeb.Com_tiMETH2ctRingDebOk_C "debouncing parameter / Duration of healing debouncing for check DFC_ComMETH2RingCnt" VALUE 0x804D8AF4 Val_Wu16 655350.0 DDRCTime_ms 0.00 655350.0 FORMAT "%8.1" /end CHARACTERISTIC
/begin CHARACTERISTIC DDRC_DurDeb.Com_tiMETH2ctRingDebDef_C "debouncing parameter / Duration of defect debouncing for check DFC_ComMETH2RingCnt" VALUE 0x804D8AF6 Val_Wu16 655350.0 DDRCTime_ms 0.00 655350.0 FORMAT "%8.1" /end CHARACTERISTIC
/begin CHARACTERISTIC DDRC_DurDeb.Com_tiMETH2tiDebDebOk_C "debouncing parameter / Duration of healing debouncing for check DFC_ComMETH2TOut" VALUE 0x804D8AF8 Val_Wu16 655350.0 DDRCTime_ms 0.00 655350.0 FORMAT "%8.1" /end CHARACTERISTIC
/begin CHARACTERISTIC DDRC_DurDeb.Com_tiMETH2tiDebDebDef_C "debouncing parameter / Duration of defect debouncing for check DFC_ComMETH2TOut" VALUE 0x804D8AFA Val_Wu16 655350.0 DDRCTime_ms 0.00 655350.0 FORMAT "%8.1" /end CHARACTERISTIC
/begin CHARACTERISTIC DDRC_DurDeb.Com_tiMETHCSumDebOk_C "debouncing parameter / Duration of healing debouncing for check DFC_ComMETHChksum" VALUE 0x804D8AFC Val_Wu16 655350.0 DDRCTime_ms 0.00 655350.0 FORMAT "%8.1" /end CHARACTERISTIC
/begin CHARACTERISTIC DDRC_DurDeb.Com_tiMETHCSumDebDef_C "debouncing parameter / Duration of defect debouncing for check DFC_ComMETHChksum" VALUE 0x804D8AFE Val_Wu16 655350.0 DDRCTime_ms 0.00 655350.0 FORMAT "%8.1" /end CHARACTERISTIC
/begin CHARACTERISTIC DDRC_DurDeb.Com_tiMETHctRingDebOk_C "debouncing parameter / Duration of healing debouncing for check DFC_ComMETHRingCnt" VALUE 0x804D8B00 Val_Wu16 655350.0 DDRCTime_ms 0.00 655350.0 FORMAT "%8.1" /end CHARACTERISTIC
/begin CHARACTERISTIC DDRC_DurDeb.Com_tiMETHctRingDebDef_C "debouncing parameter / Duration of defect debouncing for check DFC_ComMETHRingCnt" VALUE 0x804D8B02 Val_Wu16 655350.0 DDRCTime_ms 0.00 655350.0 FORMAT "%8.1" /end CHARACTERISTIC
/begin CHARACTERISTIC DDRC_DurDeb.Com_tiMETHtiDebDebOk_C "debouncing parameter / Duration of healing debouncing for check DFC_ComMETHTOut" VALUE 0x804D8B04 Val_Wu16 655350.0 DDRCTime_ms 0.00 655350.0 FORMAT "%8.1" /end CHARACTERISTIC
/begin CHARACTERISTIC DDRC_DurDeb.Com_tiMETHtiDebDebDef_C "debouncing parameter / Duration of defect debouncing for check DFC_ComMETHTOut" VALUE 0x804D8B06 Val_Wu16 655350.0 DDRCTime_ms 0.00 655350.0 FORMAT "%8.1" /end CHARACTERISTIC
/begin CHARACTERISTIC DDRC_DurDeb.Com_tiMETICSumDebOk_C "debouncing parameter / Duration of healing debouncing for check DFC_ComMETIChksum" VALUE 0x804D8B08 Val_Wu16 655350.0 DDRCTime_ms 0.00 655350.0 FORMAT "%8.1" /end CHARACTERISTIC
/begin CHARACTERISTIC DDRC_DurDeb.Com_tiMETICSumDebDef_C "debouncing parameter / Duration of defect debouncing for check DFC_ComMETIChksum" VALUE 0x804D8B0A Val_Wu16 655350.0 DDRCTime_ms 0.00 655350.0 FORMAT "%8.1" /end CHARACTERISTIC
/begin CHARACTERISTIC DDRC_DurDeb.Com_tiMETIctRingDebOk_C "debouncing parameter / Duration of healing debouncing for check DFC_ComMETIRingCnt" VALUE 0x804D8B0C Val_Wu16 655350.0 DDRCTime_ms 0.00 655350.0 FORMAT "%8.1" /end CHARACTERISTIC
/begin CHARACTERISTIC DDRC_DurDeb.Com_tiMETIctRingDebDef_C "debouncing parameter / Duration of defect debouncing for check DFC_ComMETIRingCnt" VALUE 0x804D8B0E Val_Wu16 655350.0 DDRCTime_ms 0.00 655350.0 FORMAT "%8.1" /end CHARACTERISTIC
/begin CHARACTERISTIC DDRC_DurDeb.Com_tiMETItiDebDebOk_C "debouncing parameter / Duration of healing debouncing for check DFC_ComMETITOut" VALUE 0x804D8B10 Val_Wu16 655350.0 DDRCTime_ms 0.00 655350.0 FORMAT "%8.1" /end CHARACTERISTIC
/begin CHARACTERISTIC DDRC_DurDeb.Com_tiMETItiDebDebDef_C "debouncing parameter / Duration of defect debouncing for check DFC_ComMETITOut" VALUE 0x804D8B12 Val_Wu16 655350.0 DDRCTime_ms 0.00 655350.0 FORMAT "%8.1" /end CHARACTERISTIC
/begin CHARACTERISTIC DDRC_DurDeb.Com_tiMETKCSumDebOk_C "debouncing parameter / Duration of healing debouncing for check DFC_ComMETKChksum" VALUE 0x804D8B14 Val_Wu16 655350.0 DDRCTime_ms 0.00 655350.0 FORMAT "%8.1" /end CHARACTERISTIC
/begin CHARACTERISTIC DDRC_DurDeb.Com_tiMETKCSumDebDef_C "debouncing parameter / Duration of defect debouncing for check DFC_ComMETKChksum" VALUE 0x804D8B16 Val_Wu16 655350.0 DDRCTime_ms 0.00 655350.0 FORMAT "%8.1" /end CHARACTERISTIC
/begin CHARACTERISTIC DDRC_DurDeb.Com_tiMETKctRingDebOk_C "debouncing parameter / Duration of healing debouncing for check DFC_ComMETKRingCnt" VALUE 0x804D8B18 Val_Wu16 655350.0 DDRCTime_ms 0.00 655350.0 FORMAT "%8.1" /end CHARACTERISTIC
/begin CHARACTERISTIC DDRC_DurDeb.Com_tiMETKctRingDebDef_C "debouncing parameter / Duration of defect debouncing for check DFC_ComMETKRingCnt" VALUE 0x804D8B1A Val_Wu16 655350.0 DDRCTime_ms 0.00 655350.0 FORMAT "%8.1" /end CHARACTERISTIC
/begin CHARACTERISTIC DDRC_DurDeb.Com_tiMETKtiDebDebOk_C "debouncing parameter / Duration of healing debouncing for check DFC_ComMETKTOut" VALUE 0x804D8B1C Val_Wu16 655350.0 DDRCTime_ms 0.00 655350.0 FORMAT "%8.1" /end CHARACTERISTIC
/begin CHARACTERISTIC DDRC_DurDeb.Com_tiMETKtiDebDebDef_C "debouncing parameter / Duration of defect debouncing for check DFC_ComMETKTOut" VALUE 0x804D8B1E Val_Wu16 655350.0 DDRCTime_ms 0.00 655350.0 FORMAT "%8.1" /end CHARACTERISTIC
/begin CHARACTERISTIC DDRC_DurDeb.Com_tiMETLCSumDebOk_C "debouncing parameter / Duration of healing debouncing for check DFC_ComMETLChksum" VALUE 0x804D8B20 Val_Wu16 655350.0 DDRCTime_ms 0.00 655350.0 FORMAT "%8.1" /end CHARACTERISTIC
/begin CHARACTERISTIC DDRC_DurDeb.Com_tiMETLCSumDebDef_C "debouncing parameter / Duration of defect debouncing for check DFC_ComMETLChksum" VALUE 0x804D8B22 Val_Wu16 655350.0 DDRCTime_ms 0.00 655350.0 FORMAT "%8.1" /end CHARACTERISTIC
/begin CHARACTERISTIC DDRC_DurDeb.Com_tiMETLRingCntrDebOk_C "debouncing parameter / Duration of healing debouncing for check DFC_ComMETLRingCnt" VALUE 0x804D8B24 Val_Wu16 655350.0 DDRCTime_ms 0.00 655350.0 FORMAT "%8.1" /end CHARACTERISTIC
/begin CHARACTERISTIC DDRC_DurDeb.Com_tiMETLRingCntrDebDef_C "debouncing parameter / Duration of defect debouncing for check DFC_ComMETLRingCnt" VALUE 0x804D8B26 Val_Wu16 655350.0 DDRCTime_ms 0.00 655350.0 FORMAT "%8.1" /end CHARACTERISTIC
/begin CHARACTERISTIC DDRC_DurDeb.Com_tiMETLToutDebOk_C "debouncing parameter / Duration of healing debouncing for check DFC_ComMETLTOut" VALUE 0x804D8B28 Val_Wu16 655350.0 DDRCTime_ms 0.00 655350.0 FORMAT "%8.1" /end CHARACTERISTIC
/begin CHARACTERISTIC DDRC_DurDeb.Com_tiMETLToutDebDef_C "debouncing parameter / Duration of defect debouncing for check DFC_ComMETLTOut" VALUE 0x804D8B2A Val_Wu16 655350.0 DDRCTime_ms 0.00 655350.0 FORMAT "%8.1" /end CHARACTERISTIC
/begin CHARACTERISTIC DDRC_DurDeb.Com_tiMETMCSumDebOk_C "debouncing parameter / Duration of healing debouncing for check DFC_ComMETMChksum" VALUE 0x804D8B2C Val_Wu16 655350.0 DDRCTime_ms 0.00 655350.0 FORMAT "%8.1" /end CHARACTERISTIC
/begin CHARACTERISTIC DDRC_DurDeb.Com_tiMETMCSumDebDef_C "debouncing parameter / Duration of defect debouncing for check DFC_ComMETMChksum" VALUE 0x804D8B2E Val_Wu16 655350.0 DDRCTime_ms 0.00 655350.0 FORMAT "%8.1" /end CHARACTERISTIC
/begin CHARACTERISTIC DDRC_DurDeb.Com_tiMETMRingCntrDebOk_C "debouncing parameter / Duration of healing debouncing for check DFC_ComMETMRingCnt" VALUE 0x804D8B30 Val_Wu16 655350.0 DDRCTime_ms 0.00 655350.0 FORMAT "%8.1" /end CHARACTERISTIC
/begin CHARACTERISTIC DDRC_DurDeb.Com_tiMETMRingCntrDebDef_C "debouncing parameter / Duration of defect debouncing for check DFC_ComMETMRingCnt" VALUE 0x804D8B32 Val_Wu16 655350.0 DDRCTime_ms 0.00 655350.0 FORMAT "%8.1" /end CHARACTERISTIC
/begin CHARACTERISTIC DDRC_DurDeb.Com_tiMETMToutDebOk_C "debouncing parameter / Duration of healing debouncing for check DFC_ComMETMTOut" VALUE 0x804D8B34 Val_Wu16 655350.0 DDRCTime_ms 0.00 655350.0 FORMAT "%8.1" /end CHARACTERISTIC
/begin CHARACTERISTIC DDRC_DurDeb.Com_tiMETMToutDebDef_C "debouncing parameter / Duration of defect debouncing for check DFC_ComMETMTOut" VALUE 0x804D8B36 Val_Wu16 655350.0 DDRCTime_ms 0.00 655350.0 FORMAT "%8.1" /end CHARACTERISTIC
/begin CHARACTERISTIC DDRC_DurDeb.Com_tiMETNCSumDebOk_C "debouncing parameter / Duration of healing debouncing for check DFC_ComMETNChksum" VALUE 0x804D8B38 Val_Wu16 655350.0 DDRCTime_ms 0.00 655350.0 FORMAT "%8.1" /end CHARACTERISTIC
/begin CHARACTERISTIC DDRC_DurDeb.Com_tiMETNCSumDebDef_C "debouncing parameter / Duration of defect debouncing for check DFC_ComMETNChksum" VALUE 0x804D8B3A Val_Wu16 655350.0 DDRCTime_ms 0.00 655350.0 FORMAT "%8.1" /end CHARACTERISTIC
/begin CHARACTERISTIC DDRC_DurDeb.Com_tiMETNRingCntrDebOk_C "debouncing parameter / Duration of healing debouncing for check DFC_ComMETNRingCnt" VALUE 0x804D8B3C Val_Wu16 655350.0 DDRCTime_ms 0.00 655350.0 FORMAT "%8.1" /end CHARACTERISTIC
/begin CHARACTERISTIC DDRC_DurDeb.Com_tiMETNRingCntrDebDef_C "debouncing parameter / Duration of defect debouncing for check DFC_ComMETNRingCnt" VALUE 0x804D8B3E Val_Wu16 655350.0 DDRCTime_ms 0.00 655350.0 FORMAT "%8.1" /end CHARACTERISTIC
/begin CHARACTERISTIC DDRC_DurDeb.Com_tiMETNToutDebOk_C "debouncing parameter / Duration of healing debouncing for check DFC_ComMETNTOut" VALUE 0x804D8B40 Val_Wu16 655350.0 DDRCTime_ms 0.00 655350.0 FORMAT "%8.1" /end CHARACTERISTIC
/begin CHARACTERISTIC DDRC_DurDeb.Com_tiMETNToutDebDef_C "debouncing parameter / Duration of defect debouncing for check DFC_ComMETNTOut" VALUE 0x804D8B42 Val_Wu16 655350.0 DDRCTime_ms 0.00 655350.0 FORMAT "%8.1" /end CHARACTERISTIC
/begin CHARACTERISTIC DDRC_DurDeb.Com_tiMtrComDebOk_C "debouncing parameter / Duration of healing debouncing for check DFC_ComMtrCom" VALUE 0x804D8B44 Val_Wu16 655350.0 DDRCTime_ms 0.00 655350.0 FORMAT "%8.1" /end CHARACTERISTIC
/begin CHARACTERISTIC DDRC_DurDeb.Com_tiMtrComDebDef_C "debouncing parameter / Duration of defect debouncing for check DFC_ComMtrCom" VALUE 0x804D8B46 Val_Wu16 655350.0 DDRCTime_ms 0.00 655350.0 FORMAT "%8.1" /end CHARACTERISTIC
/begin CHARACTERISTIC DDRC_DurDeb.Com_tiPCUChkSumDebOk_C "debouncing parameter / Duration of healing debouncing for check DFC_ComPCUChkSum" VALUE 0x804D8B48 Val_Wu16 655350.0 DDRCTime_ms 0.00 655350.0 FORMAT "%8.1" /end CHARACTERISTIC
/begin CHARACTERISTIC DDRC_DurDeb.Com_tiPCUChkSumDebDef_C "debouncing parameter / Duration of defect debouncing for check DFC_ComPCUChkSum" VALUE 0x804D8B4A Val_Wu16 655350.0 DDRCTime_ms 0.00 655350.0 FORMAT "%8.1" /end CHARACTERISTIC
/begin CHARACTERISTIC DDRC_DurDeb.Com_tiPCURingCntDebOk_C "debouncing parameter / Duration of healing debouncing for check DFC_ComPCURingCnt" VALUE 0x804D8B4C Val_Wu16 655350.0 DDRCTime_ms 0.00 655350.0 FORMAT "%8.1" /end CHARACTERISTIC
/begin CHARACTERISTIC DDRC_DurDeb.Com_tiPCURingCntDebDef_C "debouncing parameter / Duration of defect debouncing for check DFC_ComPCURingCnt" VALUE 0x804D8B4E Val_Wu16 655350.0 DDRCTime_ms 0.00 655350.0 FORMAT "%8.1" /end CHARACTERISTIC
/begin CHARACTERISTIC DDRC_DurDeb.Com_tiPCUTOutDebOk_C "debouncing parameter / Duration of healing debouncing for check DFC_ComPCUTOut" VALUE 0x804D8B50 Val_Wu16 655350.0 DDRCTime_ms 0.00 655350.0 FORMAT "%8.1" /end CHARACTERISTIC
/begin CHARACTERISTIC DDRC_DurDeb.Com_tiPCUTOutDebDef_C "debouncing parameter / Duration of defect debouncing for check DFC_ComPCUTOut" VALUE 0x804D8B52 Val_Wu16 655350.0 DDRCTime_ms 0.00 655350.0 FORMAT "%8.1" /end CHARACTERISTIC
/begin CHARACTERISTIC DDRC_DurDeb.Com_tiSRSACSumDebOk_C "debouncing parameter / Duration of healing debouncing for check DFC_ComSRSAChksum" VALUE 0x804D8B54 Val_Wu16 655350.0 DDRCTime_ms 0.00 655350.0 FORMAT "%8.1" /end CHARACTERISTIC
/begin CHARACTERISTIC DDRC_DurDeb.Com_tiSRSACSumDebDef_C "debouncing parameter / Duration of defect debouncing for check DFC_ComSRSAChksum" VALUE 0x804D8B56 Val_Wu16 655350.0 DDRCTime_ms 0.00 655350.0 FORMAT "%8.1" /end CHARACTERISTIC
/begin CHARACTERISTIC DDRC_DurDeb.Com_tiSRSARingCntDebOk_C "debouncing parameter / Duration of healing debouncing for check DFC_ComSRSARingCnt" VALUE 0x804D8B58 Val_Wu16 655350.0 DDRCTime_ms 0.00 655350.0 FORMAT "%8.1" /end CHARACTERISTIC
/begin CHARACTERISTIC DDRC_DurDeb.Com_tiSRSARingCntDebDef_C "debouncing parameter / Duration of defect debouncing for check DFC_ComSRSARingCnt" VALUE 0x804D8B5A Val_Wu16 655350.0 DDRCTime_ms 0.00 655350.0 FORMAT "%8.1" /end CHARACTERISTIC
/begin CHARACTERISTIC DDRC_DurDeb.Com_tiSRSATOutDebOk_C "debouncing parameter / Duration of healing debouncing for check DFC_ComSRSATOut" VALUE 0x804D8B5C Val_Wu16 655350.0 DDRCTime_ms 0.00 655350.0 FORMAT "%8.1" /end CHARACTERISTIC
/begin CHARACTERISTIC DDRC_DurDeb.Com_tiSRSATOutDebDef_C "debouncing parameter / Duration of defect debouncing for check DFC_ComSRSATOut" VALUE 0x804D8B5E Val_Wu16 655350.0 DDRCTime_ms 0.00 655350.0 FORMAT "%8.1" /end CHARACTERISTIC
/begin CHARACTERISTIC DDRC_DurDeb.Com_tiSRSBCSumDebOk_C "debouncing parameter / Duration of healing debouncing for check DFC_ComSRSBChksum" VALUE 0x804D8B60 Val_Wu16 655350.0 DDRCTime_ms 0.00 655350.0 FORMAT "%8.1" /end CHARACTERISTIC
/begin CHARACTERISTIC DDRC_DurDeb.Com_tiSRSBCSumDebDef_C "debouncing parameter / Duration of defect debouncing for check DFC_ComSRSBChksum" VALUE 0x804D8B62 Val_Wu16 655350.0 DDRCTime_ms 0.00 655350.0 FORMAT "%8.1" /end CHARACTERISTIC
/begin CHARACTERISTIC DDRC_DurDeb.Com_tiSRSBRingCntDebOk_C "debouncing parameter / Duration of healing debouncing for check DFC_ComSRSBRingCnt" VALUE 0x804D8B64 Val_Wu16 655350.0 DDRCTime_ms 0.00 655350.0 FORMAT "%8.1" /end CHARACTERISTIC
/begin CHARACTERISTIC DDRC_DurDeb.Com_tiSRSBRingCntDebDef_C "debouncing parameter / Duration of defect debouncing for check DFC_ComSRSBRingCnt" VALUE 0x804D8B66 Val_Wu16 655350.0 DDRCTime_ms 0.00 655350.0 FORMAT "%8.1" /end CHARACTERISTIC
/begin CHARACTERISTIC DDRC_DurDeb.Com_tiSRSBTOutDebOk_C "debouncing parameter / Duration of healing debouncing for check DFC_ComSRSBTOut" VALUE 0x804D8B68 Val_Wu16 655350.0 DDRCTime_ms 0.00 655350.0 FORMAT "%8.1" /end CHARACTERISTIC
/begin CHARACTERISTIC DDRC_DurDeb.Com_tiSRSBTOutDebDef_C "debouncing parameter / Duration of defect debouncing for check DFC_ComSRSBTOut" VALUE 0x804D8B6A Val_Wu16 655350.0 DDRCTime_ms 0.00 655350.0 FORMAT "%8.1" /end CHARACTERISTIC
/begin CHARACTERISTIC DDRC_DurDeb.Com_tiSRSCSumDebOk_C "debouncing parameter / Duration of healing debouncing for check DFC_ComSRSChksum" VALUE 0x804D8B6C Val_Wu16 655350.0 DDRCTime_ms 0.00 655350.0 FORMAT "%8.1" /end CHARACTERISTIC
/begin CHARACTERISTIC DDRC_DurDeb.Com_tiSRSCSumDebDef_C "debouncing parameter / Duration of defect debouncing for check DFC_ComSRSChksum" VALUE 0x804D8B6E Val_Wu16 655350.0 DDRCTime_ms 0.00 655350.0 FORMAT "%8.1" /end CHARACTERISTIC
/begin CHARACTERISTIC DDRC_DurDeb.Com_tiSRSErrDebOk_C "debouncing parameter / Duration of healing debouncing for check DFC_ComSRSErr" VALUE 0x804D8B70 Val_Wu16 655350.0 DDRCTime_ms 0.00 655350.0 FORMAT "%8.1" /end CHARACTERISTIC
/begin CHARACTERISTIC DDRC_DurDeb.Com_tiSRSErrDebDef_C "debouncing parameter / Duration of defect debouncing for check DFC_ComSRSErr" VALUE 0x804D8B72 Val_Wu16 655350.0 DDRCTime_ms 0.00 655350.0 FORMAT "%8.1" /end CHARACTERISTIC
/begin CHARACTERISTIC DDRC_DurDeb.Com_tiSRSRingCntDebOk_C "debouncing parameter / Duration of healing debouncing for check DFC_ComSRSRingCnt" VALUE 0x804D8B74 Val_Wu16 655350.0 DDRCTime_ms 0.00 655350.0 FORMAT "%8.1" /end CHARACTERISTIC
/begin CHARACTERISTIC DDRC_DurDeb.Com_tiSRSRingCntDebDef_C "debouncing parameter / Duration of defect debouncing for check DFC_ComSRSRingCnt" VALUE 0x804D8B76 Val_Wu16 655350.0 DDRCTime_ms 0.00 655350.0 FORMAT "%8.1" /end CHARACTERISTIC
/begin CHARACTERISTIC DDRC_DurDeb.Com_tiSRSTOutDebOk_C "debouncing parameter / Duration of healing debouncing for check DFC_ComSRSTOut" VALUE 0x804D8B78 Val_Wu16 655350.0 DDRCTime_ms 0.00 655350.0 FORMAT "%8.1" /end CHARACTERISTIC
/begin CHARACTERISTIC DDRC_DurDeb.Com_tiSRSTOutDebDef_C "debouncing parameter / Duration of defect debouncing for check DFC_ComSRSTOut" VALUE 0x804D8B7A Val_Wu16 655350.0 DDRCTime_ms 0.00 655350.0 FORMAT "%8.1" /end CHARACTERISTIC
/begin CHARACTERISTIC DDRC_DurDeb.Com_tiVehSpdPndFltTCUDebOk_C "debouncing parameter / Duration of healing debouncing for check DFC_ComVehSpdPndFltTCU" VALUE 0x804D8B7C Val_Wu16 655350.0 DDRCTime_ms 0.00 655350.0 FORMAT "%8.1" /end CHARACTERISTIC
/begin CHARACTERISTIC DDRC_DurDeb.Com_tiVehSpdPndFltTCUDebDef_C "debouncing parameter / Duration of defect debouncing for check DFC_ComVehSpdPndFltTCU" VALUE 0x804D8B7E Val_Wu16 655350.0 DDRCTime_ms 0.00 655350.0 FORMAT "%8.1" /end CHARACTERISTIC
/begin CHARACTERISTIC DDRC_DurDeb.CstrPurg_tiDebDebOk_C "debouncing parameter / Duration of healing debouncing for check DFC_TEVEsig" VALUE 0x804D8B80 Val_Wu16 655350.0 DDRCTime_ms 0.00 655350.0 FORMAT "%8.1" /end CHARACTERISTIC
/begin CHARACTERISTIC DDRC_DurDeb.CstrPurg_tiDebDebDef_C "debouncing parameter / Duration of defect debouncing for check DFC_TEVEsig" VALUE 0x804D8B82 Val_Wu16 655350.0 DDRCTime_ms 0.00 655350.0 FORMAT "%8.1" /end CHARACTERISTIC
/begin CHARACTERISTIC DDRC_DurDeb.Ebs_tiChartcCurrErrDebOk_C "debouncing parameter / Duration of healing debouncing for check DFC_EbsChartcCurrErr" VALUE 0x804D8B84 Val_Wu16 655350.0 DDRCTime_ms 0.00 655350.0 FORMAT "%8.1" /end CHARACTERISTIC
/begin CHARACTERISTIC DDRC_DurDeb.Ebs_tiChartcCurrErrDebDef_C "debouncing parameter / Duration of defect debouncing for check DFC_EbsChartcCurrErr" VALUE 0x804D8B86 Val_Wu16 655350.0 DDRCTime_ms 0.00 655350.0 FORMAT "%8.1" /end CHARACTERISTIC
/begin CHARACTERISTIC DDRC_DurDeb.Ebs_tiSelfDiagErrDebOk_C "debouncing parameter / Duration of healing debouncing for check DFC_EbsSelfDiagErr" VALUE 0x804D8B88 Val_Wu16 655350.0 DDRCTime_ms 0.00 655350.0 FORMAT "%8.1" /end CHARACTERISTIC
/begin CHARACTERISTIC DDRC_DurDeb.Ebs_tiSelfDiagErrDebDef_C "debouncing parameter / Duration of defect debouncing for check DFC_EbsSelfDiagErr" VALUE 0x804D8B8A Val_Wu16 655350.0 DDRCTime_ms 0.00 655350.0 FORMAT "%8.1" /end CHARACTERISTIC
/begin CHARACTERISTIC DDRC_DurDeb.EnStrt_ReqOilWrmUp_tiOilWrmUpDebOk_C "debouncing parameter / Duration of healing debouncing for check DFC_BGOELWAF" VALUE 0x804D8B8C Val_Wu16 655350.0 DDRCTime_ms 0.00 655350.0 FORMAT "%8.1" /end CHARACTERISTIC
/begin CHARACTERISTIC DDRC_DurDeb.EnStrt_ReqOilWrmUp_tiOilWrmUpDebDef_C "debouncing parameter / Duration of defect debouncing for check DFC_BGOELWAF" VALUE 0x804D8B8E Val_Wu16 655350.0 DDRCTime_ms 0.00 655350.0 FORMAT "%8.1" /end CHARACTERISTIC
/begin CHARACTERISTIC DDRC_DurDeb.EvapActrCcv_tiDebDebOk_C "debouncing parameter / Duration of healing debouncing for check DFC_AAVEsig" VALUE 0x804D8B90 Val_Wu16 655350.0 DDRCTime_ms 0.00 655350.0 FORMAT "%8.1" /end CHARACTERISTIC
/begin CHARACTERISTIC DDRC_DurDeb.EvapActrCcv_tiDebDebDef_C "debouncing parameter / Duration of defect debouncing for check DFC_AAVEsig" VALUE 0x804D8B92 Val_Wu16 655350.0 DDRCTime_ms 0.00 655350.0 FORMAT "%8.1" /end CHARACTERISTIC
/begin CHARACTERISTIC DDRC_DurDeb.GEVlv_tiPhaCsersIntkB1DebOk_C "debouncing parameter / Duration of healing debouncing for check DFC_GEVlvPhaCsersIntkB1" VALUE 0x804D8B94 Val_Wu16 655350.0 DDRCTime_ms 0.00 655350.0 FORMAT "%8.1" /end CHARACTERISTIC
/begin CHARACTERISTIC DDRC_DurDeb.GEVlv_tiPhaCsersIntkB1DebDef_C "debouncing parameter / Duration of defect debouncing for check DFC_GEVlvPhaCsersIntkB1" VALUE 0x804D8B96 Val_Wu16 655350.0 DDRCTime_ms 0.00 655350.0 FORMAT "%8.1" /end CHARACTERISTIC
/begin CHARACTERISTIC DDRC_DurDeb.GEVlv_tiPhaPsOpenLoadIntkB1DebOk_C "debouncing parameter / Duration of healing debouncing for check DFC_GEVlvPhaPsOpenLoadIntkB1" VALUE 0x804D8B98 Val_Wu16 655350.0 DDRCTime_ms 0.00 655350.0 FORMAT "%8.1" /end CHARACTERISTIC
/begin CHARACTERISTIC DDRC_DurDeb.GEVlv_tiPhaPsOpenLoadIntkB1DebDef_C "debouncing parameter / Duration of defect debouncing for check DFC_GEVlvPhaPsOpenLoadIntkB1" VALUE 0x804D8B9A Val_Wu16 655350.0 DDRCTime_ms 0.00 655350.0 FORMAT "%8.1" /end CHARACTERISTIC
/begin CHARACTERISTIC DDRC_DurDeb.GEVlv_tiPhaPsShoToBattIntkB1DebOk_C "debouncing parameter / Duration of healing debouncing for check DFC_GEVlvPhaPsShoToBattIntkB1" VALUE 0x804D8B9C Val_Wu16 655350.0 DDRCTime_ms 0.00 655350.0 FORMAT "%8.1" /end CHARACTERISTIC
/begin CHARACTERISTIC DDRC_DurDeb.GEVlv_tiPhaPsShoToBattIntkB1DebDef_C "debouncing parameter / Duration of defect debouncing for check DFC_GEVlvPhaPsShoToBattIntkB1" VALUE 0x804D8B9E Val_Wu16 655350.0 DDRCTime_ms 0.00 655350.0 FORMAT "%8.1" /end CHARACTERISTIC
/begin CHARACTERISTIC DDRC_DurDeb.GEVlv_tiPhaPsShoToGndIntkB1DebOk_C "debouncing parameter / Duration of healing debouncing for check DFC_GEVlvPhaPsShoToGndIntkB1" VALUE 0x804D8BA0 Val_Wu16 655350.0 DDRCTime_ms 0.00 655350.0 FORMAT "%8.1" /end CHARACTERISTIC
/begin CHARACTERISTIC DDRC_DurDeb.GEVlv_tiPhaPsShoToGndIntkB1DebDef_C "debouncing parameter / Duration of defect debouncing for check DFC_GEVlvPhaPsShoToGndIntkB1" VALUE 0x804D8BA2 Val_Wu16 655350.0 DDRCTime_ms 0.00 655350.0 FORMAT "%8.1" /end CHARACTERISTIC
/begin CHARACTERISTIC DDRC_DurDeb.GbxNPos_tiCANDigPlausDebOk_C "debouncing parameter / Duration of healing debouncing for check DFC_GbxCANDigPlausErr" VALUE 0x804D8BA4 Val_Wu16 655350.0 DDRCTime_ms 0.00 655350.0 FORMAT "%8.1" /end CHARACTERISTIC
/begin CHARACTERISTIC DDRC_DurDeb.GbxNPos_tiCANDigPlausDebDef_C "debouncing parameter / Duration of defect debouncing for check DFC_GbxCANDigPlausErr" VALUE 0x804D8BA6 Val_Wu16 655350.0 DDRCTime_ms 0.00 655350.0 FORMAT "%8.1" /end CHARACTERISTIC
/begin CHARACTERISTIC DDRC_DurDeb.GbxNPos_tiNPos1SRCMaxDebOk_C "debouncing parameter / Duration of healing debouncing for check DFC_GbxNPos1SRCMax" VALUE 0x804D8BA8 Val_Wu16 655350.0 DDRCTime_ms 0.00 655350.0 FORMAT "%8.1" /end CHARACTERISTIC
/begin CHARACTERISTIC DDRC_DurDeb.GbxNPos_tiNPos1SRCMaxDebDef_C "debouncing parameter / Duration of defect debouncing for check DFC_GbxNPos1SRCMax" VALUE 0x804D8BAA Val_Wu16 655350.0 DDRCTime_ms 0.00 655350.0 FORMAT "%8.1" /end CHARACTERISTIC
/begin CHARACTERISTIC DDRC_DurDeb.GbxNPos_tiNPos1SRCMinDebOk_C "debouncing parameter / Duration of healing debouncing for check DFC_GbxNPos1SRCMin" VALUE 0x804D8BAC Val_Wu16 655350.0 DDRCTime_ms 0.00 655350.0 FORMAT "%8.1" /end CHARACTERISTIC
/begin CHARACTERISTIC DDRC_DurDeb.GbxNPos_tiNPos1SRCMinDebDef_C "debouncing parameter / Duration of defect debouncing for check DFC_GbxNPos1SRCMin" VALUE 0x804D8BAE Val_Wu16 655350.0 DDRCTime_ms 0.00 655350.0 FORMAT "%8.1" /end CHARACTERISTIC
/begin CHARACTERISTIC DDRC_DurDeb.GbxNPos_tiNPos2SRCMaxDebOk_C "debouncing parameter / Duration of healing debouncing for check DFC_GbxNPos2SRCMax" VALUE 0x804D8BB0 Val_Wu16 655350.0 DDRCTime_ms 0.00 655350.0 FORMAT "%8.1" /end CHARACTERISTIC
/begin CHARACTERISTIC DDRC_DurDeb.GbxNPos_tiNPos2SRCMaxDebDef_C "debouncing parameter / Duration of defect debouncing for check DFC_GbxNPos2SRCMax" VALUE 0x804D8BB2 Val_Wu16 655350.0 DDRCTime_ms 0.00 655350.0 FORMAT "%8.1" /end CHARACTERISTIC
/begin CHARACTERISTIC DDRC_DurDeb.GbxNPos_tiNPos2SRCMinDebOk_C "debouncing parameter / Duration of healing debouncing for check DFC_GbxNPos2SRCMin" VALUE 0x804D8BB4 Val_Wu16 655350.0 DDRCTime_ms 0.00 655350.0 FORMAT "%8.1" /end CHARACTERISTIC
/begin CHARACTERISTIC DDRC_DurDeb.GbxNPos_tiNPos2SRCMinDebDef_C "debouncing parameter / Duration of defect debouncing for check DFC_GbxNPos2SRCMin" VALUE 0x804D8BB6 Val_Wu16 655350.0 DDRCTime_ms 0.00 655350.0 FORMAT "%8.1" /end CHARACTERISTIC
/begin CHARACTERISTIC DDRC_DurDeb.GbxNPos_tiNPosAlvChkDebOk_C "debouncing parameter / Duration of healing debouncing for check DFC_GbxNPosAlvChk" VALUE 0x804D8BB8 Val_Wu16 655350.0 DDRCTime_ms 0.00 655350.0 FORMAT "%8.1" /end CHARACTERISTIC
/begin CHARACTERISTIC DDRC_DurDeb.GbxNPos_tiNPosAlvChkDebDef_C "debouncing parameter / Duration of defect debouncing for check DFC_GbxNPosAlvChk" VALUE 0x804D8BBA Val_Wu16 655350.0 DDRCTime_ms 0.00 655350.0 FORMAT "%8.1" /end CHARACTERISTIC
/begin CHARACTERISTIC DDRC_DurDeb.GbxNPos_tiNPosSyncErrDebOk_C "debouncing parameter / Duration of healing debouncing for check DFC_GbxNPosSyncErr" VALUE 0x804D8BBC Val_Wu16 655350.0 DDRCTime_ms 0.00 655350.0 FORMAT "%8.1" /end CHARACTERISTIC
/begin CHARACTERISTIC DDRC_DurDeb.GbxNPos_tiNPosSyncErrDebDef_C "debouncing parameter / Duration of defect debouncing for check DFC_GbxNPosSyncErr" VALUE 0x804D8BBE Val_Wu16 655350.0 DDRCTime_ms 0.00 655350.0 FORMAT "%8.1" /end CHARACTERISTIC
/begin CHARACTERISTIC DDRC_DurDeb.HEGO_tiDebHtrPsErrDebOk_C "debouncing parameter / Duration of healing debouncing for check DFC_HEGOS2B1HtrPsSig" VALUE 0x804D8BC0 Val_Wu16 655350.0 DDRCTime_ms 0.00 655350.0 FORMAT "%8.1" /end CHARACTERISTIC
/begin CHARACTERISTIC DDRC_DurDeb.HEGO_tiDebHtrPsErrDebDef_C "debouncing parameter / Duration of defect debouncing for check DFC_HEGOS2B1HtrPsSig" VALUE 0x804D8BC2 Val_Wu16 655350.0 DDRCTime_ms 0.00 655350.0 FORMAT "%8.1" /end CHARACTERISTIC
/begin CHARACTERISTIC DDRC_DurDeb.LIN_tiCSErrACGDebOk_C "debouncing parameter / Duration of healing debouncing for check DFC_LinCSErrACG" VALUE 0x804D8BC4 Val_Wu16 655350.0 DDRCTime_ms 0.00 655350.0 FORMAT "%8.1" /end CHARACTERISTIC
/begin CHARACTERISTIC DDRC_DurDeb.LIN_tiCSErrACGDebDef_C "debouncing parameter / Duration of defect debouncing for check DFC_LinCSErrACG" VALUE 0x804D8BC6 Val_Wu16 655350.0 DDRCTime_ms 0.00 655350.0 FORMAT "%8.1" /end CHARACTERISTIC
/begin CHARACTERISTIC DDRC_DurDeb.LIN_tiCSErrAEVDebOk_C "debouncing parameter / Duration of healing debouncing for check DFC_LinCSErrAEV" VALUE 0x804D8BC8 Val_Wu16 655350.0 DDRCTime_ms 0.00 655350.0 FORMAT "%8.1" /end CHARACTERISTIC
/begin CHARACTERISTIC DDRC_DurDeb.LIN_tiCSErrAEVDebDef_C "debouncing parameter / Duration of defect debouncing for check DFC_LinCSErrAEV" VALUE 0x804D8BCA Val_Wu16 655350.0 DDRCTime_ms 0.00 655350.0 FORMAT "%8.1" /end CHARACTERISTIC
/begin CHARACTERISTIC DDRC_DurDeb.LIN_tiCSErrDCDCDebOk_C "debouncing parameter / Duration of healing debouncing for check DFC_LinCSErrDCDC" VALUE 0x804D8BCC Val_Wu16 655350.0 DDRCTime_ms 0.00 655350.0 FORMAT "%8.1" /end CHARACTERISTIC
/begin CHARACTERISTIC DDRC_DurDeb.LIN_tiCSErrDCDCDebDef_C "debouncing parameter / Duration of defect debouncing for check DFC_LinCSErrDCDC" VALUE 0x804D8BCE Val_Wu16 655350.0 DDRCTime_ms 0.00 655350.0 FORMAT "%8.1" /end CHARACTERISTIC
/begin CHARACTERISTIC DDRC_DurDeb.LIN_tiCSErrEBSDebOk_C "debouncing parameter / Duration of healing debouncing for check DFC_LinCSErrEBS" VALUE 0x804D8BD0 Val_Wu16 655350.0 DDRCTime_ms 0.00 655350.0 FORMAT "%8.1" /end CHARACTERISTIC
/begin CHARACTERISTIC DDRC_DurDeb.LIN_tiCSErrEBSDebDef_C "debouncing parameter / Duration of defect debouncing for check DFC_LinCSErrEBS" VALUE 0x804D8BD2 Val_Wu16 655350.0 DDRCTime_ms 0.00 655350.0 FORMAT "%8.1" /end CHARACTERISTIC
/begin CHARACTERISTIC DDRC_DurDeb.LIN_tiHdrTimeoutErrACGDebOk_C "debouncing parameter / Duration of healing debouncing for check DFC_LinHdrTimeoutErrACG" VALUE 0x804D8BD4 Val_Wu16 655350.0 DDRCTime_ms 0.00 655350.0 FORMAT "%8.1" /end CHARACTERISTIC
/begin CHARACTERISTIC DDRC_DurDeb.LIN_tiHdrTimeoutErrACGDebDef_C "debouncing parameter / Duration of defect debouncing for check DFC_LinHdrTimeoutErrACG" VALUE 0x804D8BD6 Val_Wu16 655350.0 DDRCTime_ms 0.00 655350.0 FORMAT "%8.1" /end CHARACTERISTIC
/begin CHARACTERISTIC DDRC_DurDeb.LIN_tiHdrTimeoutErrAEVDebOk_C "debouncing parameter / Duration of healing debouncing for check DFC_LinHdrTimeoutErrAEV" VALUE 0x804D8BD8 Val_Wu16 655350.0 DDRCTime_ms 0.00 655350.0 FORMAT "%8.1" /end CHARACTERISTIC
/begin CHARACTERISTIC DDRC_DurDeb.LIN_tiHdrTimeoutErrAEVDebDef_C "debouncing parameter / Duration of defect debouncing for check DFC_LinHdrTimeoutErrAEV" VALUE 0x804D8BDA Val_Wu16 655350.0 DDRCTime_ms 0.00 655350.0 FORMAT "%8.1" /end CHARACTERISTIC
/begin CHARACTERISTIC DDRC_DurDeb.LIN_tiHdrTimeoutErrDCDCDebOk_C "debouncing parameter / Duration of healing debouncing for check DFC_LinHdrTimeoutErrDCDC" VALUE 0x804D8BDC Val_Wu16 655350.0 DDRCTime_ms 0.00 655350.0 FORMAT "%8.1" /end CHARACTERISTIC
/begin CHARACTERISTIC DDRC_DurDeb.LIN_tiHdrTimeoutErrDCDCDebDef_C "debouncing parameter / Duration of defect debouncing for check DFC_LinHdrTimeoutErrDCDC" VALUE 0x804D8BDE Val_Wu16 655350.0 DDRCTime_ms 0.00 655350.0 FORMAT "%8.1" /end CHARACTERISTIC
/begin CHARACTERISTIC DDRC_DurDeb.LIN_tiHdrTimeoutErrEBSDebOk_C "debouncing parameter / Duration of healing debouncing for check DFC_LinHdrTimeoutErrEBS" VALUE 0x804D8BE0 Val_Wu16 655350.0 DDRCTime_ms 0.00 655350.0 FORMAT "%8.1" /end CHARACTERISTIC
/begin CHARACTERISTIC DDRC_DurDeb.LIN_tiHdrTimeoutErrEBSDebDef_C "debouncing parameter / Duration of defect debouncing for check DFC_LinHdrTimeoutErrEBS" VALUE 0x804D8BE2 Val_Wu16 655350.0 DDRCTime_ms 0.00 655350.0 FORMAT "%8.1" /end CHARACTERISTIC
/begin CHARACTERISTIC DDRC_DurDeb.LIN_tiMsgTimeoutErrACGDebOk_C "debouncing parameter / Duration of healing debouncing for check DFC_LinMsgTimeoutErrACG" VALUE 0x804D8BE4 Val_Wu16 655350.0 DDRCTime_ms 0.00 655350.0 FORMAT "%8.1" /end CHARACTERISTIC
/begin CHARACTERISTIC DDRC_DurDeb.LIN_tiMsgTimeoutErrACGDebDef_C "debouncing parameter / Duration of defect debouncing for check DFC_LinMsgTimeoutErrACG" VALUE 0x804D8BE6 Val_Wu16 655350.0 DDRCTime_ms 0.00 655350.0 FORMAT "%8.1" /end CHARACTERISTIC
/begin CHARACTERISTIC DDRC_DurDeb.LIN_tiMsgTimeoutErrAEVDebOk_C "debouncing parameter / Duration of healing debouncing for check DFC_LinMsgTimeoutErrAEV" VALUE 0x804D8BE8 Val_Wu16 655350.0 DDRCTime_ms 0.00 655350.0 FORMAT "%8.1" /end CHARACTERISTIC
/begin CHARACTERISTIC DDRC_DurDeb.LIN_tiMsgTimeoutErrAEVDebDef_C "debouncing parameter / Duration of defect debouncing for check DFC_LinMsgTimeoutErrAEV" VALUE 0x804D8BEA Val_Wu16 655350.0 DDRCTime_ms 0.00 655350.0 FORMAT "%8.1" /end CHARACTERISTIC
/begin CHARACTERISTIC DDRC_DurDeb.LIN_tiMsgTimeoutErrDCDCDebOk_C "debouncing parameter / Duration of healing debouncing for check DFC_LinMsgTimeoutErrDCDC" VALUE 0x804D8BEC Val_Wu16 655350.0 DDRCTime_ms 0.00 655350.0 FORMAT "%8.1" /end CHARACTERISTIC
/begin CHARACTERISTIC DDRC_DurDeb.LIN_tiMsgTimeoutErrDCDCDebDef_C "debouncing parameter / Duration of defect debouncing for check DFC_LinMsgTimeoutErrDCDC" VALUE 0x804D8BEE Val_Wu16 655350.0 DDRCTime_ms 0.00 655350.0 FORMAT "%8.1" /end CHARACTERISTIC
/begin CHARACTERISTIC DDRC_DurDeb.LIN_tiMsgTimeoutErrEBSDebOk_C "debouncing parameter / Duration of healing debouncing for check DFC_LinMsgTimeoutErrEBS" VALUE 0x804D8BF0 Val_Wu16 655350.0 DDRCTime_ms 0.00 655350.0 FORMAT "%8.1" /end CHARACTERISTIC
/begin CHARACTERISTIC DDRC_DurDeb.LIN_tiMsgTimeoutErrEBSDebDef_C "debouncing parameter / Duration of defect debouncing for check DFC_LinMsgTimeoutErrEBS" VALUE 0x804D8BF2 Val_Wu16 655350.0 DDRCTime_ms 0.00 655350.0 FORMAT "%8.1" /end CHARACTERISTIC
/begin CHARACTERISTIC DDRC_DurDeb.LIN_tiNoStrtComErrDebOk_C "debouncing parameter / Duration of healing debouncing for check DFC_LinNoStrtComErr" VALUE 0x804D8BF4 Val_Wu16 655350.0 DDRCTime_ms 0.00 655350.0 FORMAT "%8.1" /end CHARACTERISTIC
/begin CHARACTERISTIC DDRC_DurDeb.LIN_tiNoStrtComErrDebDef_C "debouncing parameter / Duration of defect debouncing for check DFC_LinNoStrtComErr" VALUE 0x804D8BF6 Val_Wu16 655350.0 DDRCTime_ms 0.00 655350.0 FORMAT "%8.1" /end CHARACTERISTIC
/begin CHARACTERISTIC DDRC_DurDeb.MisfDet_tiVWhlOORDebOk_C "debouncing parameter / Duration of healing debouncing for check DFC_MisfDetVWhlReRiOORHi" VALUE 0x804D8BF8 Val_Wu16 655350.0 DDRCTime_ms 0.00 655350.0 FORMAT "%8.1" /end CHARACTERISTIC
/begin CHARACTERISTIC DDRC_DurDeb.MisfDet_tiVWhlOORDebDef_C "debouncing parameter / Duration of defect debouncing for check DFC_MisfDetVWhlReRiOORHi" VALUE 0x804D8BFA Val_Wu16 655350.0 DDRCTime_ms 0.00 655350.0 FORMAT "%8.1" /end CHARACTERISTIC
/begin CHARACTERISTIC DDRC_DurDeb.MisfDet_tiVWhlRatyDebOk_C "debouncing parameter / Duration of healing debouncing for check DFC_MisfDetVWhlReRiRatyLo" VALUE 0x804D8BFC Val_Wu16 655350.0 DDRCTime_ms 0.00 655350.0 FORMAT "%8.1" /end CHARACTERISTIC
/begin CHARACTERISTIC DDRC_DurDeb.MisfDet_tiVWhlRatyDebDef_C "debouncing parameter / Duration of defect debouncing for check DFC_MisfDetVWhlReRiRatyLo" VALUE 0x804D8BFE Val_Wu16 655350.0 DDRCTime_ms 0.00 655350.0 FORMAT "%8.1" /end CHARACTERISTIC
/begin CHARACTERISTIC DDRC_DurDeb.MisfDet_tiVWhlStuckDebOk_C "debouncing parameter / Duration of healing debouncing for check DFC_MisfDetVWhlReRiStuck" VALUE 0x804D8C00 Val_Wu16 655350.0 DDRCTime_ms 0.00 655350.0 FORMAT "%8.1" /end CHARACTERISTIC
/begin CHARACTERISTIC DDRC_DurDeb.MisfDet_tiVWhlStuckDebDef_C "debouncing parameter / Duration of defect debouncing for check DFC_MisfDetVWhlReRiStuck" VALUE 0x804D8C02 Val_Wu16 655350.0 DDRCTime_ms 0.00 655350.0 FORMAT "%8.1" /end CHARACTERISTIC
/begin CHARACTERISTIC DDRC_DurDeb.MisfDet_tidVWhlPlausDebOk_C "debouncing parameter / Duration of healing debouncing for check DFC_MisfDetdVWhlReRiPlaus" VALUE 0x804D8C04 Val_Wu16 655350.0 DDRCTime_ms 0.00 655350.0 FORMAT "%8.1" /end CHARACTERISTIC
/begin CHARACTERISTIC DDRC_DurDeb.MisfDet_tidVWhlPlausDebDef_C "debouncing parameter / Duration of defect debouncing for check DFC_MisfDetdVWhlReRiPlaus" VALUE 0x804D8C06 Val_Wu16 655350.0 DDRCTime_ms 0.00 655350.0 FORMAT "%8.1" /end CHARACTERISTIC
/begin CHARACTERISTIC DDRC_DurDeb.OilP_tiLowPresDebOk_C "debouncing parameter / Duration of healing debouncing for check DFC_LowPresOilP" VALUE 0x804D8C08 Val_Wu16 655350.0 DDRCTime_ms 0.00 655350.0 FORMAT "%8.1" /end CHARACTERISTIC
/begin CHARACTERISTIC DDRC_DurDeb.OilP_tiLowPresDebDef_C "debouncing parameter / Duration of defect debouncing for check DFC_LowPresOilP" VALUE 0x804D8C0A Val_Wu16 655350.0 DDRCTime_ms 0.00 655350.0 FORMAT "%8.1" /end CHARACTERISTIC
/begin CHARACTERISTIC DDRC_DurDeb.PEnv_tiSigRngChkDebOk_C "debouncing parameter / Duration of healing debouncing for check DFC_PEnvSigRngMin" VALUE 0x804D8C0C Val_Wu16 655350.0 DDRCTime_ms 0.00 655350.0 FORMAT "%8.1" /end CHARACTERISTIC
/begin CHARACTERISTIC DDRC_DurDeb.PEnv_tiSigRngChkDebDef_C "debouncing parameter / Duration of defect debouncing for check DFC_PEnvSigRngMin" VALUE 0x804D8C0E Val_Wu16 655350.0 DDRCTime_ms 0.00 655350.0 FORMAT "%8.1" /end CHARACTERISTIC
/begin CHARACTERISTIC DDRC_DurDeb.Strt_tiCtOffPthDebOk_C "debouncing parameter / Duration of healing debouncing for check DFC_StrtCtOffPth" VALUE 0x804D8C10 Val_Wu16 655350.0 DDRCTime_ms 0.00 655350.0 FORMAT "%8.1" /end CHARACTERISTIC
/begin CHARACTERISTIC DDRC_DurDeb.Strt_tiCtOffPthDebDef_C "debouncing parameter / Duration of defect debouncing for check DFC_StrtCtOffPth" VALUE 0x804D8C12 Val_Wu16 655350.0 DDRCTime_ms 0.00 655350.0 FORMAT "%8.1" /end CHARACTERISTIC
/begin CHARACTERISTIC DDRC_DurDeb.Strt_tiCtlErrDebOk_C "debouncing parameter / Duration of healing debouncing for check DFC_StrtCtlErr" VALUE 0x804D8C14 Val_Wu16 655350.0 DDRCTime_ms 0.00 655350.0 FORMAT "%8.1" /end CHARACTERISTIC
/begin CHARACTERISTIC DDRC_DurDeb.Strt_tiCtlErrDebDef_C "debouncing parameter / Duration of defect debouncing for check DFC_StrtCtlErr" VALUE 0x804D8C16 Val_Wu16 655350.0 DDRCTime_ms 0.00 655350.0 FORMAT "%8.1" /end CHARACTERISTIC
/begin CHARACTERISTIC DDRC_DurDeb.Strt_tiFaultDebOk_C "debouncing parameter / Duration of healing debouncing for check DFC_StrtFault" VALUE 0x804D8C18 Val_Wu16 655350.0 DDRCTime_ms 0.00 655350.0 FORMAT "%8.1" /end CHARACTERISTIC
/begin CHARACTERISTIC DDRC_DurDeb.Strt_tiFaultDebDef_C "debouncing parameter / Duration of defect debouncing for check DFC_StrtFault" VALUE 0x804D8C1A Val_Wu16 655350.0 DDRCTime_ms 0.00 655350.0 FORMAT "%8.1" /end CHARACTERISTIC
/begin CHARACTERISTIC DDRC_DurDeb.Strt_tiStkRly1DebOk_C "debouncing parameter / Duration of healing debouncing for check DFC_StrtStkRly1" VALUE 0x804D8C1C Val_Wu16 655350.0 DDRCTime_ms 0.00 655350.0 FORMAT "%8.1" /end CHARACTERISTIC
/begin CHARACTERISTIC DDRC_DurDeb.Strt_tiStkRly1DebDef_C "debouncing parameter / Duration of defect debouncing for check DFC_StrtStkRly1" VALUE 0x804D8C1E Val_Wu16 655350.0 DDRCTime_ms 0.00 655350.0 FORMAT "%8.1" /end CHARACTERISTIC
/begin CHARACTERISTIC DDRC_DurDeb.Strt_tiStkRly2DebOk_C "debouncing parameter / Duration of healing debouncing for check DFC_StrtStkRly2" VALUE 0x804D8C20 Val_Wu16 655350.0 DDRCTime_ms 0.00 655350.0 FORMAT "%8.1" /end CHARACTERISTIC
/begin CHARACTERISTIC DDRC_DurDeb.Strt_tiStkRly2DebDef_C "debouncing parameter / Duration of defect debouncing for check DFC_StrtStkRly2" VALUE 0x804D8C22 Val_Wu16 655350.0 DDRCTime_ms 0.00 655350.0 FORMAT "%8.1" /end CHARACTERISTIC
/begin CHARACTERISTIC DDRC_DurDeb.Strt_tiStmFaultDebOk_C "debouncing parameter / Duration of healing debouncing for check DFC_StmFault" VALUE 0x804D8C24 Val_Wu16 655350.0 DDRCTime_ms 0.00 655350.0 FORMAT "%8.1" /end CHARACTERISTIC
/begin CHARACTERISTIC DDRC_DurDeb.Strt_tiStmFaultDebDef_C "debouncing parameter / Duration of defect debouncing for check DFC_StmFault" VALUE 0x804D8C26 Val_Wu16 655350.0 DDRCTime_ms 0.00 655350.0 FORMAT "%8.1" /end CHARACTERISTIC
/begin CHARACTERISTIC DDRC_DurDeb.Strt_tiStrtLckJudg1DebOk_C "debouncing parameter / Duration of healing debouncing for check DFC_StrtLckJudg1" VALUE 0x804D8C28 Val_Wu16 655350.0 DDRCTime_ms 0.00 655350.0 FORMAT "%8.1" /end CHARACTERISTIC
/begin CHARACTERISTIC DDRC_DurDeb.Strt_tiStrtLckJudg1DebDef_C "debouncing parameter / Duration of defect debouncing for check DFC_StrtLckJudg1" VALUE 0x804D8C2A Val_Wu16 655350.0 DDRCTime_ms 0.00 655350.0 FORMAT "%8.1" /end CHARACTERISTIC
/begin CHARACTERISTIC DDRC_DurDeb.Strt_tiStrtLckJudg2DebOk_C "debouncing parameter / Duration of healing debouncing for check DFC_StrtLckJudg2" VALUE 0x804D8C2C Val_Wu16 655350.0 DDRCTime_ms 0.00 655350.0 FORMAT "%8.1" /end CHARACTERISTIC
/begin CHARACTERISTIC DDRC_DurDeb.Strt_tiStrtLckJudg2DebDef_C "debouncing parameter / Duration of defect debouncing for check DFC_StrtLckJudg2" VALUE 0x804D8C2E Val_Wu16 655350.0 DDRCTime_ms 0.00 655350.0 FORMAT "%8.1" /end CHARACTERISTIC
/begin CHARACTERISTIC DDRC_DurDeb.Strt_tiStrtOLDebOk_C "debouncing parameter / Duration of healing debouncing for check DFC_StrtOL" VALUE 0x804D8C30 Val_Wu16 655350.0 DDRCTime_ms 0.00 655350.0 FORMAT "%8.1" /end CHARACTERISTIC
/begin CHARACTERISTIC DDRC_DurDeb.Strt_tiStrtOLDebDef_C "debouncing parameter / Duration of defect debouncing for check DFC_StrtOL" VALUE 0x804D8C32 Val_Wu16 655350.0 DDRCTime_ms 0.00 655350.0 FORMAT "%8.1" /end CHARACTERISTIC
/begin CHARACTERISTIC DDRC_DurDeb.Strt_tiStrtOL2DebOk_C "debouncing parameter / Duration of healing debouncing for check DFC_StrtOL2" VALUE 0x804D8C34 Val_Wu16 655350.0 DDRCTime_ms 0.00 655350.0 FORMAT "%8.1" /end CHARACTERISTIC
/begin CHARACTERISTIC DDRC_DurDeb.Strt_tiStrtOL2DebDef_C "debouncing parameter / Duration of defect debouncing for check DFC_StrtOL2" VALUE 0x804D8C36 Val_Wu16 655350.0 DDRCTime_ms 0.00 655350.0 FORMAT "%8.1" /end CHARACTERISTIC
/begin CHARACTERISTIC DDRC_DurDeb.Strt_tiStrtSCBDebOk_C "debouncing parameter / Duration of healing debouncing for check DFC_StrtSCB" VALUE 0x804D8C38 Val_Wu16 655350.0 DDRCTime_ms 0.00 655350.0 FORMAT "%8.1" /end CHARACTERISTIC
/begin CHARACTERISTIC DDRC_DurDeb.Strt_tiStrtSCBDebDef_C "debouncing parameter / Duration of defect debouncing for check DFC_StrtSCB" VALUE 0x804D8C3A Val_Wu16 655350.0 DDRCTime_ms 0.00 655350.0 FORMAT "%8.1" /end CHARACTERISTIC
/begin CHARACTERISTIC DDRC_DurDeb.Strt_tiStrtSCB2DebOk_C "debouncing parameter / Duration of healing debouncing for check DFC_StrtSCB2" VALUE 0x804D8C3C Val_Wu16 655350.0 DDRCTime_ms 0.00 655350.0 FORMAT "%8.1" /end CHARACTERISTIC
/begin CHARACTERISTIC DDRC_DurDeb.Strt_tiStrtSCB2DebDef_C "debouncing parameter / Duration of defect debouncing for check DFC_StrtSCB2" VALUE 0x804D8C3E Val_Wu16 655350.0 DDRCTime_ms 0.00 655350.0 FORMAT "%8.1" /end CHARACTERISTIC
/begin CHARACTERISTIC DDRC_DurDeb.Strt_tiStrtSCGDebOk_C "debouncing parameter / Duration of healing debouncing for check DFC_StrtSCG" VALUE 0x804D8C40 Val_Wu16 655350.0 DDRCTime_ms 0.00 655350.0 FORMAT "%8.1" /end CHARACTERISTIC
/begin CHARACTERISTIC DDRC_DurDeb.Strt_tiStrtSCGDebDef_C "debouncing parameter / Duration of defect debouncing for check DFC_StrtSCG" VALUE 0x804D8C42 Val_Wu16 655350.0 DDRCTime_ms 0.00 655350.0 FORMAT "%8.1" /end CHARACTERISTIC
/begin CHARACTERISTIC DDRC_DurDeb.Strt_tiStrtSCG2DebOk_C "debouncing parameter / Duration of healing debouncing for check DFC_StrtSCG2" VALUE 0x804D8C44 Val_Wu16 655350.0 DDRCTime_ms 0.00 655350.0 FORMAT "%8.1" /end CHARACTERISTIC
/begin CHARACTERISTIC DDRC_DurDeb.Strt_tiStrtSCG2DebDef_C "debouncing parameter / Duration of defect debouncing for check DFC_StrtSCG2" VALUE 0x804D8C46 Val_Wu16 655350.0 DDRCTime_ms 0.00 655350.0 FORMAT "%8.1" /end CHARACTERISTIC
/begin CHARACTERISTIC DDRC_DurDeb.UEGO_DiagHeatrPfrmnc_tiLoDebOk_C "debouncing parameter / Duration of healing debouncing for check DFC_UegoHeatrPrfmncLoS1B1" VALUE 0x804D8C48 Val_Wu16 655350.0 DDRCTime_ms 0.00 655350.0 FORMAT "%8.1" /end CHARACTERISTIC
/begin CHARACTERISTIC DDRC_DurDeb.UEGO_DiagHeatrPfrmnc_tiLoDebDef_C "debouncing parameter / Duration of defect debouncing for check DFC_UegoHeatrPrfmncLoS1B1" VALUE 0x804D8C4A Val_Wu16 655350.0 DDRCTime_ms 0.00 655350.0 FORMAT "%8.1" /end CHARACTERISTIC
/begin CHARACTERISTIC DDRC_DurDeb.VehV_tiNCSnsrElecFailrDebOk_C "debouncing parameter / Duration of healing debouncing for check DFC_VehVNCSnsrElecFailr" VALUE 0x804D8C4C Val_Wu16 655350.0 DDRCTime_ms 0.00 655350.0 FORMAT "%8.1" /end CHARACTERISTIC
/begin CHARACTERISTIC DDRC_DurDeb.VehV_tiNCSnsrElecFailrDebDef_C "debouncing parameter / Duration of defect debouncing for check DFC_VehVNCSnsrElecFailr" VALUE 0x804D8C4E Val_Wu16 655350.0 DDRCTime_ms 0.00 655350.0 FORMAT "%8.1" /end CHARACTERISTIC
/begin CHARACTERISTIC DDRC_DurDeb.VehV_tiPlaAllDebOk_C "debouncing parameter / Duration of healing debouncing for check DFC_VehVAllPlaus" VALUE 0x804D8C50 Val_Wu16 655350.0 DDRCTime_ms 0.00 655350.0 FORMAT "%8.1" /end CHARACTERISTIC
/begin CHARACTERISTIC DDRC_DurDeb.VehV_tiPlaAllDebDef_C "debouncing parameter / Duration of defect debouncing for check DFC_VehVAllPlaus" VALUE 0x804D8C52 Val_Wu16 655350.0 DDRCTime_ms 0.00 655350.0 FORMAT "%8.1" /end CHARACTERISTIC
/begin CHARACTERISTIC DDRC_DurDeb.VehV_tiPlaCanDebOk_C "debouncing parameter / Duration of healing debouncing for check DFC_VehVPlausCan" VALUE 0x804D8C54 Val_Wu16 655350.0 DDRCTime_ms 0.00 655350.0 FORMAT "%8.1" /end CHARACTERISTIC
/begin CHARACTERISTIC DDRC_DurDeb.VehV_tiPlaCanDebDef_C "debouncing parameter / Duration of defect debouncing for check DFC_VehVPlausCan" VALUE 0x804D8C56 Val_Wu16 655350.0 DDRCTime_ms 0.00 655350.0 FORMAT "%8.1" /end CHARACTERISTIC
/begin CHARACTERISTIC DDRC_DurDeb.VehV_tiPlaFcoDebOk_C "debouncing parameter / Duration of healing debouncing for check DFC_VehVPlausFco" VALUE 0x804D8C58 Val_Wu16 655350.0 DDRCTime_ms 0.00 655350.0 FORMAT "%8.1" /end CHARACTERISTIC
/begin CHARACTERISTIC DDRC_DurDeb.VehV_tiPlaFcoDebDef_C "debouncing parameter / Duration of defect debouncing for check DFC_VehVPlausFco" VALUE 0x804D8C5A Val_Wu16 655350.0 DDRCTime_ms 0.00 655350.0 FORMAT "%8.1" /end CHARACTERISTIC
/begin CHARACTERISTIC DDRC_DurDeb.VehV_tiPlaPwrDebOk_C "debouncing parameter / Duration of healing debouncing for check DFC_VehVPlausPwr" VALUE 0x804D8C5C Val_Wu16 655350.0 DDRCTime_ms 0.00 655350.0 FORMAT "%8.1" /end CHARACTERISTIC
/begin CHARACTERISTIC DDRC_DurDeb.VehV_tiPlaPwrDebDef_C "debouncing parameter / Duration of defect debouncing for check DFC_VehVPlausPwr" VALUE 0x804D8C5E Val_Wu16 655350.0 DDRCTime_ms 0.00 655350.0 FORMAT "%8.1" /end CHARACTERISTIC
/begin CHARACTERISTIC DDRC_DurDeb.VehV_tiPlaV2NDebOk_C "debouncing parameter / Duration of healing debouncing for check DFC_VehVPlausV2N" VALUE 0x804D8C60 Val_Wu16 655350.0 DDRCTime_ms 0.00 655350.0 FORMAT "%8.1" /end CHARACTERISTIC
/begin CHARACTERISTIC DDRC_DurDeb.VehV_tiPlaV2NDebDef_C "debouncing parameter / Duration of defect debouncing for check DFC_VehVPlausV2N" VALUE 0x804D8C62 Val_Wu16 655350.0 DDRCTime_ms 0.00 655350.0 FORMAT "%8.1" /end CHARACTERISTIC
/begin CHARACTERISTIC DDRC_DurDeb.VehV_tiSpdSnsrAElecFailrDebOk_C "debouncing parameter / Duration of healing debouncing for check DFC_VehVSpdSnsrAElecFailr" VALUE 0x804D8C64 Val_Wu16 655350.0 DDRCTime_ms 0.00 655350.0 FORMAT "%8.1" /end CHARACTERISTIC
/begin CHARACTERISTIC DDRC_DurDeb.VehV_tiSpdSnsrAElecFailrDebDef_C "debouncing parameter / Duration of defect debouncing for check DFC_VehVSpdSnsrAElecFailr" VALUE 0x804D8C66 Val_Wu16 655350.0 DDRCTime_ms 0.00 655350.0 FORMAT "%8.1" /end CHARACTERISTIC
/begin CHARACTERISTIC DDRC_DurDeb.VehV_tiSpdSnsrBElecFailrDebOk_C "debouncing parameter / Duration of healing debouncing for check DFC_VehVSpdSnsrBElecFailr" VALUE 0x804D8C68 Val_Wu16 655350.0 DDRCTime_ms 0.00 655350.0 FORMAT "%8.1" /end CHARACTERISTIC
/begin CHARACTERISTIC DDRC_DurDeb.VehV_tiSpdSnsrBElecFailrDebDef_C "debouncing parameter / Duration of defect debouncing for check DFC_VehVSpdSnsrBElecFailr" VALUE 0x804D8C6A Val_Wu16 655350.0 DDRCTime_ms 0.00 655350.0 FORMAT "%8.1" /end CHARACTERISTIC
/begin CHARACTERISTIC DDRC_DurDeb.Clth_tiMaxDebOk_C "debouncing parameter / Duration of healing debouncing for check DFC_ClthMax" VALUE 0x804D8C6C Val_Wu16 65535.00 OneToOne 0.00 65535.00 FORMAT "%8.2" /end CHARACTERISTIC
/begin CHARACTERISTIC DDRC_DurDeb.Clth_tiMaxDebDef_C "debouncing parameter / Duration of defect debouncing for check DFC_ClthMax" VALUE 0x804D8C6E Val_Wu16 65535.00 OneToOne 0.00 65535.00 FORMAT "%8.2" /end CHARACTERISTIC
/begin CHARACTERISTIC DDRC_DurDeb.IgnClPs_numDevComErrDebOk_C "debouncing parameter / Duration of healing debouncing for check DFC_IgnClPs_DevComErr" VALUE 0x804D8C70 Val_Wu16 65535.00 OneToOne 0.00 65535.00 FORMAT "%8.2" /end CHARACTERISTIC
/begin CHARACTERISTIC DDRC_DurDeb.IgnClPs_numDevComErrDebDef_C "debouncing parameter / Duration of defect debouncing for check DFC_IgnClPs_DevComErr" VALUE 0x804D8C72 Val_Wu16 65535.00 OneToOne 0.00 65535.00 FORMAT "%8.2" /end CHARACTERISTIC
/begin CHARACTERISTIC DDRC_DurDeb.IgnClPs_numOpenLoadDebOk_C "debouncing parameter / Duration of healing debouncing for check DFC_IgnClPs_LineOl" VALUE 0x804D8C74 Val_Wu16 65535.00 OneToOne 0.00 65535.00 FORMAT "%8.2" /end CHARACTERISTIC
/begin CHARACTERISTIC DDRC_DurDeb.IgnClPs_numOpenLoadDebDef_C "debouncing parameter / Duration of defect debouncing for check DFC_IgnClPs_LineOl" VALUE 0x804D8C76 Val_Wu16 65535.00 OneToOne 0.00 65535.00 FORMAT "%8.2" /end CHARACTERISTIC
/begin CHARACTERISTIC DDRC_DurDeb.IgnClPs_numShCirBattDebOk_C "debouncing parameter / Duration of healing debouncing for check DFC_IgnClPs_LineScb" VALUE 0x804D8C78 Val_Wu16 65535.00 OneToOne 0.00 65535.00 FORMAT "%8.2" /end CHARACTERISTIC
/begin CHARACTERISTIC DDRC_DurDeb.IgnClPs_numShCirBattDebDef_C "debouncing parameter / Duration of defect debouncing for check DFC_IgnClPs_LineScb" VALUE 0x804D8C7A Val_Wu16 65535.00 OneToOne 0.00 65535.00 FORMAT "%8.2" /end CHARACTERISTIC
/begin CHARACTERISTIC DDRC_DurDeb.IgnClPs_numShCirGndDebOk_C "debouncing parameter / Duration of healing debouncing for check DFC_IgnClPs_LineScg" VALUE 0x804D8C7C Val_Wu16 65535.00 OneToOne 0.00 65535.00 FORMAT "%8.2" /end CHARACTERISTIC
/begin CHARACTERISTIC DDRC_DurDeb.IgnClPs_numShCirGndDebDef_C "debouncing parameter / Duration of defect debouncing for check DFC_IgnClPs_LineScg" VALUE 0x804D8C7E Val_Wu16 65535.00 OneToOne 0.00 65535.00 FORMAT "%8.2" /end CHARACTERISTIC
/begin CHARACTERISTIC DDRC_DurDeb.KRVEKO_num_DebDef_CDebOk_C "debouncing parameter / Duration of healing debouncing for check DFC_KRVEKOEVAB3" VALUE 0x804D8C80 Val_Wu16 65535.00 OneToOne 0.00 65535.00 FORMAT "%8.2" /end CHARACTERISTIC
/begin CHARACTERISTIC DDRC_DurDeb.KRVEKO_num_DebDef_CDebDef_C "debouncing parameter / Duration of defect debouncing for check DFC_KRVEKOEVAB3" VALUE 0x804D8C82 Val_Wu16 65535.00 OneToOne 0.00 65535.00 FORMAT "%8.2" /end CHARACTERISTIC
/begin CHARACTERISTIC DDRC_DurDeb.UEGO_numDiagSigSnsrDebOk_C "debouncing parameter / Duration of healing debouncing for check DFC_UegoSigSnsrS1B1" VALUE 0x804D8C84 Val_Wu16 65535.00 OneToOne 0.00 65535.00 FORMAT "%8.2" /end CHARACTERISTIC
/begin CHARACTERISTIC DDRC_DurDeb.UEGO_numDiagSigSnsrDebDef_C "debouncing parameter / Duration of defect debouncing for check DFC_UegoSigSnsrS1B1" VALUE 0x804D8C86 Val_Wu16 65535.00 OneToOne 0.00 65535.00 FORMAT "%8.2" /end CHARACTERISTIC
/begin CHARACTERISTIC DDRC_DurDeb.UEGO_numSigEcuAsicDebOk_C "debouncing parameter / Duration of healing debouncing for check DFC_UegoSigEcuAsicS1B1" VALUE 0x804D8C88 Val_Wu16 65535.00 OneToOne 0.00 65535.00 FORMAT "%8.2" /end CHARACTERISTIC
/begin CHARACTERISTIC DDRC_DurDeb.UEGO_numSigEcuAsicDebDef_C "debouncing parameter / Duration of defect debouncing for check DFC_UegoSigEcuAsicS1B1" VALUE 0x804D8C8A Val_Wu16 65535.00 OneToOne 0.00 65535.00 FORMAT "%8.2" /end CHARACTERISTIC
/begin CHARACTERISTIC DDRC_DurDeb.UEGO_numSigEcuComDebOk_C "debouncing parameter / Duration of healing debouncing for check DFC_UegoSigEcuComS1B1" VALUE 0x804D8C8C Val_Wu16 65535.00 OneToOne 0.00 65535.00 FORMAT "%8.2" /end CHARACTERISTIC
/begin CHARACTERISTIC DDRC_DurDeb.UEGO_numSigEcuComDebDef_C "debouncing parameter / Duration of defect debouncing for check DFC_UegoSigEcuComS1B1" VALUE 0x804D8C8E Val_Wu16 65535.00 OneToOne 0.00 65535.00 FORMAT "%8.2" /end CHARACTERISTIC
/begin CHARACTERISTIC DDRC_DurDeb.UEGO_numSigWireOlDebOk_C "debouncing parameter / Duration of healing debouncing for check DFC_UegoSigWireRCmpS1B1" VALUE 0x804D8C90 Val_Wu16 65535.00 OneToOne 0.00 65535.00 FORMAT "%8.2" /end CHARACTERISTIC
/begin CHARACTERISTIC DDRC_DurDeb.UEGO_numSigWireOlDebDef_C "debouncing parameter / Duration of defect debouncing for check DFC_UegoSigWireRCmpS1B1" VALUE 0x804D8C92 Val_Wu16 65535.00 OneToOne 0.00 65535.00 FORMAT "%8.2" /end CHARACTERISTIC
/begin CHARACTERISTIC DDRC_DurDeb.UEGO_numSigWireScDebOk_C "debouncing parameter / Duration of healing debouncing for check DFC_UegoSigWireScgS1B1" VALUE 0x804D8C94 Val_Wu16 65535.00 OneToOne 0.00 65535.00 FORMAT "%8.2" /end CHARACTERISTIC
/begin CHARACTERISTIC DDRC_DurDeb.UEGO_numSigWireScDebDef_C "debouncing parameter / Duration of defect debouncing for check DFC_UegoSigWireScgS1B1" VALUE 0x804D8C96 Val_Wu16 65535.00 OneToOne 0.00 65535.00 FORMAT "%8.2" /end CHARACTERISTIC
/begin CHARACTERISTIC DDRC_DurDeb.AFS_tiSigErrLineHiB1DebOk_C "debouncing parameter / Duration of healing debouncing for check DFC_AfsSigErrLineHiB1" VALUE 0x804D8C98 Val_Wu16 655350.0 DDRCTime_ms 0.00 655350.0 FORMAT "%8.1" /end CHARACTERISTIC
/begin CHARACTERISTIC DDRC_DurDeb.AFS_tiSigErrLineHiB1DebDef_C "debouncing parameter / Duration of defect debouncing for check DFC_AfsSigErrLineHiB1" VALUE 0x804D8C9A Val_Wu16 655350.0 DDRCTime_ms 0.00 655350.0 FORMAT "%8.1" /end CHARACTERISTIC
/begin CHARACTERISTIC DDRC_DurDeb.AFS_tiSigErrLineLoB1DebOk_C "debouncing parameter / Duration of healing debouncing for check DFC_AfsSigErrLineLoB1" VALUE 0x804D8C9C Val_Wu16 655350.0 DDRCTime_ms 0.00 655350.0 FORMAT "%8.1" /end CHARACTERISTIC
/begin CHARACTERISTIC DDRC_DurDeb.AFS_tiSigErrLineLoB1DebDef_C "debouncing parameter / Duration of defect debouncing for check DFC_AfsSigErrLineLoB1" VALUE 0x804D8C9E Val_Wu16 655350.0 DDRCTime_ms 0.00 655350.0 FORMAT "%8.1" /end CHARACTERISTIC
/begin CHARACTERISTIC DDRC_DurDeb.PEnv_tiVDDiagDebOk_C "debouncing parameter / Duration of healing debouncing for check DFC_PEnvSnsrPlaus" VALUE 0x804D8CA0 Val_Wu16 655350.0 DDRCTime_ms 0.00 655350.0 FORMAT "%8.1" /end CHARACTERISTIC
/begin CHARACTERISTIC DDRC_DurDeb.PEnv_tiVDDiagDebDef_C "debouncing parameter / Duration of defect debouncing for check DFC_PEnvSnsrPlaus" VALUE 0x804D8CA2 Val_Wu16 655350.0 DDRCTime_ms 0.00 655350.0 FORMAT "%8.1" /end CHARACTERISTIC
/begin CHARACTERISTIC DDRC_DurDeb.UEGO_DiagHeatrWire_tiOlDebOk_C "debouncing parameter / Duration of healing debouncing for check DFC_UegoHeatrWireOlS1B1" VALUE 0x804D8CA4 Val_Wu16 655350.0 DDRCTime_ms 0.00 655350.0 FORMAT "%8.1" /end CHARACTERISTIC
/begin CHARACTERISTIC DDRC_DurDeb.UEGO_DiagHeatrWire_tiOlDebDef_C "debouncing parameter / Duration of defect debouncing for check DFC_UegoHeatrWireOlS1B1" VALUE 0x804D8CA6 Val_Wu16 655350.0 DDRCTime_ms 0.00 655350.0 FORMAT "%8.1" /end CHARACTERISTIC
/begin CHARACTERISTIC DDRC_DurDeb.UEGO_DiagHeatrWire_tiScbDebOk_C "debouncing parameter / Duration of healing debouncing for check DFC_UegoHeatrWireScbS1B1" VALUE 0x804D8CA8 Val_Wu16 655350.0 DDRCTime_ms 0.00 655350.0 FORMAT "%8.1" /end CHARACTERISTIC
/begin CHARACTERISTIC DDRC_DurDeb.UEGO_DiagHeatrWire_tiScbDebDef_C "debouncing parameter / Duration of defect debouncing for check DFC_UegoHeatrWireScbS1B1" VALUE 0x804D8CAA Val_Wu16 655350.0 DDRCTime_ms 0.00 655350.0 FORMAT "%8.1" /end CHARACTERISTIC
/begin CHARACTERISTIC DDRC_DurDeb.UEGO_DiagHeatrWire_tiScgDebOk_C "debouncing parameter / Duration of healing debouncing for check DFC_UegoHeatrWireScgS1B1" VALUE 0x804D8CAC Val_Wu16 655350.0 DDRCTime_ms 0.00 655350.0 FORMAT "%8.1" /end CHARACTERISTIC
/begin CHARACTERISTIC DDRC_DurDeb.UEGO_DiagHeatrWire_tiScgDebDef_C "debouncing parameter / Duration of defect debouncing for check DFC_UegoHeatrWireScgS1B1" VALUE 0x804D8CAE Val_Wu16 655350.0 DDRCTime_ms 0.00 655350.0 FORMAT "%8.1" /end CHARACTERISTIC
/begin CHARACTERISTIC DDRC_DurDeb.UEGO_HeatrRlyPsDiag_tiOLDebOk_C "debouncing parameter / Duration of healing debouncing for check DFC_UEGOHeatrRlyPsOLS1B1" VALUE 0x804D8CB0 Val_Wu16 655350.0 DDRCTime_ms 0.00 655350.0 FORMAT "%8.1" /end CHARACTERISTIC
/begin CHARACTERISTIC DDRC_DurDeb.UEGO_HeatrRlyPsDiag_tiOLDebDef_C "debouncing parameter / Duration of defect debouncing for check DFC_UEGOHeatrRlyPsOLS1B1" VALUE 0x804D8CB2 Val_Wu16 655350.0 DDRCTime_ms 0.00 655350.0 FORMAT "%8.1" /end CHARACTERISTIC
/begin CHARACTERISTIC DDRC_DurDeb.UEGO_HeatrRlyPsDiag_tiSCBDebOk_C "debouncing parameter / Duration of healing debouncing for check DFC_UEGOHeatrRlyPsSCBS1B1" VALUE 0x804D8CB4 Val_Wu16 655350.0 DDRCTime_ms 0.00 655350.0 FORMAT "%8.1" /end CHARACTERISTIC
/begin CHARACTERISTIC DDRC_DurDeb.UEGO_HeatrRlyPsDiag_tiSCBDebDef_C "debouncing parameter / Duration of defect debouncing for check DFC_UEGOHeatrRlyPsSCBS1B1" VALUE 0x804D8CB6 Val_Wu16 655350.0 DDRCTime_ms 0.00 655350.0 FORMAT "%8.1" /end CHARACTERISTIC
/begin CHARACTERISTIC DDRC_DurDeb.UEGO_HeatrRlyPsDiag_tiSCGDebOk_C "debouncing parameter / Duration of healing debouncing for check DFC_UEGOHeatrRlyPsSCGS1B1" VALUE 0x804D8CB8 Val_Wu16 655350.0 DDRCTime_ms 0.00 655350.0 FORMAT "%8.1" /end CHARACTERISTIC
/begin CHARACTERISTIC DDRC_DurDeb.UEGO_HeatrRlyPsDiag_tiSCGDebDef_C "debouncing parameter / Duration of defect debouncing for check DFC_UEGOHeatrRlyPsSCGS1B1" VALUE 0x804D8CBA Val_Wu16 655350.0 DDRCTime_ms 0.00 655350.0 FORMAT "%8.1" /end CHARACTERISTIC
/begin CHARACTERISTIC DDRC_DurDeb.KnDet_numShCirDebOk_C "debouncing parameter / Duration of healing debouncing for check DFC_KnDetSens1PortBMax" VALUE 0x804D8CBC Val_Wu16 65535.00 OneToOne 0.00 65535.00 FORMAT "%8.2" /end CHARACTERISTIC
/begin CHARACTERISTIC DDRC_DurDeb.KnDet_numShCirDebDef_C "debouncing parameter / Duration of defect debouncing for check DFC_KnDetSens1PortBMax" VALUE 0x804D8CBE Val_Wu16 65535.00 OneToOne 0.00 65535.00 FORMAT "%8.2" /end CHARACTERISTIC
/begin CHARACTERISTIC DDRC_RatDeb.AFS_tiPhyRngChkHiUDRat_C "Ratioof up-down debouncing / Defect / Heal Ratio for check DFC_AfsPhyRngHiB1" VALUE 0x804F5796 Val_Wu8 3.00000000000 DDRC_Ratio 1.00000000000 4.00000000000 FORMAT "%13.11" /end CHARACTERISTIC
/begin CHARACTERISTIC DDRC_RatDeb.AFS_tiPhyRngChkLoUDRat_C "Ratioof up-down debouncing / Defect / Heal Ratio for check DFC_AfsPhyRngLoB1" VALUE 0x804F5797 Val_Wu8 3.00000000000 DDRC_Ratio 1.00000000000 4.00000000000 FORMAT "%13.11" /end CHARACTERISTIC
/begin CHARACTERISTIC DDRC_RatDeb.AirC_tiCmprOLUDRat_C "Ratioof up-down debouncing / Defect / Heal Ratio for check DFC_AirCCmprOL" VALUE 0x804F5798 Val_Wu8 3.00000000000 DDRC_Ratio 1.00000000000 4.00000000000 FORMAT "%13.11" /end CHARACTERISTIC
/begin CHARACTERISTIC DDRC_RatDeb.AirC_tiCmprOvrTempUDRat_C "Ratioof up-down debouncing / Defect / Heal Ratio for check DFC_AirCCmprOvrTemp" VALUE 0x804F5799 Val_Wu8 3.00000000000 DDRC_Ratio 1.00000000000 4.00000000000 FORMAT "%13.11" /end CHARACTERISTIC
/begin CHARACTERISTIC DDRC_RatDeb.AirC_tiCmprSCBUDRat_C "Ratioof up-down debouncing / Defect / Heal Ratio for check DFC_AirCCmprSCB" VALUE 0x804F579A Val_Wu8 3.00000000000 DDRC_Ratio 1.00000000000 4.00000000000 FORMAT "%13.11" /end CHARACTERISTIC
/begin CHARACTERISTIC DDRC_RatDeb.AirC_tiCmprSCGUDRat_C "Ratioof up-down debouncing / Defect / Heal Ratio for check DFC_AirCCmprSCG" VALUE 0x804F579B Val_Wu8 3.00000000000 DDRC_Ratio 1.00000000000 4.00000000000 FORMAT "%13.11" /end CHARACTERISTIC
/begin CHARACTERISTIC DDRC_RatDeb.Alt_tiErrUDRat_C "Ratioof up-down debouncing / Defect / Heal Ratio for check DFC_AltErr" VALUE 0x804F579C Val_Wu8 3.00000000000 DDRC_Ratio 1.00000000000 4.00000000000 FORMAT "%13.11" /end CHARACTERISTIC
/begin CHARACTERISTIC DDRC_RatDeb.BattU_tiMaxUDRat_C "Ratioof up-down debouncing / Defect / Heal Ratio for check DFC_BattUSRCMax" VALUE 0x804F579D Val_Wu8 3.00000000000 DDRC_Ratio 1.00000000000 4.00000000000 FORMAT "%13.11" /end CHARACTERISTIC
/begin CHARACTERISTIC DDRC_RatDeb.BattU_tiMinUDRat_C "Ratioof up-down debouncing / Defect / Heal Ratio for check DFC_BattUSRCMin" VALUE 0x804F579E Val_Wu8 3.00000000000 DDRC_Ratio 1.00000000000 4.00000000000 FORMAT "%13.11" /end CHARACTERISTIC
/begin CHARACTERISTIC DDRC_RatDeb.Com_tiChksTCU1UDRat_C "Ratioof up-down debouncing / Defect / Heal Ratio for check DFC_ComChksTCU1" VALUE 0x804F579F Val_Wu8 3.00000000000 DDRC_Ratio 1.00000000000 4.00000000000 FORMAT "%13.11" /end CHARACTERISTIC
/begin CHARACTERISTIC DDRC_RatDeb.Com_tiChksTCU11UDRat_C "Ratioof up-down debouncing / Defect / Heal Ratio for check DFC_ComChksTCU11" VALUE 0x804F57A0 Val_Wu8 3.00000000000 DDRC_Ratio 1.00000000000 4.00000000000 FORMAT "%13.11" /end CHARACTERISTIC
/begin CHARACTERISTIC DDRC_RatDeb.Com_tiChksTCU12UDRat_C "Ratioof up-down debouncing / Defect / Heal Ratio for check DFC_ComChksTCU12" VALUE 0x804F57A1 Val_Wu8 3.00000000000 DDRC_Ratio 1.00000000000 4.00000000000 FORMAT "%13.11" /end CHARACTERISTIC
/begin CHARACTERISTIC DDRC_RatDeb.Com_tiChksTCU13UDRat_C "Ratioof up-down debouncing / Defect / Heal Ratio for check DFC_ComChksTCU13" VALUE 0x804F57A2 Val_Wu8 3.00000000000 DDRC_Ratio 1.00000000000 4.00000000000 FORMAT "%13.11" /end CHARACTERISTIC
/begin CHARACTERISTIC DDRC_RatDeb.Com_tiChksTCU2UDRat_C "Ratioof up-down debouncing / Defect / Heal Ratio for check DFC_ComChksTCU2" VALUE 0x804F57A3 Val_Wu8 3.00000000000 DDRC_Ratio 1.00000000000 4.00000000000 FORMAT "%13.11" /end CHARACTERISTIC
/begin CHARACTERISTIC DDRC_RatDeb.Com_tiChksTCU3UDRat_C "Ratioof up-down debouncing / Defect / Heal Ratio for check DFC_ComChksTCU3" VALUE 0x804F57A4 Val_Wu8 3.00000000000 DDRC_Ratio 1.00000000000 4.00000000000 FORMAT "%13.11" /end CHARACTERISTIC
/begin CHARACTERISTIC DDRC_RatDeb.Com_tiChksTCU4UDRat_C "Ratioof up-down debouncing / Defect / Heal Ratio for check DFC_ComChksTCU4" VALUE 0x804F57A5 Val_Wu8 3.00000000000 DDRC_Ratio 1.00000000000 4.00000000000 FORMAT "%13.11" /end CHARACTERISTIC
/begin CHARACTERISTIC DDRC_RatDeb.Com_tiCntTCU1UDRat_C "Ratioof up-down debouncing / Defect / Heal Ratio for check DFC_ComCntTCU1" VALUE 0x804F57A6 Val_Wu8 3.00000000000 DDRC_Ratio 1.00000000000 4.00000000000 FORMAT "%13.11" /end CHARACTERISTIC
/begin CHARACTERISTIC DDRC_RatDeb.Com_tiCntTCU11UDRat_C "Ratioof up-down debouncing / Defect / Heal Ratio for check DFC_ComCntTCU11" VALUE 0x804F57A7 Val_Wu8 3.00000000000 DDRC_Ratio 1.00000000000 4.00000000000 FORMAT "%13.11" /end CHARACTERISTIC
/begin FUNCTION DDRC "30000.21.1Diagnostic Debounce and Report of Check"
 /begin DEF_CHARACTERISTIC DDRC_DurDeb.Com_tiCntTCU1DebDef_C DDRC_DurDeb.Com_tiCntTCU11DebOk_C DDRC_DurDeb.Com_tiCntTCU11DebDef_C DDRC_DurDeb.Com_tiCntTCU12DebOk_C DDRC_DurDeb.Com_tiCntTCU12DebDef_C DDRC_DurDeb.Com_tiCntTCU13DebOk_C DDRC_DurDeb.Com_tiCntTCU13DebDef_C DDRC_DurDeb.Com_tiCntTCU2DebOk_C DDRC_DurDeb.Com_tiCntTCU2DebDef_C DDRC_DurDeb.Com_tiCntTCU3DebOk_C DDRC_DurDeb.Com_tiCntTCU3DebDef_C DDRC_DurDeb.Com_tiCntTCU4DebOk_C DDRC_DurDeb.Com_tiCntTCU4DebDef_C DDRC_DurDeb.Com_tiTOutTCU01DebOk_C DDRC_DurDeb.Com_tiTOutTCU01DebDef_C DDRC_DurDeb.Com_tiTOutTCU02DebOk_C DDRC_DurDeb.Com_tiTOutTCU02DebDef_C DDRC_DurDeb.Com_tiTOutTCU1DebOk_C DDRC_DurDeb.Com_tiTOutTCU1DebDef_C DDRC_DurDeb.Com_tiTOutTCU11DebOk_C DDRC_DurDeb.Com_tiTOutTCU11DebDef_C DDRC_DurDeb.Com_tiTOutTCU12DebOk_C DDRC_DurDeb.Com_tiTOutTCU12DebDef_C DDRC_DurDeb.Com_tiTOutTCU13DebOk_C DDRC_DurDeb.Com_tiTOutTCU13DebDef_C DDRC_DurDeb.Com_tiTOutTCU14DebOk_C DDRC_DurDeb.Com_tiTOutTCU14DebDef_C DDRC_DurDeb.Com_tiTOutTCU2DebOk_C DDRC_DurDeb.Com_tiTOutTCU2DebDef_C DDRC_DurDeb.Com_tiTOutTCU3DebOk_C DDRC_DurDeb.Com_tiTOutTCU3DebDef_C DDRC_DurDeb.Com_tiTOutTCU4DebOk_C DDRC_DurDeb.Com_tiTOutTCU4DebDef_C DDRC_DurDeb.DevLib_tiBattUHiDebOk_C DDRC_DurDeb.DevLib_tiBattUHiDebDef_C DDRC_DurDeb.DevLib_tiBattULoDebOk_C DDRC_DurDeb.DevLib_tiBattULoDebDef_C DDRC_DurDeb.EGRVlv_tiFailSafeActvDebOk_C DDRC_DurDeb.EGRVlv_tiFailSafeActvDebDef_C DDRC_DurDeb.EGRVlv_tiGovDvtCldDebOk_C DDRC_DurDeb.EGRVlv_tiGovDvtCldDebDef_C DDRC_DurDeb.EGRVlv_tiPhysSRCMaxDebOk_C DDRC_DurDeb.EGRVlv_tiPhysSRCMaxDebDef_C DDRC_DurDeb.EGRVlv_tiPhysSRCMinDebOk_C DDRC_DurDeb.EGRVlv_tiPhysSRCMinDebDef_C DDRC_DurDeb.Fan_tiDIOOLDebOk_C DDRC_DurDeb.Fan_tiDIOOLDebDef_C DDRC_DurDeb.Fan_tiDIOOvrTempDebOk_C DDRC_DurDeb.Fan_tiDIOOvrTempDebDef_C DDRC_DurDeb.Fan_tiDIOSCBDebOk_C DDRC_DurDeb.Fan_tiDIOSCBDebDef_C DDRC_DurDeb.Fan_tiDIOSCGDebOk_C DDRC_DurDeb.Fan_tiDIOSCGDebDef_C DDRC_DurDeb.MRlyDcOL_tisigOLDebOk_C DDRC_DurDeb.MRlyDcOL_tisigOLDebDef_C DDRC_DurDeb.MRlyDcSCB_tisigSCBDebOk_C DDRC_DurDeb.MRlyDcSCB_tisigSCBDebDef_C DDRC_DurDeb.MRlyDcSCG_tisigSCGDebOk_C DDRC_DurDeb.MRlyDcSCG_tisigSCGDebDef_C DDRC_DurDeb.PSP_tiOLDebOk_C DDRC_DurDeb.PSP_tiOLDebDef_C DDRC_DurDeb.PSP_tiOvrTempDebOk_C DDRC_DurDeb.PSP_tiOvrTempDebDef_C DDRC_DurDeb.PSP_tiSCBDebOk_C DDRC_DurDeb.PSP_tiSCBDebDef_C DDRC_DurDeb.PSP_tiSCGDebOk_C DDRC_DurDeb.PSP_tiSCGDebDef_C DDRC_DurDeb.T50_tiErrDebOk_C DDRC_DurDeb.T50_tiErrDebDef_C DDRC_DurDeb.ThrVlv_tiLoBattB1DebOk_C DDRC_DurDeb.ThrVlv_tiLoBattB1DebDef_C DDRC_DurDeb.UEGO_tiOperPlausDebOk_C DDRC_DurDeb.UEGO_tiOperPlausDebDef_C DDRC_DurDeb.VehV_tiCANSigFLDebOk_C DDRC_DurDeb.VehV_tiCANSigFLDebDef_C DDRC_DurDeb.VehV_tiCANSigFRDebOk_C DDRC_DurDeb.VehV_tiCANSigFRDebDef_C DDRC_DurDeb.VehV_tiCANSigRLDebOk_C DDRC_DurDeb.VehV_tiCANSigRLDebDef_C DDRC_DurDeb.VehV_tiCANSigRRDebOk_C DDRC_DurDeb.VehV_tiCANSigRRDebDef_C DDRC_DurDeb.VehV_tiOLDebOk_C DDRC_DurDeb.VehV_tiOLDebDef_C DDRC_DurDeb.VehV_tiOTDebOk_C DDRC_DurDeb.VehV_tiOTDebDef_C DDRC_DurDeb.VehV_tiPhysRngHiDebOk_C DDRC_DurDeb.VehV_tiPhysRngHiDebDef_C DDRC_DurDeb.VehV_tiSCBDebOk_C DDRC_DurDeb.VehV_tiSCBDebDef_C DDRC_DurDeb.VehV_tiSCGDebOk_C DDRC_DurDeb.VehV_tiSCGDebDef_C DDRC_DurDeb.VehV_tiSnsrARngHiDebOk_C DDRC_DurDeb.VehV_tiSnsrARngHiDebDef_C DDRC_DurDeb.VehV_tiSnsrBRngHiDebOk_C DDRC_DurDeb.VehV_tiSnsrBRngHiDebDef_C DDRC_DurDeb.VehV_tiSpdRtyDiagDebOk_C DDRC_DurDeb.VehV_tiSpdRtyDiagDebDef_C DDRC_DurDeb.DDHFHD_numDhfDebDef_CDebOk_C DDRC_DurDeb.DDHFHD_numDhfDebDef_CDebDef_C DDRC_DurDeb.InjVlv_numDcDcDebOk_C DDRC_DurDeb.InjVlv_numDcDcDebDef_C DDRC_DurDeb.InjVlv_numNoLdDebOk_C DDRC_DurDeb.InjVlv_numNoLdDebDef_C DDRC_DurDeb.InjVlv_numScBnkDebOk_C DDRC_DurDeb.InjVlv_numScBnkDebDef_C DDRC_DurDeb.InjVlv_numScCylDebOk_C DDRC_DurDeb.InjVlv_numScCylDebDef_C DDRC_DurDeb.InjVlv_numScHsLsDebOk_C DDRC_DurDeb.InjVlv_numScHsLsDebDef_C DDRC_DurDeb.MfPsDia_numOpenLoadDebOk_C DDRC_DurDeb.MfPsDia_numOpenLoadDebDef_C DDRC_DurDeb.MfPsDia_numScHiSDebOk_C DDRC_DurDeb.MfPsDia_numScHiSDebDef_C DDRC_DurDeb.MfPsDia_numScHiSLowSDebOk_C DDRC_DurDeb.MfPsDia_numScHiSLowSDebDef_C DDRC_DurDeb.MfPsDia_numScLowSDebOk_C DDRC_DurDeb.MfPsDia_numScLowSDebDef_C DDRC_DurDeb.ACEvpT_tiPhysRngHiDebOk_C DDRC_DurDeb.ACEvpT_tiPhysRngHiDebDef_C DDRC_DurDeb.ACEvpT_tiPhysRngLoDebOk_C DDRC_DurDeb.ACEvpT_tiPhysRngLoDebDef_C DDRC_DurDeb.ACEvpT_tiSRCMaxDebOk_C DDRC_DurDeb.ACEvpT_tiSRCMaxDebDef_C DDRC_DurDeb.ACEvpT_tiSRCMinDebOk_C DDRC_DurDeb.ACEvpT_tiSRCMinDebDef_C DDRC_DurDeb.AFS_tiRawSigRngHiB1DebOk_C DDRC_DurDeb.AFS_tiRawSigRngHiB1DebDef_C DDRC_DurDeb.AFS_tiRawSigRngLoB1DebOk_C DDRC_DurDeb.AFS_tiRawSigRngLoB1DebDef_C DDRC_DurDeb.AFS_tiSnsrErrB1DebOk_C DDRC_DurDeb.AFS_tiSnsrErrB1DebDef_C DDRC_DurDeb.AirC_tiClntSRCMaxDebOk_C DDRC_DurDeb.AirC_tiClntSRCMaxDebDef_C DDRC_DurDeb.AirC_tiClntSRCMinDebOk_C DDRC_DurDeb.AirC_tiClntSRCMinDebDef_C DDRC_DurDeb.AirC_tiSwtNplDebOk_C DDRC_DurDeb.AirC_tiSwtNplDebDef_C DDRC_DurDeb.AirC_tiSwtSigDebOk_C DDRC_DurDeb.AirC_tiSwtSigDebDef_C DDRC_DurDeb.BrkBstP_tiSCBDebOk_C DDRC_DurDeb.BrkBstP_tiSCBDebDef_C DDRC_DurDeb.BrkBstP_tiSCGDebOk_C DDRC_DurDeb.BrkBstP_tiSCGDebDef_C DDRC_DurDeb.Brk_tiDebOk_C DDRC_DurDeb.Brk_tiDebDef_C DDRC_DurDeb.Brk_tiSigDebOk_C DDRC_DurDeb.Brk_tiSigDebDef_C DDRC_DurDeb.Clth_tiSigDebOk_C DDRC_DurDeb.Clth_tiSigDebDef_C DDRC_DurDeb.EGRVlv_tiCurrLimDebOk_C DDRC_DurDeb.EGRVlv_tiCurrLimDebDef_C DDRC_DurDeb.EGRVlv_tiOLDebOk_C DDRC_DurDeb.EGRVlv_tiOLDebDef_C DDRC_DurDeb.EGRVlv_tiOvrTempDebOk_C DDRC_DurDeb.EGRVlv_tiOvrTempDebDef_C DDRC_DurDeb.EGRVlv_tiSCBDebOk_C DDRC_DurDeb.EGRVlv_tiSCBDebDef_C DDRC_DurDeb.EGRVlv_tiSCGDebOk_C DDRC_DurDeb.EGRVlv_tiSCGDebDef_C DDRC_DurDeb.EGRVlv_tiSRCMaxDebOk_C DDRC_DurDeb.EGRVlv_tiSRCMaxDebDef_C DDRC_DurDeb.EGRVlv_tiSRCMinDebOk_C DDRC_DurDeb.EGRVlv_tiSRCMinDebDef_C DDRC_DurDeb.HLSDem_tiOvhtDebOk_C DDRC_DurDeb.HLSDem_tiOvhtDebDef_C DDRC_DurDeb.Oil_tiSRCMaxPSwmpDebOk_C DDRC_DurDeb.Oil_tiSRCMaxPSwmpDebDef_C DDRC_DurDeb.Oil_tiSRCMinPSwmpDebOk_C DDRC_DurDeb.Oil_tiSRCMinPSwmpDebDef_C DDRC_DurDeb.PIntkVUs_tiLineHiB1DebOk_C DDRC_DurDeb.PIntkVUs_tiLineHiB1DebDef_C DDRC_DurDeb.PIntkVUs_tiLineLoB1DebOk_C DDRC_DurDeb.PIntkVUs_tiLineLoB1DebDef_C DDRC_DurDeb.VehV_tiPhysRngLoDebOk_C DDRC_DurDeb.VehV_tiPhysRngLoDebDef_C DDRC_DurDeb.VehV_tiSigCanDebOk_C DDRC_DurDeb.VehV_tiSigCanDebDef_C DDRC_DurDeb.VehV_tiSigCanSafeDebOk_C DDRC_DurDeb.VehV_tiSigCanSafeDebDef_C DDRC_DurDeb.VlvLft_tiSRCMaxOilPSnsrIntk11DebOk_C DDRC_DurDeb.VlvLft_tiSRCMaxOilPSnsrIntk11DebDef_C DDRC_DurDeb.VlvLft_tiSRCMinOilPSnsrIntk11DebOk_C DDRC_DurDeb.VlvLft_tiSRCMinOilPSnsrIntk11DebDef_C DDRC_DurDeb.Clth_numPlaDebOk_C DDRC_DurDeb.Clth_numPlaDebDef_C DDRC_DurDeb.Gbx_numPNPosnDrvCdnDebOk_C DDRC_DurDeb.Gbx_numPNPosnDrvCdnDebDef_C DDRC_DurDeb.Gbx_numPNPosnPlausyDebOk_C DDRC_DurDeb.Gbx_numPNPosnPlausyDebDef_C DDRC_DurDeb.AltIO_tiACGFailrDebOk_C DDRC_DurDeb.AltIO_tiACGFailrDebDef_C DDRC_DurDeb.AltIO_tiACGHiVltgDebOk_C DDRC_DurDeb.AltIO_tiACGHiVltgDebDef_C DDRC_DurDeb.AltIO_tiACGLoVltgDebOk_C DDRC_DurDeb.AltIO_tiACGLoVltgDebDef_C DDRC_DurDeb.AltIO_tiACGTHiDebOk_C DDRC_DurDeb.AltIO_tiACGTHiDebDef_C DDRC_DurDeb.AltIO_tiDConnACGDebOk_C DDRC_DurDeb.AltIO_tiDConnACGDebDef_C DDRC_DurDeb.BattU_tiHiFailrDebOk_C DDRC_DurDeb.BattU_tiHiFailrDebDef_C DDRC_DurDeb.BattU_tiLoFailrDebOk_C DDRC_DurDeb.BattU_tiLoFailrDebDef_C DDRC_DurDeb.BrkBstP_tiDriftHiErrDebOk_C DDRC_DurDeb.BrkBstP_tiDriftHiErrDebDef_C DDRC_DurDeb.BrkBstP_tiDriftLoErrDebOk_C DDRC_DurDeb.BrkBstP_tiDriftLoErrDebDef_C DDRC_DurDeb.BrkBstP_tiSnsrStuckDebOk_C DDRC_DurDeb.BrkBstP_tiSnsrStuckDebDef_C DDRC_DurDeb.Brk_tiMnSwtContOnDebOk_C DDRC_DurDeb.Brk_tiMnSwtContOnDebDef_C DDRC_DurDeb.Brk_tiMnSwtNotStpDebOk_C DDRC_DurDeb.Brk_tiMnSwtNotStpDebDef_C DDRC_DurDeb.Brk_tiPlaDebOk_C DDRC_DurDeb.Brk_tiPlaDebDef_C DDRC_DurDeb.Brk_tiRdntSwtContOnDebOk_C DDRC_DurDeb.Brk_tiRdntSwtContOnDebDef_C DDRC_DurDeb.Brk_tiRdntSwtNotStpDebOk_C DDRC_DurDeb.Brk_tiRdntSwtNotStpDebDef_C DDRC_DurDeb.Clth_tiClth3ONStuckDebOk_C DDRC_DurDeb.Clth_tiClth3ONStuckDebDef_C DDRC_DurDeb.Clth_tiClth4OFFStuckDebOk_C DDRC_DurDeb.Clth_tiClth4OFFStuckDebDef_C DDRC_DurDeb.Clth_tiClthOFFStuckDebOk_C DDRC_DurDeb.Clth_tiClthOFFStuckDebDef_C DDRC_DurDeb.Clth_tiClthONStuckDebOk_C DDRC_DurDeb.Clth_tiClthONStuckDebDef_C DDRC_DurDeb.Clth_tiClthStkFailInfoDebOk_C DDRC_DurDeb.Clth_tiClthStkFailInfoDebDef_C DDRC_DurDeb.Com_tiACFailInfoDebOk_C DDRC_DurDeb.Com_tiACFailInfoDebDef_C DDRC_DurDeb.Com_tiATFTValErrDebOk_C DDRC_DurDeb.Com_tiATFTValErrDebDef_C DDRC_DurDeb.Com_tiATMILReqDebOk_C DDRC_DurDeb.Com_tiATMILReqDebDef_C DDRC_DurDeb.Com_tiAYCAChksumDebOk_C DDRC_DurDeb.Com_tiAYCAChksumDebDef_C DDRC_DurDeb.Com_tiAYCARingCntDebOk_C DDRC_DurDeb.Com_tiAYCARingCntDebDef_C DDRC_DurDeb.Com_tiAYCATOutDebOk_C DDRC_DurDeb.Com_tiAYCATOutDebDef_C DDRC_DurDeb.Com_tiAYCDChkSumDebOk_C DDRC_DurDeb.Com_tiAYCDChkSumDebDef_C DDRC_DurDeb.Com_tiAYCDTOutDebOk_C DDRC_DurDeb.Com_tiAYCDTOutDebDef_C DDRC_DurDeb.Com_tiAYCFChksumDebOk_C DDRC_DurDeb.Com_tiAYCFChksumDebDef_C DDRC_DurDeb.Com_tiAYCFRingCntDebOk_C DDRC_DurDeb.Com_tiAYCFRingCntDebDef_C DDRC_DurDeb.Com_tiAYCFTOutDebOk_C DDRC_DurDeb.Com_tiAYCFTOutDebDef_C DDRC_DurDeb.Com_tiAYCGChksumDebOk_C DDRC_DurDeb.Com_tiAYCGChksumDebDef_C DDRC_DurDeb.Com_tiAYCGRingCntDebOk_C DDRC_DurDeb.Com_tiAYCGRingCntDebDef_C DDRC_DurDeb.Com_tiAYCGTOutDebOk_C DDRC_DurDeb.Com_tiAYCGTOutDebDef_C DDRC_DurDeb.Com_tiAYCIChkSumDebOk_C DDRC_DurDeb.Com_tiAYCIChkSumDebDef_C DDRC_DurDeb.Com_tiAYCIRingCntDebOk_C DDRC_DurDeb.Com_tiAYCIRingCntDebDef_C DDRC_DurDeb.Com_tiAYCITOutDebOk_C DDRC_DurDeb.Com_tiAYCITOutDebDef_C DDRC_DurDeb.Com_tiBCM1ChkSumDebOk_C DDRC_DurDeb.Com_tiBCM1ChkSumDebDef_C DDRC_DurDeb.Com_tiBCM1RingCntDebOk_C DDRC_DurDeb.Com_tiBCM1RingCntDebDef_C DDRC_DurDeb.Com_tiBCM1TOutDebOk_C DDRC_DurDeb.Com_tiBCM1TOutDebDef_C DDRC_DurDeb.Com_tiCANABusOffErrDebOk_C DDRC_DurDeb.Com_tiCANABusOffErrDebDef_C DDRC_DurDeb.Com_tiCANBBusOffErrDebOk_C DDRC_DurDeb.Com_tiCANBBusOffErrDebDef_C DDRC_DurDeb.Com_tiCANCBusOffErrDebOk_C DDRC_DurDeb.Com_tiCANCBusOffErrDebDef_C DDRC_DurDeb.Com_tiCGW1ChkSumDebOk_C DDRC_DurDeb.Com_tiCGW1ChkSumDebDef_C DDRC_DurDeb.Com_tiCGW1TOutDebOk_C DDRC_DurDeb.Com_tiCGW1TOutDebDef_C DDRC_DurDeb.Com_tiCGW1ctRingDebOk_C DDRC_DurDeb.Com_tiCGW1ctRingDebDef_C DDRC_DurDeb.Com_tiConvBoostErrDebOk_C DDRC_DurDeb.Com_tiConvBoostErrDebDef_C DDRC_DurDeb.Com_tiConvSlipErrDebOk_C DDRC_DurDeb.Com_tiConvSlipErrDebDef_C DDRC_DurDeb.Com_tiDCDCPrfmncErrDebOk_C DDRC_DurDeb.Com_tiDCDCPrfmncErrDebDef_C DDRC_DurDeb.Com_tiDCDCTempWarnDebOk_C DDRC_DurDeb.Com_tiDCDCTempWarnDebDef_C DDRC_DurDeb.Com_tiEAT10ChkSumDebOk_C DDRC_DurDeb.Com_tiEAT10ChkSumDebDef_C DDRC_DurDeb.Com_tiEAT10RingCntDebOk_C DDRC_DurDeb.Com_tiEAT10RingCntDebDef_C DDRC_DurDeb.Com_tiEAT10TOutDebOk_C DDRC_DurDeb.Com_tiEAT10TOutDebDef_C DDRC_DurDeb.Com_tiEAT11ChkSumDebOk_C DDRC_DurDeb.Com_tiEAT11ChkSumDebDef_C DDRC_DurDeb.Com_tiEAT11RingCntDebOk_C DDRC_DurDeb.Com_tiEAT11RingCntDebDef_C DDRC_DurDeb.Com_tiEAT11TOutDebOk_C DDRC_DurDeb.Com_tiEAT11TOutDebDef_C DDRC_DurDeb.Com_tiEAT12ChkSumDebOk_C DDRC_DurDeb.Com_tiEAT12ChkSumDebDef_C DDRC_DurDeb.Com_tiEAT12RingCntDebOk_C DDRC_DurDeb.Com_tiEAT12RingCntDebDef_C DDRC_DurDeb.Com_tiEAT12TOutDebOk_C DDRC_DurDeb.Com_tiEAT12TOutDebDef_C DDRC_DurDeb.Com_tiEAT13ChkSumDebOk_C DDRC_DurDeb.Com_tiEAT13ChkSumDebDef_C DDRC_DurDeb.Com_tiEAT13RingCntDebOk_C DDRC_DurDeb.Com_tiEAT13RingCntDebDef_C DDRC_DurDeb.Com_tiEAT13TOutDebOk_C DDRC_DurDeb.Com_tiEAT13TOutDebDef_C DDRC_DurDeb.Com_tiEAT1ChksumDebOk_C DDRC_DurDeb.Com_tiEAT1ChksumDebDef_C DDRC_DurDeb.Com_tiEAT1RingCntDebOk_C DDRC_DurDeb.Com_tiEAT1RingCntDebDef_C DDRC_DurDeb.Com_tiEAT1TOutDebOk_C DDRC_DurDeb.Com_tiEAT1TOutDebDef_C DDRC_DurDeb.Com_tiEAT2ChksumDebOk_C DDRC_DurDeb.Com_tiEAT2ChksumDebDef_C DDRC_DurDeb.Com_tiEAT2RingCntDebOk_C DDRC_DurDeb.Com_tiEAT2RingCntDebDef_C DDRC_DurDeb.Com_tiEAT2TOutDebOk_C DDRC_DurDeb.Com_tiEAT2TOutDebDef_C DDRC_DurDeb.Com_tiEAT4ChksumDebOk_C DDRC_DurDeb.Com_tiEAT4ChksumDebDef_C DDRC_DurDeb.Com_tiEAT4RingCntDebOk_C DDRC_DurDeb.Com_tiEAT4RingCntDebDef_C DDRC_DurDeb.Com_tiEAT4TOutDebOk_C DDRC_DurDeb.Com_tiEAT4TOutDebDef_C DDRC_DurDeb.Com_tiEAT6ChkSumDebOk_C DDRC_DurDeb.Com_tiEAT6ChkSumDebDef_C DDRC_DurDeb.Com_tiEAT6RingCntDebOk_C DDRC_DurDeb.Com_tiEAT6RingCntDebDef_C DDRC_DurDeb.Com_tiEAT6TOutDebOk_C DDRC_DurDeb.Com_tiEAT6TOutDebDef_C DDRC_DurDeb.Com_tiEAT7ChkSumDebOk_C DDRC_DurDeb.Com_tiEAT7ChkSumDebDef_C DDRC_DurDeb.Com_tiEAT7RingCntDebOk_C DDRC_DurDeb.Com_tiEAT7RingCntDebDef_C DDRC_DurDeb.Com_tiEAT7TOutDebOk_C DDRC_DurDeb.Com_tiEAT7TOutDebDef_C DDRC_DurDeb.Com_tiEAT8ChkSumDebOk_C DDRC_DurDeb.Com_tiEAT8ChkSumDebDef_C DDRC_DurDeb.Com_tiEAT8RingCntDebOk_C DDRC_DurDeb.Com_tiEAT8RingCntDebDef_C DDRC_DurDeb.Com_tiEAT8TOutDebOk_C DDRC_DurDeb.Com_tiEAT8TOutDebDef_C DDRC_DurDeb.Com_tiEATAChkSumDebOk_C DDRC_DurDeb.Com_tiEATAChkSumDebDef_C DDRC_DurDeb.Com_tiEATARingCntDebOk_C DDRC_DurDeb.Com_tiEATARingCntDebDef_C DDRC_DurDeb.Com_tiEATATOutDebOk_C DDRC_DurDeb.Com_tiEATATOutDebDef_C DDRC_DurDeb.Com_tiEATBChksumDebOk_C DDRC_DurDeb.Com_tiEATBChksumDebDef_C DDRC_DurDeb.Com_tiEATBRingCntDebOk_C DDRC_DurDeb.Com_tiEATBRingCntDebDef_C DDRC_DurDeb.Com_tiEATBTOutDebOk_C DDRC_DurDeb.Com_tiEATBTOutDebDef_C DDRC_DurDeb.Com_tiEATCChkSumDebOk_C DDRC_DurDeb.Com_tiEATCChkSumDebDef_C DDRC_DurDeb.Com_tiEATCRingCntDebOk_C DDRC_DurDeb.Com_tiEATCRingCntDebDef_C DDRC_DurDeb.Com_tiEATCTOutDebOk_C DDRC_DurDeb.Com_tiEATCTOutDebDef_C DDRC_DurDeb.Com_tiEPBBChkSumDebOk_C DDRC_DurDeb.Com_tiEPBBChkSumDebDef_C DDRC_DurDeb.Com_tiEPBBRingCntDebOk_C DDRC_DurDeb.Com_tiEPBBRingCntDebDef_C DDRC_DurDeb.Com_tiEPBBTOutDebOk_C DDRC_DurDeb.Com_tiEPBBTOutDebDef_C DDRC_DurDeb.Com_tiEPBChkSumDebOk_C DDRC_DurDeb.Com_tiEPBChkSumDebDef_C DDRC_DurDeb.Com_tiEPBTOutDebOk_C DDRC_DurDeb.Com_tiEPBTOutDebDef_C DDRC_DurDeb.Com_tiEPBctRingDebOk_C DDRC_DurDeb.Com_tiEPBctRingDebDef_C DDRC_DurDeb.Com_tiEPS1ChksumDebOk_C DDRC_DurDeb.Com_tiEPS1ChksumDebDef_C DDRC_DurDeb.Com_tiEPS1RingCntDebOk_C DDRC_DurDeb.Com_tiEPS1RingCntDebDef_C DDRC_DurDeb.Com_tiEPS1TOutDebOk_C DDRC_DurDeb.Com_tiEPS1TOutDebDef_C DDRC_DurDeb.Com_tiEngCanRxErrDebOk_C DDRC_DurDeb.Com_tiEngCanRxErrDebDef_C DDRC_DurDeb.Com_tiGrvySnsrErrDebOk_C DDRC_DurDeb.Com_tiGrvySnsrErrDebDef_C DDRC_DurDeb.Com_tiGwIMG1ChkSumDebOk_C DDRC_DurDeb.Com_tiGwIMG1ChkSumDebDef_C DDRC_DurDeb.Com_tiGwIMG1RingCntDebOk_C DDRC_DurDeb.Com_tiGwIMG1RingCntDebDef_C DDRC_DurDeb.Com_tiGwIMG1TOutDebOk_C DDRC_DurDeb.Com_tiGwIMG1TOutDebDef_C DDRC_DurDeb.Com_tiGwIMG3ChkSumDebOk_C DDRC_DurDeb.Com_tiGwIMG3ChkSumDebDef_C DDRC_DurDeb.Com_tiGwIMG3RingCntDebOk_C DDRC_DurDeb.Com_tiGwIMG3RingCntDebDef_C DDRC_DurDeb.Com_tiGwIMG3TOutDebOk_C DDRC_DurDeb.Com_tiGwIMG3TOutDebDef_C DDRC_DurDeb.Com_tiGwIMG4ChkSumDebOk_C DDRC_DurDeb.Com_tiGwIMG4ChkSumDebDef_C DDRC_DurDeb.Com_tiGwIMG4RingCntDebOk_C DDRC_DurDeb.Com_tiGwIMG4RingCntDebDef_C DDRC_DurDeb.Com_tiGwIMG4TOutDebOk_C DDRC_DurDeb.Com_tiGwIMG4TOutDebDef_C DDRC_DurDeb.Com_tiGwIMG5ChkSumDebOk_C DDRC_DurDeb.Com_tiGwIMG5ChkSumDebDef_C DDRC_DurDeb.Com_tiGwIMG5RingCntDebOk_C DDRC_DurDeb.Com_tiGwIMG5RingCntDebDef_C DDRC_DurDeb.Com_tiGwIMG5TOutDebOk_C DDRC_DurDeb.Com_tiGwIMG5TOutDebDef_C DDRC_DurDeb.Com_tiGwIMG6ChkSumDebOk_C DDRC_DurDeb.Com_tiGwIMG6ChkSumDebDef_C DDRC_DurDeb.Com_tiGwIMG6RingCntDebOk_C DDRC_DurDeb.Com_tiGwIMG6RingCntDebDef_C DDRC_DurDeb.Com_tiGwIMG6TOutDebOk_C DDRC_DurDeb.Com_tiGwIMG6TOutDebDef_C DDRC_DurDeb.Com_tiIDASBChkSumDebOk_C DDRC_DurDeb.Com_tiIDASBChkSumDebDef_C DDRC_DurDeb.Com_tiIDASBRingCntDebOk_C DDRC_DurDeb.Com_tiIDASBRingCntDebDef_C DDRC_DurDeb.Com_tiIDASBTOutDebOk_C DDRC_DurDeb.Com_tiIDASBTOutDebDef_C DDRC_DurDeb.Com_tiIMGMILReqDebOk_C DDRC_DurDeb.Com_tiIMGMILReqDebDef_C DDRC_DurDeb.Com_tiISSPrmsDebOk_C DDRC_DurDeb.Com_tiISSPrmsDebDef_C DDRC_DurDeb.Com_tiMETACSumDebOk_C DDRC_DurDeb.Com_tiMETACSumDebDef_C DDRC_DurDeb.Com_tiMETACSumPstDrvDebOk_C DDRC_DurDeb.Com_tiMETACSumPstDrvDebDef_C DDRC_DurDeb.Com_tiMETARingCntrPstDrvDebOk_C DDRC_DurDeb.Com_tiMETARingCntrPstDrvDebDef_C DDRC_DurDeb.Com_tiMETAToutPstDrvDebOk_C DDRC_DurDeb.Com_tiMETAToutPstDrvDebDef_C DDRC_DurDeb.Com_tiMETActRingDebOk_C DDRC_DurDeb.Com_tiMETActRingDebDef_C DDRC_DurDeb.Com_tiMETAtiDebDebOk_C DDRC_DurDeb.Com_tiMETAtiDebDebDef_C DDRC_DurDeb.Com_tiMETCCSumDebOk_C DDRC_DurDeb.Com_tiMETCCSumDebDef_C DDRC_DurDeb.Com_tiMETCctRingDebOk_C DDRC_DurDeb.Com_tiMETCctRingDebDef_C DDRC_DurDeb.Com_tiMETCtiDebDebOk_C DDRC_DurDeb.Com_tiMETCtiDebDebDef_C DDRC_DurDeb.Com_tiMETDCSumDebOk_C DDRC_DurDeb.Com_tiMETDCSumDebDef_C DDRC_DurDeb.Com_tiMETDctRingDebOk_C DDRC_DurDeb.Com_tiMETDctRingDebDef_C DDRC_DurDeb.Com_tiMETDtiDebDebOk_C DDRC_DurDeb.Com_tiMETDtiDebDebDef_C DDRC_DurDeb.Com_tiMETE2CSumDebOk_C DDRC_DurDeb.Com_tiMETE2CSumDebDef_C DDRC_DurDeb.Com_tiMETE2ctRingDebOk_C DDRC_DurDeb.Com_tiMETE2ctRingDebDef_C DDRC_DurDeb.Com_tiMETE2tiDebDebOk_C DDRC_DurDeb.Com_tiMETE2tiDebDebDef_C DDRC_DurDeb.Com_tiMETFChksumDebOk_C DDRC_DurDeb.Com_tiMETFChksumDebDef_C DDRC_DurDeb.Com_tiMETFRingCntDebOk_C DDRC_DurDeb.Com_tiMETFRingCntDebDef_C DDRC_DurDeb.Com_tiMETFTOutDebOk_C DDRC_DurDeb.Com_tiMETFTOutDebDef_C DDRC_DurDeb.Com_tiMETGCSumDebOk_C DDRC_DurDeb.Com_tiMETGCSumDebDef_C DDRC_DurDeb.Com_tiMETGctRingDebOk_C DDRC_DurDeb.Com_tiMETGctRingDebDef_C DDRC_DurDeb.Com_tiMETGtiDebDebOk_C DDRC_DurDeb.Com_tiMETGtiDebDebDef_C DDRC_DurDeb.Com_tiMETH2CSumDebOk_C DDRC_DurDeb.Com_tiMETH2CSumDebDef_C DDRC_DurDeb.Com_tiMETH2ctRingDebOk_C DDRC_DurDeb.Com_tiMETH2ctRingDebDef_C DDRC_DurDeb.Com_tiMETH2tiDebDebOk_C DDRC_DurDeb.Com_tiMETH2tiDebDebDef_C DDRC_DurDeb.Com_tiMETHCSumDebOk_C DDRC_DurDeb.Com_tiMETHCSumDebDef_C DDRC_DurDeb.Com_tiMETHctRingDebOk_C DDRC_DurDeb.Com_tiMETHctRingDebDef_C DDRC_DurDeb.Com_tiMETHtiDebDebOk_C DDRC_DurDeb.Com_tiMETHtiDebDebDef_C DDRC_DurDeb.Com_tiMETICSumDebOk_C DDRC_DurDeb.Com_tiMETICSumDebDef_C DDRC_DurDeb.Com_tiMETIctRingDebOk_C DDRC_DurDeb.Com_tiMETIctRingDebDef_C DDRC_DurDeb.Com_tiMETItiDebDebOk_C DDRC_DurDeb.Com_tiMETItiDebDebDef_C DDRC_DurDeb.Com_tiMETKCSumDebOk_C DDRC_DurDeb.Com_tiMETKCSumDebDef_C DDRC_DurDeb.Com_tiMETKctRingDebOk_C DDRC_DurDeb.Com_tiMETKctRingDebDef_C DDRC_DurDeb.Com_tiMETKtiDebDebOk_C DDRC_DurDeb.Com_tiMETKtiDebDebDef_C DDRC_DurDeb.Com_tiMETLCSumDebOk_C DDRC_DurDeb.Com_tiMETLCSumDebDef_C DDRC_DurDeb.Com_tiMETLRingCntrDebOk_C DDRC_DurDeb.Com_tiMETLRingCntrDebDef_C DDRC_DurDeb.Com_tiMETLToutDebOk_C DDRC_DurDeb.Com_tiMETLToutDebDef_C DDRC_DurDeb.Com_tiMETMCSumDebOk_C DDRC_DurDeb.Com_tiMETMCSumDebDef_C DDRC_DurDeb.Com_tiMETMRingCntrDebOk_C DDRC_DurDeb.Com_tiMETMRingCntrDebDef_C DDRC_DurDeb.Com_tiMETMToutDebOk_C DDRC_DurDeb.Com_tiMETMToutDebDef_C DDRC_DurDeb.Com_tiMETNCSumDebOk_C DDRC_DurDeb.Com_tiMETNCSumDebDef_C DDRC_DurDeb.Com_tiMETNRingCntrDebOk_C DDRC_DurDeb.Com_tiMETNRingCntrDebDef_C DDRC_DurDeb.Com_tiMETNToutDebOk_C DDRC_DurDeb.Com_tiMETNToutDebDef_C DDRC_DurDeb.Com_tiMtrComDebOk_C DDRC_DurDeb.Com_tiMtrComDebDef_C DDRC_DurDeb.Com_tiPCUChkSumDebOk_C DDRC_DurDeb.Com_tiPCUChkSumDebDef_C DDRC_DurDeb.Com_tiPCURingCntDebOk_C DDRC_DurDeb.Com_tiPCURingCntDebDef_C DDRC_DurDeb.Com_tiPCUTOutDebOk_C DDRC_DurDeb.Com_tiPCUTOutDebDef_C DDRC_DurDeb.Com_tiSRSACSumDebOk_C DDRC_DurDeb.Com_tiSRSACSumDebDef_C DDRC_DurDeb.Com_tiSRSARingCntDebOk_C DDRC_DurDeb.Com_tiSRSARingCntDebDef_C DDRC_DurDeb.Com_tiSRSATOutDebOk_C DDRC_DurDeb.Com_tiSRSATOutDebDef_C DDRC_DurDeb.Com_tiSRSBCSumDebOk_C DDRC_DurDeb.Com_tiSRSBCSumDebDef_C DDRC_DurDeb.Com_tiSRSBRingCntDebOk_C DDRC_DurDeb.Com_tiSRSBRingCntDebDef_C DDRC_DurDeb.Com_tiSRSBTOutDebOk_C DDRC_DurDeb.Com_tiSRSBTOutDebDef_C DDRC_DurDeb.Com_tiSRSCSumDebOk_C DDRC_DurDeb.Com_tiSRSCSumDebDef_C DDRC_DurDeb.Com_tiSRSErrDebOk_C DDRC_DurDeb.Com_tiSRSErrDebDef_C DDRC_DurDeb.Com_tiSRSRingCntDebOk_C DDRC_DurDeb.Com_tiSRSRingCntDebDef_C DDRC_DurDeb.Com_tiSRSTOutDebOk_C DDRC_DurDeb.Com_tiSRSTOutDebDef_C DDRC_DurDeb.Com_tiVehSpdPndFltTCUDebOk_C DDRC_DurDeb.Com_tiVehSpdPndFltTCUDebDef_C DDRC_DurDeb.CstrPurg_tiDebDebOk_C DDRC_DurDeb.CstrPurg_tiDebDebDef_C DDRC_DurDeb.Ebs_tiChartcCurrErrDebOk_C DDRC_DurDeb.Ebs_tiChartcCurrErrDebDef_C DDRC_DurDeb.Ebs_tiSelfDiagErrDebOk_C DDRC_DurDeb.Ebs_tiSelfDiagErrDebDef_C DDRC_DurDeb.EnStrt_ReqOilWrmUp_tiOilWrmUpDebOk_C DDRC_DurDeb.EnStrt_ReqOilWrmUp_tiOilWrmUpDebDef_C DDRC_DurDeb.EvapActrCcv_tiDebDebOk_C DDRC_DurDeb.EvapActrCcv_tiDebDebDef_C DDRC_DurDeb.GEVlv_tiPhaCsersIntkB1DebOk_C DDRC_DurDeb.GEVlv_tiPhaCsersIntkB1DebDef_C DDRC_DurDeb.GEVlv_tiPhaPsOpenLoadIntkB1DebOk_C DDRC_DurDeb.GEVlv_tiPhaPsOpenLoadIntkB1DebDef_C DDRC_DurDeb.GEVlv_tiPhaPsShoToBattIntkB1DebOk_C DDRC_DurDeb.GEVlv_tiPhaPsShoToBattIntkB1DebDef_C DDRC_DurDeb.GEVlv_tiPhaPsShoToGndIntkB1DebOk_C DDRC_DurDeb.GEVlv_tiPhaPsShoToGndIntkB1DebDef_C DDRC_DurDeb.GbxNPos_tiCANDigPlausDebOk_C DDRC_DurDeb.GbxNPos_tiCANDigPlausDebDef_C DDRC_DurDeb.GbxNPos_tiNPos1SRCMaxDebOk_C DDRC_DurDeb.GbxNPos_tiNPos1SRCMaxDebDef_C DDRC_DurDeb.GbxNPos_tiNPos1SRCMinDebOk_C DDRC_DurDeb.GbxNPos_tiNPos1SRCMinDebDef_C DDRC_DurDeb.GbxNPos_tiNPos2SRCMaxDebOk_C DDRC_DurDeb.GbxNPos_tiNPos2SRCMaxDebDef_C DDRC_DurDeb.GbxNPos_tiNPos2SRCMinDebOk_C DDRC_DurDeb.GbxNPos_tiNPos2SRCMinDebDef_C DDRC_DurDeb.GbxNPos_tiNPosAlvChkDebOk_C DDRC_DurDeb.GbxNPos_tiNPosAlvChkDebDef_C DDRC_DurDeb.GbxNPos_tiNPosSyncErrDebOk_C DDRC_DurDeb.GbxNPos_tiNPosSyncErrDebDef_C DDRC_DurDeb.HEGO_tiDebHtrPsErrDebOk_C DDRC_DurDeb.HEGO_tiDebHtrPsErrDebDef_C DDRC_DurDeb.LIN_tiCSErrACGDebOk_C DDRC_DurDeb.LIN_tiCSErrACGDebDef_C DDRC_DurDeb.LIN_tiCSErrAEVDebOk_C DDRC_DurDeb.LIN_tiCSErrAEVDebDef_C DDRC_DurDeb.LIN_tiCSErrDCDCDebOk_C DDRC_DurDeb.LIN_tiCSErrDCDCDebDef_C DDRC_DurDeb.LIN_tiCSErrEBSDebOk_C DDRC_DurDeb.LIN_tiCSErrEBSDebDef_C DDRC_DurDeb.LIN_tiHdrTimeoutErrACGDebOk_C DDRC_DurDeb.LIN_tiHdrTimeoutErrACGDebDef_C DDRC_DurDeb.LIN_tiHdrTimeoutErrAEVDebOk_C DDRC_DurDeb.LIN_tiHdrTimeoutErrAEVDebDef_C DDRC_DurDeb.LIN_tiHdrTimeoutErrDCDCDebOk_C DDRC_DurDeb.LIN_tiHdrTimeoutErrDCDCDebDef_C DDRC_DurDeb.LIN_tiHdrTimeoutErrEBSDebOk_C DDRC_DurDeb.LIN_tiHdrTimeoutErrEBSDebDef_C DDRC_DurDeb.LIN_tiMsgTimeoutErrACGDebOk_C DDRC_DurDeb.LIN_tiMsgTimeoutErrACGDebDef_C DDRC_DurDeb.LIN_tiMsgTimeoutErrAEVDebOk_C DDRC_DurDeb.LIN_tiMsgTimeoutErrAEVDebDef_C DDRC_DurDeb.LIN_tiMsgTimeoutErrDCDCDebOk_C DDRC_DurDeb.LIN_tiMsgTimeoutErrDCDCDebDef_C DDRC_DurDeb.LIN_tiMsgTimeoutErrEBSDebOk_C DDRC_DurDeb.LIN_tiMsgTimeoutErrEBSDebDef_C DDRC_DurDeb.LIN_tiNoStrtComErrDebOk_C DDRC_DurDeb.LIN_tiNoStrtComErrDebDef_C DDRC_DurDeb.MisfDet_tiVWhlOORDebOk_C DDRC_DurDeb.MisfDet_tiVWhlOORDebDef_C DDRC_DurDeb.MisfDet_tiVWhlRatyDebOk_C DDRC_DurDeb.MisfDet_tiVWhlRatyDebDef_C DDRC_DurDeb.MisfDet_tiVWhlStuckDebOk_C DDRC_DurDeb.MisfDet_tiVWhlStuckDebDef_C DDRC_DurDeb.MisfDet_tidVWhlPlausDebOk_C DDRC_DurDeb.MisfDet_tidVWhlPlausDebDef_C DDRC_DurDeb.OilP_tiLowPresDebOk_C DDRC_DurDeb.OilP_tiLowPresDebDef_C DDRC_DurDeb.PEnv_tiSigRngChkDebOk_C DDRC_DurDeb.PEnv_tiSigRngChkDebDef_C DDRC_DurDeb.Strt_tiCtOffPthDebOk_C DDRC_DurDeb.Strt_tiCtOffPthDebDef_C DDRC_DurDeb.Strt_tiCtlErrDebOk_C DDRC_DurDeb.Strt_tiCtlErrDebDef_C DDRC_DurDeb.Strt_tiFaultDebOk_C DDRC_DurDeb.Strt_tiFaultDebDef_C DDRC_DurDeb.Strt_tiStkRly1DebOk_C DDRC_DurDeb.Strt_tiStkRly1DebDef_C DDRC_DurDeb.Strt_tiStkRly2DebOk_C DDRC_DurDeb.Strt_tiStkRly2DebDef_C DDRC_DurDeb.Strt_tiStmFaultDebOk_C DDRC_DurDeb.Strt_tiStmFaultDebDef_C DDRC_DurDeb.Strt_tiStrtLckJudg1DebOk_C DDRC_DurDeb.Strt_tiStrtLckJudg1DebDef_C DDRC_DurDeb.Strt_tiStrtLckJudg2DebOk_C DDRC_DurDeb.Strt_tiStrtLckJudg2DebDef_C DDRC_DurDeb.Strt_tiStrtOLDebOk_C DDRC_DurDeb.Strt_tiStrtOLDebDef_C DDRC_DurDeb.Strt_tiStrtOL2DebOk_C DDRC_DurDeb.Strt_tiStrtOL2DebDef_C DDRC_DurDeb.Strt_tiStrtSCBDebOk_C DDRC_DurDeb.Strt_tiStrtSCBDebDef_C DDRC_DurDeb.Strt_tiStrtSCB2DebOk_C DDRC_DurDeb.Strt_tiStrtSCB2DebDef_C DDRC_DurDeb.Strt_tiStrtSCGDebOk_C DDRC_DurDeb.Strt_tiStrtSCGDebDef_C DDRC_DurDeb.Strt_tiStrtSCG2DebOk_C DDRC_DurDeb.Strt_tiStrtSCG2DebDef_C DDRC_DurDeb.UEGO_DiagHeatrPfrmnc_tiLoDebOk_C DDRC_DurDeb.UEGO_DiagHeatrPfrmnc_tiLoDebDef_C DDRC_DurDeb.VehV_tiNCSnsrElecFailrDebOk_C DDRC_DurDeb.VehV_tiNCSnsrElecFailrDebDef_C DDRC_DurDeb.VehV_tiPlaAllDebOk_C DDRC_DurDeb.VehV_tiPlaAllDebDef_C DDRC_DurDeb.VehV_tiPlaCanDebOk_C DDRC_DurDeb.VehV_tiPlaCanDebDef_C DDRC_DurDeb.VehV_tiPlaFcoDebOk_C DDRC_DurDeb.VehV_tiPlaFcoDebDef_C DDRC_DurDeb.VehV_tiPlaPwrDebOk_C DDRC_DurDeb.VehV_tiPlaPwrDebDef_C DDRC_DurDeb.VehV_tiPlaV2NDebOk_C DDRC_DurDeb.VehV_tiPlaV2NDebDef_C DDRC_DurDeb.VehV_tiSpdSnsrAElecFailrDebOk_C DDRC_DurDeb.VehV_tiSpdSnsrAElecFailrDebDef_C DDRC_DurDeb.VehV_tiSpdSnsrBElecFailrDebOk_C DDRC_DurDeb.VehV_tiSpdSnsrBElecFailrDebDef_C DDRC_DurDeb.Clth_tiMaxDebOk_C DDRC_DurDeb.Clth_tiMaxDebDef_C DDRC_DurDeb.IgnClPs_numDevComErrDebOk_C DDRC_DurDeb.IgnClPs_numDevComErrDebDef_C DDRC_DurDeb.IgnClPs_numOpenLoadDebOk_C DDRC_DurDeb.IgnClPs_numOpenLoadDebDef_C DDRC_DurDeb.IgnClPs_numShCirBattDebOk_C DDRC_DurDeb.IgnClPs_numShCirBattDebDef_C DDRC_DurDeb.IgnClPs_numShCirGndDebOk_C DDRC_DurDeb.IgnClPs_numShCirGndDebDef_C DDRC_DurDeb.KRVEKO_num_DebDef_CDebOk_C DDRC_DurDeb.KRVEKO_num_DebDef_CDebDef_C DDRC_DurDeb.UEGO_numDiagSigSnsrDebOk_C DDRC_DurDeb.UEGO_numDiagSigSnsrDebDef_C DDRC_DurDeb.UEGO_numSigEcuAsicDebOk_C DDRC_DurDeb.UEGO_numSigEcuAsicDebDef_C DDRC_DurDeb.UEGO_numSigEcuComDebOk_C DDRC_DurDeb.UEGO_numSigEcuComDebDef_C DDRC_DurDeb.UEGO_numSigWireOlDebOk_C DDRC_DurDeb.UEGO_numSigWireOlDebDef_C DDRC_DurDeb.UEGO_numSigWireScDebOk_C DDRC_DurDeb.UEGO_numSigWireScDebDef_C DDRC_DurDeb.AFS_tiSigErrLineHiB1DebOk_C DDRC_DurDeb.AFS_tiSigErrLineHiB1DebDef_C DDRC_DurDeb.AFS_tiSigErrLineLoB1DebOk_C DDRC_DurDeb.AFS_tiSigErrLineLoB1DebDef_C DDRC_DurDeb.PEnv_tiVDDiagDebOk_C DDRC_DurDeb.PEnv_tiVDDiagDebDef_C DDRC_DurDeb.UEGO_DiagHeatrWire_tiOlDebOk_C DDRC_DurDeb.UEGO_DiagHeatrWire_tiOlDebDef_C DDRC_DurDeb.UEGO_DiagHeatrWire_tiScbDebOk_C DDRC_DurDeb.UEGO_DiagHeatrWire_tiScbDebDef_C DDRC_DurDeb.UEGO_DiagHeatrWire_tiScgDebOk_C DDRC_DurDeb.UEGO_DiagHeatrWire_tiScgDebDef_C DDRC_DurDeb.UEGO_HeatrRlyPsDiag_tiOLDebOk_C DDRC_DurDeb.UEGO_HeatrRlyPsDiag_tiOLDebDef_C DDRC_DurDeb.UEGO_HeatrRlyPsDiag_tiSCBDebOk_C DDRC_DurDeb.UEGO_HeatrRlyPsDiag_tiSCBDebDef_C DDRC_DurDeb.UEGO_HeatrRlyPsDiag_tiSCGDebOk_C DDRC_DurDeb.UEGO_HeatrRlyPsDiag_tiSCGDebDef_C DDRC_DurDeb.KnDet_numShCirDebOk_C DDRC_DurDeb.KnDet_numShCirDebDef_C DDRC_RatDeb.AFS_tiPhyRngChkHiUDRat_C DDRC_RatDeb.AFS_tiPhyRngChkLoUDRat_C DDRC_RatDeb.AirC_tiCmprOLUDRat_C DDRC_RatDeb.AirC_tiCmprOvrTempUDRat_C DDRC_RatDeb.AirC_tiCmprSCBUDRat_C DDRC_RatDeb.AirC_tiCmprSCGUDRat_C DDRC_RatDeb.Alt_tiErrUDRat_C DDRC_RatDeb.BattU_tiMaxUDRat_C DDRC_RatDeb.BattU_tiMinUDRat_C DDRC_RatDeb.Com_tiChksTCU1UDRat_C DDRC_RatDeb.Com_tiChksTCU11UDRat_C DDRC_RatDeb.Com_tiChksTCU12UDRat_C DDRC_RatDeb.Com_tiChksTCU13UDRat_C DDRC_RatDeb.Com_tiChksTCU2UDRat_C DDRC_RatDeb.Com_tiChksTCU3UDRat_C DDRC_RatDeb.Com_tiChksTCU4UDRat_C DDRC_RatDeb.Com_tiCntTCU1UDRat_C DDRC_RatDeb.Com_tiCntTCU11UDRat_C /end DEF_CHARACTERISTIC
 FUNCTION_VERSION "30000.21.1" /end FUNCTION
/begin COMPU_METHOD DDRCTime_ms "" RAT_FUNC "%6.1" "ms" COEFFS 0 1 0 0 0 10 /end COMPU_METHOD
/begin COMPU_METHOD DDRC_Ratio "" TAB_VERB "%6.3" "-" COMPU_TAB_REF DDRC_Ratio /end COMPU_METHOD
/begin COMPU_VTAB DDRC_Ratio "" TAB_VERB 4 1 "Ratio1" 2 "Ratio2" 3 "Ratio3" 4 "Ratio4" /end COMPU_VTAB
/begin COMPU_METHOD OneToOne "" RAT_FUNC "%6.2" "-" COEFFS 0 1 0 0 0 1 /end COMPU_METHOD
/begin RECORD_LAYOUT Val_Wu16 FNC_VALUES 1 UWORD COLUMN_DIR DIRECT /end RECORD_LAYOUT
/begin RECORD_LAYOUT Val_Wu8 FNC_VALUES 1 UBYTE COLUMN_DIR DIRECT /end RECORD_LAYOUT
/end MODULE
/end PROJECT
