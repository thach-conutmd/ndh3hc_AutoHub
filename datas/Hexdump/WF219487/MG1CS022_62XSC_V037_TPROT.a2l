ASAP2_VERSION 1 60
/begin PROJECT MG1CS022 "MG1CS022"
/begin HEADER "" VERSION "MG1CS022_62XSC_V037_TPROT" PROJECT_NO MG1CS022 /end HEADER
/begin MODULE DIM ""
/begin MOD_COMMON "" BYTE_ORDER MSB_LAST ALIGNMENT_BYTE 1 ALIGNMENT_WORD 2 ALIGNMENT_LONG 4 ALIGNMENT_INT64 4 ALIGNMENT_FLOAT32_IEEE 4 ALIGNMENT_FLOAT64_IEEE 4 DATA_SIZE 32 /end MOD_COMMON
/begin CHARACTERISTIC DFC_DisblMsk.DFC_Clth2ONStuckLdc_C "disable mask / Disable masks of check DFC_Clth2ONStuckLdc" VALUE 0x804F5B68 Val_Wu16 65535.00 DFES_OneToOne 0.00 65535.00 FORMAT "%8.2" /end CHARACTERISTIC
/begin CHARACTERISTIC DFC_DisblMsk.DFC_Clth3ONStuckLdc_C "disable mask / Disable masks of check DFC_Clth3ONStuckLdc" VALUE 0x804F5B6A Val_Wu16 65535.00 DFES_OneToOne 0.00 65535.00 FORMAT "%8.2" /end CHARACTERISTIC
/begin CHARACTERISTIC DFC_DisblMsk.DFC_Clth3ONStuckPostDrv_C "disable mask / Disable masks of check DFC_Clth3ONStuckPostDrv" VALUE 0x804F5B6C Val_Wu16 65535.00 DFES_OneToOne 0.00 65535.00 FORMAT "%8.2" /end CHARACTERISTIC
/begin CHARACTERISTIC DFC_DisblMsk.DFC_Clth4ONStuck_C "disable mask / Disable masks of check DFC_Clth4ONStuck" VALUE 0x804F5B6E Val_Wu16 65535.00 DFES_OneToOne 0.00 65535.00 FORMAT "%8.2" /end CHARACTERISTIC
/begin CHARACTERISTIC DFC_DisblMsk.DFC_Clth4ONStuckLdc_C "disable mask / Disable masks of check DFC_Clth4ONStuckLdc" VALUE 0x804F5B70 Val_Wu16 65535.00 DFES_OneToOne 0.00 65535.00 FORMAT "%8.2" /end CHARACTERISTIC
/begin CHARACTERISTIC DFC_DisblMsk.DFC_ComBCMUnit_C "disable mask / Disable masks of check DFC_ComBCMUnit" VALUE 0x804F5B72 Val_Wu16 65535.00 DFES_OneToOne 0.00 65535.00 FORMAT "%8.2" /end CHARACTERISTIC
/begin CHARACTERISTIC DFC_DisblMsk.DFC_ComDLCTCU01_C "disable mask / Disable masks of check DFC_ComDLCTCU01" VALUE 0x804F5B74 Val_Wu16 65535.00 DFES_OneToOne 0.00 65535.00 FORMAT "%8.2" /end CHARACTERISTIC
/begin CHARACTERISTIC DFC_DisblMsk.DFC_ComDLCTCU02_C "disable mask / Disable masks of check DFC_ComDLCTCU02" VALUE 0x804F5B76 Val_Wu16 65535.00 DFES_OneToOne 0.00 65535.00 FORMAT "%8.2" /end CHARACTERISTIC
/begin CHARACTERISTIC DFC_DisblMsk.DFC_ComDLCTCU1_C "disable mask / Disable masks of check DFC_ComDLCTCU1" VALUE 0x804F5B78 Val_Wu16 65535.00 DFES_OneToOne 0.00 65535.00 FORMAT "%8.2" /end CHARACTERISTIC
/begin CHARACTERISTIC DFC_DisblMsk.DFC_ComDLCTCU11_C "disable mask / Disable masks of check DFC_ComDLCTCU11" VALUE 0x804F5B7A Val_Wu16 65535.00 DFES_OneToOne 0.00 65535.00 FORMAT "%8.2" /end CHARACTERISTIC
/begin CHARACTERISTIC DFC_DisblMsk.DFC_ComDLCTCU12_C "disable mask / Disable masks of check DFC_ComDLCTCU12" VALUE 0x804F5B7C Val_Wu16 65535.00 DFES_OneToOne 0.00 65535.00 FORMAT "%8.2" /end CHARACTERISTIC
/begin CHARACTERISTIC DFC_DisblMsk.DFC_ComDLCTCU13_C "disable mask / Disable masks of check DFC_ComDLCTCU13" VALUE 0x804F5B7E Val_Wu16 65535.00 DFES_OneToOne 0.00 65535.00 FORMAT "%8.2" /end CHARACTERISTIC
/begin CHARACTERISTIC DFC_DisblMsk.DFC_ComDLCTCU14_C "disable mask / Disable masks of check DFC_ComDLCTCU14" VALUE 0x804F5B80 Val_Wu16 65535.00 DFES_OneToOne 0.00 65535.00 FORMAT "%8.2" /end CHARACTERISTIC
/begin CHARACTERISTIC DFC_DisblMsk.DFC_ComDLCTCU2_C "disable mask / Disable masks of check DFC_ComDLCTCU2" VALUE 0x804F5B82 Val_Wu16 65535.00 DFES_OneToOne 0.00 65535.00 FORMAT "%8.2" /end CHARACTERISTIC
/begin CHARACTERISTIC DFC_DisblMsk.DFC_ComDLCTCU3_C "disable mask / Disable masks of check DFC_ComDLCTCU3" VALUE 0x804F5B84 Val_Wu16 65535.00 DFES_OneToOne 0.00 65535.00 FORMAT "%8.2" /end CHARACTERISTIC
/begin CHARACTERISTIC DFC_DisblMsk.DFC_ComDLCTCU4_C "disable mask / Disable masks of check DFC_ComDLCTCU4" VALUE 0x804F5B86 Val_Wu16 65535.00 DFES_OneToOne 0.00 65535.00 FORMAT "%8.2" /end CHARACTERISTIC
/begin CHARACTERISTIC DFC_DisblMsk.DFC_ComEPSUnit_C "disable mask / Disable masks of check DFC_ComEPSUnit" VALUE 0x804F5B88 Val_Wu16 65535.00 DFES_OneToOne 0.00 65535.00 FORMAT "%8.2" /end CHARACTERISTIC
/begin CHARACTERISTIC DFC_DisblMsk.DFC_ComIDASBUnit_C "disable mask / Disable masks of check DFC_ComIDASBUnit" VALUE 0x804F5B8A Val_Wu16 65535.00 DFES_OneToOne 0.00 65535.00 FORMAT "%8.2" /end CHARACTERISTIC
/begin CHARACTERISTIC DFC_DisblMsk.DFC_ComIMGUnit_C "disable mask / Disable masks of check DFC_ComIMGUnit" VALUE 0x804F5B8C Val_Wu16 65535.00 DFES_OneToOne 0.00 65535.00 FORMAT "%8.2" /end CHARACTERISTIC
/begin CHARACTERISTIC DFC_DisblMsk.DFC_ComMETUnit_C "disable mask / Disable masks of check DFC_ComMETUnit" VALUE 0x804F5B8E Val_Wu16 65535.00 DFES_OneToOne 0.00 65535.00 FORMAT "%8.2" /end CHARACTERISTIC
/begin CHARACTERISTIC DFC_DisblMsk.DFC_ComSRSUnit_C "disable mask / Disable masks of check DFC_ComSRSUnit" VALUE 0x804F5B90 Val_Wu16 65535.00 DFES_OneToOne 0.00 65535.00 FORMAT "%8.2" /end CHARACTERISTIC
/begin CHARACTERISTIC DFC_DisblMsk.DFC_ComVSAUnit_C "disable mask / Disable masks of check DFC_ComVSAUnit" VALUE 0x804F5B92 Val_Wu16 65535.00 DFES_OneToOne 0.00 65535.00 FORMAT "%8.2" /end CHARACTERISTIC
/begin CHARACTERISTIC DFC_DisblMsk.DFC_EbsSocFlt_C "disable mask / Disable masks of check DFC_EbsSocFlt" VALUE 0x804F5B94 Val_Wu16 65535.00 DFES_OneToOne 0.00 65535.00 FORMAT "%8.2" /end CHARACTERISTIC
/begin CHARACTERISTIC DFC_DisblMsk.DFC_I14229VINErr_C "disable mask / Disable masks of check DFC_I14229VINErr" VALUE 0x804F5B96 Val_Wu16 65535.00 DFES_OneToOne 0.00 65535.00 FORMAT "%8.2" /end CHARACTERISTIC
/begin CHARACTERISTIC DFC_DisblMsk.DFC_InjCatHeatgErr_C "disable mask / Disable masks of check DFC_InjCatHeatgErr" VALUE 0x804F5B98 Val_Wu16 65535.00 DFES_OneToOne 0.00 65535.00 FORMAT "%8.2" /end CHARACTERISTIC
/begin CHARACTERISTIC DFC_DisblMsk.DFC_InjSysMulInjDiagErr_C "disable mask / Disable masks of check DFC_InjSysMulInjDiagErr" VALUE 0x804F5B9A Val_Wu16 65535.00 DFES_OneToOne 0.00 65535.00 FORMAT "%8.2" /end CHARACTERISTIC
/begin CHARACTERISTIC DFC_DisblMsk.DFC_LLRHmax_C "disable mask / Disable masks of check DFC_LLRHmax" VALUE 0x804F5B9C Val_Wu16 65535.00 DFES_OneToOne 0.00 65535.00 FORMAT "%8.2" /end CHARACTERISTIC
/begin CHARACTERISTIC DFC_DisblMsk.DFC_LLRHmin_C "disable mask / Disable masks of check DFC_LLRHmin" VALUE 0x804F5B9E Val_Wu16 65535.00 DFES_OneToOne 0.00 65535.00 FORMAT "%8.2" /end CHARACTERISTIC
/begin CHARACTERISTIC DFC_DisblMsk.DFC_LLRHnpl_C "disable mask / Disable masks of check DFC_LLRHnpl" VALUE 0x804F5BA0 Val_Wu16 65535.00 DFES_OneToOne 0.00 65535.00 FORMAT "%8.2" /end CHARACTERISTIC
/begin CHARACTERISTIC DFC_DisblMsk.DFC_LLRKHmax_C "disable mask / Disable masks of check DFC_LLRKHmax" VALUE 0x804F5BA2 Val_Wu16 65535.00 DFES_OneToOne 0.00 65535.00 FORMAT "%8.2" /end CHARACTERISTIC
/begin CHARACTERISTIC DFC_DisblMsk.DFC_LLRKHmin_C "disable mask / Disable masks of check DFC_LLRKHmin" VALUE 0x804F5BA4 Val_Wu16 65535.00 DFES_OneToOne 0.00 65535.00 FORMAT "%8.2" /end CHARACTERISTIC
/begin CHARACTERISTIC DFC_DisblMsk.DFC_LLRKHnpl_C "disable mask / Disable masks of check DFC_LLRKHnpl" VALUE 0x804F5BA6 Val_Wu16 65535.00 DFES_OneToOne 0.00 65535.00 FORMAT "%8.2" /end CHARACTERISTIC
/begin CHARACTERISTIC DFC_DisblMsk.DFC_LinACGUnit_C "disable mask / Disable masks of check DFC_LinACGUnit" VALUE 0x804F5BA8 Val_Wu16 65535.00 DFES_OneToOne 0.00 65535.00 FORMAT "%8.2" /end CHARACTERISTIC
/begin CHARACTERISTIC DFC_DisblMsk.DFC_LinAEVUnit_C "disable mask / Disable masks of check DFC_LinAEVUnit" VALUE 0x804F5BAA Val_Wu16 65535.00 DFES_OneToOne 0.00 65535.00 FORMAT "%8.2" /end CHARACTERISTIC
/begin CHARACTERISTIC DFC_DisblMsk.DFC_LinEBSUnit_C "disable mask / Disable masks of check DFC_LinEBSUnit" VALUE 0x804F5BAC Val_Wu16 65535.00 DFES_OneToOne 0.00 65535.00 FORMAT "%8.2" /end CHARACTERISTIC
/begin CHARACTERISTIC DFC_DisblMsk.DFC_RoughRoad_C "disable mask / Disable masks of check DFC_RoughRoad" VALUE 0x804F5BAE Val_Wu16 65535.00 DFES_OneToOne 0.00 65535.00 FORMAT "%8.2" /end CHARACTERISTIC
/begin CHARACTERISTIC DFC_DisblMsk.DFC_SiaEEPRdErr_C "disable mask / Disable masks of check DFC_SiaEEPRdErr" VALUE 0x804F5BB0 Val_Wu16 65535.00 DFES_OneToOne 0.00 65535.00 FORMAT "%8.2" /end CHARACTERISTIC
/begin CHARACTERISTIC DFC_DisblMsk.DFC_SiaEEPWrngCod_C "disable mask / Disable masks of check DFC_SiaEEPWrngCod" VALUE 0x804F5BB2 Val_Wu16 65535.00 DFES_OneToOne 0.00 65535.00 FORMAT "%8.2" /end CHARACTERISTIC
/begin CHARACTERISTIC DFC_DisblMsk.DFC_UegoHeatrStrtS1B1_C "disable mask / Disable masks of check DFC_UegoHeatrStrtS1B1" VALUE 0x804F5BB4 Val_Wu16 65535.00 DFES_OneToOne 0.00 65535.00 FORMAT "%8.2" /end CHARACTERISTIC
/begin CHARACTERISTIC DFC_DisblMsk.DFC_BusDiagCANAPPLBusOff_C "disable mask / Disable masks of check DFC_BusDiagCANAPPLBusOff" VALUE 0x804F5BB6 Val_Wu16 65535.00 DFES_OneToOne 0.00 65535.00 FORMAT "%8.2" /end CHARACTERISTIC
/begin CHARACTERISTIC DFC_DisblMsk.DFC_BusDiagCANCANCBusOff_C "disable mask / Disable masks of check DFC_BusDiagCANCANCBusOff" VALUE 0x804F5BB8 Val_Wu16 65535.00 DFES_OneToOne 0.00 65535.00 FORMAT "%8.2" /end CHARACTERISTIC
/begin CHARACTERISTIC DFC_DisblMsk.DFC_BusDiagCANVEHICLEBusOff_C "disable mask / Disable masks of check DFC_BusDiagCANVEHICLEBusOff" VALUE 0x804F5BBA Val_Wu16 65535.00 DFES_OneToOne 0.00 65535.00 FORMAT "%8.2" /end CHARACTERISTIC
/begin CHARACTERISTIC DFC_DisblMsk.DFC_RBA_IODIAGPWR_rba_IoExtCy329_SignalVltSply_0_C "disable mask / Disable masks of check DFC_RBA_IODIAGPWR_rba_IoExtCy329_SignalVltSply_0" VALUE 0x804F5BBC Val_Wu16 65535.00 DFES_OneToOne 0.00 65535.00 FORMAT "%8.2" /end CHARACTERISTIC
/begin CHARACTERISTIC DFC_DisblMsk.DFC_RBA_IODIAGPWR_rba_IoExtCy329_SignalVltSply_0OT_C "disable mask / Disable masks of check DFC_RBA_IODIAGPWR_rba_IoExtCy329_SignalVltSply_0OT" VALUE 0x804F5BBE Val_Wu16 65535.00 DFES_OneToOne 0.00 65535.00 FORMAT "%8.2" /end CHARACTERISTIC
/begin CHARACTERISTIC DFC_DisblMsk.DFC_RBA_IODIAGPWR_rba_IoExtCy329_SignalVltSply_0OV_C "disable mask / Disable masks of check DFC_RBA_IODIAGPWR_rba_IoExtCy329_SignalVltSply_0OV" VALUE 0x804F5BC0 Val_Wu16 65535.00 DFES_OneToOne 0.00 65535.00 FORMAT "%8.2" /end CHARACTERISTIC
/begin CHARACTERISTIC DFC_DisblMsk.DFC_RBA_IODIAGPWR_rba_IoExtCy329_SignalVltSply_0SCG_C "disable mask / Disable masks of check DFC_RBA_IODIAGPWR_rba_IoExtCy329_SignalVltSply_0SCG" VALUE 0x804F5BC2 Val_Wu16 65535.00 DFES_OneToOne 0.00 65535.00 FORMAT "%8.2" /end CHARACTERISTIC
/begin CHARACTERISTIC DFC_DisblMsk.DFC_RBA_IODIAGPWR_rba_IoExtCy329_SignalVltSply_0UV_C "disable mask / Disable masks of check DFC_RBA_IODIAGPWR_rba_IoExtCy329_SignalVltSply_0UV" VALUE 0x804F5BC4 Val_Wu16 65535.00 DFES_OneToOne 0.00 65535.00 FORMAT "%8.2" /end CHARACTERISTIC
/begin CHARACTERISTIC DFC_DisblMsk.DFC_RBA_IODIAGPWR_rba_IoExtCy329_SignalVltSply_1_C "disable mask / Disable masks of check DFC_RBA_IODIAGPWR_rba_IoExtCy329_SignalVltSply_1" VALUE 0x804F5BC6 Val_Wu16 65535.00 DFES_OneToOne 0.00 65535.00 FORMAT "%8.2" /end CHARACTERISTIC
/begin CHARACTERISTIC DFC_DisblMsk.DFC_RBA_IODIAGPWR_rba_IoExtCy329_SignalVltSply_1OT_C "disable mask / Disable masks of check DFC_RBA_IODIAGPWR_rba_IoExtCy329_SignalVltSply_1OT" VALUE 0x804F5BC8 Val_Wu16 65535.00 DFES_OneToOne 0.00 65535.00 FORMAT "%8.2" /end CHARACTERISTIC
/begin CHARACTERISTIC DFC_DisblMsk.DFC_RBA_IODIAGPWR_rba_IoExtCy329_SignalVltSply_1OV_C "disable mask / Disable masks of check DFC_RBA_IODIAGPWR_rba_IoExtCy329_SignalVltSply_1OV" VALUE 0x804F5BCA Val_Wu16 65535.00 DFES_OneToOne 0.00 65535.00 FORMAT "%8.2" /end CHARACTERISTIC
/begin CHARACTERISTIC DFC_DisblMsk.DFC_RBA_IODIAGPWR_rba_IoExtCy329_SignalVltSply_1SCG_C "disable mask / Disable masks of check DFC_RBA_IODIAGPWR_rba_IoExtCy329_SignalVltSply_1SCG" VALUE 0x804F5BCC Val_Wu16 65535.00 DFES_OneToOne 0.00 65535.00 FORMAT "%8.2" /end CHARACTERISTIC
/begin CHARACTERISTIC DFC_DisblMsk.DFC_RBA_IODIAGPWR_rba_IoExtCy329_SignalVltSply_1UV_C "disable mask / Disable masks of check DFC_RBA_IODIAGPWR_rba_IoExtCy329_SignalVltSply_1UV" VALUE 0x804F5BCE Val_Wu16 65535.00 DFES_OneToOne 0.00 65535.00 FORMAT "%8.2" /end CHARACTERISTIC
/begin CHARACTERISTIC DFC_DisblMsk.DFC_RBA_IODIAGPWR_rba_IoExtCy329_SignalVltSply_2_C "disable mask / Disable masks of check DFC_RBA_IODIAGPWR_rba_IoExtCy329_SignalVltSply_2" VALUE 0x804F5BD0 Val_Wu16 65535.00 DFES_OneToOne 0.00 65535.00 FORMAT "%8.2" /end CHARACTERISTIC
/begin CHARACTERISTIC DFC_DisblMsk.DFC_RBA_IODIAGPWR_rba_IoExtCy329_SignalVltSply_2OT_C "disable mask / Disable masks of check DFC_RBA_IODIAGPWR_rba_IoExtCy329_SignalVltSply_2OT" VALUE 0x804F5BD2 Val_Wu16 65535.00 DFES_OneToOne 0.00 65535.00 FORMAT "%8.2" /end CHARACTERISTIC
/begin CHARACTERISTIC DFC_DisblMsk.DFC_RBA_IODIAGPWR_rba_IoExtCy329_SignalVltSply_2OV_C "disable mask / Disable masks of check DFC_RBA_IODIAGPWR_rba_IoExtCy329_SignalVltSply_2OV" VALUE 0x804F5BD4 Val_Wu16 65535.00 DFES_OneToOne 0.00 65535.00 FORMAT "%8.2" /end CHARACTERISTIC
/begin CHARACTERISTIC DFC_DisblMsk.DFC_RBA_IODIAGPWR_rba_IoExtCy329_SignalVltSply_2SCG_C "disable mask / Disable masks of check DFC_RBA_IODIAGPWR_rba_IoExtCy329_SignalVltSply_2SCG" VALUE 0x804F5BD6 Val_Wu16 65535.00 DFES_OneToOne 0.00 65535.00 FORMAT "%8.2" /end CHARACTERISTIC
/begin CHARACTERISTIC DFC_DisblMsk.DFC_RBA_IODIAGPWR_rba_IoExtCy329_SignalVltSply_2UV_C "disable mask / Disable masks of check DFC_RBA_IODIAGPWR_rba_IoExtCy329_SignalVltSply_2UV" VALUE 0x804F5BD8 Val_Wu16 65535.00 DFES_OneToOne 0.00 65535.00 FORMAT "%8.2" /end CHARACTERISTIC
/begin CHARACTERISTIC DFC_DisblMsk.DFC_CAN_E_TIMEOUT_C "disable mask / Disable masks of check DFC_CAN_E_TIMEOUT" VALUE 0x804F5BDA Val_Wu16 65535.00 DFES_OneToOne 0.00 65535.00 FORMAT "%8.2" /end CHARACTERISTIC
/begin CHARACTERISTIC DFC_DisblMsk.DFC_LIN_E_TIMEOUT_C "disable mask / Disable masks of check DFC_LIN_E_TIMEOUT" VALUE 0x804F5BDC Val_Wu16 65535.00 DFES_OneToOne 0.00 65535.00 FORMAT "%8.2" /end CHARACTERISTIC
/begin CHARACTERISTIC DFC_DisblMsk.DFC_MRlyOL_C "disable mask / Disable masks of check DFC_MRlyOL" VALUE 0x804F5BDE Val_Wu16 65535.00 DFES_OneToOne 0.00 65535.00 FORMAT "%8.2" /end CHARACTERISTIC
/begin CHARACTERISTIC DFC_DisblMsk.DFC_MRlySCB_C "disable mask / Disable masks of check DFC_MRlySCB" VALUE 0x804F5BE0 Val_Wu16 65535.00 DFES_OneToOne 0.00 65535.00 FORMAT "%8.2" /end CHARACTERISTIC
/begin CHARACTERISTIC DFC_DisblMsk.DFC_MRlySCG_C "disable mask / Disable masks of check DFC_MRlySCG" VALUE 0x804F5BE2 Val_Wu16 65535.00 DFES_OneToOne 0.00 65535.00 FORMAT "%8.2" /end CHARACTERISTIC
/begin CHARACTERISTIC DFC_DisblMsk.DFC_rba_MultiStackTrace_Threshold_C "disable mask / Disable masks of check DFC_rba_MultiStackTrace_Threshold" VALUE 0x804F5BE4 Val_Wu16 65535.00 DFES_OneToOne 0.00 65535.00 FORMAT "%8.2" /end CHARACTERISTIC
/begin CHARACTERISTIC DFC_DisblMsk.DFC_BSWM_E_ACTION_FAILED_C "disable mask / Disable masks of check DFC_BSWM_E_ACTION_FAILED" VALUE 0x804F5BE6 Val_Wu16 65535.00 DFES_OneToOne 0.00 65535.00 FORMAT "%8.2" /end CHARACTERISTIC
/begin CHARACTERISTIC DFC_DisblMsk.DFC_BSWM_E_INTRPTQUEUE_FULL_C "disable mask / Disable masks of check DFC_BSWM_E_INTRPTQUEUE_FULL" VALUE 0x804F5BE8 Val_Wu16 65535.00 DFES_OneToOne 0.00 65535.00 FORMAT "%8.2" /end CHARACTERISTIC
/begin CHARACTERISTIC DFC_DisblMsk.DFC_RBA_IOEXTLIB_KEEPALIVE_DRV_C "disable mask / Disable masks of check DFC_RBA_IOEXTLIB_KEEPALIVE_DRV" VALUE 0x804F5BEA Val_Wu16 65535.00 DFES_OneToOne 0.00 65535.00 FORMAT "%8.2" /end CHARACTERISTIC
/begin CHARACTERISTIC DFC_DisblMsk.DFC_RBA_IOEXTLIB_KEEPALIVE_INI_C "disable mask / Disable masks of check DFC_RBA_IOEXTLIB_KEEPALIVE_INI" VALUE 0x804F5BEC Val_Wu16 65535.00 DFES_OneToOne 0.00 65535.00 FORMAT "%8.2" /end CHARACTERISTIC
/begin CHARACTERISTIC DFC_DisblMsk.DFC_rba_IoSigRtc_StopCounter_C "disable mask / Disable masks of check DFC_rba_IoSigRtc_StopCounter" VALUE 0x804F5BEE Val_Wu16 65535.00 DFES_OneToOne 0.00 65535.00 FORMAT "%8.2" /end CHARACTERISTIC
/begin CHARACTERISTIC DFC_DisblMsk.DFC_rba_MRly_Diag_Stk_Event_C "disable mask / Disable masks of check DFC_rba_MRly_Diag_Stk_Event" VALUE 0x804F5BF0 Val_Wu16 65535.00 DFES_OneToOne 0.00 65535.00 FORMAT "%8.2" /end CHARACTERISTIC
/begin CHARACTERISTIC DFC_DisblMsk.DFC_rba_MemDiag_MemReadErr_C "disable mask / Disable masks of check DFC_rba_MemDiag_MemReadErr" VALUE 0x804F5BF2 Val_Wu16 65535.00 DFES_OneToOne 0.00 65535.00 FORMAT "%8.2" /end CHARACTERISTIC
/begin CHARACTERISTIC DFC_DisblMsk.DFC_rba_MemDiag_MemWrErr_C "disable mask / Disable masks of check DFC_rba_MemDiag_MemWrErr" VALUE 0x804F5BF4 Val_Wu16 65535.00 DFES_OneToOne 0.00 65535.00 FORMAT "%8.2" /end CHARACTERISTIC
/begin CHARACTERISTIC DFC_DisblMsk.DFC_rba_SyC_IrrSwOffTrigEngRun_Event_C "disable mask / Disable masks of check DFC_rba_SyC_IrrSwOffTrigEngRun_Event" VALUE 0x804F5BF6 Val_Wu16 65535.00 DFES_OneToOne 0.00 65535.00 FORMAT "%8.2" /end CHARACTERISTIC
/begin CHARACTERISTIC DFC_DisblMsk.DFC_rba_T15_Diag_ComInVld_Event_C "disable mask / Disable masks of check DFC_rba_T15_Diag_ComInVld_Event" VALUE 0x804F5BF8 Val_Wu16 65535.00 DFES_OneToOne 0.00 65535.00 FORMAT "%8.2" /end CHARACTERISTIC
/begin CHARACTERISTIC DFC_DisblMsk.DFC_rba_T15_Diag_ComOff_HwOn_Event_C "disable mask / Disable masks of check DFC_rba_T15_Diag_ComOff_HwOn_Event" VALUE 0x804F5BFA Val_Wu16 65535.00 DFES_OneToOne 0.00 65535.00 FORMAT "%8.2" /end CHARACTERISTIC
/begin CHARACTERISTIC DFC_DisblMsk.DFC_rba_T15_Diag_ComOn_HwOff_Event_C "disable mask / Disable masks of check DFC_rba_T15_Diag_ComOn_HwOff_Event" VALUE 0x804F5BFC Val_Wu16 65535.00 DFES_OneToOne 0.00 65535.00 FORMAT "%8.2" /end CHARACTERISTIC
/begin CHARACTERISTIC DFC_DisblMsk.DFC_AAVmin_C "disable mask / Disable masks of check DFC_AAVmin" VALUE 0x804F5BFE Val_Wu16 65535.00 DFES_OneToOne 0.00 65535.00 FORMAT "%8.2" /end CHARACTERISTIC
/begin CHARACTERISTIC DFC_DisblMsk.DFC_AGRSUS_C "disable mask / Disable masks of check DFC_AGRSUS" VALUE 0x804F5C00 Val_Wu16 65535.00 DFES_OneToOne 0.00 65535.00 FORMAT "%8.2" /end CHARACTERISTIC
/begin CHARACTERISTIC DFC_DisblMsk.DFC_AfsPlausDiagHi_C "disable mask / Disable masks of check DFC_AfsPlausDiagHi" VALUE 0x804F5C02 Val_Wu16 65535.00 DFES_OneToOne 0.00 65535.00 FORMAT "%8.2" /end CHARACTERISTIC
/begin CHARACTERISTIC DFC_DisblMsk.DFC_AfsPlausDiagLo_C "disable mask / Disable masks of check DFC_AfsPlausDiagLo" VALUE 0x804F5C04 Val_Wu16 65535.00 DFES_OneToOne 0.00 65535.00 FORMAT "%8.2" /end CHARACTERISTIC
/begin CHARACTERISTIC DFC_DisblMsk.DFC_AfsVrntDiagErrB1_C "disable mask / Disable masks of check DFC_AfsVrntDiagErrB1" VALUE 0x804F5C06 Val_Wu16 65535.00 DFES_OneToOne 0.00 65535.00 FORMAT "%8.2" /end CHARACTERISTIC
/begin CHARACTERISTIC DFC_DisblMsk.DFC_AppAllSnsrDfct_C "disable mask / Disable masks of check DFC_AppAllSnsrDfct" VALUE 0x804F5C08 Val_Wu16 65535.00 DFES_OneToOne 0.00 65535.00 FORMAT "%8.2" /end CHARACTERISTIC
/begin CHARACTERISTIC DFC_DisblMsk.DFC_BBKRnldg_C "disable mask / Disable masks of check DFC_BBKRnldg" VALUE 0x804F5C0A Val_Wu16 65535.00 DFES_OneToOne 0.00 65535.00 FORMAT "%8.2" /end CHARACTERISTIC
/begin CHARACTERISTIC DFC_DisblMsk.DFC_BBKRsyne_C "disable mask / Disable masks of check DFC_BBKRsyne" VALUE 0x804F5C0C Val_Wu16 65535.00 DFES_OneToOne 0.00 65535.00 FORMAT "%8.2" /end CHARACTERISTIC
/begin CHARACTERISTIC DFC_DisblMsk.DFC_BattUStdbyDiaOL_C "disable mask / Disable masks of check DFC_BattUStdbyDiaOL" VALUE 0x804F5C0E Val_Wu16 65535.00 DFES_OneToOne 0.00 65535.00 FORMAT "%8.2" /end CHARACTERISTIC
/begin CHARACTERISTIC DFC_DisblMsk.DFC_BigLeakIntkMnfldEmiInfl_C "disable mask / Disable masks of check DFC_BigLeakIntkMnfldEmiInfl" VALUE 0x804F5C10 Val_Wu16 65535.00 DFES_OneToOne 0.00 65535.00 FORMAT "%8.2" /end CHARACTERISTIC
/begin CHARACTERISTIC DFC_DisblMsk.DFC_BlkdLineTank_C "disable mask / Disable masks of check DFC_BlkdLineTank" VALUE 0x804F5C12 Val_Wu16 65535.00 DFES_OneToOne 0.00 65535.00 FORMAT "%8.2" /end CHARACTERISTIC
/begin CHARACTERISTIC DFC_DisblMsk.DFC_BrkMnSwtContOnWarnLmp_C "disable mask / Disable masks of check DFC_BrkMnSwtContOnWarnLmp" VALUE 0x804F5C14 Val_Wu16 65535.00 DFES_OneToOne 0.00 65535.00 FORMAT "%8.2" /end CHARACTERISTIC
/begin CHARACTERISTIC DFC_DisblMsk.DFC_BrkMnSwtNotStpWarnLmp_C "disable mask / Disable masks of check DFC_BrkMnSwtNotStpWarnLmp" VALUE 0x804F5C16 Val_Wu16 65535.00 DFES_OneToOne 0.00 65535.00 FORMAT "%8.2" /end CHARACTERISTIC
/begin CHARACTERISTIC DFC_DisblMsk.DFC_BrkRdntSwtContOnWarnLmp_C "disable mask / Disable masks of check DFC_BrkRdntSwtContOnWarnLmp" VALUE 0x804F5C18 Val_Wu16 65535.00 DFES_OneToOne 0.00 65535.00 FORMAT "%8.2" /end CHARACTERISTIC
/begin CHARACTERISTIC DFC_DisblMsk.DFC_BrkRdntSwtNotStpWarnLmp_C "disable mask / Disable masks of check DFC_BrkRdntSwtNotStpWarnLmp" VALUE 0x804F5C1A Val_Wu16 65535.00 DFES_OneToOne 0.00 65535.00 FORMAT "%8.2" /end CHARACTERISTIC
/begin CHARACTERISTIC DFC_DisblMsk.DFC_CEngDsTColdStrtMax_C "disable mask / Disable masks of check DFC_CEngDsTColdStrtMax" VALUE 0x804F5C1C Val_Wu16 65535.00 DFES_OneToOne 0.00 65535.00 FORMAT "%8.2" /end CHARACTERISTIC
/begin CHARACTERISTIC DFC_DisblMsk.DFC_CEngDsTColdStrtMin_C "disable mask / Disable masks of check DFC_CEngDsTColdStrtMin" VALUE 0x804F5C1E Val_Wu16 65535.00 DFES_OneToOne 0.00 65535.00 FORMAT "%8.2" /end CHARACTERISTIC
/begin CHARACTERISTIC DFC_DisblMsk.DFC_CEngDsTImps_C "disable mask / Disable masks of check DFC_CEngDsTImps" VALUE 0x804F5C20 Val_Wu16 65535.00 DFES_OneToOne 0.00 65535.00 FORMAT "%8.2" /end CHARACTERISTIC
/begin CHARACTERISTIC DFC_DisblMsk.DFC_CEngDsTPlausHSC_C "disable mask / Disable masks of check DFC_CEngDsTPlausHSC" VALUE 0x804F5C22 Val_Wu16 65535.00 DFES_OneToOne 0.00 65535.00 FORMAT "%8.2" /end CHARACTERISTIC
/begin CHARACTERISTIC DFC_DisblMsk.DFC_CEngDsTPlausLSC_C "disable mask / Disable masks of check DFC_CEngDsTPlausLSC" VALUE 0x804F5C24 Val_Wu16 65535.00 DFES_OneToOne 0.00 65535.00 FORMAT "%8.2" /end CHARACTERISTIC
/begin CHARACTERISTIC DFC_DisblMsk.DFC_CEngDsTPlausSTC_C "disable mask / Disable masks of check DFC_CEngDsTPlausSTC" VALUE 0x804F5C26 Val_Wu16 65535.00 DFES_OneToOne 0.00 65535.00 FORMAT "%8.2" /end CHARACTERISTIC
/begin CHARACTERISTIC DFC_DisblMsk.DFC_CEngDsTSRCMax_C "disable mask / Disable masks of check DFC_CEngDsTSRCMax" VALUE 0x804F5C28 Val_Wu16 65535.00 DFES_OneToOne 0.00 65535.00 FORMAT "%8.2" /end CHARACTERISTIC
/begin CHARACTERISTIC DFC_DisblMsk.DFC_CEngDsTSRCMin_C "disable mask / Disable masks of check DFC_CEngDsTSRCMin" VALUE 0x804F5C2A Val_Wu16 65535.00 DFES_OneToOne 0.00 65535.00 FORMAT "%8.2" /end CHARACTERISTIC
/begin CHARACTERISTIC DFC_DisblMsk.DFC_CEngDsTSig_C "disable mask / Disable masks of check DFC_CEngDsTSig" VALUE 0x804F5C2C Val_Wu16 65535.00 DFES_OneToOne 0.00 65535.00 FORMAT "%8.2" /end CHARACTERISTIC
/begin CHARACTERISTIC DFC_DisblMsk.DFC_CEngUsTColdStrtMax_C "disable mask / Disable masks of check DFC_CEngUsTColdStrtMax" VALUE 0x804F5C2E Val_Wu16 65535.00 DFES_OneToOne 0.00 65535.00 FORMAT "%8.2" /end CHARACTERISTIC
/begin CHARACTERISTIC DFC_DisblMsk.DFC_CEngUsTColdStrtMin_C "disable mask / Disable masks of check DFC_CEngUsTColdStrtMin" VALUE 0x804F5C30 Val_Wu16 65535.00 DFES_OneToOne 0.00 65535.00 FORMAT "%8.2" /end CHARACTERISTIC
/begin CHARACTERISTIC DFC_DisblMsk.DFC_CEngUsTLooseCnctn_C "disable mask / Disable masks of check DFC_CEngUsTLooseCnctn" VALUE 0x804F5C32 Val_Wu16 65535.00 DFES_OneToOne 0.00 65535.00 FORMAT "%8.2" /end CHARACTERISTIC
/begin CHARACTERISTIC DFC_DisblMsk.DFC_CEngUsTSRCMax_C "disable mask / Disable masks of check DFC_CEngUsTSRCMax" VALUE 0x804F5C34 Val_Wu16 65535.00 DFES_OneToOne 0.00 65535.00 FORMAT "%8.2" /end CHARACTERISTIC
/begin CHARACTERISTIC DFC_DisblMsk.DFC_CEngUsTSRCMin_C "disable mask / Disable masks of check DFC_CEngUsTSRCMin" VALUE 0x804F5C36 Val_Wu16 65535.00 DFES_OneToOne 0.00 65535.00 FORMAT "%8.2" /end CHARACTERISTIC
/begin CHARACTERISTIC DFC_DisblMsk.DFC_ComDCDCACCFailr_C "disable mask / Disable masks of check DFC_ComDCDCACCFailr" VALUE 0x804F5C38 Val_Wu16 65535.00 DFES_OneToOne 0.00 65535.00 FORMAT "%8.2" /end CHARACTERISTIC
/begin CHARACTERISTIC DFC_DisblMsk.DFC_DCDCFltDet_C "disable mask / Disable masks of check DFC_DCDCFltDet" VALUE 0x804F5C3A Val_Wu16 65535.00 DFES_OneToOne 0.00 65535.00 FORMAT "%8.2" /end CHARACTERISTIC
/begin CHARACTERISTIC DFC_DisblMsk.DFC_DKRSA_C "disable mask / Disable masks of check DFC_DKRSA" VALUE 0x804F5C3C Val_Wu16 65535.00 DFES_OneToOne 0.00 65535.00 FORMAT "%8.2" /end CHARACTERISTIC
/begin CHARACTERISTIC DFC_DisblMsk.DFC_DKVSmax_C "disable mask / Disable masks of check DFC_DKVSmax" VALUE 0x804F5C3E Val_Wu16 65535.00 DFES_OneToOne 0.00 65535.00 FORMAT "%8.2" /end CHARACTERISTIC
/begin CHARACTERISTIC DFC_DisblMsk.DFC_DKnpl_C "disable mask / Disable masks of check DFC_DKnpl" VALUE 0x804F5C40 Val_Wu16 65535.00 DFES_OneToOne 0.00 65535.00 FORMAT "%8.2" /end CHARACTERISTIC
/begin CHARACTERISTIC DFC_DisblMsk.DFC_DSKVRmax_C "disable mask / Disable masks of check DFC_DSKVRmax" VALUE 0x804F5C42 Val_Wu16 65535.00 DFES_OneToOne 0.00 65535.00 FORMAT "%8.2" /end CHARACTERISTIC
/begin CHARACTERISTIC DFC_DisblMsk.DFC_DSKVRmin_C "disable mask / Disable masks of check DFC_DSKVRmin" VALUE 0x804F5C44 Val_Wu16 65535.00 DFES_OneToOne 0.00 65535.00 FORMAT "%8.2" /end CHARACTERISTIC
/begin CHARACTERISTIC DFC_DisblMsk.DFC_DSKVRnpl_C "disable mask / Disable masks of check DFC_DSKVRnpl" VALUE 0x804F5C46 Val_Wu16 65535.00 DFES_OneToOne 0.00 65535.00 FORMAT "%8.2" /end CHARACTERISTIC
/begin CHARACTERISTIC DFC_DisblMsk.DFC_DSKVRsig_C "disable mask / Disable masks of check DFC_DSKVRsig" VALUE 0x804F5C48 Val_Wu16 65535.00 DFES_OneToOne 0.00 65535.00 FORMAT "%8.2" /end CHARACTERISTIC
/begin CHARACTERISTIC DFC_DisblMsk.DFC_DSKVSsig_C "disable mask / Disable masks of check DFC_DSKVSsig" VALUE 0x804F5C4A Val_Wu16 65535.00 DFES_OneToOne 0.00 65535.00 FORMAT "%8.2" /end CHARACTERISTIC
/begin CHARACTERISTIC DFC_DisblMsk.DFC_DSSmax_C "disable mask / Disable masks of check DFC_DSSmax" VALUE 0x804F5C4C Val_Wu16 65535.00 DFES_OneToOne 0.00 65535.00 FORMAT "%8.2" /end CHARACTERISTIC
/begin CHARACTERISTIC DFC_DisblMsk.DFC_DSTDmax_C "disable mask / Disable masks of check DFC_DSTDmax" VALUE 0x804F5C4E Val_Wu16 65535.00 DFES_OneToOne 0.00 65535.00 FORMAT "%8.2" /end CHARACTERISTIC
/begin CHARACTERISTIC DFC_DisblMsk.DFC_DSTEmax_C "disable mask / Disable masks of check DFC_DSTEmax" VALUE 0x804F5C50 Val_Wu16 65535.00 DFES_OneToOne 0.00 65535.00 FORMAT "%8.2" /end CHARACTERISTIC
/begin CHARACTERISTIC DFC_DisblMsk.DFC_DSTEmin_C "disable mask / Disable masks of check DFC_DSTEmin" VALUE 0x804F5C52 Val_Wu16 65535.00 DFES_OneToOne 0.00 65535.00 FORMAT "%8.2" /end CHARACTERISTIC
/begin CHARACTERISTIC DFC_DisblMsk.DFC_DSTOFmax_C "disable mask / Disable masks of check DFC_DSTOFmax" VALUE 0x804F5C54 Val_Wu16 65535.00 DFES_OneToOne 0.00 65535.00 FORMAT "%8.2" /end CHARACTERISTIC
/begin CHARACTERISTIC DFC_DisblMsk.DFC_DSTRmax_C "disable mask / Disable masks of check DFC_DSTRmax" VALUE 0x804F5C56 Val_Wu16 65535.00 DFES_OneToOne 0.00 65535.00 FORMAT "%8.2" /end CHARACTERISTIC
/begin CHARACTERISTIC DFC_DisblMsk.DFC_DSTRmin_C "disable mask / Disable masks of check DFC_DSTRmin" VALUE 0x804F5C58 Val_Wu16 65535.00 DFES_OneToOne 0.00 65535.00 FORMAT "%8.2" /end CHARACTERISTIC
/begin CHARACTERISTIC DFC_DisblMsk.DFC_DSTRnpl_C "disable mask / Disable masks of check DFC_DSTRnpl" VALUE 0x804F5C5A Val_Wu16 65535.00 DFES_OneToOne 0.00 65535.00 FORMAT "%8.2" /end CHARACTERISTIC
/begin CHARACTERISTIC DFC_DisblMsk.DFC_DSTRsig_C "disable mask / Disable masks of check DFC_DSTRsig" VALUE 0x804F5C5C Val_Wu16 65535.00 DFES_OneToOne 0.00 65535.00 FORMAT "%8.2" /end CHARACTERISTIC
/begin CHARACTERISTIC DFC_DisblMsk.DFC_DSTTI_C "disable mask / Disable masks of check DFC_DSTTI" VALUE 0x804F5C5E Val_Wu16 65535.00 DFES_OneToOne 0.00 65535.00 FORMAT "%8.2" /end CHARACTERISTIC
/begin CHARACTERISTIC DFC_DisblMsk.DFC_DSUmax_C "disable mask / Disable masks of check DFC_DSUmax" VALUE 0x804F5C60 Val_Wu16 65535.00 DFES_OneToOne 0.00 65535.00 FORMAT "%8.2" /end CHARACTERISTIC
/begin CHARACTERISTIC DFC_DisblMsk.DFC_DiagCpv1DteskLoLoadStuckClsd_C "disable mask / Disable masks of check DFC_DiagCpv1DteskLoLoadStuckClsd" VALUE 0x804F5C62 Val_Wu16 65535.00 DFES_OneToOne 0.00 65535.00 FORMAT "%8.2" /end CHARACTERISTIC
/begin CHARACTERISTIC DFC_DisblMsk.DFC_DiagCpv1DteskLoLoadStuckOpen_C "disable mask / Disable masks of check DFC_DiagCpv1DteskLoLoadStuckOpen" VALUE 0x804F5C64 Val_Wu16 65535.00 DFES_OneToOne 0.00 65535.00 FORMAT "%8.2" /end CHARACTERISTIC
/begin CHARACTERISTIC DFC_DisblMsk.DFC_EGRVlvDrftClsd_C "disable mask / Disable masks of check DFC_EGRVlvDrftClsd" VALUE 0x804F5C66 Val_Wu16 65535.00 DFES_OneToOne 0.00 65535.00 FORMAT "%8.2" /end CHARACTERISTIC
/begin CHARACTERISTIC DFC_DisblMsk.DFC_EGRVlvDrftOpn_C "disable mask / Disable masks of check DFC_EGRVlvDrftOpn" VALUE 0x804F5C68 Val_Wu16 65535.00 DFES_OneToOne 0.00 65535.00 FORMAT "%8.2" /end CHARACTERISTIC
/begin CHARACTERISTIC DFC_DisblMsk.DFC_EGRVlvJamVlvClsd_C "disable mask / Disable masks of check DFC_EGRVlvJamVlvClsd" VALUE 0x804F5C6A Val_Wu16 65535.00 DFES_OneToOne 0.00 65535.00 FORMAT "%8.2" /end CHARACTERISTIC
/begin CHARACTERISTIC DFC_DisblMsk.DFC_EGRVlvJamVlvOpn_C "disable mask / Disable masks of check DFC_EGRVlvJamVlvOpn" VALUE 0x804F5C6C Val_Wu16 65535.00 DFES_OneToOne 0.00 65535.00 FORMAT "%8.2" /end CHARACTERISTIC
/begin CHARACTERISTIC DFC_DisblMsk.DFC_EGRVlvSprgBrk_C "disable mask / Disable masks of check DFC_EGRVlvSprgBrk" VALUE 0x804F5C6E Val_Wu16 65535.00 DFES_OneToOne 0.00 65535.00 FORMAT "%8.2" /end CHARACTERISTIC
/begin CHARACTERISTIC DFC_DisblMsk.DFC_EGRVlvTempMdlEEPErr_C "disable mask / Disable masks of check DFC_EGRVlvTempMdlEEPErr" VALUE 0x804F5C70 Val_Wu16 65535.00 DFES_OneToOne 0.00 65535.00 FORMAT "%8.2" /end CHARACTERISTIC
/begin CHARACTERISTIC DFC_DisblMsk.DFC_EGRVlvTmpErr_C "disable mask / Disable masks of check DFC_EGRVlvTmpErr" VALUE 0x804F5C72 Val_Wu16 65535.00 DFES_OneToOne 0.00 65535.00 FORMAT "%8.2" /end CHARACTERISTIC
/begin CHARACTERISTIC DFC_DisblMsk.DFC_EGSDUS2B1LtrDly_C "disable mask / Disable masks of check DFC_EGSDUS2B1LtrDly" VALUE 0x804F5C74 Val_Wu16 65535.00 DFES_OneToOne 0.00 65535.00 FORMAT "%8.2" /end CHARACTERISTIC
/begin CHARACTERISTIC DFC_DisblMsk.DFC_EGSDUS2B1LtrPT1_C "disable mask / Disable masks of check DFC_EGSDUS2B1LtrPT1" VALUE 0x804F5C76 Val_Wu16 65535.00 DFES_OneToOne 0.00 65535.00 FORMAT "%8.2" /end CHARACTERISTIC
/begin CHARACTERISTIC DFC_DisblMsk.DFC_EGSDUS2B1RtlDly_C "disable mask / Disable masks of check DFC_EGSDUS2B1RtlDly" VALUE 0x804F5C78 Val_Wu16 65535.00 DFES_OneToOne 0.00 65535.00 FORMAT "%8.2" /end CHARACTERISTIC
/begin CHARACTERISTIC DFC_DisblMsk.DFC_EGSDUS2B1RtlPT1_C "disable mask / Disable masks of check DFC_EGSDUS2B1RtlPT1" VALUE 0x804F5C7A Val_Wu16 65535.00 DFES_OneToOne 0.00 65535.00 FORMAT "%8.2" /end CHARACTERISTIC
/begin CHARACTERISTIC DFC_DisblMsk.DFC_EGSDUS2B1TarLean_C "disable mask / Disable masks of check DFC_EGSDUS2B1TarLean" VALUE 0x804F5C7C Val_Wu16 65535.00 DFES_OneToOne 0.00 65535.00 FORMAT "%8.2" /end CHARACTERISTIC
/begin CHARACTERISTIC DFC_DisblMsk.DFC_EGSDUS2B1TarRich_C "disable mask / Disable masks of check DFC_EGSDUS2B1TarRich" VALUE 0x804F5C7E Val_Wu16 65535.00 DFES_OneToOne 0.00 65535.00 FORMAT "%8.2" /end CHARACTERISTIC
/begin CHARACTERISTIC DFC_DisblMsk.DFC_EONVmax_C "disable mask / Disable masks of check DFC_EONVmax" VALUE 0x804F5C80 Val_Wu16 65535.00 DFES_OneToOne 0.00 65535.00 FORMAT "%8.2" /end CHARACTERISTIC
/begin CHARACTERISTIC DFC_DisblMsk.DFC_ETAKHLmax_C "disable mask / Disable masks of check DFC_ETAKHLmax" VALUE 0x804F5C82 Val_Wu16 65535.00 DFES_OneToOne 0.00 65535.00 FORMAT "%8.2" /end CHARACTERISTIC
/begin CHARACTERISTIC DFC_DisblMsk.DFC_ETAKHTmax_C "disable mask / Disable masks of check DFC_ETAKHTmax" VALUE 0x804F5C84 Val_Wu16 65535.00 DFES_OneToOne 0.00 65535.00 FORMAT "%8.2" /end CHARACTERISTIC
/begin CHARACTERISTIC DFC_DisblMsk.DFC_ETHSEmax_C "disable mask / Disable masks of check DFC_ETHSEmax" VALUE 0x804F5C86 Val_Wu16 65535.00 DFES_OneToOne 0.00 65535.00 FORMAT "%8.2" /end CHARACTERISTIC
/begin CHARACTERISTIC DFC_DisblMsk.DFC_ETHSEmin_C "disable mask / Disable masks of check DFC_ETHSEmin" VALUE 0x804F5C88 Val_Wu16 65535.00 DFES_OneToOne 0.00 65535.00 FORMAT "%8.2" /end CHARACTERISTIC
/begin CHARACTERISTIC DFC_DisblMsk.DFC_ETHSFmax_C "disable mask / Disable masks of check DFC_ETHSFmax" VALUE 0x804F5C8A Val_Wu16 65535.00 DFES_OneToOne 0.00 65535.00 FORMAT "%8.2" /end CHARACTERISTIC
/begin CHARACTERISTIC DFC_DisblMsk.DFC_ETHSFmin_C "disable mask / Disable masks of check DFC_ETHSFmin" VALUE 0x804F5C8C Val_Wu16 65535.00 DFES_OneToOne 0.00 65535.00 FORMAT "%8.2" /end CHARACTERISTIC
/begin CHARACTERISTIC DFC_DisblMsk.DFC_ETHSFsig_C "disable mask / Disable masks of check DFC_ETHSFsig" VALUE 0x804F5C8E Val_Wu16 65535.00 DFES_OneToOne 0.00 65535.00 FORMAT "%8.2" /end CHARACTERISTIC
/begin CHARACTERISTIC DFC_DisblMsk.DFC_ETHSNPWmax_C "disable mask / Disable masks of check DFC_ETHSNPWmax" VALUE 0x804F5C90 Val_Wu16 65535.00 DFES_OneToOne 0.00 65535.00 FORMAT "%8.2" /end CHARACTERISTIC
/begin CHARACTERISTIC DFC_DisblMsk.DFC_ETHSNPWmin_C "disable mask / Disable masks of check DFC_ETHSNPWmin" VALUE 0x804F5C92 Val_Wu16 65535.00 DFES_OneToOne 0.00 65535.00 FORMAT "%8.2" /end CHARACTERISTIC
/begin CHARACTERISTIC DFC_DisblMsk.DFC_ETHSNPWsig_C "disable mask / Disable masks of check DFC_ETHSNPWsig" VALUE 0x804F5C94 Val_Wu16 65535.00 DFES_OneToOne 0.00 65535.00 FORMAT "%8.2" /end CHARACTERISTIC
/begin CHARACTERISTIC DFC_DisblMsk.DFC_ETHSPLnpl_C "disable mask / Disable masks of check DFC_ETHSPLnpl" VALUE 0x804F5C96 Val_Wu16 65535.00 DFES_OneToOne 0.00 65535.00 FORMAT "%8.2" /end CHARACTERISTIC
/begin CHARACTERISTIC DFC_DisblMsk.DFC_ETHSTPLnpl_C "disable mask / Disable masks of check DFC_ETHSTPLnpl" VALUE 0x804F5C98 Val_Wu16 65535.00 DFES_OneToOne 0.00 65535.00 FORMAT "%8.2" /end CHARACTERISTIC
/begin CHARACTERISTIC DFC_DisblMsk.DFC_EngICO_C "disable mask / Disable masks of check DFC_EngICO" VALUE 0x804F5C9A Val_Wu16 65535.00 DFES_OneToOne 0.00 65535.00 FORMAT "%8.2" /end CHARACTERISTIC
/begin CHARACTERISTIC DFC_DisblMsk.DFC_EngPrtOvrSpdMon_C "disable mask / Disable masks of check DFC_EngPrtOvrSpdMon" VALUE 0x804F5C9C Val_Wu16 65535.00 DFES_OneToOne 0.00 65535.00 FORMAT "%8.2" /end CHARACTERISTIC
/begin CHARACTERISTIC DFC_DisblMsk.DFC_EpmCaSI1ErrSig_C "disable mask / Disable masks of check DFC_EpmCaSI1ErrSig" VALUE 0x804F5C9E Val_Wu16 65535.00 DFES_OneToOne 0.00 65535.00 FORMAT "%8.2" /end CHARACTERISTIC
/begin CHARACTERISTIC DFC_DisblMsk.DFC_EpmCaSI1MntErr_C "disable mask / Disable masks of check DFC_EpmCaSI1MntErr" VALUE 0x804F5CA0 Val_Wu16 65535.00 DFES_OneToOne 0.00 65535.00 FORMAT "%8.2" /end CHARACTERISTIC
/begin CHARACTERISTIC DFC_DisblMsk.DFC_EpmCaSI1NoSigMax_C "disable mask / Disable masks of check DFC_EpmCaSI1NoSigMax" VALUE 0x804F5CA2 Val_Wu16 65535.00 DFES_OneToOne 0.00 65535.00 FORMAT "%8.2" /end CHARACTERISTIC
/begin CHARACTERISTIC DFC_DisblMsk.DFC_EpmCaSI1NoSigMin_C "disable mask / Disable masks of check DFC_EpmCaSI1NoSigMin" VALUE 0x804F5CA4 Val_Wu16 65535.00 DFES_OneToOne 0.00 65535.00 FORMAT "%8.2" /end CHARACTERISTIC
/begin CHARACTERISTIC DFC_DisblMsk.DFC_EpmCaSI1OfsErr_C "disable mask / Disable masks of check DFC_EpmCaSI1OfsErr" VALUE 0x804F5CA6 Val_Wu16 65535.00 DFES_OneToOne 0.00 65535.00 FORMAT "%8.2" /end CHARACTERISTIC
/begin CHARACTERISTIC DFC_DisblMsk.DFC_EpmCrSDGI_C "disable mask / Disable masks of check DFC_EpmCrSDGI" VALUE 0x804F5CA8 Val_Wu16 65535.00 DFES_OneToOne 0.00 65535.00 FORMAT "%8.2" /end CHARACTERISTIC
/begin CHARACTERISTIC DFC_DisblMsk.DFC_EpmCrSErrSig_C "disable mask / Disable masks of check DFC_EpmCrSErrSig" VALUE 0x804F5CAA Val_Wu16 65535.00 DFES_OneToOne 0.00 65535.00 FORMAT "%8.2" /end CHARACTERISTIC
/begin CHARACTERISTIC DFC_DisblMsk.DFC_EpmCrSNoSig_C "disable mask / Disable masks of check DFC_EpmCrSNoSig" VALUE 0x804F5CAC Val_Wu16 65535.00 DFES_OneToOne 0.00 65535.00 FORMAT "%8.2" /end CHARACTERISTIC
/begin CHARACTERISTIC DFC_DisblMsk.DFC_EtaEngIdleNonCsers_C "disable mask / Disable masks of check DFC_EtaEngIdleNonCsers" VALUE 0x804F5CAE Val_Wu16 65535.00 DFES_OneToOne 0.00 65535.00 FORMAT "%8.2" /end CHARACTERISTIC
/begin CHARACTERISTIC DFC_DisblMsk.DFC_EtaEngPtlNonCsers_C "disable mask / Disable masks of check DFC_EtaEngPtlNonCsers" VALUE 0x804F5CB0 Val_Wu16 65535.00 DFES_OneToOne 0.00 65535.00 FORMAT "%8.2" /end CHARACTERISTIC
/begin CHARACTERISTIC DFC_DisblMsk.DFC_FRAmax_C "disable mask / Disable masks of check DFC_FRAmax" VALUE 0x804F5CB2 Val_Wu16 65535.00 DFES_OneToOne 0.00 65535.00 FORMAT "%8.2" /end CHARACTERISTIC
/begin CHARACTERISTIC DFC_DisblMsk.DFC_FRAmin_C "disable mask / Disable masks of check DFC_FRAmin" VALUE 0x804F5CB4 Val_Wu16 65535.00 DFES_OneToOne 0.00 65535.00 FORMAT "%8.2" /end CHARACTERISTIC
/begin CHARACTERISTIC DFC_DisblMsk.DFC_FSTEmax_C "disable mask / Disable masks of check DFC_FSTEmax" VALUE 0x804F5CB6 Val_Wu16 65535.00 DFES_OneToOne 0.00 65535.00 FORMAT "%8.2" /end CHARACTERISTIC
/begin CHARACTERISTIC DFC_DisblMsk.DFC_FSTEmin_C "disable mask / Disable masks of check DFC_FSTEmin" VALUE 0x804F5CB8 Val_Wu16 65535.00 DFES_OneToOne 0.00 65535.00 FORMAT "%8.2" /end CHARACTERISTIC
/begin CHARACTERISTIC DFC_DisblMsk.DFC_FSTRmax_C "disable mask / Disable masks of check DFC_FSTRmax" VALUE 0x804F5CBA Val_Wu16 65535.00 DFES_OneToOne 0.00 65535.00 FORMAT "%8.2" /end CHARACTERISTIC
/begin CHARACTERISTIC DFC_DisblMsk.DFC_FSTRmin_C "disable mask / Disable masks of check DFC_FSTRmin" VALUE 0x804F5CBC Val_Wu16 65535.00 DFES_OneToOne 0.00 65535.00 FORMAT "%8.2" /end CHARACTERISTIC
/begin CHARACTERISTIC DFC_DisblMsk.DFC_FSTRnpl_C "disable mask / Disable masks of check DFC_FSTRnpl" VALUE 0x804F5CBE Val_Wu16 65535.00 DFES_OneToOne 0.00 65535.00 FORMAT "%8.2" /end CHARACTERISTIC
/begin CHARACTERISTIC DFC_DisblMsk.DFC_FSTmax_C "disable mask / Disable masks of check DFC_FSTmax" VALUE 0x804F5CC0 Val_Wu16 65535.00 DFES_OneToOne 0.00 65535.00 FORMAT "%8.2" /end CHARACTERISTIC
/begin CHARACTERISTIC DFC_DisblMsk.DFC_FTDLAmax_C "disable mask / Disable masks of check DFC_FTDLAmax" VALUE 0x804F5CC2 Val_Wu16 65535.00 DFES_OneToOne 0.00 65535.00 FORMAT "%8.2" /end CHARACTERISTIC
/begin CHARACTERISTIC DFC_DisblMsk.DFC_FTDLAmin_C "disable mask / Disable masks of check DFC_FTDLAmin" VALUE 0x804F5CC4 Val_Wu16 65535.00 DFES_OneToOne 0.00 65535.00 FORMAT "%8.2" /end CHARACTERISTIC
/begin CHARACTERISTIC DFC_DisblMsk.DFC_FuPHiSnsrEleclmax_C "disable mask / Disable masks of check DFC_FuPHiSnsrEleclmax" VALUE 0x804F5CC6 Val_Wu16 65535.00 DFES_OneToOne 0.00 65535.00 FORMAT "%8.2" /end CHARACTERISTIC
/begin CHARACTERISTIC DFC_DisblMsk.DFC_FuPHiSnsrEleclmin_C "disable mask / Disable masks of check DFC_FuPHiSnsrEleclmin" VALUE 0x804F5CC8 Val_Wu16 65535.00 DFES_OneToOne 0.00 65535.00 FORMAT "%8.2" /end CHARACTERISTIC
/begin CHARACTERISTIC DFC_DisblMsk.DFC_FuPHiSnsrEleclnpl_C "disable mask / Disable masks of check DFC_FuPHiSnsrEleclnpl" VALUE 0x804F5CCA Val_Wu16 65535.00 DFES_OneToOne 0.00 65535.00 FORMAT "%8.2" /end CHARACTERISTIC
/begin CHARACTERISTIC DFC_DisblMsk.DFC_FuPHiSnsrURngMax_C "disable mask / Disable masks of check DFC_FuPHiSnsrURngMax" VALUE 0x804F5CCC Val_Wu16 65535.00 DFES_OneToOne 0.00 65535.00 FORMAT "%8.2" /end CHARACTERISTIC
/begin CHARACTERISTIC DFC_DisblMsk.DFC_FuPHiSnsrURngMin_C "disable mask / Disable masks of check DFC_FuPHiSnsrURngMin" VALUE 0x804F5CCE Val_Wu16 65535.00 DFES_OneToOne 0.00 65535.00 FORMAT "%8.2" /end CHARACTERISTIC
/begin CHARACTERISTIC DFC_DisblMsk.DFC_FuSnsrPhyRngMaxErr_C "disable mask / Disable masks of check DFC_FuSnsrPhyRngMaxErr" VALUE 0x804F5CD0 Val_Wu16 65535.00 DFES_OneToOne 0.00 65535.00 FORMAT "%8.2" /end CHARACTERISTIC
/begin CHARACTERISTIC DFC_DisblMsk.DFC_FuSnsrPhyRngMinErr_C "disable mask / Disable masks of check DFC_FuSnsrPhyRngMinErr" VALUE 0x804F5CD2 Val_Wu16 65535.00 DFES_OneToOne 0.00 65535.00 FORMAT "%8.2" /end CHARACTERISTIC
/begin CHARACTERISTIC DFC_DisblMsk.DFC_GEVlvLockPinDiagIntkB1_C "disable mask / Disable masks of check DFC_GEVlvLockPinDiagIntkB1" VALUE 0x804F5CD4 Val_Wu16 65535.00 DFES_OneToOne 0.00 65535.00 FORMAT "%8.2" /end CHARACTERISTIC
/begin CHARACTERISTIC DFC_DisblMsk.DFC_GEVlvPhaSlowIntkB1_C "disable mask / Disable masks of check DFC_GEVlvPhaSlowIntkB1" VALUE 0x804F5CD6 Val_Wu16 65535.00 DFES_OneToOne 0.00 65535.00 FORMAT "%8.2" /end CHARACTERISTIC
/begin CHARACTERISTIC DFC_DisblMsk.DFC_GEVlvPhaTargIntkB1_C "disable mask / Disable masks of check DFC_GEVlvPhaTargIntkB1" VALUE 0x804F5CD8 Val_Wu16 65535.00 DFES_OneToOne 0.00 65535.00 FORMAT "%8.2" /end CHARACTERISTIC
/begin CHARACTERISTIC DFC_DisblMsk.DFC_GbxRvsSwtStk_C "disable mask / Disable masks of check DFC_GbxRvsSwtStk" VALUE 0x804F5CDA Val_Wu16 65535.00 DFES_OneToOne 0.00 65535.00 FORMAT "%8.2" /end CHARACTERISTIC
/begin CHARACTERISTIC DFC_DisblMsk.DFC_HDRKHmax_C "disable mask / Disable masks of check DFC_HDRKHmax" VALUE 0x804F5CDC Val_Wu16 65535.00 DFES_OneToOne 0.00 65535.00 FORMAT "%8.2" /end CHARACTERISTIC
/begin CHARACTERISTIC DFC_DisblMsk.DFC_HDRKHmin_C "disable mask / Disable masks of check DFC_HDRKHmin" VALUE 0x804F5CDE Val_Wu16 65535.00 DFES_OneToOne 0.00 65535.00 FORMAT "%8.2" /end CHARACTERISTIC
/begin CHARACTERISTIC DFC_DisblMsk.DFC_HDRPLmax_C "disable mask / Disable masks of check DFC_HDRPLmax" VALUE 0x804F5CE0 Val_Wu16 65535.00 DFES_OneToOne 0.00 65535.00 FORMAT "%8.2" /end CHARACTERISTIC
/begin CHARACTERISTIC DFC_DisblMsk.DFC_HDRPLmin_C "disable mask / Disable masks of check DFC_HDRPLmin" VALUE 0x804F5CE2 Val_Wu16 65535.00 DFES_OneToOne 0.00 65535.00 FORMAT "%8.2" /end CHARACTERISTIC
/begin CHARACTERISTIC DFC_DisblMsk.DFC_HDRmax_C "disable mask / Disable masks of check DFC_HDRmax" VALUE 0x804F5CE4 Val_Wu16 65535.00 DFES_OneToOne 0.00 65535.00 FORMAT "%8.2" /end CHARACTERISTIC
/begin CHARACTERISTIC DFC_DisblMsk.DFC_HDRmin_C "disable mask / Disable masks of check DFC_HDRmin" VALUE 0x804F5CE6 Val_Wu16 65535.00 DFES_OneToOne 0.00 65535.00 FORMAT "%8.2" /end CHARACTERISTIC
/begin CHARACTERISTIC DFC_DisblMsk.DFC_HEGOS2B1ElecMax_C "disable mask / Disable masks of check DFC_HEGOS2B1ElecMax" VALUE 0x804F5CE8 Val_Wu16 65535.00 DFES_OneToOne 0.00 65535.00 FORMAT "%8.2" /end CHARACTERISTIC
/begin CHARACTERISTIC DFC_DisblMsk.DFC_HEGOS2B1ElecMin_C "disable mask / Disable masks of check DFC_HEGOS2B1ElecMin" VALUE 0x804F5CEA Val_Wu16 65535.00 DFES_OneToOne 0.00 65535.00 FORMAT "%8.2" /end CHARACTERISTIC
/begin CHARACTERISTIC DFC_DisblMsk.DFC_HEGOS2B1ElecSig_C "disable mask / Disable masks of check DFC_HEGOS2B1ElecSig" VALUE 0x804F5CEC Val_Wu16 65535.00 DFES_OneToOne 0.00 65535.00 FORMAT "%8.2" /end CHARACTERISTIC
/begin CHARACTERISTIC DFC_DisblMsk.DFC_HEGOS2B1HtgNpl_C "disable mask / Disable masks of check DFC_HEGOS2B1HtgNpl" VALUE 0x804F5CEE Val_Wu16 65535.00 DFES_OneToOne 0.00 65535.00 FORMAT "%8.2" /end CHARACTERISTIC
/begin CHARACTERISTIC DFC_DisblMsk.DFC_HEV00max_C "disable mask / Disable masks of check DFC_HEV00max" VALUE 0x804F5CF0 Val_Wu16 65535.00 DFES_OneToOne 0.00 65535.00 FORMAT "%8.2" /end CHARACTERISTIC
/begin CHARACTERISTIC DFC_DisblMsk.DFC_HEV01max_C "disable mask / Disable masks of check DFC_HEV01max" VALUE 0x804F5CF2 Val_Wu16 65535.00 DFES_OneToOne 0.00 65535.00 FORMAT "%8.2" /end CHARACTERISTIC
/begin CHARACTERISTIC DFC_DisblMsk.DFC_HEV02max_C "disable mask / Disable masks of check DFC_HEV02max" VALUE 0x804F5CF4 Val_Wu16 65535.00 DFES_OneToOne 0.00 65535.00 FORMAT "%8.2" /end CHARACTERISTIC
/begin CHARACTERISTIC DFC_DisblMsk.DFC_HEV03max_C "disable mask / Disable masks of check DFC_HEV03max" VALUE 0x804F5CF6 Val_Wu16 65535.00 DFES_OneToOne 0.00 65535.00 FORMAT "%8.2" /end CHARACTERISTIC
/begin CHARACTERISTIC DFC_DisblMsk.DFC_HEVE0max_C "disable mask / Disable masks of check DFC_HEVE0max" VALUE 0x804F5CF8 Val_Wu16 65535.00 DFES_OneToOne 0.00 65535.00 FORMAT "%8.2" /end CHARACTERISTIC
/begin CHARACTERISTIC DFC_DisblMsk.DFC_HEVE1max_C "disable mask / Disable masks of check DFC_HEVE1max" VALUE 0x804F5CFA Val_Wu16 65535.00 DFES_OneToOne 0.00 65535.00 FORMAT "%8.2" /end CHARACTERISTIC
/begin CHARACTERISTIC DFC_DisblMsk.DFC_HFMmax_C "disable mask / Disable masks of check DFC_HFMmax" VALUE 0x804F5CFC Val_Wu16 65535.00 DFES_OneToOne 0.00 65535.00 FORMAT "%8.2" /end CHARACTERISTIC
/begin CHARACTERISTIC DFC_DisblMsk.DFC_HiPSysHiPMaxLimExcdd_C "disable mask / Disable masks of check DFC_HiPSysHiPMaxLimExcdd" VALUE 0x804F5CFE Val_Wu16 65535.00 DFES_OneToOne 0.00 65535.00 FORMAT "%8.2" /end CHARACTERISTIC
/begin CHARACTERISTIC DFC_DisblMsk.DFC_IVGdiCtlCvoErrMax_0_C "disable mask / Disable masks of check DFC_IVGdiCtlCvoErrMax_0" VALUE 0x804F5D00 Val_Wu16 65535.00 DFES_OneToOne 0.00 65535.00 FORMAT "%8.2" /end CHARACTERISTIC
/begin CHARACTERISTIC DFC_DisblMsk.DFC_IVGdiCtlCvoErrMax_1_C "disable mask / Disable masks of check DFC_IVGdiCtlCvoErrMax_1" VALUE 0x804F5D02 Val_Wu16 65535.00 DFES_OneToOne 0.00 65535.00 FORMAT "%8.2" /end CHARACTERISTIC
/begin CHARACTERISTIC DFC_DisblMsk.DFC_IVGdiCtlCvoErrMax_2_C "disable mask / Disable masks of check DFC_IVGdiCtlCvoErrMax_2" VALUE 0x804F5D04 Val_Wu16 65535.00 DFES_OneToOne 0.00 65535.00 FORMAT "%8.2" /end CHARACTERISTIC
/begin CHARACTERISTIC DFC_DisblMsk.DFC_IVGdiCtlCvoErrMax_3_C "disable mask / Disable masks of check DFC_IVGdiCtlCvoErrMax_3" VALUE 0x804F5D06 Val_Wu16 65535.00 DFES_OneToOne 0.00 65535.00 FORMAT "%8.2" /end CHARACTERISTIC
/begin CHARACTERISTIC DFC_DisblMsk.DFC_IVGdiCtlCvoErrMin_0_C "disable mask / Disable masks of check DFC_IVGdiCtlCvoErrMin_0" VALUE 0x804F5D08 Val_Wu16 65535.00 DFES_OneToOne 0.00 65535.00 FORMAT "%8.2" /end CHARACTERISTIC
/begin CHARACTERISTIC DFC_DisblMsk.DFC_IVGdiCtlCvoErrMin_1_C "disable mask / Disable masks of check DFC_IVGdiCtlCvoErrMin_1" VALUE 0x804F5D0A Val_Wu16 65535.00 DFES_OneToOne 0.00 65535.00 FORMAT "%8.2" /end CHARACTERISTIC
/begin CHARACTERISTIC DFC_DisblMsk.DFC_IVGdiCtlCvoErrMin_2_C "disable mask / Disable masks of check DFC_IVGdiCtlCvoErrMin_2" VALUE 0x804F5D0C Val_Wu16 65535.00 DFES_OneToOne 0.00 65535.00 FORMAT "%8.2" /end CHARACTERISTIC
/begin CHARACTERISTIC DFC_DisblMsk.DFC_IVGdiCtlCvoErrMin_3_C "disable mask / Disable masks of check DFC_IVGdiCtlCvoErrMin_3" VALUE 0x804F5D0E Val_Wu16 65535.00 DFES_OneToOne 0.00 65535.00 FORMAT "%8.2" /end CHARACTERISTIC
/begin CHARACTERISTIC DFC_DisblMsk.DFC_IVGdiCtlCvoErrMinMax_C "disable mask / Disable masks of check DFC_IVGdiCtlCvoErrMinMax" VALUE 0x804F5D10 Val_Wu16 65535.00 DFES_OneToOne 0.00 65535.00 FORMAT "%8.2" /end CHARACTERISTIC
/begin CHARACTERISTIC DFC_DisblMsk.DFC_IVGdiCtlCvoSigPlausErrSmrCdn_C "disable mask / Disable masks of check DFC_IVGdiCtlCvoSigPlausErrSmrCdn" VALUE 0x804F5D12 Val_Wu16 65535.00 DFES_OneToOne 0.00 65535.00 FORMAT "%8.2" /end CHARACTERISTIC
/begin CHARACTERISTIC DFC_DisblMsk.DFC_IVGdiCtl_CvoErr_C "disable mask / Disable masks of check DFC_IVGdiCtl_CvoErr" VALUE 0x804F5D14 Val_Wu16 65535.00 DFES_OneToOne 0.00 65535.00 FORMAT "%8.2" /end CHARACTERISTIC
/begin CHARACTERISTIC DFC_DisblMsk.DFC_IVGdiCtl_CvoSigPlaus_0_C "disable mask / Disable masks of check DFC_IVGdiCtl_CvoSigPlaus_0" VALUE 0x804F5D16 Val_Wu16 65535.00 DFES_OneToOne 0.00 65535.00 FORMAT "%8.2" /end CHARACTERISTIC
/begin CHARACTERISTIC DFC_DisblMsk.DFC_IVGdiCtl_CvoSigPlaus_1_C "disable mask / Disable masks of check DFC_IVGdiCtl_CvoSigPlaus_1" VALUE 0x804F5D18 Val_Wu16 65535.00 DFES_OneToOne 0.00 65535.00 FORMAT "%8.2" /end CHARACTERISTIC
/begin CHARACTERISTIC DFC_DisblMsk.DFC_IVGdiCtl_CvoSigPlaus_2_C "disable mask / Disable masks of check DFC_IVGdiCtl_CvoSigPlaus_2" VALUE 0x804F5D1A Val_Wu16 65535.00 DFES_OneToOne 0.00 65535.00 FORMAT "%8.2" /end CHARACTERISTIC
/begin CHARACTERISTIC DFC_DisblMsk.DFC_IVGdiCtl_CvoSigPlaus_3_C "disable mask / Disable masks of check DFC_IVGdiCtl_CvoSigPlaus_3" VALUE 0x804F5D1C Val_Wu16 65535.00 DFES_OneToOne 0.00 65535.00 FORMAT "%8.2" /end CHARACTERISTIC
/begin CHARACTERISTIC DFC_DisblMsk.DFC_IntkAirTAirFltDsCrssMax_C "disable mask / Disable masks of check DFC_IntkAirTAirFltDsCrssMax" VALUE 0x804F5D1E Val_Wu16 65535.00 DFES_OneToOne 0.00 65535.00 FORMAT "%8.2" /end CHARACTERISTIC
/begin CHARACTERISTIC DFC_DisblMsk.DFC_IntkAirTAirFltDsCrssMin_C "disable mask / Disable masks of check DFC_IntkAirTAirFltDsCrssMin" VALUE 0x804F5D20 Val_Wu16 65535.00 DFES_OneToOne 0.00 65535.00 FORMAT "%8.2" /end CHARACTERISTIC
/begin CHARACTERISTIC DFC_DisblMsk.DFC_IntkAirTAirFltDsHSCMax_C "disable mask / Disable masks of check DFC_IntkAirTAirFltDsHSCMax" VALUE 0x804F5D22 Val_Wu16 65535.00 DFES_OneToOne 0.00 65535.00 FORMAT "%8.2" /end CHARACTERISTIC
/begin CHARACTERISTIC DFC_DisblMsk.DFC_IntkAirTAirFltDsImps_C "disable mask / Disable masks of check DFC_IntkAirTAirFltDsImps" VALUE 0x804F5D24 Val_Wu16 65535.00 DFES_OneToOne 0.00 65535.00 FORMAT "%8.2" /end CHARACTERISTIC
/begin CHARACTERISTIC DFC_DisblMsk.DFC_IntkAirTAirFltDsPRCMax_C "disable mask / Disable masks of check DFC_IntkAirTAirFltDsPRCMax" VALUE 0x804F5D26 Val_Wu16 65535.00 DFES_OneToOne 0.00 65535.00 FORMAT "%8.2" /end CHARACTERISTIC
/begin CHARACTERISTIC DFC_DisblMsk.DFC_IntkAirTAirFltDsPRCMin_C "disable mask / Disable masks of check DFC_IntkAirTAirFltDsPRCMin" VALUE 0x804F5D28 Val_Wu16 65535.00 DFES_OneToOne 0.00 65535.00 FORMAT "%8.2" /end CHARACTERISTIC
/begin CHARACTERISTIC DFC_DisblMsk.DFC_IntkAirTAirFltDsSRCMax_C "disable mask / Disable masks of check DFC_IntkAirTAirFltDsSRCMax" VALUE 0x804F5D2A Val_Wu16 65535.00 DFES_OneToOne 0.00 65535.00 FORMAT "%8.2" /end CHARACTERISTIC
/begin CHARACTERISTIC DFC_DisblMsk.DFC_IntkAirTAirFltDsSRCMin_C "disable mask / Disable masks of check DFC_IntkAirTAirFltDsSRCMin" VALUE 0x804F5D2C Val_Wu16 65535.00 DFES_OneToOne 0.00 65535.00 FORMAT "%8.2" /end CHARACTERISTIC
/begin CHARACTERISTIC DFC_DisblMsk.DFC_IntkAirTAirFltDsSTC_C "disable mask / Disable masks of check DFC_IntkAirTAirFltDsSTC" VALUE 0x804F5D2E Val_Wu16 65535.00 DFES_OneToOne 0.00 65535.00 FORMAT "%8.2" /end CHARACTERISTIC
/begin CHARACTERISTIC DFC_DisblMsk.DFC_IntkAirTIntkMnfldCrssMax_C "disable mask / Disable masks of check DFC_IntkAirTIntkMnfldCrssMax" VALUE 0x804F5D30 Val_Wu16 65535.00 DFES_OneToOne 0.00 65535.00 FORMAT "%8.2" /end CHARACTERISTIC
/begin CHARACTERISTIC DFC_DisblMsk.DFC_IntkAirTIntkMnfldCrssMin_C "disable mask / Disable masks of check DFC_IntkAirTIntkMnfldCrssMin" VALUE 0x804F5D32 Val_Wu16 65535.00 DFES_OneToOne 0.00 65535.00 FORMAT "%8.2" /end CHARACTERISTIC
/begin CHARACTERISTIC DFC_DisblMsk.DFC_IntkAirTIntkMnfldHSCMax_C "disable mask / Disable masks of check DFC_IntkAirTIntkMnfldHSCMax" VALUE 0x804F5D34 Val_Wu16 65535.00 DFES_OneToOne 0.00 65535.00 FORMAT "%8.2" /end CHARACTERISTIC
/begin CHARACTERISTIC DFC_DisblMsk.DFC_IntkAirTIntkMnfldImps_C "disable mask / Disable masks of check DFC_IntkAirTIntkMnfldImps" VALUE 0x804F5D36 Val_Wu16 65535.00 DFES_OneToOne 0.00 65535.00 FORMAT "%8.2" /end CHARACTERISTIC
/begin CHARACTERISTIC DFC_DisblMsk.DFC_IntkAirTIntkMnfldPRCMax_C "disable mask / Disable masks of check DFC_IntkAirTIntkMnfldPRCMax" VALUE 0x804F5D38 Val_Wu16 65535.00 DFES_OneToOne 0.00 65535.00 FORMAT "%8.2" /end CHARACTERISTIC
/begin CHARACTERISTIC DFC_DisblMsk.DFC_IntkAirTIntkMnfldPRCMin_C "disable mask / Disable masks of check DFC_IntkAirTIntkMnfldPRCMin" VALUE 0x804F5D3A Val_Wu16 65535.00 DFES_OneToOne 0.00 65535.00 FORMAT "%8.2" /end CHARACTERISTIC
/begin CHARACTERISTIC DFC_DisblMsk.DFC_IntkAirTIntkMnfldSRCMax_C "disable mask / Disable masks of check DFC_IntkAirTIntkMnfldSRCMax" VALUE 0x804F5D3C Val_Wu16 65535.00 DFES_OneToOne 0.00 65535.00 FORMAT "%8.2" /end CHARACTERISTIC
/begin CHARACTERISTIC DFC_DisblMsk.DFC_IntkAirTIntkMnfldSRCMin_C "disable mask / Disable masks of check DFC_IntkAirTIntkMnfldSRCMin" VALUE 0x804F5D3E Val_Wu16 65535.00 DFES_OneToOne 0.00 65535.00 FORMAT "%8.2" /end CHARACTERISTIC
/begin CHARACTERISTIC DFC_DisblMsk.DFC_IntkAirTIntkMnfldSTC_C "disable mask / Disable masks of check DFC_IntkAirTIntkMnfldSTC" VALUE 0x804F5D40 Val_Wu16 65535.00 DFES_OneToOne 0.00 65535.00 FORMAT "%8.2" /end CHARACTERISTIC
/begin CHARACTERISTIC DFC_DisblMsk.DFC_KRREGRLMX_C "disable mask / Disable masks of check DFC_KRREGRLMX" VALUE 0x804F5D42 Val_Wu16 65535.00 DFES_OneToOne 0.00 65535.00 FORMAT "%8.2" /end CHARACTERISTIC
/begin CHARACTERISTIC DFC_DisblMsk.DFC_KRVEKOCVLCI_C "disable mask / Disable masks of check DFC_KRVEKOCVLCI" VALUE 0x804F5D44 Val_Wu16 65535.00 DFES_OneToOne 0.00 65535.00 FORMAT "%8.2" /end CHARACTERISTIC
/begin CHARACTERISTIC DFC_DisblMsk.DFC_KRVEKOENCHMT_C "disable mask / Disable masks of check DFC_KRVEKOENCHMT" VALUE 0x804F5D46 Val_Wu16 65535.00 DFES_OneToOne 0.00 65535.00 FORMAT "%8.2" /end CHARACTERISTIC
/begin CHARACTERISTIC DFC_DisblMsk.DFC_KRVEKOENCHMT0_C "disable mask / Disable masks of check DFC_KRVEKOENCHMT0" VALUE 0x804F5D48 Val_Wu16 65535.00 DFES_OneToOne 0.00 65535.00 FORMAT "%8.2" /end CHARACTERISTIC
/begin CHARACTERISTIC DFC_DisblMsk.DFC_KRVEKOENCHMT1_C "disable mask / Disable masks of check DFC_KRVEKOENCHMT1" VALUE 0x804F5D4A Val_Wu16 65535.00 DFES_OneToOne 0.00 65535.00 FORMAT "%8.2" /end CHARACTERISTIC
/begin CHARACTERISTIC DFC_DisblMsk.DFC_KRVEKOENCHMT2_C "disable mask / Disable masks of check DFC_KRVEKOENCHMT2" VALUE 0x804F5D4C Val_Wu16 65535.00 DFES_OneToOne 0.00 65535.00 FORMAT "%8.2" /end CHARACTERISTIC
/begin CHARACTERISTIC DFC_DisblMsk.DFC_KRVEKOENCHMT3_C "disable mask / Disable masks of check DFC_KRVEKOENCHMT3" VALUE 0x804F5D4E Val_Wu16 65535.00 DFES_OneToOne 0.00 65535.00 FORMAT "%8.2" /end CHARACTERISTIC
/begin CHARACTERISTIC DFC_DisblMsk.DFC_KRVEKOENCHMT4_C "disable mask / Disable masks of check DFC_KRVEKOENCHMT4" VALUE 0x804F5D50 Val_Wu16 65535.00 DFES_OneToOne 0.00 65535.00 FORMAT "%8.2" /end CHARACTERISTIC
/begin CHARACTERISTIC DFC_DisblMsk.DFC_KRVEKOENCHMT5_C "disable mask / Disable masks of check DFC_KRVEKOENCHMT5" VALUE 0x804F5D52 Val_Wu16 65535.00 DFES_OneToOne 0.00 65535.00 FORMAT "%8.2" /end CHARACTERISTIC
/begin CHARACTERISTIC DFC_DisblMsk.DFC_KRVEKOENCHMT6_C "disable mask / Disable masks of check DFC_KRVEKOENCHMT6" VALUE 0x804F5D54 Val_Wu16 65535.00 DFES_OneToOne 0.00 65535.00 FORMAT "%8.2" /end CHARACTERISTIC
/begin CHARACTERISTIC DFC_DisblMsk.DFC_KRVEKOENCHMT7_C "disable mask / Disable masks of check DFC_KRVEKOENCHMT7" VALUE 0x804F5D56 Val_Wu16 65535.00 DFES_OneToOne 0.00 65535.00 FORMAT "%8.2" /end CHARACTERISTIC
/begin CHARACTERISTIC DFC_DisblMsk.DFC_KRVEKORLMX_C "disable mask / Disable masks of check DFC_KRVEKORLMX" VALUE 0x804F5D58 Val_Wu16 65535.00 DFES_OneToOne 0.00 65535.00 FORMAT "%8.2" /end CHARACTERISTIC
/begin CHARACTERISTIC DFC_DisblMsk.DFC_KRVEKORLMXL_C "disable mask / Disable masks of check DFC_KRVEKORLMXL" VALUE 0x804F5D5A Val_Wu16 65535.00 DFES_OneToOne 0.00 65535.00 FORMAT "%8.2" /end CHARACTERISTIC
/begin CHARACTERISTIC DFC_DisblMsk.DFC_KS1max_C "disable mask / Disable masks of check DFC_KS1max" VALUE 0x804F5D5C Val_Wu16 65535.00 DFES_OneToOne 0.00 65535.00 FORMAT "%8.2" /end CHARACTERISTIC
/begin CHARACTERISTIC DFC_DisblMsk.DFC_KS1min_C "disable mask / Disable masks of check DFC_KS1min" VALUE 0x804F5D5E Val_Wu16 65535.00 DFES_OneToOne 0.00 65535.00 FORMAT "%8.2" /end CHARACTERISTIC
/begin CHARACTERISTIC DFC_DisblMsk.DFC_LMmax_C "disable mask / Disable masks of check DFC_LMmax" VALUE 0x804F5D60 Val_Wu16 65535.00 DFES_OneToOne 0.00 65535.00 FORMAT "%8.2" /end CHARACTERISTIC
/begin CHARACTERISTIC DFC_DisblMsk.DFC_LZSRnpl_C "disable mask / Disable masks of check DFC_LZSRnpl" VALUE 0x804F5D62 Val_Wu16 65535.00 DFES_OneToOne 0.00 65535.00 FORMAT "%8.2" /end CHARACTERISTIC
/begin CHARACTERISTIC DFC_DisblMsk.DFC_LamDynDiagS1B1_C "disable mask / Disable masks of check DFC_LamDynDiagS1B1" VALUE 0x804F5D64 Val_Wu16 65535.00 DFES_OneToOne 0.00 65535.00 FORMAT "%8.2" /end CHARACTERISTIC
/begin CHARACTERISTIC DFC_DisblMsk.DFC_LeakIntkMnfldEmiInfl_C "disable mask / Disable masks of check DFC_LeakIntkMnfldEmiInfl" VALUE 0x804F5D66 Val_Wu16 65535.00 DFES_OneToOne 0.00 65535.00 FORMAT "%8.2" /end CHARACTERISTIC
/begin CHARACTERISTIC DFC_DisblMsk.DFC_LinFrameErrDCDC_C "disable mask / Disable masks of check DFC_LinFrameErrDCDC" VALUE 0x804F5D68 Val_Wu16 65535.00 DFES_OneToOne 0.00 65535.00 FORMAT "%8.2" /end CHARACTERISTIC
/begin CHARACTERISTIC DFC_DisblMsk.DFC_LinOverrunErrDCDC_C "disable mask / Disable masks of check DFC_LinOverrunErrDCDC" VALUE 0x804F5D6A Val_Wu16 65535.00 DFES_OneToOne 0.00 65535.00 FORMAT "%8.2" /end CHARACTERISTIC
/begin CHARACTERISTIC DFC_DisblMsk.DFC_MD00max_C "disable mask / Disable masks of check DFC_MD00max" VALUE 0x804F5D6C Val_Wu16 65535.00 DFES_OneToOne 0.00 65535.00 FORMAT "%8.2" /end CHARACTERISTIC
/begin CHARACTERISTIC DFC_DisblMsk.DFC_MDBmax_C "disable mask / Disable masks of check DFC_MDBmax" VALUE 0x804F5D6E Val_Wu16 65535.00 DFES_OneToOne 0.00 65535.00 FORMAT "%8.2" /end CHARACTERISTIC
/begin CHARACTERISTIC DFC_DisblMsk.DFC_MDCat_C "disable mask / Disable masks of check DFC_MDCat" VALUE 0x804F5D70 Val_Wu16 65535.00 DFES_OneToOne 0.00 65535.00 FORMAT "%8.2" /end CHARACTERISTIC
/begin CHARACTERISTIC DFC_DisblMsk.DFC_MDCatCrit_C "disable mask / Disable masks of check DFC_MDCatCrit" VALUE 0x804F5D72 Val_Wu16 65535.00 DFES_OneToOne 0.00 65535.00 FORMAT "%8.2" /end CHARACTERISTIC
/begin CHARACTERISTIC DFC_DisblMsk.DFC_MDCatCurr_C "disable mask / Disable masks of check DFC_MDCatCurr" VALUE 0x804F5D74 Val_Wu16 65535.00 DFES_OneToOne 0.00 65535.00 FORMAT "%8.2" /end CHARACTERISTIC
/begin CHARACTERISTIC DFC_DisblMsk.DFC_MDCyl_0_C "disable mask / Disable masks of check DFC_MDCyl_0" VALUE 0x804F5D76 Val_Wu16 65535.00 DFES_OneToOne 0.00 65535.00 FORMAT "%8.2" /end CHARACTERISTIC
/begin CHARACTERISTIC DFC_DisblMsk.DFC_MDCyl_1_C "disable mask / Disable masks of check DFC_MDCyl_1" VALUE 0x804F5D78 Val_Wu16 65535.00 DFES_OneToOne 0.00 65535.00 FORMAT "%8.2" /end CHARACTERISTIC
/begin CHARACTERISTIC DFC_DisblMsk.DFC_MDCyl_2_C "disable mask / Disable masks of check DFC_MDCyl_2" VALUE 0x804F5D7A Val_Wu16 65535.00 DFES_OneToOne 0.00 65535.00 FORMAT "%8.2" /end CHARACTERISTIC
/begin CHARACTERISTIC DFC_DisblMsk.DFC_MDCyl_3_C "disable mask / Disable masks of check DFC_MDCyl_3" VALUE 0x804F5D7C Val_Wu16 65535.00 DFES_OneToOne 0.00 65535.00 FORMAT "%8.2" /end CHARACTERISTIC
/begin CHARACTERISTIC DFC_DisblMsk.DFC_MDEmi_C "disable mask / Disable masks of check DFC_MDEmi" VALUE 0x804F5D7E Val_Wu16 65535.00 DFES_OneToOne 0.00 65535.00 FORMAT "%8.2" /end CHARACTERISTIC
/begin CHARACTERISTIC DFC_DisblMsk.DFC_MDEmiStrt_C "disable mask / Disable masks of check DFC_MDEmiStrt" VALUE 0x804F5D80 Val_Wu16 65535.00 DFES_OneToOne 0.00 65535.00 FORMAT "%8.2" /end CHARACTERISTIC
/begin CHARACTERISTIC DFC_DisblMsk.DFC_MDFco_C "disable mask / Disable masks of check DFC_MDFco" VALUE 0x804F5D82 Val_Wu16 65535.00 DFES_OneToOne 0.00 65535.00 FORMAT "%8.2" /end CHARACTERISTIC
/begin CHARACTERISTIC DFC_DisblMsk.DFC_MDMpl_C "disable mask / Disable masks of check DFC_MDMpl" VALUE 0x804F5D84 Val_Wu16 65535.00 DFES_OneToOne 0.00 65535.00 FORMAT "%8.2" /end CHARACTERISTIC
/begin CHARACTERISTIC DFC_DisblMsk.DFC_MDSegTiAdpn_C "disable mask / Disable masks of check DFC_MDSegTiAdpn" VALUE 0x804F5D86 Val_Wu16 65535.00 DFES_OneToOne 0.00 65535.00 FORMAT "%8.2" /end CHARACTERISTIC
/begin CHARACTERISTIC DFC_DisblMsk.DFC_MDmax_C "disable mask / Disable masks of check DFC_MDmax" VALUE 0x804F5D88 Val_Wu16 65535.00 DFES_OneToOne 0.00 65535.00 FORMAT "%8.2" /end CHARACTERISTIC
/begin CHARACTERISTIC DFC_DisblMsk.DFC_MFuOilMax_C "disable mask / Disable masks of check DFC_MFuOilMax" VALUE 0x804F5D8A Val_Wu16 65535.00 DFES_OneToOne 0.00 65535.00 FORMAT "%8.2" /end CHARACTERISTIC
/begin CHARACTERISTIC DFC_DisblMsk.DFC_MOXEMM_SMU_ALM0_0_C "disable mask / Disable masks of check DFC_MOXEMM_SMU_ALM0_0" VALUE 0x804F5D8C Val_Wu16 65535.00 DFES_OneToOne 0.00 65535.00 FORMAT "%8.2" /end CHARACTERISTIC
/begin CHARACTERISTIC DFC_DisblMsk.DFC_MOXEMM_SMU_ALM0_1_C "disable mask / Disable masks of check DFC_MOXEMM_SMU_ALM0_1" VALUE 0x804F5D8E Val_Wu16 65535.00 DFES_OneToOne 0.00 65535.00 FORMAT "%8.2" /end CHARACTERISTIC
/begin CHARACTERISTIC DFC_DisblMsk.DFC_MOXEMM_SMU_ALM0_10_C "disable mask / Disable masks of check DFC_MOXEMM_SMU_ALM0_10" VALUE 0x804F5D90 Val_Wu16 65535.00 DFES_OneToOne 0.00 65535.00 FORMAT "%8.2" /end CHARACTERISTIC
/begin CHARACTERISTIC DFC_DisblMsk.DFC_MOXEMM_SMU_ALM0_11_C "disable mask / Disable masks of check DFC_MOXEMM_SMU_ALM0_11" VALUE 0x804F5D92 Val_Wu16 65535.00 DFES_OneToOne 0.00 65535.00 FORMAT "%8.2" /end CHARACTERISTIC
/begin CHARACTERISTIC DFC_DisblMsk.DFC_MOXEMM_SMU_ALM0_13_C "disable mask / Disable masks of check DFC_MOXEMM_SMU_ALM0_13" VALUE 0x804F5D94 Val_Wu16 65535.00 DFES_OneToOne 0.00 65535.00 FORMAT "%8.2" /end CHARACTERISTIC
/begin CHARACTERISTIC DFC_DisblMsk.DFC_MOXEMM_SMU_ALM0_14_C "disable mask / Disable masks of check DFC_MOXEMM_SMU_ALM0_14" VALUE 0x804F5D96 Val_Wu16 65535.00 DFES_OneToOne 0.00 65535.00 FORMAT "%8.2" /end CHARACTERISTIC
/begin CHARACTERISTIC DFC_DisblMsk.DFC_MOXEMM_SMU_ALM0_2_C "disable mask / Disable masks of check DFC_MOXEMM_SMU_ALM0_2" VALUE 0x804F5D98 Val_Wu16 65535.00 DFES_OneToOne 0.00 65535.00 FORMAT "%8.2" /end CHARACTERISTIC
/begin CHARACTERISTIC DFC_DisblMsk.DFC_MOXEMM_SMU_ALM0_22_C "disable mask / Disable masks of check DFC_MOXEMM_SMU_ALM0_22" VALUE 0x804F5D9A Val_Wu16 65535.00 DFES_OneToOne 0.00 65535.00 FORMAT "%8.2" /end CHARACTERISTIC
/begin CHARACTERISTIC DFC_DisblMsk.DFC_MOXEMM_SMU_ALM0_23_C "disable mask / Disable masks of check DFC_MOXEMM_SMU_ALM0_23" VALUE 0x804F5D9C Val_Wu16 65535.00 DFES_OneToOne 0.00 65535.00 FORMAT "%8.2" /end CHARACTERISTIC
/begin CHARACTERISTIC DFC_DisblMsk.DFC_MOXEMM_SMU_ALM0_4_C "disable mask / Disable masks of check DFC_MOXEMM_SMU_ALM0_4" VALUE 0x804F5D9E Val_Wu16 65535.00 DFES_OneToOne 0.00 65535.00 FORMAT "%8.2" /end CHARACTERISTIC
/begin CHARACTERISTIC DFC_DisblMsk.DFC_MOXEMM_SMU_ALM0_5_C "disable mask / Disable masks of check DFC_MOXEMM_SMU_ALM0_5" VALUE 0x804F5DA0 Val_Wu16 65535.00 DFES_OneToOne 0.00 65535.00 FORMAT "%8.2" /end CHARACTERISTIC
/begin CHARACTERISTIC DFC_DisblMsk.DFC_MOXEMM_SMU_ALM0_7_C "disable mask / Disable masks of check DFC_MOXEMM_SMU_ALM0_7" VALUE 0x804F5DA2 Val_Wu16 65535.00 DFES_OneToOne 0.00 65535.00 FORMAT "%8.2" /end CHARACTERISTIC
/begin CHARACTERISTIC DFC_DisblMsk.DFC_MOXEMM_SMU_ALM0_8_C "disable mask / Disable masks of check DFC_MOXEMM_SMU_ALM0_8" VALUE 0x804F5DA4 Val_Wu16 65535.00 DFES_OneToOne 0.00 65535.00 FORMAT "%8.2" /end CHARACTERISTIC
/begin CHARACTERISTIC DFC_DisblMsk.DFC_MOXEMM_SMU_ALM10_16_C "disable mask / Disable masks of check DFC_MOXEMM_SMU_ALM10_16" VALUE 0x804F5DA6 Val_Wu16 65535.00 DFES_OneToOne 0.00 65535.00 FORMAT "%8.2" /end CHARACTERISTIC
/begin CHARACTERISTIC DFC_DisblMsk.DFC_MOXEMM_SMU_ALM10_17_C "disable mask / Disable masks of check DFC_MOXEMM_SMU_ALM10_17" VALUE 0x804F5DA8 Val_Wu16 65535.00 DFES_OneToOne 0.00 65535.00 FORMAT "%8.2" /end CHARACTERISTIC
/begin CHARACTERISTIC DFC_DisblMsk.DFC_MOXEMM_SMU_ALM10_21_C "disable mask / Disable masks of check DFC_MOXEMM_SMU_ALM10_21" VALUE 0x804F5DAA Val_Wu16 65535.00 DFES_OneToOne 0.00 65535.00 FORMAT "%8.2" /end CHARACTERISTIC
/begin CHARACTERISTIC DFC_DisblMsk.DFC_MOXEMM_SMU_ALM11_0_C "disable mask / Disable masks of check DFC_MOXEMM_SMU_ALM11_0" VALUE 0x804F5DAC Val_Wu16 65535.00 DFES_OneToOne 0.00 65535.00 FORMAT "%8.2" /end CHARACTERISTIC
/begin CHARACTERISTIC DFC_DisblMsk.DFC_MOXEMM_SMU_ALM11_1_C "disable mask / Disable masks of check DFC_MOXEMM_SMU_ALM11_1" VALUE 0x804F5DAE Val_Wu16 65535.00 DFES_OneToOne 0.00 65535.00 FORMAT "%8.2" /end CHARACTERISTIC
/begin CHARACTERISTIC DFC_DisblMsk.DFC_MOXEMM_SMU_ALM11_2_C "disable mask / Disable masks of check DFC_MOXEMM_SMU_ALM11_2" VALUE 0x804F5DB0 Val_Wu16 65535.00 DFES_OneToOne 0.00 65535.00 FORMAT "%8.2" /end CHARACTERISTIC
/begin CHARACTERISTIC DFC_DisblMsk.DFC_MOXEMM_SMU_ALM11_3_C "disable mask / Disable masks of check DFC_MOXEMM_SMU_ALM11_3" VALUE 0x804F5DB2 Val_Wu16 65535.00 DFES_OneToOne 0.00 65535.00 FORMAT "%8.2" /end CHARACTERISTIC
/begin CHARACTERISTIC DFC_DisblMsk.DFC_MOXEMM_SMU_ALM11_4_C "disable mask / Disable masks of check DFC_MOXEMM_SMU_ALM11_4" VALUE 0x804F5DB4 Val_Wu16 65535.00 DFES_OneToOne 0.00 65535.00 FORMAT "%8.2" /end CHARACTERISTIC
/begin CHARACTERISTIC DFC_DisblMsk.DFC_MOXEMM_SMU_ALM11_5_C "disable mask / Disable masks of check DFC_MOXEMM_SMU_ALM11_5" VALUE 0x804F5DB6 Val_Wu16 65535.00 DFES_OneToOne 0.00 65535.00 FORMAT "%8.2" /end CHARACTERISTIC
/begin CHARACTERISTIC DFC_DisblMsk.DFC_MOXEMM_SMU_ALM11_8_C "disable mask / Disable masks of check DFC_MOXEMM_SMU_ALM11_8" VALUE 0x804F5DB8 Val_Wu16 65535.00 DFES_OneToOne 0.00 65535.00 FORMAT "%8.2" /end CHARACTERISTIC
/begin CHARACTERISTIC DFC_DisblMsk.DFC_MOXEMM_SMU_ALM11_9_C "disable mask / Disable masks of check DFC_MOXEMM_SMU_ALM11_9" VALUE 0x804F5DBA Val_Wu16 65535.00 DFES_OneToOne 0.00 65535.00 FORMAT "%8.2" /end CHARACTERISTIC
/begin CHARACTERISTIC DFC_DisblMsk.DFC_MOXEMM_SMU_ALM1_0_C "disable mask / Disable masks of check DFC_MOXEMM_SMU_ALM1_0" VALUE 0x804F5DBC Val_Wu16 65535.00 DFES_OneToOne 0.00 65535.00 FORMAT "%8.2" /end CHARACTERISTIC
/begin CHARACTERISTIC DFC_DisblMsk.DFC_MOXEMM_SMU_ALM1_1_C "disable mask / Disable masks of check DFC_MOXEMM_SMU_ALM1_1" VALUE 0x804F5DBE Val_Wu16 65535.00 DFES_OneToOne 0.00 65535.00 FORMAT "%8.2" /end CHARACTERISTIC
/begin CHARACTERISTIC DFC_DisblMsk.DFC_MOXEMM_SMU_ALM1_10_C "disable mask / Disable masks of check DFC_MOXEMM_SMU_ALM1_10" VALUE 0x804F5DC0 Val_Wu16 65535.00 DFES_OneToOne 0.00 65535.00 FORMAT "%8.2" /end CHARACTERISTIC
/begin CHARACTERISTIC DFC_DisblMsk.DFC_MOXEMM_SMU_ALM1_11_C "disable mask / Disable masks of check DFC_MOXEMM_SMU_ALM1_11" VALUE 0x804F5DC2 Val_Wu16 65535.00 DFES_OneToOne 0.00 65535.00 FORMAT "%8.2" /end CHARACTERISTIC
/begin CHARACTERISTIC DFC_DisblMsk.DFC_MOXEMM_SMU_ALM1_13_C "disable mask / Disable masks of check DFC_MOXEMM_SMU_ALM1_13" VALUE 0x804F5DC4 Val_Wu16 65535.00 DFES_OneToOne 0.00 65535.00 FORMAT "%8.2" /end CHARACTERISTIC
/begin CHARACTERISTIC DFC_DisblMsk.DFC_MOXEMM_SMU_ALM1_14_C "disable mask / Disable masks of check DFC_MOXEMM_SMU_ALM1_14" VALUE 0x804F5DC6 Val_Wu16 65535.00 DFES_OneToOne 0.00 65535.00 FORMAT "%8.2" /end CHARACTERISTIC
/begin CHARACTERISTIC DFC_DisblMsk.DFC_MOXEMM_SMU_ALM1_2_C "disable mask / Disable masks of check DFC_MOXEMM_SMU_ALM1_2" VALUE 0x804F5DC8 Val_Wu16 65535.00 DFES_OneToOne 0.00 65535.00 FORMAT "%8.2" /end CHARACTERISTIC
/begin CHARACTERISTIC DFC_DisblMsk.DFC_MOXEMM_SMU_ALM1_22_C "disable mask / Disable masks of check DFC_MOXEMM_SMU_ALM1_22" VALUE 0x804F5DCA Val_Wu16 65535.00 DFES_OneToOne 0.00 65535.00 FORMAT "%8.2" /end CHARACTERISTIC
/begin CHARACTERISTIC DFC_DisblMsk.DFC_MOXEMM_SMU_ALM1_23_C "disable mask / Disable masks of check DFC_MOXEMM_SMU_ALM1_23" VALUE 0x804F5DCC Val_Wu16 65535.00 DFES_OneToOne 0.00 65535.00 FORMAT "%8.2" /end CHARACTERISTIC
/begin CHARACTERISTIC DFC_DisblMsk.DFC_MOXEMM_SMU_ALM1_4_C "disable mask / Disable masks of check DFC_MOXEMM_SMU_ALM1_4" VALUE 0x804F5DCE Val_Wu16 65535.00 DFES_OneToOne 0.00 65535.00 FORMAT "%8.2" /end CHARACTERISTIC
/begin CHARACTERISTIC DFC_DisblMsk.DFC_MOXEMM_SMU_ALM1_5_C "disable mask / Disable masks of check DFC_MOXEMM_SMU_ALM1_5" VALUE 0x804F5DD0 Val_Wu16 65535.00 DFES_OneToOne 0.00 65535.00 FORMAT "%8.2" /end CHARACTERISTIC
/begin CHARACTERISTIC DFC_DisblMsk.DFC_MOXEMM_SMU_ALM1_7_C "disable mask / Disable masks of check DFC_MOXEMM_SMU_ALM1_7" VALUE 0x804F5DD2 Val_Wu16 65535.00 DFES_OneToOne 0.00 65535.00 FORMAT "%8.2" /end CHARACTERISTIC
/begin CHARACTERISTIC DFC_DisblMsk.DFC_MOXEMM_SMU_ALM1_8_C "disable mask / Disable masks of check DFC_MOXEMM_SMU_ALM1_8" VALUE 0x804F5DD4 Val_Wu16 65535.00 DFES_OneToOne 0.00 65535.00 FORMAT "%8.2" /end CHARACTERISTIC
/begin CHARACTERISTIC DFC_DisblMsk.DFC_MOXEMM_SMU_ALM21_0_C "disable mask / Disable masks of check DFC_MOXEMM_SMU_ALM21_0" VALUE 0x804F5DD6 Val_Wu16 65535.00 DFES_OneToOne 0.00 65535.00 FORMAT "%8.2" /end CHARACTERISTIC
/begin CHARACTERISTIC DFC_DisblMsk.DFC_MOXEMM_SMU_ALM21_16_C "disable mask / Disable masks of check DFC_MOXEMM_SMU_ALM21_16" VALUE 0x804F5DD8 Val_Wu16 65535.00 DFES_OneToOne 0.00 65535.00 FORMAT "%8.2" /end CHARACTERISTIC
/begin CHARACTERISTIC DFC_DisblMsk.DFC_MOXEMM_SMU_ALM21_3_C "disable mask / Disable masks of check DFC_MOXEMM_SMU_ALM21_3" VALUE 0x804F5DDA Val_Wu16 65535.00 DFES_OneToOne 0.00 65535.00 FORMAT "%8.2" /end CHARACTERISTIC
/begin CHARACTERISTIC DFC_DisblMsk.DFC_MOXEMM_SMU_ALM2_1_C "disable mask / Disable masks of check DFC_MOXEMM_SMU_ALM2_1" VALUE 0x804F5DDC Val_Wu16 65535.00 DFES_OneToOne 0.00 65535.00 FORMAT "%8.2" /end CHARACTERISTIC
/begin CHARACTERISTIC DFC_DisblMsk.DFC_MOXEMM_SMU_ALM2_10_C "disable mask / Disable masks of check DFC_MOXEMM_SMU_ALM2_10" VALUE 0x804F5DDE Val_Wu16 65535.00 DFES_OneToOne 0.00 65535.00 FORMAT "%8.2" /end CHARACTERISTIC
/begin CHARACTERISTIC DFC_DisblMsk.DFC_MOXEMM_SMU_ALM2_11_C "disable mask / Disable masks of check DFC_MOXEMM_SMU_ALM2_11" VALUE 0x804F5DE0 Val_Wu16 65535.00 DFES_OneToOne 0.00 65535.00 FORMAT "%8.2" /end CHARACTERISTIC
/begin CHARACTERISTIC DFC_DisblMsk.DFC_MOXEMM_SMU_ALM2_13_C "disable mask / Disable masks of check DFC_MOXEMM_SMU_ALM2_13" VALUE 0x804F5DE2 Val_Wu16 65535.00 DFES_OneToOne 0.00 65535.00 FORMAT "%8.2" /end CHARACTERISTIC
/begin CHARACTERISTIC DFC_DisblMsk.DFC_MOXEMM_SMU_ALM2_14_C "disable mask / Disable masks of check DFC_MOXEMM_SMU_ALM2_14" VALUE 0x804F5DE4 Val_Wu16 65535.00 DFES_OneToOne 0.00 65535.00 FORMAT "%8.2" /end CHARACTERISTIC
/begin CHARACTERISTIC DFC_DisblMsk.DFC_MOXEMM_SMU_ALM2_22_C "disable mask / Disable masks of check DFC_MOXEMM_SMU_ALM2_22" VALUE 0x804F5DE6 Val_Wu16 65535.00 DFES_OneToOne 0.00 65535.00 FORMAT "%8.2" /end CHARACTERISTIC
/begin CHARACTERISTIC DFC_DisblMsk.DFC_MOXEMM_SMU_ALM2_23_C "disable mask / Disable masks of check DFC_MOXEMM_SMU_ALM2_23" VALUE 0x804F5DE8 Val_Wu16 65535.00 DFES_OneToOne 0.00 65535.00 FORMAT "%8.2" /end CHARACTERISTIC
/begin CHARACTERISTIC DFC_DisblMsk.DFC_MOXEMM_SMU_ALM2_4_C "disable mask / Disable masks of check DFC_MOXEMM_SMU_ALM2_4" VALUE 0x804F5DEA Val_Wu16 65535.00 DFES_OneToOne 0.00 65535.00 FORMAT "%8.2" /end CHARACTERISTIC
/begin CHARACTERISTIC DFC_DisblMsk.DFC_MOXEMM_SMU_ALM2_5_C "disable mask / Disable masks of check DFC_MOXEMM_SMU_ALM2_5" VALUE 0x804F5DEC Val_Wu16 65535.00 DFES_OneToOne 0.00 65535.00 FORMAT "%8.2" /end CHARACTERISTIC
/begin CHARACTERISTIC DFC_DisblMsk.DFC_MOXEMM_SMU_ALM2_7_C "disable mask / Disable masks of check DFC_MOXEMM_SMU_ALM2_7" VALUE 0x804F5DEE Val_Wu16 65535.00 DFES_OneToOne 0.00 65535.00 FORMAT "%8.2" /end CHARACTERISTIC
/begin CHARACTERISTIC DFC_DisblMsk.DFC_MOXEMM_SMU_ALM2_8_C "disable mask / Disable masks of check DFC_MOXEMM_SMU_ALM2_8" VALUE 0x804F5DF0 Val_Wu16 65535.00 DFES_OneToOne 0.00 65535.00 FORMAT "%8.2" /end CHARACTERISTIC
/begin CHARACTERISTIC DFC_DisblMsk.DFC_MOXEMM_SMU_ALM6_0_C "disable mask / Disable masks of check DFC_MOXEMM_SMU_ALM6_0" VALUE 0x804F5DF2 Val_Wu16 65535.00 DFES_OneToOne 0.00 65535.00 FORMAT "%8.2" /end CHARACTERISTIC
/begin CHARACTERISTIC DFC_DisblMsk.DFC_MOXEMM_SMU_ALM6_11_C "disable mask / Disable masks of check DFC_MOXEMM_SMU_ALM6_11" VALUE 0x804F5DF4 Val_Wu16 65535.00 DFES_OneToOne 0.00 65535.00 FORMAT "%8.2" /end CHARACTERISTIC
/begin CHARACTERISTIC DFC_DisblMsk.DFC_MOXEMM_SMU_ALM6_12_C "disable mask / Disable masks of check DFC_MOXEMM_SMU_ALM6_12" VALUE 0x804F5DF6 Val_Wu16 65535.00 DFES_OneToOne 0.00 65535.00 FORMAT "%8.2" /end CHARACTERISTIC
/begin CHARACTERISTIC DFC_DisblMsk.DFC_MOXEMM_SMU_ALM6_14_C "disable mask / Disable masks of check DFC_MOXEMM_SMU_ALM6_14" VALUE 0x804F5DF8 Val_Wu16 65535.00 DFES_OneToOne 0.00 65535.00 FORMAT "%8.2" /end CHARACTERISTIC
/begin CHARACTERISTIC DFC_DisblMsk.DFC_MOXEMM_SMU_ALM6_15_C "disable mask / Disable masks of check DFC_MOXEMM_SMU_ALM6_15" VALUE 0x804F5DFA Val_Wu16 65535.00 DFES_OneToOne 0.00 65535.00 FORMAT "%8.2" /end CHARACTERISTIC
/begin CHARACTERISTIC DFC_DisblMsk.DFC_MOXEMM_SMU_ALM6_17_C "disable mask / Disable masks of check DFC_MOXEMM_SMU_ALM6_17" VALUE 0x804F5DFC Val_Wu16 65535.00 DFES_OneToOne 0.00 65535.00 FORMAT "%8.2" /end CHARACTERISTIC
/begin CHARACTERISTIC DFC_DisblMsk.DFC_MOXEMM_SMU_ALM6_18_C "disable mask / Disable masks of check DFC_MOXEMM_SMU_ALM6_18" VALUE 0x804F5DFE Val_Wu16 65535.00 DFES_OneToOne 0.00 65535.00 FORMAT "%8.2" /end CHARACTERISTIC
/begin CHARACTERISTIC DFC_DisblMsk.DFC_MOXEMM_SMU_ALM6_20_C "disable mask / Disable masks of check DFC_MOXEMM_SMU_ALM6_20" VALUE 0x804F5E00 Val_Wu16 65535.00 DFES_OneToOne 0.00 65535.00 FORMAT "%8.2" /end CHARACTERISTIC
/begin CHARACTERISTIC DFC_DisblMsk.DFC_MOXEMM_SMU_ALM6_21_C "disable mask / Disable masks of check DFC_MOXEMM_SMU_ALM6_21" VALUE 0x804F5E02 Val_Wu16 65535.00 DFES_OneToOne 0.00 65535.00 FORMAT "%8.2" /end CHARACTERISTIC
/begin CHARACTERISTIC DFC_DisblMsk.DFC_MOXEMM_SMU_ALM6_25_C "disable mask / Disable masks of check DFC_MOXEMM_SMU_ALM6_25" VALUE 0x804F5E04 Val_Wu16 65535.00 DFES_OneToOne 0.00 65535.00 FORMAT "%8.2" /end CHARACTERISTIC
/begin CHARACTERISTIC DFC_DisblMsk.DFC_MOXEMM_SMU_ALM6_4_C "disable mask / Disable masks of check DFC_MOXEMM_SMU_ALM6_4" VALUE 0x804F5E06 Val_Wu16 65535.00 DFES_OneToOne 0.00 65535.00 FORMAT "%8.2" /end CHARACTERISTIC
/begin CHARACTERISTIC DFC_DisblMsk.DFC_MOXEMM_SMU_ALM6_5_C "disable mask / Disable masks of check DFC_MOXEMM_SMU_ALM6_5" VALUE 0x804F5E08 Val_Wu16 65535.00 DFES_OneToOne 0.00 65535.00 FORMAT "%8.2" /end CHARACTERISTIC
/begin CHARACTERISTIC DFC_DisblMsk.DFC_MOXEMM_SMU_ALM6_7_C "disable mask / Disable masks of check DFC_MOXEMM_SMU_ALM6_7" VALUE 0x804F5E0A Val_Wu16 65535.00 DFES_OneToOne 0.00 65535.00 FORMAT "%8.2" /end CHARACTERISTIC
/begin CHARACTERISTIC DFC_DisblMsk.DFC_MOXEMM_SMU_ALM6_8_C "disable mask / Disable masks of check DFC_MOXEMM_SMU_ALM6_8" VALUE 0x804F5E0C Val_Wu16 65535.00 DFES_OneToOne 0.00 65535.00 FORMAT "%8.2" /end CHARACTERISTIC
/begin CHARACTERISTIC DFC_DisblMsk.DFC_MOXEMM_SMU_ALM7_1_C "disable mask / Disable masks of check DFC_MOXEMM_SMU_ALM7_1" VALUE 0x804F5E0E Val_Wu16 65535.00 DFES_OneToOne 0.00 65535.00 FORMAT "%8.2" /end CHARACTERISTIC
/begin CHARACTERISTIC DFC_DisblMsk.DFC_MOXEMM_SMU_ALM7_12_C "disable mask / Disable masks of check DFC_MOXEMM_SMU_ALM7_12" VALUE 0x804F5E10 Val_Wu16 65535.00 DFES_OneToOne 0.00 65535.00 FORMAT "%8.2" /end CHARACTERISTIC
/begin CHARACTERISTIC DFC_DisblMsk.DFC_MOXEMM_SMU_ALM7_13_C "disable mask / Disable masks of check DFC_MOXEMM_SMU_ALM7_13" VALUE 0x804F5E12 Val_Wu16 65535.00 DFES_OneToOne 0.00 65535.00 FORMAT "%8.2" /end CHARACTERISTIC
/begin CHARACTERISTIC DFC_DisblMsk.DFC_MOXEMM_SMU_ALM7_14_C "disable mask / Disable masks of check DFC_MOXEMM_SMU_ALM7_14" VALUE 0x804F5E14 Val_Wu16 65535.00 DFES_OneToOne 0.00 65535.00 FORMAT "%8.2" /end CHARACTERISTIC
/begin CHARACTERISTIC DFC_DisblMsk.DFC_MOXEMM_SMU_ALM7_15_C "disable mask / Disable masks of check DFC_MOXEMM_SMU_ALM7_15" VALUE 0x804F5E16 Val_Wu16 65535.00 DFES_OneToOne 0.00 65535.00 FORMAT "%8.2" /end CHARACTERISTIC
/begin CHARACTERISTIC DFC_DisblMsk.DFC_MOXEMM_SMU_ALM7_16_C "disable mask / Disable masks of check DFC_MOXEMM_SMU_ALM7_16" VALUE 0x804F5E18 Val_Wu16 65535.00 DFES_OneToOne 0.00 65535.00 FORMAT "%8.2" /end CHARACTERISTIC
/begin CHARACTERISTIC DFC_DisblMsk.DFC_MOXEMM_SMU_ALM7_17_C "disable mask / Disable masks of check DFC_MOXEMM_SMU_ALM7_17" VALUE 0x804F5E1A Val_Wu16 65535.00 DFES_OneToOne 0.00 65535.00 FORMAT "%8.2" /end CHARACTERISTIC
/begin CHARACTERISTIC DFC_DisblMsk.DFC_MOXEMM_SMU_ALM7_2_C "disable mask / Disable masks of check DFC_MOXEMM_SMU_ALM7_2" VALUE 0x804F5E1C Val_Wu16 65535.00 DFES_OneToOne 0.00 65535.00 FORMAT "%8.2" /end CHARACTERISTIC
/begin CHARACTERISTIC DFC_DisblMsk.DFC_MOXEMM_SMU_ALM7_20_C "disable mask / Disable masks of check DFC_MOXEMM_SMU_ALM7_20" VALUE 0x804F5E1E Val_Wu16 65535.00 DFES_OneToOne 0.00 65535.00 FORMAT "%8.2" /end CHARACTERISTIC
/begin CHARACTERISTIC DFC_DisblMsk.DFC_MOXEMM_SMU_ALM7_25_C "disable mask / Disable masks of check DFC_MOXEMM_SMU_ALM7_25" VALUE 0x804F5E20 Val_Wu16 65535.00 DFES_OneToOne 0.00 65535.00 FORMAT "%8.2" /end CHARACTERISTIC
/begin CHARACTERISTIC DFC_DisblMsk.DFC_MOXEMM_SMU_ALM7_26_C "disable mask / Disable masks of check DFC_MOXEMM_SMU_ALM7_26" VALUE 0x804F5E22 Val_Wu16 65535.00 DFES_OneToOne 0.00 65535.00 FORMAT "%8.2" /end CHARACTERISTIC
/begin CHARACTERISTIC DFC_DisblMsk.DFC_MOXEMM_SMU_ALM7_28_C "disable mask / Disable masks of check DFC_MOXEMM_SMU_ALM7_28" VALUE 0x804F5E24 Val_Wu16 65535.00 DFES_OneToOne 0.00 65535.00 FORMAT "%8.2" /end CHARACTERISTIC
/begin CHARACTERISTIC DFC_DisblMsk.DFC_MOXEMM_SMU_ALM7_29_C "disable mask / Disable masks of check DFC_MOXEMM_SMU_ALM7_29" VALUE 0x804F5E26 Val_Wu16 65535.00 DFES_OneToOne 0.00 65535.00 FORMAT "%8.2" /end CHARACTERISTIC
/begin CHARACTERISTIC DFC_DisblMsk.DFC_MOXEMM_SMU_ALM7_30_C "disable mask / Disable masks of check DFC_MOXEMM_SMU_ALM7_30" VALUE 0x804F5E28 Val_Wu16 65535.00 DFES_OneToOne 0.00 65535.00 FORMAT "%8.2" /end CHARACTERISTIC
/begin CHARACTERISTIC DFC_DisblMsk.DFC_MOXEMM_SMU_ALM7_31_C "disable mask / Disable masks of check DFC_MOXEMM_SMU_ALM7_31" VALUE 0x804F5E2A Val_Wu16 65535.00 DFES_OneToOne 0.00 65535.00 FORMAT "%8.2" /end CHARACTERISTIC
/begin CHARACTERISTIC DFC_DisblMsk.DFC_MOXEMM_SMU_ALM8_0_C "disable mask / Disable masks of check DFC_MOXEMM_SMU_ALM8_0" VALUE 0x804F5E2C Val_Wu16 65535.00 DFES_OneToOne 0.00 65535.00 FORMAT "%8.2" /end CHARACTERISTIC
/begin CHARACTERISTIC DFC_DisblMsk.DFC_MOXEMM_SMU_ALM8_1_C "disable mask / Disable masks of check DFC_MOXEMM_SMU_ALM8_1" VALUE 0x804F5E2E Val_Wu16 65535.00 DFES_OneToOne 0.00 65535.00 FORMAT "%8.2" /end CHARACTERISTIC
/begin CHARACTERISTIC DFC_DisblMsk.DFC_MOXEMM_SMU_ALM8_10_C "disable mask / Disable masks of check DFC_MOXEMM_SMU_ALM8_10" VALUE 0x804F5E30 Val_Wu16 65535.00 DFES_OneToOne 0.00 65535.00 FORMAT "%8.2" /end CHARACTERISTIC
/begin CHARACTERISTIC DFC_DisblMsk.DFC_MOXEMM_SMU_ALM8_11_C "disable mask / Disable masks of check DFC_MOXEMM_SMU_ALM8_11" VALUE 0x804F5E32 Val_Wu16 65535.00 DFES_OneToOne 0.00 65535.00 FORMAT "%8.2" /end CHARACTERISTIC
/begin CHARACTERISTIC DFC_DisblMsk.DFC_MOXEMM_SMU_ALM8_12_C "disable mask / Disable masks of check DFC_MOXEMM_SMU_ALM8_12" VALUE 0x804F5E34 Val_Wu16 65535.00 DFES_OneToOne 0.00 65535.00 FORMAT "%8.2" /end CHARACTERISTIC
/begin CHARACTERISTIC DFC_DisblMsk.DFC_MOXEMM_SMU_ALM8_16_C "disable mask / Disable masks of check DFC_MOXEMM_SMU_ALM8_16" VALUE 0x804F5E36 Val_Wu16 65535.00 DFES_OneToOne 0.00 65535.00 FORMAT "%8.2" /end CHARACTERISTIC
/begin CHARACTERISTIC DFC_DisblMsk.DFC_MOXEMM_SMU_ALM8_18_C "disable mask / Disable masks of check DFC_MOXEMM_SMU_ALM8_18" VALUE 0x804F5E38 Val_Wu16 65535.00 DFES_OneToOne 0.00 65535.00 FORMAT "%8.2" /end CHARACTERISTIC
/begin CHARACTERISTIC DFC_DisblMsk.DFC_MOXEMM_SMU_ALM8_2_C "disable mask / Disable masks of check DFC_MOXEMM_SMU_ALM8_2" VALUE 0x804F5E3A Val_Wu16 65535.00 DFES_OneToOne 0.00 65535.00 FORMAT "%8.2" /end CHARACTERISTIC
/begin CHARACTERISTIC DFC_DisblMsk.DFC_MOXEMM_SMU_ALM8_3_C "disable mask / Disable masks of check DFC_MOXEMM_SMU_ALM8_3" VALUE 0x804F5E3C Val_Wu16 65535.00 DFES_OneToOne 0.00 65535.00 FORMAT "%8.2" /end CHARACTERISTIC
/begin CHARACTERISTIC DFC_DisblMsk.DFC_MOXEMM_SMU_ALM8_31_C "disable mask / Disable masks of check DFC_MOXEMM_SMU_ALM8_31" VALUE 0x804F5E3E Val_Wu16 65535.00 DFES_OneToOne 0.00 65535.00 FORMAT "%8.2" /end CHARACTERISTIC
/begin CHARACTERISTIC DFC_DisblMsk.DFC_MOXEMM_SMU_ALM8_4_C "disable mask / Disable masks of check DFC_MOXEMM_SMU_ALM8_4" VALUE 0x804F5E40 Val_Wu16 65535.00 DFES_OneToOne 0.00 65535.00 FORMAT "%8.2" /end CHARACTERISTIC
/begin CHARACTERISTIC DFC_DisblMsk.DFC_MOXEMM_SMU_ALM9_0_C "disable mask / Disable masks of check DFC_MOXEMM_SMU_ALM9_0" VALUE 0x804F5E42 Val_Wu16 65535.00 DFES_OneToOne 0.00 65535.00 FORMAT "%8.2" /end CHARACTERISTIC
/begin CHARACTERISTIC DFC_DisblMsk.DFC_MOXEMM_SMU_ALM9_15_C "disable mask / Disable masks of check DFC_MOXEMM_SMU_ALM9_15" VALUE 0x804F5E44 Val_Wu16 65535.00 DFES_OneToOne 0.00 65535.00 FORMAT "%8.2" /end CHARACTERISTIC
/begin CHARACTERISTIC DFC_DisblMsk.DFC_MOXEMM_SMU_ALM9_3_C "disable mask / Disable masks of check DFC_MOXEMM_SMU_ALM9_3" VALUE 0x804F5E46 Val_Wu16 65535.00 DFES_OneToOne 0.00 65535.00 FORMAT "%8.2" /end CHARACTERISTIC
/begin CHARACTERISTIC DFC_DisblMsk.DFC_MoCADCNTP_C "disable mask / Disable masks of check DFC_MoCADCNTP" VALUE 0x804F5E48 Val_Wu16 65535.00 DFES_OneToOne 0.00 65535.00 FORMAT "%8.2" /end CHARACTERISTIC
/begin CHARACTERISTIC DFC_DisblMsk.DFC_MoCADCTst_C "disable mask / Disable masks of check DFC_MoCADCTst" VALUE 0x804F5E4A Val_Wu16 65535.00 DFES_OneToOne 0.00 65535.00 FORMAT "%8.2" /end CHARACTERISTIC
/begin CHARACTERISTIC DFC_DisblMsk.DFC_MoCSOPICO_C "disable mask / Disable masks of check DFC_MoCSOPICO" VALUE 0x804F5E4C Val_Wu16 65535.00 DFES_OneToOne 0.00 65535.00 FORMAT "%8.2" /end CHARACTERISTIC
/begin CHARACTERISTIC DFC_DisblMsk.DFC_MoFAPP_C "disable mask / Disable masks of check DFC_MoFAPP" VALUE 0x804F5E4E Val_Wu16 65535.00 DFES_OneToOne 0.00 65535.00 FORMAT "%8.2" /end CHARACTERISTIC
/begin CHARACTERISTIC DFC_DisblMsk.DFC_MoFAirFilgPrdc_C "disable mask / Disable masks of check DFC_MoFAirFilgPrdc" VALUE 0x804F5E50 Val_Wu16 65535.00 DFES_OneToOne 0.00 65535.00 FORMAT "%8.2" /end CHARACTERISTIC
/begin CHARACTERISTIC DFC_DisblMsk.DFC_MoFAirFlCtOffGdi_C "disable mask / Disable masks of check DFC_MoFAirFlCtOffGdi" VALUE 0x804F5E52 Val_Wu16 65535.00 DFES_OneToOne 0.00 65535.00 FORMAT "%8.2" /end CHARACTERISTIC
/begin CHARACTERISTIC DFC_DisblMsk.DFC_MoFAirFlCylGdi_C "disable mask / Disable masks of check DFC_MoFAirFlCylGdi" VALUE 0x804F5E54 Val_Wu16 65535.00 DFES_OneToOne 0.00 65535.00 FORMAT "%8.2" /end CHARACTERISTIC
/begin CHARACTERISTIC DFC_DisblMsk.DFC_MoFAirFlFF_C "disable mask / Disable masks of check DFC_MoFAirFlFF" VALUE 0x804F5E56 Val_Wu16 65535.00 DFES_OneToOne 0.00 65535.00 FORMAT "%8.2" /end CHARACTERISTIC
/begin CHARACTERISTIC DFC_DisblMsk.DFC_MoFAirFlIn_C "disable mask / Disable masks of check DFC_MoFAirFlIn" VALUE 0x804F5E58 Val_Wu16 65535.00 DFES_OneToOne 0.00 65535.00 FORMAT "%8.2" /end CHARACTERISTIC
/begin CHARACTERISTIC DFC_DisblMsk.DFC_MoFAirFlMixCtlGdiChkAirFl_C "disable mask / Disable masks of check DFC_MoFAirFlMixCtlGdiChkAirFl" VALUE 0x804F5E5A Val_Wu16 65535.00 DFES_OneToOne 0.00 65535.00 FORMAT "%8.2" /end CHARACTERISTIC
/begin CHARACTERISTIC DFC_DisblMsk.DFC_MoFAirFlMixCtlGdiChkCtrl_C "disable mask / Disable masks of check DFC_MoFAirFlMixCtlGdiChkCtrl" VALUE 0x804F5E5C Val_Wu16 65535.00 DFES_OneToOne 0.00 65535.00 FORMAT "%8.2" /end CHARACTERISTIC
/begin CHARACTERISTIC DFC_DisblMsk.DFC_MoFAirFlMode_C "disable mask / Disable masks of check DFC_MoFAirFlMode" VALUE 0x804F5E5E Val_Wu16 65535.00 DFES_OneToOne 0.00 65535.00 FORMAT "%8.2" /end CHARACTERISTIC
/begin CHARACTERISTIC DFC_DisblMsk.DFC_MoFESpd_C "disable mask / Disable masks of check DFC_MoFESpd" VALUE 0x804F5E60 Val_Wu16 65535.00 DFES_OneToOne 0.00 65535.00 FORMAT "%8.2" /end CHARACTERISTIC
/begin CHARACTERISTIC DFC_DisblMsk.DFC_MoFIACo_C "disable mask / Disable masks of check DFC_MoFIACo" VALUE 0x804F5E62 Val_Wu16 65535.00 DFES_OneToOne 0.00 65535.00 FORMAT "%8.2" /end CHARACTERISTIC
/begin CHARACTERISTIC DFC_DisblMsk.DFC_MoFICOL1_C "disable mask / Disable masks of check DFC_MoFICOL1" VALUE 0x804F5E64 Val_Wu16 65535.00 DFES_OneToOne 0.00 65535.00 FORMAT "%8.2" /end CHARACTERISTIC
/begin CHARACTERISTIC DFC_DisblMsk.DFC_MoFICOL2_C "disable mask / Disable masks of check DFC_MoFICOL2" VALUE 0x804F5E66 Val_Wu16 65535.00 DFES_OneToOne 0.00 65535.00 FORMAT "%8.2" /end CHARACTERISTIC
/begin CHARACTERISTIC DFC_DisblMsk.DFC_MoFStrt_C "disable mask / Disable masks of check DFC_MoFStrt" VALUE 0x804F5E68 Val_Wu16 65535.00 DFES_OneToOne 0.00 65535.00 FORMAT "%8.2" /end CHARACTERISTIC
/begin CHARACTERISTIC DFC_DisblMsk.DFC_MoFTrqCmp_C "disable mask / Disable masks of check DFC_MoFTrqCmp" VALUE 0x804F5E6A Val_Wu16 65535.00 DFES_OneToOne 0.00 65535.00 FORMAT "%8.2" /end CHARACTERISTIC
/begin CHARACTERISTIC DFC_DisblMsk.DFC_MoFTrqCmpMax_C "disable mask / Disable masks of check DFC_MoFTrqCmpMax" VALUE 0x804F5E6C Val_Wu16 65535.00 DFES_OneToOne 0.00 65535.00 FORMAT "%8.2" /end CHARACTERISTIC
/begin CHARACTERISTIC DFC_DisblMsk.DFC_MoFTrqCmpMin_C "disable mask / Disable masks of check DFC_MoFTrqCmpMin" VALUE 0x804F5E6E Val_Wu16 65535.00 DFES_OneToOne 0.00 65535.00 FORMAT "%8.2" /end CHARACTERISTIC
/begin CHARACTERISTIC DFC_DisblMsk.DFC_MoFVarPostBldSel_C "disable mask / Disable masks of check DFC_MoFVarPostBldSel" VALUE 0x804F5E70 Val_Wu16 65535.00 DFES_OneToOne 0.00 65535.00 FORMAT "%8.2" /end CHARACTERISTIC
/begin CHARACTERISTIC DFC_DisblMsk.DFC_MoXEMMHwLTMCUFW_C "disable mask / Disable masks of check DFC_MoXEMMHwLTMCUFW" VALUE 0x804F5E72 Val_Wu16 65535.00 DFES_OneToOne 0.00 65535.00 FORMAT "%8.2" /end CHARACTERISTIC
/begin CHARACTERISTIC DFC_DisblMsk.DFC_MoXEMMHwLTMonBIST_C "disable mask / Disable masks of check DFC_MoXEMMHwLTMonBIST" VALUE 0x804F5E74 Val_Wu16 65535.00 DFES_OneToOne 0.00 65535.00 FORMAT "%8.2" /end CHARACTERISTIC
/begin CHARACTERISTIC DFC_DisblMsk.DFC_MoXEMMHwLTRegMonTest_C "disable mask / Disable masks of check DFC_MoXEMMHwLTRegMonTest" VALUE 0x804F5E76 Val_Wu16 65535.00 DFES_OneToOne 0.00 65535.00 FORMAT "%8.2" /end CHARACTERISTIC
/begin CHARACTERISTIC DFC_DisblMsk.DFC_MoXEMMHwLTStbySMUAlvTest_C "disable mask / Disable masks of check DFC_MoXEMMHwLTStbySMUAlvTest" VALUE 0x804F5E78 Val_Wu16 65535.00 DFES_OneToOne 0.00 65535.00 FORMAT "%8.2" /end CHARACTERISTIC
/begin CHARACTERISTIC DFC_DisblMsk.DFC_MoXEMMHwLTTempSens_C "disable mask / Disable masks of check DFC_MoXEMMHwLTTempSens" VALUE 0x804F5E7A Val_Wu16 65535.00 DFES_OneToOne 0.00 65535.00 FORMAT "%8.2" /end CHARACTERISTIC
/begin CHARACTERISTIC DFC_DisblMsk.DFC_MoXEMMHwLTUCBCfg_C "disable mask / Disable masks of check DFC_MoXEMMHwLTUCBCfg" VALUE 0x804F5E7C Val_Wu16 65535.00 DFES_OneToOne 0.00 65535.00 FORMAT "%8.2" /end CHARACTERISTIC
/begin CHARACTERISTIC DFC_DisblMsk.DFC_NWSEmax_C "disable mask / Disable masks of check DFC_NWSEmax" VALUE 0x804F5E7E Val_Wu16 65535.00 DFES_OneToOne 0.00 65535.00 FORMAT "%8.2" /end CHARACTERISTIC
/begin CHARACTERISTIC DFC_DisblMsk.DFC_NWSmax_C "disable mask / Disable masks of check DFC_NWSmax" VALUE 0x804F5E80 Val_Wu16 65535.00 DFES_OneToOne 0.00 65535.00 FORMAT "%8.2" /end CHARACTERISTIC
/begin CHARACTERISTIC DFC_DisblMsk.DFC_OCWDAABEActv_C "disable mask / Disable masks of check DFC_OCWDAABEActv" VALUE 0x804F5E82 Val_Wu16 65535.00 DFES_OneToOne 0.00 65535.00 FORMAT "%8.2" /end CHARACTERISTIC
/begin CHARACTERISTIC DFC_DisblMsk.DFC_OCWDACom_C "disable mask / Disable masks of check DFC_OCWDACom" VALUE 0x804F5E84 Val_Wu16 65535.00 DFES_OneToOne 0.00 65535.00 FORMAT "%8.2" /end CHARACTERISTIC
/begin CHARACTERISTIC DFC_DisblMsk.DFC_OCWDAErrPin_C "disable mask / Disable masks of check DFC_OCWDAErrPin" VALUE 0x804F5E86 Val_Wu16 65535.00 DFES_OneToOne 0.00 65535.00 FORMAT "%8.2" /end CHARACTERISTIC
/begin CHARACTERISTIC DFC_DisblMsk.DFC_OCWDAOvrVltg_C "disable mask / Disable masks of check DFC_OCWDAOvrVltg" VALUE 0x804F5E88 Val_Wu16 65535.00 DFES_OneToOne 0.00 65535.00 FORMAT "%8.2" /end CHARACTERISTIC
/begin CHARACTERISTIC DFC_DisblMsk.DFC_ORAmax_C "disable mask / Disable masks of check DFC_ORAmax" VALUE 0x804F5E8A Val_Wu16 65535.00 DFES_OneToOne 0.00 65535.00 FORMAT "%8.2" /end CHARACTERISTIC
/begin CHARACTERISTIC DFC_DisblMsk.DFC_ORAmin_C "disable mask / Disable masks of check DFC_ORAmin" VALUE 0x804F5E8C Val_Wu16 65535.00 DFES_OneToOne 0.00 65535.00 FORMAT "%8.2" /end CHARACTERISTIC
/begin CHARACTERISTIC DFC_DisblMsk.DFC_OilPPlaus_C "disable mask / Disable masks of check DFC_OilPPlaus" VALUE 0x804F5E8E Val_Wu16 65535.00 DFES_OneToOne 0.00 65535.00 FORMAT "%8.2" /end CHARACTERISTIC
/begin CHARACTERISTIC DFC_DisblMsk.DFC_PLLSUmax_C "disable mask / Disable masks of check DFC_PLLSUmax" VALUE 0x804F5E90 Val_Wu16 65535.00 DFES_OneToOne 0.00 65535.00 FORMAT "%8.2" /end CHARACTERISTIC
/begin CHARACTERISTIC DFC_DisblMsk.DFC_PLLSUmin_C "disable mask / Disable masks of check DFC_PLLSUmin" VALUE 0x804F5E92 Val_Wu16 65535.00 DFES_OneToOne 0.00 65535.00 FORMAT "%8.2" /end CHARACTERISTIC
/begin CHARACTERISTIC DFC_DisblMsk.DFC_PSR1max_C "disable mask / Disable masks of check DFC_PSR1max" VALUE 0x804F5E94 Val_Wu16 65535.00 DFES_OneToOne 0.00 65535.00 FORMAT "%8.2" /end CHARACTERISTIC
/begin CHARACTERISTIC DFC_DisblMsk.DFC_PSRBmax_C "disable mask / Disable masks of check DFC_PSRBmax" VALUE 0x804F5E96 Val_Wu16 65535.00 DFES_OneToOne 0.00 65535.00 FORMAT "%8.2" /end CHARACTERISTIC
/begin CHARACTERISTIC DFC_DisblMsk.DFC_PSRBmin_C "disable mask / Disable masks of check DFC_PSRBmin" VALUE 0x804F5E98 Val_Wu16 65535.00 DFES_OneToOne 0.00 65535.00 FORMAT "%8.2" /end CHARACTERISTIC
/begin CHARACTERISTIC DFC_DisblMsk.DFC_PSRPmax_C "disable mask / Disable masks of check DFC_PSRPmax" VALUE 0x804F5E9A Val_Wu16 65535.00 DFES_OneToOne 0.00 65535.00 FORMAT "%8.2" /end CHARACTERISTIC
/begin CHARACTERISTIC DFC_DisblMsk.DFC_PSRPmin_C "disable mask / Disable masks of check DFC_PSRPmin" VALUE 0x804F5E9C Val_Wu16 65535.00 DFES_OneToOne 0.00 65535.00 FORMAT "%8.2" /end CHARACTERISTIC
/begin CHARACTERISTIC DFC_DisblMsk.DFC_PSRPsig_C "disable mask / Disable masks of check DFC_PSRPsig" VALUE 0x804F5E9E Val_Wu16 65535.00 DFES_OneToOne 0.00 65535.00 FORMAT "%8.2" /end CHARACTERISTIC
/begin CHARACTERISTIC DFC_DisblMsk.DFC_PSRmax_C "disable mask / Disable masks of check DFC_PSRmax" VALUE 0x804F5EA0 Val_Wu16 65535.00 DFES_OneToOne 0.00 65535.00 FORMAT "%8.2" /end CHARACTERISTIC
/begin CHARACTERISTIC DFC_DisblMsk.DFC_PUmax_C "disable mask / Disable masks of check DFC_PUmax" VALUE 0x804F5EA2 Val_Wu16 65535.00 DFES_OneToOne 0.00 65535.00 FORMAT "%8.2" /end CHARACTERISTIC
/begin CHARACTERISTIC DFC_DisblMsk.DFC_P_VSE11_OL_C "disable mask / Disable masks of check DFC_P_VSE11_OL" VALUE 0x804F5EA4 Val_Wu16 65535.00 DFES_OneToOne 0.00 65535.00 FORMAT "%8.2" /end CHARACTERISTIC
/begin CHARACTERISTIC DFC_DisblMsk.DFC_P_VSE11_SCB_C "disable mask / Disable masks of check DFC_P_VSE11_SCB" VALUE 0x804F5EA6 Val_Wu16 65535.00 DFES_OneToOne 0.00 65535.00 FORMAT "%8.2" /end CHARACTERISTIC
/begin CHARACTERISTIC DFC_DisblMsk.DFC_P_VSE11_SCG_C "disable mask / Disable masks of check DFC_P_VSE11_SCG" VALUE 0x804F5EA8 Val_Wu16 65535.00 DFES_OneToOne 0.00 65535.00 FORMAT "%8.2" /end CHARACTERISTIC
/begin CHARACTERISTIC DFC_DisblMsk.DFC_PhyHighAPP1_C "disable mask / Disable masks of check DFC_PhyHighAPP1" VALUE 0x804F5EAA Val_Wu16 65535.00 DFES_OneToOne 0.00 65535.00 FORMAT "%8.2" /end CHARACTERISTIC
/begin CHARACTERISTIC DFC_DisblMsk.DFC_PhyHighAPP2_C "disable mask / Disable masks of check DFC_PhyHighAPP2" VALUE 0x804F5EAC Val_Wu16 65535.00 DFES_OneToOne 0.00 65535.00 FORMAT "%8.2" /end CHARACTERISTIC
/begin CHARACTERISTIC DFC_DisblMsk.DFC_PhyLowAPP1_C "disable mask / Disable masks of check DFC_PhyLowAPP1" VALUE 0x804F5EAE Val_Wu16 65535.00 DFES_OneToOne 0.00 65535.00 FORMAT "%8.2" /end CHARACTERISTIC
/begin CHARACTERISTIC DFC_DisblMsk.DFC_PhyLowAPP2_C "disable mask / Disable masks of check DFC_PhyLowAPP2" VALUE 0x804F5EB0 Val_Wu16 65535.00 DFES_OneToOne 0.00 65535.00 FORMAT "%8.2" /end CHARACTERISTIC
/begin CHARACTERISTIC DFC_DisblMsk.DFC_SRCHighAPP1_C "disable mask / Disable masks of check DFC_SRCHighAPP1" VALUE 0x804F5EB2 Val_Wu16 65535.00 DFES_OneToOne 0.00 65535.00 FORMAT "%8.2" /end CHARACTERISTIC
/begin CHARACTERISTIC DFC_DisblMsk.DFC_SRCHighAPP2_C "disable mask / Disable masks of check DFC_SRCHighAPP2" VALUE 0x804F5EB4 Val_Wu16 65535.00 DFES_OneToOne 0.00 65535.00 FORMAT "%8.2" /end CHARACTERISTIC
/begin CHARACTERISTIC DFC_DisblMsk.DFC_SRCLowAPP1_C "disable mask / Disable masks of check DFC_SRCLowAPP1" VALUE 0x804F5EB6 Val_Wu16 65535.00 DFES_OneToOne 0.00 65535.00 FORMAT "%8.2" /end CHARACTERISTIC
/begin CHARACTERISTIC DFC_DisblMsk.DFC_SRCLowAPP2_C "disable mask / Disable masks of check DFC_SRCLowAPP2" VALUE 0x804F5EB8 Val_Wu16 65535.00 DFES_OneToOne 0.00 65535.00 FORMAT "%8.2" /end CHARACTERISTIC
/begin CHARACTERISTIC DFC_DisblMsk.DFC_SSpMon2_C "disable mask / Disable masks of check DFC_SSpMon2" VALUE 0x804F5EBA Val_Wu16 65535.00 DFES_OneToOne 0.00 65535.00 FORMAT "%8.2" /end CHARACTERISTIC
/begin CHARACTERISTIC DFC_DisblMsk.DFC_STHDRmax_C "disable mask / Disable masks of check DFC_STHDRmax" VALUE 0x804F5EBC Val_Wu16 65535.00 DFES_OneToOne 0.00 65535.00 FORMAT "%8.2" /end CHARACTERISTIC
/begin CHARACTERISTIC DFC_DisblMsk.DFC_SWReset_0_C "disable mask / Disable masks of check DFC_SWReset_0" VALUE 0x804F5EBE Val_Wu16 65535.00 DFES_OneToOne 0.00 65535.00 FORMAT "%8.2" /end CHARACTERISTIC
/begin CHARACTERISTIC DFC_DisblMsk.DFC_SWReset_1_C "disable mask / Disable masks of check DFC_SWReset_1" VALUE 0x804F5EC0 Val_Wu16 65535.00 DFES_OneToOne 0.00 65535.00 FORMAT "%8.2" /end CHARACTERISTIC
/begin CHARACTERISTIC DFC_DisblMsk.DFC_SWReset_2_C "disable mask / Disable masks of check DFC_SWReset_2" VALUE 0x804F5EC2 Val_Wu16 65535.00 DFES_OneToOne 0.00 65535.00 FORMAT "%8.2" /end CHARACTERISTIC
/begin CHARACTERISTIC DFC_DisblMsk.DFC_SyncAPP_C "disable mask / Disable masks of check DFC_SyncAPP" VALUE 0x804F5EC4 Val_Wu16 65535.00 DFES_OneToOne 0.00 65535.00 FORMAT "%8.2" /end CHARACTERISTIC
/begin CHARACTERISTIC DFC_DisblMsk.DFC_TANKLnpl_C "disable mask / Disable masks of check DFC_TANKLnpl" VALUE 0x804F5EC6 Val_Wu16 65535.00 DFES_OneToOne 0.00 65535.00 FORMAT "%8.2" /end CHARACTERISTIC
/begin CHARACTERISTIC DFC_DisblMsk.DFC_TAmax_Dummy_C "disable mask / Disable masks of check DFC_TAmax_Dummy" VALUE 0x804F5EC8 Val_Wu16 65535.00 DFES_OneToOne 0.00 65535.00 FORMAT "%8.2" /end CHARACTERISTIC
/begin CHARACTERISTIC DFC_DisblMsk.DFC_TESFmax_C "disable mask / Disable masks of check DFC_TESFmax" VALUE 0x804F5ECA Val_Wu16 65535.00 DFES_OneToOne 0.00 65535.00 FORMAT "%8.2" /end CHARACTERISTIC
/begin CHARACTERISTIC DFC_DisblMsk.DFC_TESGmax_C "disable mask / Disable masks of check DFC_TESGmax" VALUE 0x804F5ECC Val_Wu16 65535.00 DFES_OneToOne 0.00 65535.00 FORMAT "%8.2" /end CHARACTERISTIC
/begin CHARACTERISTIC DFC_DisblMsk.DFC_TKAEmax_C "disable mask / Disable masks of check DFC_TKAEmax" VALUE 0x804F5ECE Val_Wu16 65535.00 DFES_OneToOne 0.00 65535.00 FORMAT "%8.2" /end CHARACTERISTIC
/begin CHARACTERISTIC DFC_DisblMsk.DFC_TKAEmin_C "disable mask / Disable masks of check DFC_TKAEmin" VALUE 0x804F5ED0 Val_Wu16 65535.00 DFES_OneToOne 0.00 65535.00 FORMAT "%8.2" /end CHARACTERISTIC
/begin CHARACTERISTIC DFC_DisblMsk.DFC_TKARmax_C "disable mask / Disable masks of check DFC_TKARmax" VALUE 0x804F5ED2 Val_Wu16 65535.00 DFES_OneToOne 0.00 65535.00 FORMAT "%8.2" /end CHARACTERISTIC
/begin CHARACTERISTIC DFC_DisblMsk.DFC_TKARnpl_C "disable mask / Disable masks of check DFC_TKARnpl" VALUE 0x804F5ED4 Val_Wu16 65535.00 DFES_OneToOne 0.00 65535.00 FORMAT "%8.2" /end CHARACTERISTIC
/begin CHARACTERISTIC DFC_DisblMsk.DFC_TMmax_Dummy_C "disable mask / Disable masks of check DFC_TMmax_Dummy" VALUE 0x804F5ED6 Val_Wu16 65535.00 DFES_OneToOne 0.00 65535.00 FORMAT "%8.2" /end CHARACTERISTIC
/begin CHARACTERISTIC DFC_DisblMsk.DFC_TUMmax_Dummy_C "disable mask / Disable masks of check DFC_TUMmax_Dummy" VALUE 0x804F5ED8 Val_Wu16 65535.00 DFES_OneToOne 0.00 65535.00 FORMAT "%8.2" /end CHARACTERISTIC
/begin CHARACTERISTIC DFC_DisblMsk.DFC_TWCDPriCatB1_C "disable mask / Disable masks of check DFC_TWCDPriCatB1" VALUE 0x804F5EDA Val_Wu16 65535.00 DFES_OneToOne 0.00 65535.00 FORMAT "%8.2" /end CHARACTERISTIC
/begin CHARACTERISTIC DFC_DisblMsk.DFC_ThrVlvClsdPosnFirstOffsLrnImpoB1_C "disable mask / Disable masks of check DFC_ThrVlvClsdPosnFirstOffsLrnImpoB1" VALUE 0x804F5EDC Val_Wu16 65535.00 DFES_OneToOne 0.00 65535.00 FORMAT "%8.2" /end CHARACTERISTIC
/begin CHARACTERISTIC DFC_DisblMsk.DFC_ThrVlvClsdPosnOffsLrnImpoB1_C "disable mask / Disable masks of check DFC_ThrVlvClsdPosnOffsLrnImpoB1" VALUE 0x804F5EDE Val_Wu16 65535.00 DFES_OneToOne 0.00 65535.00 FORMAT "%8.2" /end CHARACTERISTIC
/begin CHARACTERISTIC DFC_DisblMsk.DFC_ThrVlvClsdPosnOffsLrnMaxB1_C "disable mask / Disable masks of check DFC_ThrVlvClsdPosnOffsLrnMaxB1" VALUE 0x804F5EE0 Val_Wu16 65535.00 DFES_OneToOne 0.00 65535.00 FORMAT "%8.2" /end CHARACTERISTIC
/begin CHARACTERISTIC DFC_DisblMsk.DFC_ThrVlvClsdPosnOffsLrnMinB1_C "disable mask / Disable masks of check DFC_ThrVlvClsdPosnOffsLrnMinB1" VALUE 0x804F5EE2 Val_Wu16 65535.00 DFES_OneToOne 0.00 65535.00 FORMAT "%8.2" /end CHARACTERISTIC
/begin CHARACTERISTIC DFC_DisblMsk.DFC_ThrVlvCtrlDeB1_C "disable mask / Disable masks of check DFC_ThrVlvCtrlDeB1" VALUE 0x804F5EE4 Val_Wu16 65535.00 DFES_OneToOne 0.00 65535.00 FORMAT "%8.2" /end CHARACTERISTIC
/begin CHARACTERISTIC DFC_DisblMsk.DFC_ThrVlvDycB1_C "disable mask / Disable masks of check DFC_ThrVlvDycB1" VALUE 0x804F5EE6 Val_Wu16 65535.00 DFES_OneToOne 0.00 65535.00 FORMAT "%8.2" /end CHARACTERISTIC
/begin CHARACTERISTIC DFC_DisblMsk.DFC_ThrVlvLimpAirPosnMaxAbsltDriftB1_C "disable mask / Disable masks of check DFC_ThrVlvLimpAirPosnMaxAbsltDriftB1" VALUE 0x804F5EE8 Val_Wu16 65535.00 DFES_OneToOne 0.00 65535.00 FORMAT "%8.2" /end CHARACTERISTIC
/begin CHARACTERISTIC DFC_DisblMsk.DFC_ThrVlvLimpAirPosnMaxB1_C "disable mask / Disable masks of check DFC_ThrVlvLimpAirPosnMaxB1" VALUE 0x804F5EEA Val_Wu16 65535.00 DFES_OneToOne 0.00 65535.00 FORMAT "%8.2" /end CHARACTERISTIC
/begin CHARACTERISTIC DFC_DisblMsk.DFC_ThrVlvLimpAirPosnMaxRelDriftB1_C "disable mask / Disable masks of check DFC_ThrVlvLimpAirPosnMaxRelDriftB1" VALUE 0x804F5EEC Val_Wu16 65535.00 DFES_OneToOne 0.00 65535.00 FORMAT "%8.2" /end CHARACTERISTIC
/begin CHARACTERISTIC DFC_DisblMsk.DFC_ThrVlvLimpAirPosnMinB1_C "disable mask / Disable masks of check DFC_ThrVlvLimpAirPosnMinB1" VALUE 0x804F5EEE Val_Wu16 65535.00 DFES_OneToOne 0.00 65535.00 FORMAT "%8.2" /end CHARACTERISTIC
/begin CHARACTERISTIC DFC_DisblMsk.DFC_ThrVlvOpenLoadB1_C "disable mask / Disable masks of check DFC_ThrVlvOpenLoadB1" VALUE 0x804F5EF0 Val_Wu16 65535.00 DFES_OneToOne 0.00 65535.00 FORMAT "%8.2" /end CHARACTERISTIC
/begin CHARACTERISTIC DFC_DisblMsk.DFC_ThrVlvOpenSprgB1_C "disable mask / Disable masks of check DFC_ThrVlvOpenSprgB1" VALUE 0x804F5EF2 Val_Wu16 65535.00 DFES_OneToOne 0.00 65535.00 FORMAT "%8.2" /end CHARACTERISTIC
/begin CHARACTERISTIC DFC_DisblMsk.DFC_ThrVlvOpenSprgSprdB1_C "disable mask / Disable masks of check DFC_ThrVlvOpenSprgSprdB1" VALUE 0x804F5EF4 Val_Wu16 65535.00 DFES_OneToOne 0.00 65535.00 FORMAT "%8.2" /end CHARACTERISTIC
/begin CHARACTERISTIC DFC_DisblMsk.DFC_ThrVlvOpenSprgTwnB1_C "disable mask / Disable masks of check DFC_ThrVlvOpenSprgTwnB1" VALUE 0x804F5EF6 Val_Wu16 65535.00 DFES_OneToOne 0.00 65535.00 FORMAT "%8.2" /end CHARACTERISTIC
/begin CHARACTERISTIC DFC_DisblMsk.DFC_ThrVlvOverTB1_C "disable mask / Disable masks of check DFC_ThrVlvOverTB1" VALUE 0x804F5EF8 Val_Wu16 65535.00 DFES_OneToOne 0.00 65535.00 FORMAT "%8.2" /end CHARACTERISTIC
/begin CHARACTERISTIC DFC_DisblMsk.DFC_ThrVlvRetSprgB1_C "disable mask / Disable masks of check DFC_ThrVlvRetSprgB1" VALUE 0x804F5EFA Val_Wu16 65535.00 DFES_OneToOne 0.00 65535.00 FORMAT "%8.2" /end CHARACTERISTIC
/begin CHARACTERISTIC DFC_DisblMsk.DFC_ThrVlvRetSprgSprdB1_C "disable mask / Disable masks of check DFC_ThrVlvRetSprgSprdB1" VALUE 0x804F5EFC Val_Wu16 65535.00 DFES_OneToOne 0.00 65535.00 FORMAT "%8.2" /end CHARACTERISTIC
/begin CHARACTERISTIC DFC_DisblMsk.DFC_ThrVlvRetSprgTwnB1_C "disable mask / Disable masks of check DFC_ThrVlvRetSprgTwnB1" VALUE 0x804F5EFE Val_Wu16 65535.00 DFES_OneToOne 0.00 65535.00 FORMAT "%8.2" /end CHARACTERISTIC
/begin CHARACTERISTIC DFC_DisblMsk.DFC_ThrVlvSens1MaxB1_C "disable mask / Disable masks of check DFC_ThrVlvSens1MaxB1" VALUE 0x804F5F00 Val_Wu16 65535.00 DFES_OneToOne 0.00 65535.00 FORMAT "%8.2" /end CHARACTERISTIC
/begin CHARACTERISTIC DFC_DisblMsk.DFC_ThrVlvSens1NplB1_C "disable mask / Disable masks of check DFC_ThrVlvSens1NplB1" VALUE 0x804F5F02 Val_Wu16 65535.00 DFES_OneToOne 0.00 65535.00 FORMAT "%8.2" /end CHARACTERISTIC
/begin CHARACTERISTIC DFC_DisblMsk.DFC_ThrVlvSens2MaxB1_C "disable mask / Disable masks of check DFC_ThrVlvSens2MaxB1" VALUE 0x804F5F04 Val_Wu16 65535.00 DFES_OneToOne 0.00 65535.00 FORMAT "%8.2" /end CHARACTERISTIC
/begin CHARACTERISTIC DFC_DisblMsk.DFC_ThrVlvSens2MinB1_C "disable mask / Disable masks of check DFC_ThrVlvSens2MinB1" VALUE 0x804F5F06 Val_Wu16 65535.00 DFES_OneToOne 0.00 65535.00 FORMAT "%8.2" /end CHARACTERISTIC
/begin CHARACTERISTIC DFC_DisblMsk.DFC_ThrVlvSens2NplB1_C "disable mask / Disable masks of check DFC_ThrVlvSens2NplB1" VALUE 0x804F5F08 Val_Wu16 65535.00 DFES_OneToOne 0.00 65535.00 FORMAT "%8.2" /end CHARACTERISTIC
/begin CHARACTERISTIC DFC_DisblMsk.DFC_ThrVlvShoCircB1_C "disable mask / Disable masks of check DFC_ThrVlvShoCircB1" VALUE 0x804F5F0A Val_Wu16 65535.00 DFES_OneToOne 0.00 65535.00 FORMAT "%8.2" /end CHARACTERISTIC
/begin CHARACTERISTIC DFC_DisblMsk.DFC_ThrVlvSpiErrB1_C "disable mask / Disable masks of check DFC_ThrVlvSpiErrB1" VALUE 0x804F5F0C Val_Wu16 65535.00 DFES_OneToOne 0.00 65535.00 FORMAT "%8.2" /end CHARACTERISTIC
/begin CHARACTERISTIC DFC_DisblMsk.DFC_ThrvlvSens1MinB1_C "disable mask / Disable masks of check DFC_ThrvlvSens1MinB1" VALUE 0x804F5F0E Val_Wu16 65535.00 DFES_OneToOne 0.00 65535.00 FORMAT "%8.2" /end CHARACTERISTIC
/begin CHARACTERISTIC DFC_DisblMsk.DFC_TiOffTBasdChkFast_C "disable mask / Disable masks of check DFC_TiOffTBasdChkFast" VALUE 0x804F5F10 Val_Wu16 65535.00 DFES_OneToOne 0.00 65535.00 FORMAT "%8.2" /end CHARACTERISTIC
/begin CHARACTERISTIC DFC_DisblMsk.DFC_TiOffTBasdChkSlow_C "disable mask / Disable masks of check DFC_TiOffTBasdChkSlow" VALUE 0x804F5F12 Val_Wu16 65535.00 DFES_OneToOne 0.00 65535.00 FORMAT "%8.2" /end CHARACTERISTIC
/begin CHARACTERISTIC DFC_DisblMsk.DFC_UEGOSnsrMntdS1B1_C "disable mask / Disable masks of check DFC_UEGOSnsrMntdS1B1" VALUE 0x804F5F14 Val_Wu16 65535.00 DFES_OneToOne 0.00 65535.00 FORMAT "%8.2" /end CHARACTERISTIC
/begin CHARACTERISTIC DFC_DisblMsk.DFC_VehVSig_C "disable mask / Disable masks of check DFC_VehVSig" VALUE 0x804F5F16 Val_Wu16 65535.00 DFES_OneToOne 0.00 65535.00 FORMAT "%8.2" /end CHARACTERISTIC
/begin CHARACTERISTIC DFC_DisblMsk.DFC_VlvLftFbSwtIntk11SpclFail_C "disable mask / Disable masks of check DFC_VlvLftFbSwtIntk11SpclFail" VALUE 0x804F5F18 Val_Wu16 65535.00 DFES_OneToOne 0.00 65535.00 FORMAT "%8.2" /end CHARACTERISTIC
/begin CHARACTERISTIC DFC_DisblMsk.DFC_VlvLftFbSwtIntk11StdFail_C "disable mask / Disable masks of check DFC_VlvLftFbSwtIntk11StdFail" VALUE 0x804F5F1A Val_Wu16 65535.00 DFES_OneToOne 0.00 65535.00 FORMAT "%8.2" /end CHARACTERISTIC
/begin CHARACTERISTIC DFC_DtcFuncUnit_C "AUTOSAR: Functional unit of DTC of all events" VALUE 0x804D93D6 Val_Wu8 255.0 OneToOne 0.00 255.0 FORMAT "%5.1" /end CHARACTERISTIC
/begin CHARACTERISTIC DFC_DtcGroup_C "AUTOSAR: Matching DTC group of all events" VALUE 0x804D93D7 Val_Wu8 16.0000000000 Dem_DTCGroup_Verb 0.00 16.0000000000 FORMAT "%13.10" /end CHARACTERISTIC
/begin CHARACTERISTIC DFC_DtcSeverity_C "AUTOSAR: DTC severity class of all events" VALUE 0x804D93D8 Val_Wu8 128.000000000 Dem_DTCSeverity_Verb 0.00 128.000000000 FORMAT "%13.9" /end CHARACTERISTIC
/begin CHARACTERISTIC DFES_Cls.DFC_Unused_C "fault class per DFC / " VALUE 0x804D93DA Val_Wu8 30.00 DFES_OneToOne 0.00 30.00 FORMAT "%5.2" EXTENDED_LIMITS 0.00 255.0 READ_ONLY /end CHARACTERISTIC
/begin CHARACTERISTIC DFES_Cls.DFC_AAVEmax_C "fault class per DFC / Fault class for check DFC_AAVEmax" VALUE 0x804D93DB Val_Wu8 30.00 DFES_OneToOne 0.00 30.00 FORMAT "%5.2" EXTENDED_LIMITS 0.00 255.0 /end CHARACTERISTIC
/begin CHARACTERISTIC DFES_Cls.DFC_AAVEmin_C "fault class per DFC / Fault class for check DFC_AAVEmin" VALUE 0x804D93DC Val_Wu8 30.00 DFES_OneToOne 0.00 30.00 FORMAT "%5.2" EXTENDED_LIMITS 0.00 255.0 /end CHARACTERISTIC
/begin CHARACTERISTIC DFES_Cls.DFC_AAVEsig_C "fault class per DFC / Fault class for check DFC_AAVEsig" VALUE 0x804D93DD Val_Wu8 30.00 DFES_OneToOne 0.00 30.00 FORMAT "%5.2" EXTENDED_LIMITS 0.00 255.0 /end CHARACTERISTIC
/begin CHARACTERISTIC DFES_Cls.DFC_AltIOACGFailr_C "fault class per DFC / Fault class for check DFC_AltIOACGFailr" VALUE 0x804D93DE Val_Wu8 30.00 DFES_OneToOne 0.00 30.00 FORMAT "%5.2" EXTENDED_LIMITS 0.00 255.0 /end CHARACTERISTIC
/begin CHARACTERISTIC DFES_Cls.DFC_AltIOACGHiVltg_C "fault class per DFC / Fault class for check DFC_AltIOACGHiVltg" VALUE 0x804D93DF Val_Wu8 30.00 DFES_OneToOne 0.00 30.00 FORMAT "%5.2" EXTENDED_LIMITS 0.00 255.0 /end CHARACTERISTIC
/begin CHARACTERISTIC DFES_Cls.DFC_AltIOACGLoVltg_C "fault class per DFC / Fault class for check DFC_AltIOACGLoVltg" VALUE 0x804D93E0 Val_Wu8 30.00 DFES_OneToOne 0.00 30.00 FORMAT "%5.2" EXTENDED_LIMITS 0.00 255.0 /end CHARACTERISTIC
/begin CHARACTERISTIC DFES_Cls.DFC_AltIOACGTHi_C "fault class per DFC / Fault class for check DFC_AltIOACGTHi" VALUE 0x804D93E1 Val_Wu8 30.00 DFES_OneToOne 0.00 30.00 FORMAT "%5.2" EXTENDED_LIMITS 0.00 255.0 /end CHARACTERISTIC
/begin CHARACTERISTIC DFES_Cls.DFC_AltIODConnACG_C "fault class per DFC / Fault class for check DFC_AltIODConnACG" VALUE 0x804D93E2 Val_Wu8 30.00 DFES_OneToOne 0.00 30.00 FORMAT "%5.2" EXTENDED_LIMITS 0.00 255.0 /end CHARACTERISTIC
/begin CHARACTERISTIC DFES_Cls.DFC_BGOELWAF_C "fault class per DFC / Fault class for check DFC_BGOELWAF" VALUE 0x804D93E3 Val_Wu8 30.00 DFES_OneToOne 0.00 30.00 FORMAT "%5.2" EXTENDED_LIMITS 0.00 255.0 /end CHARACTERISTIC
/begin CHARACTERISTIC DFES_Cls.DFC_BattUHiFailr_C "fault class per DFC / Fault class for check DFC_BattUHiFailr" VALUE 0x804D93E4 Val_Wu8 30.00 DFES_OneToOne 0.00 30.00 FORMAT "%5.2" EXTENDED_LIMITS 0.00 255.0 /end CHARACTERISTIC
/begin CHARACTERISTIC DFES_Cls.DFC_BattULoFailr_C "fault class per DFC / Fault class for check DFC_BattULoFailr" VALUE 0x804D93E5 Val_Wu8 30.00 DFES_OneToOne 0.00 30.00 FORMAT "%5.2" EXTENDED_LIMITS 0.00 255.0 /end CHARACTERISTIC
/begin CHARACTERISTIC DFES_Cls.DFC_BrkBstPDriftHiErr_C "fault class per DFC / Fault class for check DFC_BrkBstPDriftHiErr" VALUE 0x804D93E6 Val_Wu8 30.00 DFES_OneToOne 0.00 30.00 FORMAT "%5.2" EXTENDED_LIMITS 0.00 255.0 /end CHARACTERISTIC
/begin CHARACTERISTIC DFES_Cls.DFC_BrkBstPDriftLoErr_C "fault class per DFC / Fault class for check DFC_BrkBstPDriftLoErr" VALUE 0x804D93E7 Val_Wu8 30.00 DFES_OneToOne 0.00 30.00 FORMAT "%5.2" EXTENDED_LIMITS 0.00 255.0 /end CHARACTERISTIC
/begin CHARACTERISTIC DFES_Cls.DFC_BrkBstPSnsrStuck_C "fault class per DFC / Fault class for check DFC_BrkBstPSnsrStuck" VALUE 0x804D93E8 Val_Wu8 30.00 DFES_OneToOne 0.00 30.00 FORMAT "%5.2" EXTENDED_LIMITS 0.00 255.0 /end CHARACTERISTIC
/begin CHARACTERISTIC DFES_Cls.DFC_BrkMnSwtContOn_C "fault class per DFC / Fault class for check DFC_BrkMnSwtContOn" VALUE 0x804D93E9 Val_Wu8 30.00 DFES_OneToOne 0.00 30.00 FORMAT "%5.2" EXTENDED_LIMITS 0.00 255.0 /end CHARACTERISTIC
/begin CHARACTERISTIC DFES_Cls.DFC_BrkMnSwtNotStp_C "fault class per DFC / Fault class for check DFC_BrkMnSwtNotStp" VALUE 0x804D93EA Val_Wu8 30.00 DFES_OneToOne 0.00 30.00 FORMAT "%5.2" EXTENDED_LIMITS 0.00 255.0 /end CHARACTERISTIC
/begin CHARACTERISTIC DFES_Cls.DFC_BrkNpl_C "fault class per DFC / Fault class for check DFC_BrkNpl" VALUE 0x804D93EB Val_Wu8 30.00 DFES_OneToOne 0.00 30.00 FORMAT "%5.2" EXTENDED_LIMITS 0.00 255.0 /end CHARACTERISTIC
/begin CHARACTERISTIC DFES_Cls.DFC_BrkRdntSwtContOn_C "fault class per DFC / Fault class for check DFC_BrkRdntSwtContOn" VALUE 0x804D93EC Val_Wu8 30.00 DFES_OneToOne 0.00 30.00 FORMAT "%5.2" EXTENDED_LIMITS 0.00 255.0 /end CHARACTERISTIC
/begin CHARACTERISTIC DFES_Cls.DFC_BrkRdntSwtNotStp_C "fault class per DFC / Fault class for check DFC_BrkRdntSwtNotStp" VALUE 0x804D93ED Val_Wu8 30.00 DFES_OneToOne 0.00 30.00 FORMAT "%5.2" EXTENDED_LIMITS 0.00 255.0 /end CHARACTERISTIC
/begin CHARACTERISTIC DFES_Cls.DFC_Clth3ONStuck_C "fault class per DFC / Fault class for check DFC_Clth3ONStuck" VALUE 0x804D93EE Val_Wu8 30.00 DFES_OneToOne 0.00 30.00 FORMAT "%5.2" EXTENDED_LIMITS 0.00 255.0 /end CHARACTERISTIC
/begin CHARACTERISTIC DFES_Cls.DFC_Clth4OFFStuck_C "fault class per DFC / Fault class for check DFC_Clth4OFFStuck" VALUE 0x804D93EF Val_Wu8 30.00 DFES_OneToOne 0.00 30.00 FORMAT "%5.2" EXTENDED_LIMITS 0.00 255.0 /end CHARACTERISTIC
/begin CHARACTERISTIC DFES_Cls.DFC_ClthOFFStuck_C "fault class per DFC / Fault class for check DFC_ClthOFFStuck" VALUE 0x804D93F0 Val_Wu8 30.00 DFES_OneToOne 0.00 30.00 FORMAT "%5.2" EXTENDED_LIMITS 0.00 255.0 /end CHARACTERISTIC
/begin MEASUREMENT DFES_ChkLstDltDemExCond_mp "Exit condition of last delete demand check during initialisation" UBYTE OneToOne 1 100 0.00 255.0 FORMAT "%5.1" ECU_ADDRESS 0x70009FE4 /end MEASUREMENT
/begin MEASUREMENT DFES_chkSt "Check state of all DFCs stored in the error memory" UWORD OneToOne 1 100 0.00 65535.00 FORMAT "%8.2" ARRAY_SIZE 20 ECU_ADDRESS 0x60038160 /end MEASUREMENT
/begin MEASUREMENT DFES_cnfSequence "DSM internal sequence counter to obtain confirmed entry sorting of all error memory entries" UBYTE OneToOne 1 100 0.00 255.0 FORMAT "%5.1" ARRAY_SIZE 20 ECU_ADDRESS 0x6003801E /end MEASUREMENT
/begin MEASUREMENT DFES_ctDef "Fault counters (FLC) of error memory entries" UBYTE DFES_OneToOne 1 100 0.00 255.0 FORMAT "%5.1" ARRAY_SIZE 20 ECU_ADDRESS 0x600380D4 /end MEASUREMENT
/begin MEASUREMENT DFES_ctDel "Delete counters (DLC) of error memory entries" UBYTE DFES_OneToOne 1 100 0.00 255.0 FORMAT "%5.1" ARRAY_SIZE 20 ECU_ADDRESS 0x60038084 /end MEASUREMENT
/begin MEASUREMENT DFES_ctEntry "Number of occupied DFES Entries" UBYTE DFES_OneToOne 1 100 0.00 255.0 FORMAT "%5.1" ECU_ADDRESS 0x600140D9 /end MEASUREMENT
/begin MEASUREMENT DFES_ctFrq "Frequency counters of error memory entries" UBYTE DFES_OneToOne 1 100 0.00 255.0 FORMAT "%5.1" ARRAY_SIZE 20 ECU_ADDRESS 0x6003724A /end MEASUREMENT
/begin MEASUREMENT DFES_ctManuDef "Manufacturer fault counters of error memory entries" UBYTE DFES_OneToOne 1 100 0.00 255.0 FORMAT "%5.1" ARRAY_SIZE 20 ECU_ADDRESS 0x600380AC /end MEASUREMENT
/begin MEASUREMENT DFES_ctManuOk "Manufacturer healing counters of error memory entries" UBYTE DFES_OneToOne 1 100 0.00 255.0 FORMAT "%5.1" ARRAY_SIZE 20 ECU_ADDRESS 0x60038098 /end MEASUREMENT
/begin MEASUREMENT DFES_ctMIL "Number of DFES Entries illuminating the MIL(Only continuous illumination, no blinking counted)" UBYTE DFES_OneToOne 1 100 0.00 255.0 FORMAT "%5.1" ECU_ADDRESS 0x600140DB /end MEASUREMENT
/begin MEASUREMENT DFES_ctOBD "Number of DFES Entries visible in OBD Mode 3" UBYTE DFES_OneToOne 1 100 0.00 255.0 FORMAT "%5.1" ECU_ADDRESS 0x600100FD /end MEASUREMENT
/begin MEASUREMENT DFES_ctOBDPend "Number of DFES Entries visible in OBD Mode 7 (pending)" UBYTE DFES_OneToOne 1 100 0.00 255.0 FORMAT "%5.1" ECU_ADDRESS 0x600140DC /end MEASUREMENT
/begin MEASUREMENT DFES_ctOk "Healing counters (HLC) of error memory entries" UBYTE DFES_OneToOne 1 100 0.00 255.0 FORMAT "%5.1" ARRAY_SIZE 20 ECU_ADDRESS 0x600380C0 /end MEASUREMENT
/begin MEASUREMENT DFES_ctPDTC "Number of DFES Entries visible in OBD Mode A (PDTC)" UBYTE DFES_OneToOne 1 100 0.00 255.0 FORMAT "%5.1" ECU_ADDRESS 0x600100FB /end MEASUREMENT
/begin MEASUREMENT DFES_ctSrv "Number of DFES Entries visible for Service tester" UBYTE DFES_OneToOne 1 100 0.00 255.0 FORMAT "%5.1" ECU_ADDRESS 0x600100FC /end MEASUREMENT
/begin MEASUREMENT DFES_entrySt "Entry state of all DFCs stored in the error memory" UBYTE DFES_Entry_Verb 1 100 0.00 34.0000000000 FORMAT "%13.10" ARRAY_SIZE 20 ECU_ADDRESS 0x6003814C /end MEASUREMENT
/begin MEASUREMENT DFES_entryStPdtcStrd "Current EEPROM storage state of PDTC DFES entries" UBYTE OneToOne 1 100 0.00 255.0 FORMAT "%5.1" ARRAY_SIZE 3 ECU_ADDRESS 0x60034000 /end MEASUREMENT
/begin MEASUREMENT DFES_EnvBlock "Environmental data of all fault entries" UBYTE DFES_OneToOne 1 100 0.00 255.0 FORMAT "%5.1" ARRAY_SIZE 20 ECU_ADDRESS 0x6003725E /end MEASUREMENT
/begin MEASUREMENT DFES_FrzFrVal "Freeze frame values of all fault entries" UBYTE DFES_OneToOne 1 100 0.00 255.0 FORMAT "%5.1" ARRAY_SIZE 3500 ECU_ADDRESS 0x60037272 /end MEASUREMENT
/begin MEASUREMENT DFES_idxSequence "Sequence in which DFES entries were allocated (became Service$03 or Service$07 visible)" UBYTE DFES_OneToOne 1 100 0.00 255.0 FORMAT "%5.1" ARRAY_SIZE 20 ECU_ADDRESS 0x60038033 /end MEASUREMENT
/begin MEASUREMENT DFES_ISOFrstCnfDFC "DFC matching to criteria of first confirmed DTC" UWORD DFCDFP_Verb 1 100 0.00 989.000000000 FORMAT "%13.9" ECU_ADDRESS 0x60037248 /end MEASUREMENT
/begin MEASUREMENT DFES_ISOFrstFailDFC "DFC matching to criteria of first failed DTC" UWORD DFCDFP_Verb 1 100 0.00 989.000000000 FORMAT "%13.9" ECU_ADDRESS 0x6003818A /end MEASUREMENT
/begin MEASUREMENT DFES_ISORcntCnfDFC "DFC matching to criteria of most recent confirmed DTC" UWORD DFCDFP_Verb 1 100 0.00 989.000000000 FORMAT "%13.9" ECU_ADDRESS 0x60037246 /end MEASUREMENT
/begin MEASUREMENT DFES_ISORcntFailDFC "DFC matching to criteria of most recent failed DTC" UWORD DFCDFP_Verb 1 100 0.00 989.000000000 FORMAT "%13.9" ECU_ADDRESS 0x60038188 /end MEASUREMENT
/begin MEASUREMENT DFES_MonEvnt "DFES monitoring - Event Id" UWORD DFES_Mon_Verb 1 100 0.00 32786.0000000 FORMAT "%13.7" ARRAY_SIZE 2 ECU_ADDRESS 0x6003820E /end MEASUREMENT
/begin MEASUREMENT DFES_MonObjt "DFES monitoring - Object Id" UWORD OneToOne 1 100 0.00 65535.00 FORMAT "%8.2" ARRAY_SIZE 2 ECU_ADDRESS 0x6003820A /end MEASUREMENT
/begin MEASUREMENT DFES_MonParm "DFES monitoring - Parameter" UWORD OneToOne 1 100 0.00 65535.00 FORMAT "%8.2" ARRAY_SIZE 2 ECU_ADDRESS 0x60038206 /end MEASUREMENT
/begin MEASUREMENT DFES_MonPtr "DSM internal pointer for DFES monitoring" UBYTE DFES_OneToOne 1 100 0.00 255.0 FORMAT "%5.1" ECU_ADDRESS 0x60038212 /end MEASUREMENT
/begin MEASUREMENT DFES_numDFC "Names of stored fault checks in the error memory" UWORD DFC_Verb 1 100 0.00 906.000000000 FORMAT "%13.9" ARRAY_SIZE 20 ECU_ADDRESS 0x60038124 /end MEASUREMENT
/begin MEASUREMENT DFES_numDFCAck "acknowledged ID of fault entry (scanned and handled)" UWORD DFC_Verb 1 100 0.00 906.000000000 FORMAT "%13.9" ARRAY_SIZE 20 ECU_ADDRESS 0x6003805C /end MEASUREMENT
/begin MEASUREMENT DFES_numDFCImdt "Names of immediately stored fault checks in the error memory" UWORD DFC_Verb 1 100 0.00 906.000000000 FORMAT "%13.9" ARRAY_SIZE 20 ECU_ADDRESS 0x600381DC /end MEASUREMENT
/begin MEASUREMENT DFES_numEntryAvl "Number of possible DFES Entries" UBYTE DFES_OneToOne 1 100 0.00 255.0 FORMAT "%5.1" ECU_ADDRESS 0x600140DD /end MEASUREMENT
/begin MEASUREMENT DFES_numEnvSize "Number of bytes in one environment block" UBYTE DFES_OneToOne 1 100 0.00 255.0 FORMAT "%5.1" ECU_ADDRESS 0x600140DE /end MEASUREMENT
/begin MEASUREMENT DFES_numExtdFrzFrmSize "Number of bytes for environmental conditions contained in one freeze frame extension set" UBYTE DFES_OneToOne 1 100 0.00 255.0 FORMAT "%5.1" ECU_ADDRESS 0x600140DF /end MEASUREMENT
/begin MEASUREMENT DFES_numFrzFrmSize "Number of bytes in one freeze frame" UBYTE DFES_OneToOne 1 100 0.00 255.0 FORMAT "%5.1" ECU_ADDRESS 0x600140E0 /end MEASUREMENT
/begin MEASUREMENT DFES_OutLamps "Error lamp status of error memory entries" UBYTE DFES_OneToOne 1 100 0.00 255.0 FORMAT "%5.1" ARRAY_SIZE 20 ECU_ADDRESS 0x600100C9 /end MEASUREMENT
/begin MEASUREMENT DFES_PDTCStore "indication to store permanent DTCs at beginning of postdrive" UBYTE OneToOne 1 100 0.00 255.0 BIT_MASK 0x1 FORMAT "%5.1" ECU_ADDRESS 0x600100F4 /end MEASUREMENT
/begin MEASUREMENT DFES_prioEntryImdt "Priority of error memory entries" UBYTE DFES_OneToOne 1 100 0.00 255.0 FORMAT "%5.1" ARRAY_SIZE 20 ECU_ADDRESS 0x600381C8 /end MEASUREMENT
/begin MEASUREMENT DFES_StateVisibility "Tester visibility of error memory entries" UWORD DFES_OneToOne 1 100 0.00 65535.00 FORMAT "%8.2" ARRAY_SIZE 20 ECU_ADDRESS 0x6000970E /end MEASUREMENT
/begin MEASUREMENT DFES_stChk "Legacy check state of all DFCs stored in the error memory" UBYTE DFES_stCheck_Verb 1 100 0.00 7.00000000000 FORMAT "%13.11" ARRAY_SIZE 20 ECU_ADDRESS 0x60038110 /end MEASUREMENT
/begin MEASUREMENT DFES_stCounters "Counter state of all DFCs stored in the error memory" UBYTE DFES_stCnt_Verb 1 100 0.00 85.0000000000 FORMAT "%13.10" ARRAY_SIZE 20 ECU_ADDRESS 0x600380E8 /end MEASUREMENT
/begin MEASUREMENT DFES_stCtlSetting "internal and central disable request" UBYTE OneToOne 1 100 0.00 255.0 FORMAT "%5.1" ECU_ADDRESS 0x50005FD0 /end MEASUREMENT
/begin MEASUREMENT DFES_stDataImdt "Environment data state of error memory entries" UBYTE DFES_stDataImdt_Verb 1 100 0.00 21.0000000000 FORMAT "%13.10" ARRAY_SIZE 20 ECU_ADDRESS 0x6003818C /end MEASUREMENT
/begin MEASUREMENT DFES_stDataImdtTrans "Alternative environment data state of error memory entries during transition." UBYTE DFES_stDataImdt_Verb 1 100 0.00 21.0000000000 FORMAT "%13.10" ARRAY_SIZE 20 ECU_ADDRESS 0x600100DD /end MEASUREMENT
/begin MEASUREMENT DFES_stDTCRecUpdt "state of disable DTC record update, AUTOSAR feature" UBYTE OneToOne 1 100 0.00 255.0 FORMAT "%5.1" ECU_ADDRESS 0x600100F2 /end MEASUREMENT
/begin MEASUREMENT DFES_stDTCStorage "state of disable DTC storage AUTOSAR feature" UBYTE OneToOne 1 100 0.00 255.0 FORMAT "%5.1" ECU_ADDRESS 0x600100F1 /end MEASUREMENT
/begin MEASUREMENT DFES_stEepBufChg "Status of change in DSM EEP buffer for PDTC entries." UBYTE OneToOne 1 100 0.00 255.0 BIT_MASK 0x1 FORMAT "%5.1" ECU_ADDRESS 0x60034062 /end MEASUREMENT
/begin MEASUREMENT DFES_stEepWrReq "request for an EEPROM storage" UBYTE OneToOne 1 100 0.00 255.0 FORMAT "%5.1" ECU_ADDRESS 0x600100F8 /end MEASUREMENT
/begin MEASUREMENT DFES_stEntry "Legacy entry state of all DFCs stored in the error memory" UBYTE DFES_stEntry_Verb 1 100 0.00 254.000000000 FORMAT "%13.9" ARRAY_SIZE 20 ECU_ADDRESS 0x600380FC /end MEASUREMENT
/begin MEASUREMENT DFES_stErrDia "DSM internal status of all tester visibilities" UBYTE DFES_OneToOne 1 100 0.00 255.0 FORMAT "%5.1" ECU_ADDRESS 0x600100FF /end MEASUREMENT
/begin MEASUREMENT DFES_stErrLamp "DFES error lamp demands" UBYTE DFES_OneToOne 1 100 0.00 255.0 FORMAT "%5.1" ECU_ADDRESS 0x60010100 /end MEASUREMENT
/begin MEASUREMENT DFES_stErrLamp_msg "DFES error lamp demands" UBYTE DFES_OneToOne 1 100 0.00 255.0 FORMAT "%5.1" ECU_ADDRESS 0x6000F468 /end MEASUREMENT
/begin MEASUREMENT DFES_stInh "Inhibit (FIM) relevant state of fault entry" UBYTE DFES_OneToOne 1 100 0.00 255.0 FORMAT "%5.1" ARRAY_SIZE 20 ECU_ADDRESS 0x60038048 /end MEASUREMENT
/begin MEASUREMENT DFES_stOrdImdt "Order state of error memory entries" UWORD DFES_OneToOne 1 100 0.00 65535.00 FORMAT "%8.2" ARRAY_SIZE 20 ECU_ADDRESS 0x600381A0 /end MEASUREMENT
/begin MEASUREMENT DFES_stOrdImdtTrans "" UBYTE DFES_OneToOne 1 100 0.00 255.0 FORMAT "%5.1" ARRAY_SIZE 20 ECU_ADDRESS 0x6003402C /end MEASUREMENT
/begin MEASUREMENT DFES_stOutstate "DSM Flag status to check whether error counter is valid or not." UBYTE DFES_OneToOne 1 100 0.00 255.0 FORMAT "%5.1" ECU_ADDRESS 0x600100FE /end MEASUREMENT
/begin MEASUREMENT DFES_stPrgEvt "ECU programming event detected (reset of all diagnostic informations including IUMPR and permanent DTCs)" UBYTE OneToOne 1 100 0.00 255.0 BIT_MASK 0x1 FORMAT "%5.1" ECU_ADDRESS 0x600100F3 /end MEASUREMENT
/begin MEASUREMENT DFES_stPrgEvt_msg "Interface that gives information about ECU programming event." UBYTE OneToOne 1 100 0.00 255.0 BIT_MASK 0x1 FORMAT "%5.1" ECU_ADDRESS 0x6000F7CB /end MEASUREMENT
/begin MEASUREMENT DFES_stRepClrAftPwrFail "Repeated DSM clear after powerfail necessary" UBYTE B_TRUE 1 100 0.00 1.00000000000 BIT_MASK 0x1 FORMAT "%13.11" ECU_ADDRESS 0x6000E824 /end MEASUREMENT
/begin MEASUREMENT DFES_xAsgnEnvAllDataSize "Memory usage of common calibrated environment data" UBYTE DFES_OneToOne 1 100 0.00 255.0 FORMAT "%5.1" ECU_ADDRESS 0x600100C8 /end MEASUREMENT
/begin MEASUREMENT DSM_stProtdRamVld "DFES protected ram content is valid" UBYTE OneToOne 1 100 0.00 255.0 BIT_MASK 0x1 FORMAT "%5.1" ECU_ADDRESS 0x60034044 /end MEASUREMENT
/begin FUNCTION DFC "30000.33.0_1.1.0Diagnostic Fault Check"
 /begin DEF_CHARACTERISTIC DFC_DisblMsk.DFC_Clth2ONStuckLdc_C DFC_DisblMsk.DFC_Clth3ONStuckLdc_C DFC_DisblMsk.DFC_Clth3ONStuckPostDrv_C DFC_DisblMsk.DFC_Clth4ONStuck_C DFC_DisblMsk.DFC_Clth4ONStuckLdc_C DFC_DisblMsk.DFC_ComBCMUnit_C DFC_DisblMsk.DFC_ComDLCTCU01_C DFC_DisblMsk.DFC_ComDLCTCU02_C DFC_DisblMsk.DFC_ComDLCTCU1_C DFC_DisblMsk.DFC_ComDLCTCU11_C DFC_DisblMsk.DFC_ComDLCTCU12_C DFC_DisblMsk.DFC_ComDLCTCU13_C DFC_DisblMsk.DFC_ComDLCTCU14_C DFC_DisblMsk.DFC_ComDLCTCU2_C DFC_DisblMsk.DFC_ComDLCTCU3_C DFC_DisblMsk.DFC_ComDLCTCU4_C DFC_DisblMsk.DFC_ComEPSUnit_C DFC_DisblMsk.DFC_ComIDASBUnit_C DFC_DisblMsk.DFC_ComIMGUnit_C DFC_DisblMsk.DFC_ComMETUnit_C DFC_DisblMsk.DFC_ComSRSUnit_C DFC_DisblMsk.DFC_ComVSAUnit_C DFC_DisblMsk.DFC_EbsSocFlt_C DFC_DisblMsk.DFC_I14229VINErr_C DFC_DisblMsk.DFC_InjCatHeatgErr_C DFC_DisblMsk.DFC_InjSysMulInjDiagErr_C DFC_DisblMsk.DFC_LLRHmax_C DFC_DisblMsk.DFC_LLRHmin_C DFC_DisblMsk.DFC_LLRHnpl_C DFC_DisblMsk.DFC_LLRKHmax_C DFC_DisblMsk.DFC_LLRKHmin_C DFC_DisblMsk.DFC_LLRKHnpl_C DFC_DisblMsk.DFC_LinACGUnit_C DFC_DisblMsk.DFC_LinAEVUnit_C DFC_DisblMsk.DFC_LinEBSUnit_C DFC_DisblMsk.DFC_RoughRoad_C DFC_DisblMsk.DFC_SiaEEPRdErr_C DFC_DisblMsk.DFC_SiaEEPWrngCod_C DFC_DisblMsk.DFC_UegoHeatrStrtS1B1_C DFC_DisblMsk.DFC_BusDiagCANAPPLBusOff_C DFC_DisblMsk.DFC_BusDiagCANCANCBusOff_C DFC_DisblMsk.DFC_BusDiagCANVEHICLEBusOff_C DFC_DisblMsk.DFC_RBA_IODIAGPWR_rba_IoExtCy329_SignalVltSply_0_C DFC_DisblMsk.DFC_RBA_IODIAGPWR_rba_IoExtCy329_SignalVltSply_0OT_C DFC_DisblMsk.DFC_RBA_IODIAGPWR_rba_IoExtCy329_SignalVltSply_0OV_C DFC_DisblMsk.DFC_RBA_IODIAGPWR_rba_IoExtCy329_SignalVltSply_0SCG_C DFC_DisblMsk.DFC_RBA_IODIAGPWR_rba_IoExtCy329_SignalVltSply_0UV_C DFC_DisblMsk.DFC_RBA_IODIAGPWR_rba_IoExtCy329_SignalVltSply_1_C DFC_DisblMsk.DFC_RBA_IODIAGPWR_rba_IoExtCy329_SignalVltSply_1OT_C DFC_DisblMsk.DFC_RBA_IODIAGPWR_rba_IoExtCy329_SignalVltSply_1OV_C DFC_DisblMsk.DFC_RBA_IODIAGPWR_rba_IoExtCy329_SignalVltSply_1SCG_C DFC_DisblMsk.DFC_RBA_IODIAGPWR_rba_IoExtCy329_SignalVltSply_1UV_C DFC_DisblMsk.DFC_RBA_IODIAGPWR_rba_IoExtCy329_SignalVltSply_2_C DFC_DisblMsk.DFC_RBA_IODIAGPWR_rba_IoExtCy329_SignalVltSply_2OT_C DFC_DisblMsk.DFC_RBA_IODIAGPWR_rba_IoExtCy329_SignalVltSply_2OV_C DFC_DisblMsk.DFC_RBA_IODIAGPWR_rba_IoExtCy329_SignalVltSply_2SCG_C DFC_DisblMsk.DFC_RBA_IODIAGPWR_rba_IoExtCy329_SignalVltSply_2UV_C DFC_DisblMsk.DFC_CAN_E_TIMEOUT_C DFC_DisblMsk.DFC_LIN_E_TIMEOUT_C DFC_DisblMsk.DFC_MRlyOL_C DFC_DisblMsk.DFC_MRlySCB_C DFC_DisblMsk.DFC_MRlySCG_C DFC_DisblMsk.DFC_rba_MultiStackTrace_Threshold_C DFC_DisblMsk.DFC_BSWM_E_ACTION_FAILED_C DFC_DisblMsk.DFC_BSWM_E_INTRPTQUEUE_FULL_C DFC_DisblMsk.DFC_RBA_IOEXTLIB_KEEPALIVE_DRV_C DFC_DisblMsk.DFC_RBA_IOEXTLIB_KEEPALIVE_INI_C DFC_DisblMsk.DFC_rba_IoSigRtc_StopCounter_C DFC_DisblMsk.DFC_rba_MRly_Diag_Stk_Event_C DFC_DisblMsk.DFC_rba_MemDiag_MemReadErr_C DFC_DisblMsk.DFC_rba_MemDiag_MemWrErr_C DFC_DisblMsk.DFC_rba_SyC_IrrSwOffTrigEngRun_Event_C DFC_DisblMsk.DFC_rba_T15_Diag_ComInVld_Event_C DFC_DisblMsk.DFC_rba_T15_Diag_ComOff_HwOn_Event_C DFC_DisblMsk.DFC_rba_T15_Diag_ComOn_HwOff_Event_C DFC_DisblMsk.DFC_AAVmin_C DFC_DisblMsk.DFC_AGRSUS_C DFC_DisblMsk.DFC_AfsPlausDiagHi_C DFC_DisblMsk.DFC_AfsPlausDiagLo_C DFC_DisblMsk.DFC_AfsVrntDiagErrB1_C DFC_DisblMsk.DFC_AppAllSnsrDfct_C DFC_DisblMsk.DFC_BBKRnldg_C DFC_DisblMsk.DFC_BBKRsyne_C DFC_DisblMsk.DFC_BattUStdbyDiaOL_C DFC_DisblMsk.DFC_BigLeakIntkMnfldEmiInfl_C DFC_DisblMsk.DFC_BlkdLineTank_C DFC_DisblMsk.DFC_BrkMnSwtContOnWarnLmp_C DFC_DisblMsk.DFC_BrkMnSwtNotStpWarnLmp_C DFC_DisblMsk.DFC_BrkRdntSwtContOnWarnLmp_C DFC_DisblMsk.DFC_BrkRdntSwtNotStpWarnLmp_C DFC_DisblMsk.DFC_CEngDsTColdStrtMax_C DFC_DisblMsk.DFC_CEngDsTColdStrtMin_C DFC_DisblMsk.DFC_CEngDsTImps_C DFC_DisblMsk.DFC_CEngDsTPlausHSC_C DFC_DisblMsk.DFC_CEngDsTPlausLSC_C DFC_DisblMsk.DFC_CEngDsTPlausSTC_C DFC_DisblMsk.DFC_CEngDsTSRCMax_C DFC_DisblMsk.DFC_CEngDsTSRCMin_C DFC_DisblMsk.DFC_CEngDsTSig_C DFC_DisblMsk.DFC_CEngUsTColdStrtMax_C DFC_DisblMsk.DFC_CEngUsTColdStrtMin_C DFC_DisblMsk.DFC_CEngUsTLooseCnctn_C DFC_DisblMsk.DFC_CEngUsTSRCMax_C DFC_DisblMsk.DFC_CEngUsTSRCMin_C DFC_DisblMsk.DFC_ComDCDCACCFailr_C DFC_DisblMsk.DFC_DCDCFltDet_C DFC_DisblMsk.DFC_DKRSA_C DFC_DisblMsk.DFC_DKVSmax_C DFC_DisblMsk.DFC_DKnpl_C DFC_DisblMsk.DFC_DSKVRmax_C DFC_DisblMsk.DFC_DSKVRmin_C DFC_DisblMsk.DFC_DSKVRnpl_C DFC_DisblMsk.DFC_DSKVRsig_C DFC_DisblMsk.DFC_DSKVSsig_C DFC_DisblMsk.DFC_DSSmax_C DFC_DisblMsk.DFC_DSTDmax_C DFC_DisblMsk.DFC_DSTEmax_C DFC_DisblMsk.DFC_DSTEmin_C DFC_DisblMsk.DFC_DSTOFmax_C DFC_DisblMsk.DFC_DSTRmax_C DFC_DisblMsk.DFC_DSTRmin_C DFC_DisblMsk.DFC_DSTRnpl_C DFC_DisblMsk.DFC_DSTRsig_C DFC_DisblMsk.DFC_DSTTI_C DFC_DisblMsk.DFC_DSUmax_C DFC_DisblMsk.DFC_DiagCpv1DteskLoLoadStuckClsd_C DFC_DisblMsk.DFC_DiagCpv1DteskLoLoadStuckOpen_C DFC_DisblMsk.DFC_EGRVlvDrftClsd_C DFC_DisblMsk.DFC_EGRVlvDrftOpn_C DFC_DisblMsk.DFC_EGRVlvJamVlvClsd_C DFC_DisblMsk.DFC_EGRVlvJamVlvOpn_C DFC_DisblMsk.DFC_EGRVlvSprgBrk_C DFC_DisblMsk.DFC_EGRVlvTempMdlEEPErr_C DFC_DisblMsk.DFC_EGRVlvTmpErr_C DFC_DisblMsk.DFC_EGSDUS2B1LtrDly_C DFC_DisblMsk.DFC_EGSDUS2B1LtrPT1_C DFC_DisblMsk.DFC_EGSDUS2B1RtlDly_C DFC_DisblMsk.DFC_EGSDUS2B1RtlPT1_C DFC_DisblMsk.DFC_EGSDUS2B1TarLean_C DFC_DisblMsk.DFC_EGSDUS2B1TarRich_C DFC_DisblMsk.DFC_EONVmax_C DFC_DisblMsk.DFC_ETAKHLmax_C DFC_DisblMsk.DFC_ETAKHTmax_C DFC_DisblMsk.DFC_ETHSEmax_C DFC_DisblMsk.DFC_ETHSEmin_C DFC_DisblMsk.DFC_ETHSFmax_C DFC_DisblMsk.DFC_ETHSFmin_C DFC_DisblMsk.DFC_ETHSFsig_C DFC_DisblMsk.DFC_ETHSNPWmax_C DFC_DisblMsk.DFC_ETHSNPWmin_C DFC_DisblMsk.DFC_ETHSNPWsig_C DFC_DisblMsk.DFC_ETHSPLnpl_C DFC_DisblMsk.DFC_ETHSTPLnpl_C DFC_DisblMsk.DFC_EngICO_C DFC_DisblMsk.DFC_EngPrtOvrSpdMon_C DFC_DisblMsk.DFC_EpmCaSI1ErrSig_C DFC_DisblMsk.DFC_EpmCaSI1MntErr_C DFC_DisblMsk.DFC_EpmCaSI1NoSigMax_C DFC_DisblMsk.DFC_EpmCaSI1NoSigMin_C DFC_DisblMsk.DFC_EpmCaSI1OfsErr_C DFC_DisblMsk.DFC_EpmCrSDGI_C DFC_DisblMsk.DFC_EpmCrSErrSig_C DFC_DisblMsk.DFC_EpmCrSNoSig_C DFC_DisblMsk.DFC_EtaEngIdleNonCsers_C DFC_DisblMsk.DFC_EtaEngPtlNonCsers_C DFC_DisblMsk.DFC_FRAmax_C DFC_DisblMsk.DFC_FRAmin_C DFC_DisblMsk.DFC_FSTEmax_C DFC_DisblMsk.DFC_FSTEmin_C DFC_DisblMsk.DFC_FSTRmax_C DFC_DisblMsk.DFC_FSTRmin_C DFC_DisblMsk.DFC_FSTRnpl_C DFC_DisblMsk.DFC_FSTmax_C DFC_DisblMsk.DFC_FTDLAmax_C DFC_DisblMsk.DFC_FTDLAmin_C DFC_DisblMsk.DFC_FuPHiSnsrEleclmax_C DFC_DisblMsk.DFC_FuPHiSnsrEleclmin_C DFC_DisblMsk.DFC_FuPHiSnsrEleclnpl_C DFC_DisblMsk.DFC_FuPHiSnsrURngMax_C DFC_DisblMsk.DFC_FuPHiSnsrURngMin_C DFC_DisblMsk.DFC_FuSnsrPhyRngMaxErr_C DFC_DisblMsk.DFC_FuSnsrPhyRngMinErr_C DFC_DisblMsk.DFC_GEVlvLockPinDiagIntkB1_C DFC_DisblMsk.DFC_GEVlvPhaSlowIntkB1_C DFC_DisblMsk.DFC_GEVlvPhaTargIntkB1_C DFC_DisblMsk.DFC_GbxRvsSwtStk_C DFC_DisblMsk.DFC_HDRKHmax_C DFC_DisblMsk.DFC_HDRKHmin_C DFC_DisblMsk.DFC_HDRPLmax_C DFC_DisblMsk.DFC_HDRPLmin_C DFC_DisblMsk.DFC_HDRmax_C DFC_DisblMsk.DFC_HDRmin_C DFC_DisblMsk.DFC_HEGOS2B1ElecMax_C DFC_DisblMsk.DFC_HEGOS2B1ElecMin_C DFC_DisblMsk.DFC_HEGOS2B1ElecSig_C DFC_DisblMsk.DFC_HEGOS2B1HtgNpl_C DFC_DisblMsk.DFC_HEV00max_C DFC_DisblMsk.DFC_HEV01max_C DFC_DisblMsk.DFC_HEV02max_C DFC_DisblMsk.DFC_HEV03max_C DFC_DisblMsk.DFC_HEVE0max_C DFC_DisblMsk.DFC_HEVE1max_C DFC_DisblMsk.DFC_HFMmax_C DFC_DisblMsk.DFC_HiPSysHiPMaxLimExcdd_C DFC_DisblMsk.DFC_IVGdiCtlCvoErrMax_0_C DFC_DisblMsk.DFC_IVGdiCtlCvoErrMax_1_C DFC_DisblMsk.DFC_IVGdiCtlCvoErrMax_2_C DFC_DisblMsk.DFC_IVGdiCtlCvoErrMax_3_C DFC_DisblMsk.DFC_IVGdiCtlCvoErrMin_0_C DFC_DisblMsk.DFC_IVGdiCtlCvoErrMin_1_C DFC_DisblMsk.DFC_IVGdiCtlCvoErrMin_2_C DFC_DisblMsk.DFC_IVGdiCtlCvoErrMin_3_C DFC_DisblMsk.DFC_IVGdiCtlCvoErrMinMax_C DFC_DisblMsk.DFC_IVGdiCtlCvoSigPlausErrSmrCdn_C DFC_DisblMsk.DFC_IVGdiCtl_CvoErr_C DFC_DisblMsk.DFC_IVGdiCtl_CvoSigPlaus_0_C DFC_DisblMsk.DFC_IVGdiCtl_CvoSigPlaus_1_C DFC_DisblMsk.DFC_IVGdiCtl_CvoSigPlaus_2_C DFC_DisblMsk.DFC_IVGdiCtl_CvoSigPlaus_3_C DFC_DisblMsk.DFC_IntkAirTAirFltDsCrssMax_C DFC_DisblMsk.DFC_IntkAirTAirFltDsCrssMin_C DFC_DisblMsk.DFC_IntkAirTAirFltDsHSCMax_C DFC_DisblMsk.DFC_IntkAirTAirFltDsImps_C DFC_DisblMsk.DFC_IntkAirTAirFltDsPRCMax_C DFC_DisblMsk.DFC_IntkAirTAirFltDsPRCMin_C DFC_DisblMsk.DFC_IntkAirTAirFltDsSRCMax_C DFC_DisblMsk.DFC_IntkAirTAirFltDsSRCMin_C DFC_DisblMsk.DFC_IntkAirTAirFltDsSTC_C DFC_DisblMsk.DFC_IntkAirTIntkMnfldCrssMax_C DFC_DisblMsk.DFC_IntkAirTIntkMnfldCrssMin_C DFC_DisblMsk.DFC_IntkAirTIntkMnfldHSCMax_C DFC_DisblMsk.DFC_IntkAirTIntkMnfldImps_C DFC_DisblMsk.DFC_IntkAirTIntkMnfldPRCMax_C DFC_DisblMsk.DFC_IntkAirTIntkMnfldPRCMin_C DFC_DisblMsk.DFC_IntkAirTIntkMnfldSRCMax_C DFC_DisblMsk.DFC_IntkAirTIntkMnfldSRCMin_C DFC_DisblMsk.DFC_IntkAirTIntkMnfldSTC_C DFC_DisblMsk.DFC_KRREGRLMX_C DFC_DisblMsk.DFC_KRVEKOCVLCI_C DFC_DisblMsk.DFC_KRVEKOENCHMT_C DFC_DisblMsk.DFC_KRVEKOENCHMT0_C DFC_DisblMsk.DFC_KRVEKOENCHMT1_C DFC_DisblMsk.DFC_KRVEKOENCHMT2_C DFC_DisblMsk.DFC_KRVEKOENCHMT3_C DFC_DisblMsk.DFC_KRVEKOENCHMT4_C DFC_DisblMsk.DFC_KRVEKOENCHMT5_C DFC_DisblMsk.DFC_KRVEKOENCHMT6_C DFC_DisblMsk.DFC_KRVEKOENCHMT7_C DFC_DisblMsk.DFC_KRVEKORLMX_C DFC_DisblMsk.DFC_KRVEKORLMXL_C DFC_DisblMsk.DFC_KS1max_C DFC_DisblMsk.DFC_KS1min_C DFC_DisblMsk.DFC_LMmax_C DFC_DisblMsk.DFC_LZSRnpl_C DFC_DisblMsk.DFC_LamDynDiagS1B1_C DFC_DisblMsk.DFC_LeakIntkMnfldEmiInfl_C DFC_DisblMsk.DFC_LinFrameErrDCDC_C DFC_DisblMsk.DFC_LinOverrunErrDCDC_C DFC_DisblMsk.DFC_MD00max_C DFC_DisblMsk.DFC_MDBmax_C DFC_DisblMsk.DFC_MDCat_C DFC_DisblMsk.DFC_MDCatCrit_C DFC_DisblMsk.DFC_MDCatCurr_C DFC_DisblMsk.DFC_MDCyl_0_C DFC_DisblMsk.DFC_MDCyl_1_C DFC_DisblMsk.DFC_MDCyl_2_C DFC_DisblMsk.DFC_MDCyl_3_C DFC_DisblMsk.DFC_MDEmi_C DFC_DisblMsk.DFC_MDEmiStrt_C DFC_DisblMsk.DFC_MDFco_C DFC_DisblMsk.DFC_MDMpl_C DFC_DisblMsk.DFC_MDSegTiAdpn_C DFC_DisblMsk.DFC_MDmax_C DFC_DisblMsk.DFC_MFuOilMax_C DFC_DisblMsk.DFC_MOXEMM_SMU_ALM0_0_C DFC_DisblMsk.DFC_MOXEMM_SMU_ALM0_1_C DFC_DisblMsk.DFC_MOXEMM_SMU_ALM0_10_C DFC_DisblMsk.DFC_MOXEMM_SMU_ALM0_11_C DFC_DisblMsk.DFC_MOXEMM_SMU_ALM0_13_C DFC_DisblMsk.DFC_MOXEMM_SMU_ALM0_14_C DFC_DisblMsk.DFC_MOXEMM_SMU_ALM0_2_C DFC_DisblMsk.DFC_MOXEMM_SMU_ALM0_22_C DFC_DisblMsk.DFC_MOXEMM_SMU_ALM0_23_C DFC_DisblMsk.DFC_MOXEMM_SMU_ALM0_4_C DFC_DisblMsk.DFC_MOXEMM_SMU_ALM0_5_C DFC_DisblMsk.DFC_MOXEMM_SMU_ALM0_7_C DFC_DisblMsk.DFC_MOXEMM_SMU_ALM0_8_C DFC_DisblMsk.DFC_MOXEMM_SMU_ALM10_16_C DFC_DisblMsk.DFC_MOXEMM_SMU_ALM10_17_C DFC_DisblMsk.DFC_MOXEMM_SMU_ALM10_21_C DFC_DisblMsk.DFC_MOXEMM_SMU_ALM11_0_C DFC_DisblMsk.DFC_MOXEMM_SMU_ALM11_1_C DFC_DisblMsk.DFC_MOXEMM_SMU_ALM11_2_C DFC_DisblMsk.DFC_MOXEMM_SMU_ALM11_3_C DFC_DisblMsk.DFC_MOXEMM_SMU_ALM11_4_C DFC_DisblMsk.DFC_MOXEMM_SMU_ALM11_5_C DFC_DisblMsk.DFC_MOXEMM_SMU_ALM11_8_C DFC_DisblMsk.DFC_MOXEMM_SMU_ALM11_9_C DFC_DisblMsk.DFC_MOXEMM_SMU_ALM1_0_C DFC_DisblMsk.DFC_MOXEMM_SMU_ALM1_1_C DFC_DisblMsk.DFC_MOXEMM_SMU_ALM1_10_C DFC_DisblMsk.DFC_MOXEMM_SMU_ALM1_11_C DFC_DisblMsk.DFC_MOXEMM_SMU_ALM1_13_C DFC_DisblMsk.DFC_MOXEMM_SMU_ALM1_14_C DFC_DisblMsk.DFC_MOXEMM_SMU_ALM1_2_C DFC_DisblMsk.DFC_MOXEMM_SMU_ALM1_22_C DFC_DisblMsk.DFC_MOXEMM_SMU_ALM1_23_C DFC_DisblMsk.DFC_MOXEMM_SMU_ALM1_4_C DFC_DisblMsk.DFC_MOXEMM_SMU_ALM1_5_C DFC_DisblMsk.DFC_MOXEMM_SMU_ALM1_7_C DFC_DisblMsk.DFC_MOXEMM_SMU_ALM1_8_C DFC_DisblMsk.DFC_MOXEMM_SMU_ALM21_0_C DFC_DisblMsk.DFC_MOXEMM_SMU_ALM21_16_C DFC_DisblMsk.DFC_MOXEMM_SMU_ALM21_3_C DFC_DisblMsk.DFC_MOXEMM_SMU_ALM2_1_C DFC_DisblMsk.DFC_MOXEMM_SMU_ALM2_10_C DFC_DisblMsk.DFC_MOXEMM_SMU_ALM2_11_C DFC_DisblMsk.DFC_MOXEMM_SMU_ALM2_13_C DFC_DisblMsk.DFC_MOXEMM_SMU_ALM2_14_C DFC_DisblMsk.DFC_MOXEMM_SMU_ALM2_22_C DFC_DisblMsk.DFC_MOXEMM_SMU_ALM2_23_C DFC_DisblMsk.DFC_MOXEMM_SMU_ALM2_4_C DFC_DisblMsk.DFC_MOXEMM_SMU_ALM2_5_C DFC_DisblMsk.DFC_MOXEMM_SMU_ALM2_7_C DFC_DisblMsk.DFC_MOXEMM_SMU_ALM2_8_C DFC_DisblMsk.DFC_MOXEMM_SMU_ALM6_0_C DFC_DisblMsk.DFC_MOXEMM_SMU_ALM6_11_C DFC_DisblMsk.DFC_MOXEMM_SMU_ALM6_12_C DFC_DisblMsk.DFC_MOXEMM_SMU_ALM6_14_C DFC_DisblMsk.DFC_MOXEMM_SMU_ALM6_15_C DFC_DisblMsk.DFC_MOXEMM_SMU_ALM6_17_C DFC_DisblMsk.DFC_MOXEMM_SMU_ALM6_18_C DFC_DisblMsk.DFC_MOXEMM_SMU_ALM6_20_C DFC_DisblMsk.DFC_MOXEMM_SMU_ALM6_21_C DFC_DisblMsk.DFC_MOXEMM_SMU_ALM6_25_C DFC_DisblMsk.DFC_MOXEMM_SMU_ALM6_4_C DFC_DisblMsk.DFC_MOXEMM_SMU_ALM6_5_C DFC_DisblMsk.DFC_MOXEMM_SMU_ALM6_7_C DFC_DisblMsk.DFC_MOXEMM_SMU_ALM6_8_C DFC_DisblMsk.DFC_MOXEMM_SMU_ALM7_1_C DFC_DisblMsk.DFC_MOXEMM_SMU_ALM7_12_C DFC_DisblMsk.DFC_MOXEMM_SMU_ALM7_13_C DFC_DisblMsk.DFC_MOXEMM_SMU_ALM7_14_C DFC_DisblMsk.DFC_MOXEMM_SMU_ALM7_15_C DFC_DisblMsk.DFC_MOXEMM_SMU_ALM7_16_C DFC_DisblMsk.DFC_MOXEMM_SMU_ALM7_17_C DFC_DisblMsk.DFC_MOXEMM_SMU_ALM7_2_C DFC_DisblMsk.DFC_MOXEMM_SMU_ALM7_20_C DFC_DisblMsk.DFC_MOXEMM_SMU_ALM7_25_C DFC_DisblMsk.DFC_MOXEMM_SMU_ALM7_26_C DFC_DisblMsk.DFC_MOXEMM_SMU_ALM7_28_C DFC_DisblMsk.DFC_MOXEMM_SMU_ALM7_29_C DFC_DisblMsk.DFC_MOXEMM_SMU_ALM7_30_C DFC_DisblMsk.DFC_MOXEMM_SMU_ALM7_31_C DFC_DisblMsk.DFC_MOXEMM_SMU_ALM8_0_C DFC_DisblMsk.DFC_MOXEMM_SMU_ALM8_1_C DFC_DisblMsk.DFC_MOXEMM_SMU_ALM8_10_C DFC_DisblMsk.DFC_MOXEMM_SMU_ALM8_11_C DFC_DisblMsk.DFC_MOXEMM_SMU_ALM8_12_C DFC_DisblMsk.DFC_MOXEMM_SMU_ALM8_16_C DFC_DisblMsk.DFC_MOXEMM_SMU_ALM8_18_C DFC_DisblMsk.DFC_MOXEMM_SMU_ALM8_2_C DFC_DisblMsk.DFC_MOXEMM_SMU_ALM8_3_C DFC_DisblMsk.DFC_MOXEMM_SMU_ALM8_31_C DFC_DisblMsk.DFC_MOXEMM_SMU_ALM8_4_C DFC_DisblMsk.DFC_MOXEMM_SMU_ALM9_0_C DFC_DisblMsk.DFC_MOXEMM_SMU_ALM9_15_C DFC_DisblMsk.DFC_MOXEMM_SMU_ALM9_3_C DFC_DisblMsk.DFC_MoCADCNTP_C DFC_DisblMsk.DFC_MoCADCTst_C DFC_DisblMsk.DFC_MoCSOPICO_C DFC_DisblMsk.DFC_MoFAPP_C DFC_DisblMsk.DFC_MoFAirFilgPrdc_C DFC_DisblMsk.DFC_MoFAirFlCtOffGdi_C DFC_DisblMsk.DFC_MoFAirFlCylGdi_C DFC_DisblMsk.DFC_MoFAirFlFF_C DFC_DisblMsk.DFC_MoFAirFlIn_C DFC_DisblMsk.DFC_MoFAirFlMixCtlGdiChkAirFl_C DFC_DisblMsk.DFC_MoFAirFlMixCtlGdiChkCtrl_C DFC_DisblMsk.DFC_MoFAirFlMode_C DFC_DisblMsk.DFC_MoFESpd_C DFC_DisblMsk.DFC_MoFIACo_C DFC_DisblMsk.DFC_MoFICOL1_C DFC_DisblMsk.DFC_MoFICOL2_C DFC_DisblMsk.DFC_MoFStrt_C DFC_DisblMsk.DFC_MoFTrqCmp_C DFC_DisblMsk.DFC_MoFTrqCmpMax_C DFC_DisblMsk.DFC_MoFTrqCmpMin_C DFC_DisblMsk.DFC_MoFVarPostBldSel_C DFC_DisblMsk.DFC_MoXEMMHwLTMCUFW_C DFC_DisblMsk.DFC_MoXEMMHwLTMonBIST_C DFC_DisblMsk.DFC_MoXEMMHwLTRegMonTest_C DFC_DisblMsk.DFC_MoXEMMHwLTStbySMUAlvTest_C DFC_DisblMsk.DFC_MoXEMMHwLTTempSens_C DFC_DisblMsk.DFC_MoXEMMHwLTUCBCfg_C DFC_DisblMsk.DFC_NWSEmax_C DFC_DisblMsk.DFC_NWSmax_C DFC_DisblMsk.DFC_OCWDAABEActv_C DFC_DisblMsk.DFC_OCWDACom_C DFC_DisblMsk.DFC_OCWDAErrPin_C DFC_DisblMsk.DFC_OCWDAOvrVltg_C DFC_DisblMsk.DFC_ORAmax_C DFC_DisblMsk.DFC_ORAmin_C DFC_DisblMsk.DFC_OilPPlaus_C DFC_DisblMsk.DFC_PLLSUmax_C DFC_DisblMsk.DFC_PLLSUmin_C DFC_DisblMsk.DFC_PSR1max_C DFC_DisblMsk.DFC_PSRBmax_C DFC_DisblMsk.DFC_PSRBmin_C DFC_DisblMsk.DFC_PSRPmax_C DFC_DisblMsk.DFC_PSRPmin_C DFC_DisblMsk.DFC_PSRPsig_C DFC_DisblMsk.DFC_PSRmax_C DFC_DisblMsk.DFC_PUmax_C DFC_DisblMsk.DFC_P_VSE11_OL_C DFC_DisblMsk.DFC_P_VSE11_SCB_C DFC_DisblMsk.DFC_P_VSE11_SCG_C DFC_DisblMsk.DFC_PhyHighAPP1_C DFC_DisblMsk.DFC_PhyHighAPP2_C DFC_DisblMsk.DFC_PhyLowAPP1_C DFC_DisblMsk.DFC_PhyLowAPP2_C DFC_DisblMsk.DFC_SRCHighAPP1_C DFC_DisblMsk.DFC_SRCHighAPP2_C DFC_DisblMsk.DFC_SRCLowAPP1_C DFC_DisblMsk.DFC_SRCLowAPP2_C DFC_DisblMsk.DFC_SSpMon2_C DFC_DisblMsk.DFC_STHDRmax_C DFC_DisblMsk.DFC_SWReset_0_C DFC_DisblMsk.DFC_SWReset_1_C DFC_DisblMsk.DFC_SWReset_2_C DFC_DisblMsk.DFC_SyncAPP_C DFC_DisblMsk.DFC_TANKLnpl_C DFC_DisblMsk.DFC_TAmax_Dummy_C DFC_DisblMsk.DFC_TESFmax_C DFC_DisblMsk.DFC_TESGmax_C DFC_DisblMsk.DFC_TKAEmax_C DFC_DisblMsk.DFC_TKAEmin_C DFC_DisblMsk.DFC_TKARmax_C DFC_DisblMsk.DFC_TKARnpl_C DFC_DisblMsk.DFC_TMmax_Dummy_C DFC_DisblMsk.DFC_TUMmax_Dummy_C DFC_DisblMsk.DFC_TWCDPriCatB1_C DFC_DisblMsk.DFC_ThrVlvClsdPosnFirstOffsLrnImpoB1_C DFC_DisblMsk.DFC_ThrVlvClsdPosnOffsLrnImpoB1_C DFC_DisblMsk.DFC_ThrVlvClsdPosnOffsLrnMaxB1_C DFC_DisblMsk.DFC_ThrVlvClsdPosnOffsLrnMinB1_C DFC_DisblMsk.DFC_ThrVlvCtrlDeB1_C DFC_DisblMsk.DFC_ThrVlvDycB1_C DFC_DisblMsk.DFC_ThrVlvLimpAirPosnMaxAbsltDriftB1_C DFC_DisblMsk.DFC_ThrVlvLimpAirPosnMaxB1_C DFC_DisblMsk.DFC_ThrVlvLimpAirPosnMaxRelDriftB1_C DFC_DisblMsk.DFC_ThrVlvLimpAirPosnMinB1_C DFC_DisblMsk.DFC_ThrVlvOpenLoadB1_C DFC_DisblMsk.DFC_ThrVlvOpenSprgB1_C DFC_DisblMsk.DFC_ThrVlvOpenSprgSprdB1_C DFC_DisblMsk.DFC_ThrVlvOpenSprgTwnB1_C DFC_DisblMsk.DFC_ThrVlvOverTB1_C DFC_DisblMsk.DFC_ThrVlvRetSprgB1_C DFC_DisblMsk.DFC_ThrVlvRetSprgSprdB1_C DFC_DisblMsk.DFC_ThrVlvRetSprgTwnB1_C DFC_DisblMsk.DFC_ThrVlvSens1MaxB1_C DFC_DisblMsk.DFC_ThrVlvSens1NplB1_C DFC_DisblMsk.DFC_ThrVlvSens2MaxB1_C DFC_DisblMsk.DFC_ThrVlvSens2MinB1_C DFC_DisblMsk.DFC_ThrVlvSens2NplB1_C DFC_DisblMsk.DFC_ThrVlvShoCircB1_C DFC_DisblMsk.DFC_ThrVlvSpiErrB1_C DFC_DisblMsk.DFC_ThrvlvSens1MinB1_C DFC_DisblMsk.DFC_TiOffTBasdChkFast_C DFC_DisblMsk.DFC_TiOffTBasdChkSlow_C DFC_DisblMsk.DFC_UEGOSnsrMntdS1B1_C DFC_DisblMsk.DFC_VehVSig_C DFC_DisblMsk.DFC_VlvLftFbSwtIntk11SpclFail_C DFC_DisblMsk.DFC_VlvLftFbSwtIntk11StdFail_C DFC_DtcFuncUnit_C DFC_DtcGroup_C DFC_DtcSeverity_C /end DEF_CHARACTERISTIC
 FUNCTION_VERSION "30000.33.0_1.1.0" /end FUNCTION
/begin FUNCTION DFES "30000.73.0_2.0.0Diagnostic Fault Event Storage"
 /begin DEF_CHARACTERISTIC DFES_Cls.DFC_Unused_C DFES_Cls.DFC_AAVEmax_C DFES_Cls.DFC_AAVEmin_C DFES_Cls.DFC_AAVEsig_C DFES_Cls.DFC_AltIOACGFailr_C DFES_Cls.DFC_AltIOACGHiVltg_C DFES_Cls.DFC_AltIOACGLoVltg_C DFES_Cls.DFC_AltIOACGTHi_C DFES_Cls.DFC_AltIODConnACG_C DFES_Cls.DFC_BGOELWAF_C DFES_Cls.DFC_BattUHiFailr_C DFES_Cls.DFC_BattULoFailr_C DFES_Cls.DFC_BrkBstPDriftHiErr_C DFES_Cls.DFC_BrkBstPDriftLoErr_C DFES_Cls.DFC_BrkBstPSnsrStuck_C DFES_Cls.DFC_BrkMnSwtContOn_C DFES_Cls.DFC_BrkMnSwtNotStp_C DFES_Cls.DFC_BrkNpl_C DFES_Cls.DFC_BrkRdntSwtContOn_C DFES_Cls.DFC_BrkRdntSwtNotStp_C DFES_Cls.DFC_Clth3ONStuck_C DFES_Cls.DFC_Clth4OFFStuck_C DFES_Cls.DFC_ClthOFFStuck_C /end DEF_CHARACTERISTIC
 /begin IN_MEASUREMENT DSMAUX_stDCy DSM_TripChgAndClrFinshd /end IN_MEASUREMENT
 /begin OUT_MEASUREMENT DFES_stEepWrReq DFES_stErrLamp DFES_stErrLamp_msg DFES_stOutstate DFES_stPrgEvt_msg DSM_stProtdRamVld /end OUT_MEASUREMENT
 /begin LOC_MEASUREMENT DFES_ChkLstDltDemExCond_mp DFES_chkSt DFES_cnfSequence DFES_ctDef DFES_ctDel DFES_ctEntry DFES_ctFrq DFES_ctManuDef DFES_ctManuOk DFES_ctMIL DFES_ctOBD DFES_ctOBDPend DFES_ctOk DFES_ctPDTC DFES_ctSrv DFES_entrySt DFES_entryStPdtcStrd DFES_EnvBlock DFES_FrzFrVal DFES_idxSequence DFES_ISOFrstCnfDFC DFES_ISOFrstFailDFC DFES_ISORcntCnfDFC DFES_ISORcntFailDFC DFES_MonEvnt DFES_MonObjt DFES_MonParm DFES_MonPtr DFES_numDFC DFES_numDFCAck DFES_numDFCImdt DFES_numEntryAvl DFES_numEnvSize DFES_numExtdFrzFrmSize DFES_numFrzFrmSize DFES_OutLamps DFES_PDTCStore DFES_prioEntryImdt DFES_StateVisibility DFES_stChk DFES_stCounters DFES_stCtlSetting DFES_stDataImdt DFES_stDataImdtTrans DFES_stDTCRecUpdt DFES_stDTCStorage DFES_stEepBufChg DFES_stEntry DFES_stErrDia DFES_stInh DFES_stOrdImdt DFES_stOrdImdtTrans DFES_stPrgEvt DFES_stRepClrAftPwrFail DFES_xAsgnEnvAllDataSize /end LOC_MEASUREMENT
 FUNCTION_VERSION "30000.73.0_2.0.0" /end FUNCTION
/begin COMPU_METHOD B_TRUE "" TAB_VERB "%6.3" "" COMPU_TAB_REF B_TRUE /end COMPU_METHOD
/begin COMPU_VTAB B_TRUE "" TAB_VERB 2 0 "FALSE" 1 "TRUE" /end COMPU_VTAB
/begin COMPU_METHOD Dem_DTCGroup_Verb "" TAB_VERB "%6.3" "-" COMPU_TAB_REF Dem_DTCGroup_Verb /end COMPU_METHOD
/begin COMPU_VTAB Dem_DTCGroup_Verb "" TAB_VERB 6 0 "DEM_DTC_GROUP_NONE" 1 "DEM_DTC_GROUP_EMISSION_REL" 2 "DEM_DTC_GROUP_POWERTRAIN" 4 "DEM_DTC_GROUP_CHASSIS" 8 "DEM_DTC_GROUP_BODY" 16 "DEM_DTC_GROUP_NETWORK_COM" /end COMPU_VTAB
/begin COMPU_METHOD Dem_DTCSeverity_Verb "" TAB_VERB "%6.3" "-" COMPU_TAB_REF Dem_DTCSeverity_Verb /end COMPU_METHOD
/begin COMPU_VTAB Dem_DTCSeverity_Verb "" TAB_VERB 4 0 "DEM_SEVERITY_NO_SEVERITY" 32 "DEM_SEVERITY_MAINTENANCE_ONLY" 64 "DEM_SEVERITY_CHECK_AT_NEXT_HALT" 128 "DEM_SEVERITY_CHECK_IMMEDIATELY" /end COMPU_VTAB
/begin COMPU_METHOD DFCDFP_Verb "" TAB_VERB "%6.3" "-" COMPU_TAB_REF DFCDFP_Verb /end COMPU_METHOD
/begin COMPU_VTAB DFCDFP_Verb "" TAB_VERB 990 0 "NoEntry" 1 "DFC_AAVEmax" 2 "DFC_AAVEmin" 3 "DFC_AAVEsig" 4 "DFC_AltIOACGFailr" 5 "DFC_AltIOACGHiVltg" 6 "DFC_AltIOACGLoVltg" 7 "DFC_AltIOACGTHi" 8 "DFC_AltIODConnACG" 9 "DFC_BGOELWAF" 10 "DFC_BattUHiFailr" 11 "DFC_BattULoFailr" 12 "DFC_BrkBstPDriftHiErr" 13 "DFC_BrkBstPDriftLoErr" 14 "DFC_BrkBstPSnsrStuck" 15 "DFC_BrkMnSwtContOn" 16 "DFC_BrkMnSwtNotStp" 17 "DFC_BrkNpl" 18 "DFC_BrkRdntSwtContOn" 19 "DFC_BrkRdntSwtNotStp" 20 "DFC_Clth3ONStuck" 21 "DFC_Clth4OFFStuck" 22 "DFC_ClthOFFStuck" 23 "DFC_ClthONStuck" 24 "DFC_ClthStkFailInfo" 25 "DFC_ComACFailInfo" 26 "DFC_ComATFTValErr" 27 "DFC_ComATMILReq" 28 "DFC_ComAYCAChksum" 29 "DFC_ComAYCARingCnt" 30 "DFC_ComAYCATOut" 31 "DFC_ComAYCDChkSum" 32 "DFC_ComAYCDTOut" 33 "DFC_ComAYCFChksum" 34 "DFC_ComAYCFRingCnt" 35 "DFC_ComAYCFTOut" 36 "DFC_ComAYCGChksum" 37 "DFC_ComAYCGRingCnt" 38 "DFC_ComAYCGTOut" 39 "DFC_ComAYCIChkSum" 40 "DFC_ComAYCIRingCnt" 41 "DFC_ComAYCITOut" 42 "DFC_ComBCM1ChkSum" 43 "DFC_ComBCM1RingCnt" 44 "DFC_ComBCM1TOut" 45 "DFC_ComCANABusOffErr" 46 "DFC_ComCANBBusOffErr" 47 "DFC_ComCANCBusOffErr" 48 "DFC_ComCGW1ChkSum" 49 "DFC_ComCGW1RingCnt" 50 "DFC_ComCGW1TOut" 51 "DFC_ComConvBoostErr" 52 "DFC_ComConvSlipErr" 53 "DFC_ComDCDCPrfmncErr" 54 "DFC_ComDCDCTempWarn" 55 "DFC_ComEAT10Chksum" 56 "DFC_ComEAT10RingCnt" 57 "DFC_ComEAT10TOut" 58 "DFC_ComEAT11ChkSum" 59 "DFC_ComEAT11RingCnt" 60 "DFC_ComEAT11TOut" 61 "DFC_ComEAT12ChkSum" 62 "DFC_ComEAT12RingCnt" 63 "DFC_ComEAT12TOut" 64 "DFC_ComEAT13ChkSum" 65 "DFC_ComEAT13RingCnt" 66 "DFC_ComEAT13TOut" 67 "DFC_ComEAT1Chksum" 68 "DFC_ComEAT1RingCnt" 69 "DFC_ComEAT1TOut" 70 "DFC_ComEAT2ChkSum" 71 "DFC_ComEAT2RingCnt" 72 "DFC_ComEAT2TOut" 73 "DFC_ComEAT4ChkSum" 74 "DFC_ComEAT4RingCnt" 75 "DFC_ComEAT4TOut" 76 "DFC_ComEAT6Chksum" 77 "DFC_ComEAT6RingCnt" 78 "DFC_ComEAT6TOut" 79 "DFC_ComEAT7Chksum" 80 "DFC_ComEAT7RingCnt" 81 "DFC_ComEAT7TOut" 82 "DFC_ComEAT8Chksum" 83 "DFC_ComEAT8RingCnt" 84 "DFC_ComEAT8TOut" 85 "DFC_ComEATAChksum" 86 "DFC_ComEATARingCnt" 87 "DFC_ComEATATOut" 88 "DFC_ComEATBChkSum" 89 "DFC_ComEATBRingCnt" 90 "DFC_ComEATBTOut" 91 "DFC_ComEATCChksum" 92 "DFC_ComEATCRingCnt" 93 "DFC_ComEATCTOut" 94 "DFC_ComEPBBChkSum" 95 "DFC_ComEPBBRingCnt" 96 "DFC_ComEPBBTOut" 97 "DFC_ComEPBChksum" 98 "DFC_ComEPBTOut" 99 "DFC_ComEPBctRing" 100 "DFC_ComEPS1Chksum" 101 "DFC_ComEPS1RingCnt" 102 "DFC_ComEPS1TOut" 103 "DFC_ComEngCanRxErr" 104 "DFC_ComGrvySnsrErr" 105 "DFC_ComGwIMG1ChkSum" 106 "DFC_ComGwIMG1RingCnt" 107 "DFC_ComGwIMG1TOut" 108 "DFC_ComGwIMG3ChkSum" 109 "DFC_ComGwIMG3RingCnt" 110 "DFC_ComGwIMG3TOut" 111 "DFC_ComGwIMG4ChkSum" 112 "DFC_ComGwIMG4RingCnt" 113 "DFC_ComGwIMG4TOut" 114 "DFC_ComGwIMG5ChkSum" 115 "DFC_ComGwIMG5RingCnt" 116 "DFC_ComGwIMG5TOut" 117 "DFC_ComGwIMG6ChkSum" 118 "DFC_ComGwIMG6RingCnt" 119 "DFC_ComGwIMG6TOut" 120 "DFC_ComIDASBChksum" 121 "DFC_ComIDASBRingCnt" 122 "DFC_ComIDASBTOut" 123 "DFC_ComIMGMILReq" 124 "DFC_ComISSPrms" 125 "DFC_ComMETAChksum" 126 "DFC_ComMETAChksumPstDrv" 127 "DFC_ComMETARingCnt" 128 "DFC_ComMETARingCntPstDrv" 129 "DFC_ComMETATOut" 130 "DFC_ComMETATOutPstDrv" 131 "DFC_ComMETCChksum" 132 "DFC_ComMETCRingCnt" 133 "DFC_ComMETCTOut" 134 "DFC_ComMETDChksum" 135 "DFC_ComMETDRingCnt" 136 "DFC_ComMETDTOut" 137 "DFC_ComMETE2Chksum" 138 "DFC_ComMETE2RingCnt" 139 "DFC_ComMETE2TOut" 140 "DFC_ComMETFChksum" 141 "DFC_ComMETFRingCnt" 142 "DFC_ComMETFTOut" 143 "DFC_ComMETGChksum" 144 "DFC_ComMETGRingCnt" 145 "DFC_ComMETGTOut" 146 "DFC_ComMETH2Chksum" 147 "DFC_ComMETH2RingCnt" 148 "DFC_ComMETH2TOut" 149 "DFC_ComMETHChksum" 150 "DFC_ComMETHRingCnt" 151 "DFC_ComMETHTOut" 152 "DFC_ComMETIChksum" 153 "DFC_ComMETIRingCnt" 154 "DFC_ComMETITOut" 155 "DFC_ComMETKChksum" 156 "DFC_ComMETKRingCnt" 157 "DFC_ComMETKTOut" 158 "DFC_ComMETLChksum" 159 "DFC_ComMETLRingCnt" 160 "DFC_ComMETLTOut" 161 "DFC_ComMETMChksum" 162 "DFC_ComMETMRingCnt" 163 "DFC_ComMETMTOut" 164 "DFC_ComMETNChksum" 165 "DFC_ComMETNRingCnt" 166 "DFC_ComMETNTOut" 167 "DFC_ComMtrCom" 168 "DFC_ComPCUChkSum" 169 "DFC_ComPCURingCnt" 170 "DFC_ComPCUTOut" 171 "DFC_ComSRSAChksum" 172 "DFC_ComSRSARingCnt" 173 "DFC_ComSRSATOut" 174 "DFC_ComSRSBChksum" 175 "DFC_ComSRSBRingCnt" 176 "DFC_ComSRSBTOut" 177 "DFC_ComSRSChksum" 178 "DFC_ComSRSErr" 179 "DFC_ComSRSRingCnt" 180 "DFC_ComSRSTOut" 181 "DFC_ComVehSpdPndFltTCU" 182 "DFC_EbsChartcCurrErr" 183 "DFC_EbsSelfDiagErr" 184 "DFC_GEVlvPhaCsersIntkB1" 185 "DFC_GEVlvPhaPsOpenLoadIntkB1" 186 "DFC_GEVlvPhaPsShoToBattIntkB1" 187 "DFC_GEVlvPhaPsShoToGndIntkB1" 188 "DFC_GbxCANDigPlausErr" 189 "DFC_GbxNPos1SRCMax" 190 "DFC_GbxNPos1SRCMin" 191 "DFC_GbxNPos2SRCMax" 192 "DFC_GbxNPos2SRCMin" 193 "DFC_GbxNPosAlvChk" 194 "DFC_GbxNPosSyncErr" 195 "DFC_HEGOS2B1HtrPsMax" 196 "DFC_HEGOS2B1HtrPsMin" 197 "DFC_HEGOS2B1HtrPsSig" 198 "DFC_LinCSErrACG" 199 "DFC_LinCSErrAEV" 200 "DFC_LinCSErrDCDC" 201 "DFC_LinCSErrEBS" 202 "DFC_LinHdrTimeoutErrACG" 203 "DFC_LinHdrTimeoutErrAEV" 204 "DFC_LinHdrTimeoutErrDCDC" 205 "DFC_LinHdrTimeoutErrEBS" 206 "DFC_LinMsgTimeoutErrACG" 207 "DFC_LinMsgTimeoutErrAEV" 208 "DFC_LinMsgTimeoutErrDCDC" 209 "DFC_LinMsgTimeoutErrEBS" 210 "DFC_LinNoStrtComErr" 211 "DFC_LowPresOilP" 212 "DFC_MisfDetVWhlFrntLeOORHi" 213 "DFC_MisfDetVWhlFrntLeRatyHi" 214 "DFC_MisfDetVWhlFrntLeRatyLo" 215 "DFC_MisfDetVWhlFrntLeStuck" 216 "DFC_MisfDetVWhlFrntRiOORHi" 217 "DFC_MisfDetVWhlFrntRiRatyHi" 218 "DFC_MisfDetVWhlFrntRiRatyLo" 219 "DFC_MisfDetVWhlFrntRiStuck" 220 "DFC_MisfDetVWhlReLeOORHi" 221 "DFC_MisfDetVWhlReLeRatyHi" 222 "DFC_MisfDetVWhlReLeRatyLo" 223 "DFC_MisfDetVWhlReLeStuck" 224 "DFC_MisfDetVWhlReRiOORHi" 225 "DFC_MisfDetVWhlReRiRatyHi" 226 "DFC_MisfDetVWhlReRiRatyLo" 227 "DFC_MisfDetVWhlReRiStuck" 228 "DFC_MisfDetdVWhlFrntLePlaus" 229 "DFC_MisfDetdVWhlFrntRiPlaus" 230 "DFC_MisfDetdVWhlReLePlaus" 231 "DFC_MisfDetdVWhlReRiPlaus" 232 "DFC_PEnvSigRngMax" 233 "DFC_PEnvSigRngMin" 234 "DFC_StmFault" 235 "DFC_StrtCtOffPth" 236 "DFC_StrtCtlErr" 237 "DFC_StrtFault" 238 "DFC_StrtLckJudg1" 239 "DFC_StrtLckJudg2" 240 "DFC_StrtOL" 241 "DFC_StrtOL2" 242 "DFC_StrtSCB" 243 "DFC_StrtSCB2" 244 "DFC_StrtSCG" 245 "DFC_StrtSCG2" 246 "DFC_StrtStkRly1" 247 "DFC_StrtStkRly2" 248 "DFC_TEVEmax" 249 "DFC_TEVEmin" 250 "DFC_TEVEsig" 251 "DFC_UegoHeatrPrfmncLoS1B1" 252 "DFC_VehVAllPlaus" 253 "DFC_VehVNCSnsrElecFailr" 254 "DFC_VehVPlausCan" 255 "DFC_VehVPlausFco" 256 "DFC_VehVPlausPwr" 257 "DFC_VehVPlausV2N" 258 "DFC_VehVSpdSnsrAElecFailr" 259 "DFC_VehVSpdSnsrBElecFailr" 260 "DFC_ClthMax" 261 "DFC_IgnClPs_DevComErr" 262 "DFC_IgnClPs_LineOl_0" 263 "DFC_IgnClPs_LineOl_1" 264 "DFC_IgnClPs_LineOl_2" 265 "DFC_IgnClPs_LineOl_3" 266 "DFC_IgnClPs_LineScb_0" 267 "DFC_IgnClPs_LineScb_1" 268 "DFC_IgnClPs_LineScb_2" 269 "DFC_IgnClPs_LineScb_3" 270 "DFC_IgnClPs_LineScg_0" 271 "DFC_IgnClPs_LineScg_1" 272 "DFC_IgnClPs_LineScg_2" 273 "DFC_IgnClPs_LineScg_3" 274 "DFC_KRVEKOEVAB" 275 "DFC_KRVEKOEVAB0" 276 "DFC_KRVEKOEVAB1" 277 "DFC_KRVEKOEVAB2" 278 "DFC_KRVEKOEVAB3" 279 "DFC_UegoSigEcuAsicS1B1" 280 "DFC_UegoSigEcuComS1B1" 281 "DFC_UegoSigSnsrS1B1" 282 "DFC_UegoSigWireOlApesS1B1" 283 "DFC_UegoSigWireOlIpeS1B1" 284 "DFC_UegoSigWireOlReS1B1" 285 "DFC_UegoSigWireRCmpS1B1" 286 "DFC_UegoSigWireScbS1B1" 287 "DFC_UegoSigWireScgS1B1" 288 "DFC_AfsPhyRngHiB1" 289 "DFC_AfsPhyRngLoB1" 290 "DFC_AirCCmprOL" 291 "DFC_AirCCmprOvrTemp" 292 "DFC_AirCCmprSCB" 293 "DFC_AirCCmprSCG" 294 "DFC_AltErr" 295 "DFC_BattUSRCMax" 296 "DFC_BattUSRCMin" 297 "DFC_ComChksTCU1" 298 "DFC_ComChksTCU11" 299 "DFC_ComChksTCU12" 300 "DFC_ComChksTCU13" 301 "DFC_ComChksTCU2" 302 "DFC_ComChksTCU3" 303 "DFC_ComChksTCU4" 304 "DFC_ComCntTCU1" 305 "DFC_ComCntTCU11" 306 "DFC_ComCntTCU12" 307 "DFC_ComCntTCU13" 308 "DFC_ComCntTCU2" 309 "DFC_ComCntTCU3" 310 "DFC_ComCntTCU4" 311 "DFC_ComTOutTCU01" 312 "DFC_ComTOutTCU02" 313 "DFC_ComTOutTCU1" 314 "DFC_ComTOutTCU11" 315 "DFC_ComTOutTCU12" 316 "DFC_ComTOutTCU13" 317 "DFC_ComTOutTCU14" 318 "DFC_ComTOutTCU2" 319 "DFC_ComTOutTCU3" 320 "DFC_ComTOutTCU4" 321 "DFC_DevLibBattUHi" 322 "DFC_DevLibBattULo" 323 "DFC_EGRVlvFailSafeActv" 324 "DFC_EGRVlvGovDvtCld" 325 "DFC_EGRVlvPhysSRCMax" 326 "DFC_EGRVlvPhysSRCMin" 327 "DFC_FanDIOOL_0" 328 "DFC_FanDIOOL_1" 329 "DFC_FanDIOOvrTemp_0" 330 "DFC_FanDIOOvrTemp_1" 331 "DFC_FanDIOSCB_0" 332 "DFC_FanDIOSCB_1" 333 "DFC_FanDIOSCG_0" 334 "DFC_FanDIOSCG_1" 335 "DFC_MRlyDcOL" 336 "DFC_MRlyDcSCB" 337 "DFC_MRlyDcSCG" 338 "DFC_PSPOL" 339 "DFC_PSPOvrTemp" 340 "DFC_PSPSCB" 341 "DFC_PSPSCG" 342 "DFC_T50Err" 343 "DFC_ThrVlvLoBattB1" 344 "DFC_UegoSigOperPlausS1B1" 345 "DFC_VehVPhysRngHi" 346 "DFC_VehVSclOutOL" 347 "DFC_VehVSclOutOT" 348 "DFC_VehVSclOutSCB" 349 "DFC_VehVSclOutSCG" 350 "DFC_VehVSigFL" 351 "DFC_VehVSigFR" 352 "DFC_VehVSigRL" 353 "DFC_VehVSigRR" 354 "DFC_VehVSnsrARngHi" 355 "DFC_VehVSnsrBRngHi" 356 "DFC_VehVSpdRtyDiag" 357 "DFC_DHFHD" 358 "DFC_InjVlv_DI_DcDc" 359 "DFC_InjVlv_DI_NoLd_0" 360 "DFC_InjVlv_DI_NoLd_1" 361 "DFC_InjVlv_DI_NoLd_2" 362 "DFC_InjVlv_DI_NoLd_3" 363 "DFC_InjVlv_DI_ScBnk_0" 364 "DFC_InjVlv_DI_ScBnk_1" 365 "DFC_InjVlv_DI_ScBnk_2" 366 "DFC_InjVlv_DI_ScBnk_3" 367 "DFC_InjVlv_DI_ScCyl_0" 368 "DFC_InjVlv_DI_ScCyl_1" 369 "DFC_InjVlv_DI_ScCyl_2" 370 "DFC_InjVlv_DI_ScCyl_3" 371 "DFC_InjVlv_DI_ScHsLs_0" 372 "DFC_InjVlv_DI_ScHsLs_1" 373 "DFC_InjVlv_DI_ScHsLs_2" 374 "DFC_InjVlv_DI_ScHsLs_3" 375 "DFC_MfPsDiaOpenLoad1" 376 "DFC_MfPsDiaScHiS1" 377 "DFC_MfPsDiaScHiSLowS1" 378 "DFC_MfPsDiaScLowS1" 379 "DFC_ACEvpTPhysRngHi" 380 "DFC_ACEvpTPhysRngLo" 381 "DFC_ACEvpTSRCMax" 382 "DFC_ACEvpTSRCMin" 383 "DFC_AfsRawSigRngHiB1" 384 "DFC_AfsRawSigRngLoB1" 385 "DFC_AfsSnsrErrB1" 386 "DFC_AirCClntPAnaSRCMax" 387 "DFC_AirCClntPAnaSRCMin" 388 "DFC_AirCSwtNpl" 389 "DFC_AirCSwtSig" 390 "DFC_Brk" 391 "DFC_BrkBstSensSCB" 392 "DFC_BrkBstSensSCG" 393 "DFC_BrkSig" 394 "DFC_ClthSig" 395 "DFC_EGRVlvCurrLim" 396 "DFC_EGRVlvOL" 397 "DFC_EGRVlvOvrTemp" 398 "DFC_EGRVlvSCB" 399 "DFC_EGRVlvSCG" 400 "DFC_EGRVlvSRCMax" 401 "DFC_EGRVlvSRCMin" 402 "DFC_HLSDemOvhtEngLim" 403 "DFC_OilPSwmpSRCMax" 404 "DFC_OilPSwmpSRCMin" 405 "DFC_PIntkVUsLineHiB1" 406 "DFC_PIntkVUsLineLoB1" 407 "DFC_VehVPhysRngLo" 408 "DFC_VehVSigCan" 409 "DFC_VehVSigCanSafe" 410 "DFC_VlvLftFbOilPSnsrIntk11SRCMax" 411 "DFC_VlvLftFbOilPSnsrIntk11SRCMin" 412 "DFC_ClthNpl" 413 "DFC_GbxPNPosnDrvCdn" 414 "DFC_GbxPNPosnPlausy" 415 "DFC_AfsSigErrLineHiB1" 416 "DFC_AfsSigErrLineLoB1" 417 "DFC_PEnvCcMax" 418 "DFC_PEnvCcMin" 419 "DFC_PEnvRngChkMax" 420 "DFC_PEnvRngChkMin" 421 "DFC_PEnvSnsrPlaus" 422 "DFC_UEGOHeatrRlyPsOLS1B1" 423 "DFC_UEGOHeatrRlyPsSCBS1B1" 424 "DFC_UEGOHeatrRlyPsSCGS1B1" 425 "DFC_UegoHeatrWireOlS1B1" 426 "DFC_UegoHeatrWireScbS1B1" 427 "DFC_UegoHeatrWireScgS1B1" 428 "DFC_KnDetSens1PortAMax" 429 "DFC_KnDetSens1PortAMin" 430 "DFC_KnDetSens1PortBMax" 431 "DFC_KnDetSens1PortBMin" 432 "DFC_Clth2ONStuck" 433 "DFC_Clth2ONStuckLdc" 434 "DFC_Clth3ONStuckLdc" 435 "DFC_Clth3ONStuckPostDrv" 436 "DFC_Clth4ONStuck" 437 "DFC_Clth4ONStuckLdc" 438 "DFC_ComBCMUnit" 439 "DFC_ComDLCTCU01" 440 "DFC_ComDLCTCU02" 441 "DFC_ComDLCTCU1" 442 "DFC_ComDLCTCU11" 443 "DFC_ComDLCTCU12" 444 "DFC_ComDLCTCU13" 445 "DFC_ComDLCTCU14" 446 "DFC_ComDLCTCU2" 447 "DFC_ComDLCTCU3" 448 "DFC_ComDLCTCU4" 449 "DFC_ComEPSUnit" 450 "DFC_ComIDASBUnit" 451 "DFC_ComIMGUnit" 452 "DFC_ComMETUnit" 453 "DFC_ComSRSUnit" 454 "DFC_ComVSAUnit" 455 "DFC_EbsSocFlt" 456 "DFC_I14229VINErr" 457 "DFC_InjCatHeatgErr" 458 "DFC_InjSysMulInjDiagErr" 459 "DFC_LLRHmax" 460 "DFC_LLRHmin" 461 "DFC_LLRHnpl" 462 "DFC_LLRKHmax" 463 "DFC_LLRKHmin" 464 "DFC_LLRKHnpl" 465 "DFC_LinACGUnit" 466 "DFC_LinAEVUnit" 467 "DFC_LinEBSUnit" 468 "DFC_RoughRoad" 469 "DFC_SiaEEPRdErr" 470 "DFC_SiaEEPWrngCod" 471 "DFC_UegoHeatrStrtS1B1" 472 "DFC_BusDiagCANAPPLBusOff" 473 "DFC_BusDiagCANCANCBusOff" 474 "DFC_BusDiagCANVEHICLEBusOff" 475 "DFC_RBA_IODIAGPWR_rba_IoExtCy329_SignalVltSply_0" 476 "DFC_RBA_IODIAGPWR_rba_IoExtCy329_SignalVltSply_0OT" 477 "DFC_RBA_IODIAGPWR_rba_IoExtCy329_SignalVltSply_0OV" 478 "DFC_RBA_IODIAGPWR_rba_IoExtCy329_SignalVltSply_0SCG" 479 "DFC_RBA_IODIAGPWR_rba_IoExtCy329_SignalVltSply_0UV" 480 "DFC_RBA_IODIAGPWR_rba_IoExtCy329_SignalVltSply_1" 481 "DFC_RBA_IODIAGPWR_rba_IoExtCy329_SignalVltSply_1OT" 482 "DFC_RBA_IODIAGPWR_rba_IoExtCy329_SignalVltSply_1OV" 483 "DFC_RBA_IODIAGPWR_rba_IoExtCy329_SignalVltSply_1SCG" 484 "DFC_RBA_IODIAGPWR_rba_IoExtCy329_SignalVltSply_1UV" 485 "DFC_RBA_IODIAGPWR_rba_IoExtCy329_SignalVltSply_2" 486 "DFC_RBA_IODIAGPWR_rba_IoExtCy329_SignalVltSply_2OT" 487 "DFC_RBA_IODIAGPWR_rba_IoExtCy329_SignalVltSply_2OV" 488 "DFC_RBA_IODIAGPWR_rba_IoExtCy329_SignalVltSply_2SCG" 489 "DFC_RBA_IODIAGPWR_rba_IoExtCy329_SignalVltSply_2UV" 490 "DFC_CAN_E_TIMEOUT" 491 "DFC_LIN_E_TIMEOUT" 492 "DFC_MRlyOL" 493 "DFC_MRlySCB" 494 "DFC_MRlySCG" 495 "DFC_rba_MultiStackTrace_Threshold" 496 "DFC_BSWM_E_ACTION_FAILED" 497 "DFC_BSWM_E_INTRPTQUEUE_FULL" 498 "DFC_RBA_IOEXTLIB_KEEPALIVE_DRV" 499 "DFC_RBA_IOEXTLIB_KEEPALIVE_INI" 500 "DFC_rba_IoSigRtc_StopCounter" 501 "DFC_rba_MRly_Diag_Stk_Event" 502 "DFC_rba_MemDiag_MemReadErr" 503 "DFC_rba_MemDiag_MemWrErr" 504 "DFC_rba_SyC_IrrSwOffTrigEngRun_Event" 505 "DFC_rba_T15_Diag_ComInVld_Event" 506 "DFC_rba_T15_Diag_ComOff_HwOn_Event" 507 "DFC_rba_T15_Diag_ComOn_HwOff_Event" 508 "DFC_AAVmin" 509 "DFC_AGRSUS" 510 "DFC_AfsPlausDiagHi" 511 "DFC_AfsPlausDiagLo" 512 "DFC_AfsVrntDiagErrB1" 513 "DFC_AppAllSnsrDfct" 514 "DFC_BBKRnldg" 515 "DFC_BBKRsyne" 516 "DFC_BattUStdbyDiaOL" 517 "DFC_BigLeakIntkMnfldEmiInfl" 518 "DFC_BlkdLineTank" 519 "DFC_BrkMnSwtContOnWarnLmp" 520 "DFC_BrkMnSwtNotStpWarnLmp" 521 "DFC_BrkRdntSwtContOnWarnLmp" 522 "DFC_BrkRdntSwtNotStpWarnLmp" 523 "DFC_CEngDsTColdStrtMax" 524 "DFC_CEngDsTColdStrtMin" 525 "DFC_CEngDsTImps" 526 "DFC_CEngDsTPlausHSC" 527 "DFC_CEngDsTPlausLSC" 528 "DFC_CEngDsTPlausSTC" 529 "DFC_CEngDsTSRCMax" 530 "DFC_CEngDsTSRCMin" 531 "DFC_CEngDsTSig" 532 "DFC_CEngUsTColdStrtMax" 533 "DFC_CEngUsTColdStrtMin" 534 "DFC_CEngUsTLooseCnctn" 535 "DFC_CEngUsTSRCMax" 536 "DFC_CEngUsTSRCMin" 537 "DFC_ComDCDCACCFailr" 538 "DFC_DCDCFltDet" 539 "DFC_DKRSA" 540 "DFC_DKVSmax" 541 "DFC_DKnpl" 542 "DFC_DSKVRmax" 543 "DFC_DSKVRmin" 544 "DFC_DSKVRnpl" 545 "DFC_DSKVRsig" 546 "DFC_DSKVSsig" 547 "DFC_DSSmax" 548 "DFC_DSTDmax" 549 "DFC_DSTEmax" 550 "DFC_DSTEmin" 551 "DFC_DSTOFmax" 552 "DFC_DSTRmax" 553 "DFC_DSTRmin" 554 "DFC_DSTRnpl" 555 "DFC_DSTRsig" 556 "DFC_DSTTI" 557 "DFC_DSUmax" 558 "DFC_DiagCpv1DteskLoLoadStuckClsd" 559 "DFC_DiagCpv1DteskLoLoadStuckOpen" 560 "DFC_EGRVlvDrftClsd" 561 "DFC_EGRVlvDrftOpn" 562 "DFC_EGRVlvJamVlvClsd" 563 "DFC_EGRVlvJamVlvOpn" 564 "DFC_EGRVlvSprgBrk" 565 "DFC_EGRVlvTempMdlEEPErr" 566 "DFC_EGRVlvTmpErr" 567 "DFC_EGSDUS2B1LtrDly" 568 "DFC_EGSDUS2B1LtrPT1" 569 "DFC_EGSDUS2B1RtlDly" 570 "DFC_EGSDUS2B1RtlPT1" 571 "DFC_EGSDUS2B1TarLean" 572 "DFC_EGSDUS2B1TarRich" 573 "DFC_EONVmax" 574 "DFC_ETAKHLmax" 575 "DFC_ETAKHTmax" 576 "DFC_ETHSEmax" 577 "DFC_ETHSEmin" 578 "DFC_ETHSFmax" 579 "DFC_ETHSFmin" 580 "DFC_ETHSFsig" 581 "DFC_ETHSNPWmax" 582 "DFC_ETHSNPWmin" 583 "DFC_ETHSNPWsig" 584 "DFC_ETHSPLnpl" 585 "DFC_ETHSTPLnpl" 586 "DFC_EngICO" 587 "DFC_EngPrtOvrSpdMon" 588 "DFC_EpmCaSI1ErrSig" 589 "DFC_EpmCaSI1MntErr" 590 "DFC_EpmCaSI1NoSigMax" 591 "DFC_EpmCaSI1NoSigMin" 592 "DFC_EpmCaSI1OfsErr" 593 "DFC_EpmCrSDGI" 594 "DFC_EpmCrSErrSig" 595 "DFC_EpmCrSNoSig" 596 "DFC_EtaEngIdleNonCsers" 597 "DFC_EtaEngPtlNonCsers" 598 "DFC_FRAmax" 599 "DFC_FRAmin" 600 "DFC_FSTEmax" 601 "DFC_FSTEmin" 602 "DFC_FSTRmax" 603 "DFC_FSTRmin" 604 "DFC_FSTRnpl" 605 "DFC_FSTmax" 606 "DFC_FTDLAmax" 607 "DFC_FTDLAmin" 608 "DFC_FuPHiSnsrEleclmax" 609 "DFC_FuPHiSnsrEleclmin" 610 "DFC_FuPHiSnsrEleclnpl" 611 "DFC_FuPHiSnsrURngMax" 612 "DFC_FuPHiSnsrURngMin" 613 "DFC_FuSnsrPhyRngMaxErr" 614 "DFC_FuSnsrPhyRngMinErr" 615 "DFC_GEVlvLockPinDiagIntkB1" 616 "DFC_GEVlvPhaSlowIntkB1" 617 "DFC_GEVlvPhaTargIntkB1" 618 "DFC_GbxRvsSwtStk" 619 "DFC_HDRKHmax" 620 "DFC_HDRKHmin" 621 "DFC_HDRPLmax" 622 "DFC_HDRPLmin" 623 "DFC_HDRmax" 624 "DFC_HDRmin" 625 "DFC_HEGOS2B1ElecMax" 626 "DFC_HEGOS2B1ElecMin" 627 "DFC_HEGOS2B1ElecSig" 628 "DFC_HEGOS2B1HtgNpl" 629 "DFC_HEV00max" 630 "DFC_HEV01max" 631 "DFC_HEV02max" 632 "DFC_HEV03max" 633 "DFC_HEVE0max" 634 "DFC_HEVE1max" 635 "DFC_HFMmax" 636 "DFC_HiPSysHiPMaxLimExcdd" 637 "DFC_IVGdiCtlCvoErrMax_0" 638 "DFC_IVGdiCtlCvoErrMax_1" 639 "DFC_IVGdiCtlCvoErrMax_2" 640 "DFC_IVGdiCtlCvoErrMax_3" 641 "DFC_IVGdiCtlCvoErrMin_0" 642 "DFC_IVGdiCtlCvoErrMin_1" 643 "DFC_IVGdiCtlCvoErrMin_2" 644 "DFC_IVGdiCtlCvoErrMin_3" 645 "DFC_IVGdiCtlCvoErrMinMax" 646 "DFC_IVGdiCtlCvoSigPlausErrSmrCdn" 647 "DFC_IVGdiCtl_CvoErr" 648 "DFC_IVGdiCtl_CvoSigPlaus_0" 649 "DFC_IVGdiCtl_CvoSigPlaus_1" 650 "DFC_IVGdiCtl_CvoSigPlaus_2" 651 "DFC_IVGdiCtl_CvoSigPlaus_3" 652 "DFC_IntkAirTAirFltDsCrssMax" 653 "DFC_IntkAirTAirFltDsCrssMin" 654 "DFC_IntkAirTAirFltDsHSCMax" 655 "DFC_IntkAirTAirFltDsImps" 656 "DFC_IntkAirTAirFltDsPRCMax" 657 "DFC_IntkAirTAirFltDsPRCMin" 658 "DFC_IntkAirTAirFltDsSRCMax" 659 "DFC_IntkAirTAirFltDsSRCMin" 660 "DFC_IntkAirTAirFltDsSTC" 661 "DFC_IntkAirTIntkMnfldCrssMax" 662 "DFC_IntkAirTIntkMnfldCrssMin" 663 "DFC_IntkAirTIntkMnfldHSCMax" 664 "DFC_IntkAirTIntkMnfldImps" 665 "DFC_IntkAirTIntkMnfldPRCMax" 666 "DFC_IntkAirTIntkMnfldPRCMin" 667 "DFC_IntkAirTIntkMnfldSRCMax" 668 "DFC_IntkAirTIntkMnfldSRCMin" 669 "DFC_IntkAirTIntkMnfldSTC" 670 "DFC_KRREGRLMX" 671 "DFC_KRVEKOCVLCI" 672 "DFC_KRVEKOENCHMT" 673 "DFC_KRVEKOENCHMT0" 674 "DFC_KRVEKOENCHMT1" 675 "DFC_KRVEKOENCHMT2" 676 "DFC_KRVEKOENCHMT3" 677 "DFC_KRVEKOENCHMT4" 678 "DFC_KRVEKOENCHMT5" 679 "DFC_KRVEKOENCHMT6" 680 "DFC_KRVEKOENCHMT7" 681 "DFC_KRVEKORLMX" 682 "DFC_KRVEKORLMXL" 683 "DFC_KS1max" 684 "DFC_KS1min" 685 "DFC_LMmax" 686 "DFC_LZSRnpl" 687 "DFC_LamDynDiagS1B1" 688 "DFC_LeakIntkMnfldEmiInfl" 689 "DFC_LinFrameErrDCDC" 690 "DFC_LinOverrunErrDCDC" 691 "DFC_MD00max" 692 "DFC_MDBmax" 693 "DFC_MDCat" 694 "DFC_MDCatCrit" 695 "DFC_MDCatCurr" 696 "DFC_MDCyl_0" 697 "DFC_MDCyl_1" 698 "DFC_MDCyl_2" 699 "DFC_MDCyl_3" 700 "DFC_MDEmi" 701 "DFC_MDEmiStrt" 702 "DFC_MDFco" 703 "DFC_MDMpl" 704 "DFC_MDSegTiAdpn" 705 "DFC_MDmax" 706 "DFC_MFuOilMax" 707 "DFC_MOXEMM_SMU_ALM0_0" 708 "DFC_MOXEMM_SMU_ALM0_1" 709 "DFC_MOXEMM_SMU_ALM0_10" 710 "DFC_MOXEMM_SMU_ALM0_11" 711 "DFC_MOXEMM_SMU_ALM0_13" 712 "DFC_MOXEMM_SMU_ALM0_14" 713 "DFC_MOXEMM_SMU_ALM0_2" 714 "DFC_MOXEMM_SMU_ALM0_22" 715 "DFC_MOXEMM_SMU_ALM0_23" 716 "DFC_MOXEMM_SMU_ALM0_4" 717 "DFC_MOXEMM_SMU_ALM0_5" 718 "DFC_MOXEMM_SMU_ALM0_7" 719 "DFC_MOXEMM_SMU_ALM0_8" 720 "DFC_MOXEMM_SMU_ALM10_16" 721 "DFC_MOXEMM_SMU_ALM10_17" 722 "DFC_MOXEMM_SMU_ALM10_21" 723 "DFC_MOXEMM_SMU_ALM11_0" 724 "DFC_MOXEMM_SMU_ALM11_1" 725 "DFC_MOXEMM_SMU_ALM11_2" 726 "DFC_MOXEMM_SMU_ALM11_3" 727 "DFC_MOXEMM_SMU_ALM11_4" 728 "DFC_MOXEMM_SMU_ALM11_5" 729 "DFC_MOXEMM_SMU_ALM11_8" 730 "DFC_MOXEMM_SMU_ALM11_9" 731 "DFC_MOXEMM_SMU_ALM1_0" 732 "DFC_MOXEMM_SMU_ALM1_1" 733 "DFC_MOXEMM_SMU_ALM1_10" 734 "DFC_MOXEMM_SMU_ALM1_11" 735 "DFC_MOXEMM_SMU_ALM1_13" 736 "DFC_MOXEMM_SMU_ALM1_14" 737 "DFC_MOXEMM_SMU_ALM1_2" 738 "DFC_MOXEMM_SMU_ALM1_22" 739 "DFC_MOXEMM_SMU_ALM1_23" 740 "DFC_MOXEMM_SMU_ALM1_4" 741 "DFC_MOXEMM_SMU_ALM1_5" 742 "DFC_MOXEMM_SMU_ALM1_7" 743 "DFC_MOXEMM_SMU_ALM1_8" 744 "DFC_MOXEMM_SMU_ALM21_0" 745 "DFC_MOXEMM_SMU_ALM21_16" 746 "DFC_MOXEMM_SMU_ALM21_3" 747 "DFC_MOXEMM_SMU_ALM2_1" 748 "DFC_MOXEMM_SMU_ALM2_10" 749 "DFC_MOXEMM_SMU_ALM2_11" 750 "DFC_MOXEMM_SMU_ALM2_13" 751 "DFC_MOXEMM_SMU_ALM2_14" 752 "DFC_MOXEMM_SMU_ALM2_22" 753 "DFC_MOXEMM_SMU_ALM2_23" 754 "DFC_MOXEMM_SMU_ALM2_4" 755 "DFC_MOXEMM_SMU_ALM2_5" 756 "DFC_MOXEMM_SMU_ALM2_7" 757 "DFC_MOXEMM_SMU_ALM2_8" 758 "DFC_MOXEMM_SMU_ALM6_0" 759 "DFC_MOXEMM_SMU_ALM6_11" 760 "DFC_MOXEMM_SMU_ALM6_12" 761 "DFC_MOXEMM_SMU_ALM6_14" 762 "DFC_MOXEMM_SMU_ALM6_15" 763 "DFC_MOXEMM_SMU_ALM6_17" 764 "DFC_MOXEMM_SMU_ALM6_18" 765 "DFC_MOXEMM_SMU_ALM6_20" 766 "DFC_MOXEMM_SMU_ALM6_21" 767 "DFC_MOXEMM_SMU_ALM6_25" 768 "DFC_MOXEMM_SMU_ALM6_4" 769 "DFC_MOXEMM_SMU_ALM6_5" 770 "DFC_MOXEMM_SMU_ALM6_7" 771 "DFC_MOXEMM_SMU_ALM6_8" 772 "DFC_MOXEMM_SMU_ALM7_1" 773 "DFC_MOXEMM_SMU_ALM7_12" 774 "DFC_MOXEMM_SMU_ALM7_13" 775 "DFC_MOXEMM_SMU_ALM7_14" 776 "DFC_MOXEMM_SMU_ALM7_15" 777 "DFC_MOXEMM_SMU_ALM7_16" 778 "DFC_MOXEMM_SMU_ALM7_17" 779 "DFC_MOXEMM_SMU_ALM7_2" 780 "DFC_MOXEMM_SMU_ALM7_20" 781 "DFC_MOXEMM_SMU_ALM7_25" 782 "DFC_MOXEMM_SMU_ALM7_26" 783 "DFC_MOXEMM_SMU_ALM7_28" 784 "DFC_MOXEMM_SMU_ALM7_29" 785 "DFC_MOXEMM_SMU_ALM7_30" 786 "DFC_MOXEMM_SMU_ALM7_31" 787 "DFC_MOXEMM_SMU_ALM8_0" 788 "DFC_MOXEMM_SMU_ALM8_1" 789 "DFC_MOXEMM_SMU_ALM8_10" 790 "DFC_MOXEMM_SMU_ALM8_11" 791 "DFC_MOXEMM_SMU_ALM8_12" 792 "DFC_MOXEMM_SMU_ALM8_16" 793 "DFC_MOXEMM_SMU_ALM8_18" 794 "DFC_MOXEMM_SMU_ALM8_2" 795 "DFC_MOXEMM_SMU_ALM8_3" 796 "DFC_MOXEMM_SMU_ALM8_31" 797 "DFC_MOXEMM_SMU_ALM8_4" 798 "DFC_MOXEMM_SMU_ALM9_0" 799 "DFC_MOXEMM_SMU_ALM9_15" 800 "DFC_MOXEMM_SMU_ALM9_3" 801 "DFC_MoCADCNTP" 802 "DFC_MoCADCTst" 803 "DFC_MoCSOPICO" 804 "DFC_MoFAPP" 805 "DFC_MoFAirFilgPrdc" 806 "DFC_MoFAirFlCtOffGdi" 807 "DFC_MoFAirFlCylGdi" 808 "DFC_MoFAirFlFF" 809 "DFC_MoFAirFlIn" 810 "DFC_MoFAirFlMixCtlGdiChkAirFl" 811 "DFC_MoFAirFlMixCtlGdiChkCtrl" 812 "DFC_MoFAirFlMode" 813 "DFC_MoFESpd" 814 "DFC_MoFIACo" 815 "DFC_MoFICOL1" 816 "DFC_MoFICOL2" 817 "DFC_MoFStrt" 818 "DFC_MoFTrqCmp" 819 "DFC_MoFTrqCmpMax" 820 "DFC_MoFTrqCmpMin" 821 "DFC_MoFVarPostBldSel" 822 "DFC_MoXEMMHwLTMCUFW" 823 "DFC_MoXEMMHwLTMonBIST" 824 "DFC_MoXEMMHwLTRegMonTest" 825 "DFC_MoXEMMHwLTStbySMUAlvTest" 826 "DFC_MoXEMMHwLTTempSens" 827 "DFC_MoXEMMHwLTUCBCfg" 828 "DFC_NWSEmax" 829 "DFC_NWSmax" 830 "DFC_OCWDAABEActv" 831 "DFC_OCWDACom" 832 "DFC_OCWDAErrPin" 833 "DFC_OCWDAOvrVltg" 834 "DFC_ORAmax" 835 "DFC_ORAmin" 836 "DFC_OilPPlaus" 837 "DFC_PLLSUmax" 838 "DFC_PLLSUmin" 839 "DFC_PSR1max" 840 "DFC_PSRBmax" 841 "DFC_PSRBmin" 842 "DFC_PSRPmax" 843 "DFC_PSRPmin" 844 "DFC_PSRPsig" 845 "DFC_PSRmax" 846 "DFC_PUmax" 847 "DFC_P_VSE11_OL" 848 "DFC_P_VSE11_SCB" 849 "DFC_P_VSE11_SCG" 850 "DFC_PhyHighAPP1" 851 "DFC_PhyHighAPP2" 852 "DFC_PhyLowAPP1" 853 "DFC_PhyLowAPP2" 854 "DFC_SRCHighAPP1" 855 "DFC_SRCHighAPP2" 856 "DFC_SRCLowAPP1" 857 "DFC_SRCLowAPP2" 858 "DFC_SSpMon2" 859 "DFC_STHDRmax" 860 "DFC_SWReset_0" 861 "DFC_SWReset_1" 862 "DFC_SWReset_2" 863 "DFC_SyncAPP" 864 "DFC_TANKLnpl" 865 "DFC_TAmax_Dummy" 866 "DFC_TESFmax" 867 "DFC_TESGmax" 868 "DFC_TKAEmax" 869 "DFC_TKAEmin" 870 "DFC_TKARmax" 871 "DFC_TKARnpl" 872 "DFC_TMmax_Dummy" 873 "DFC_TUMmax_Dummy" 874 "DFC_TWCDPriCatB1" 875 "DFC_ThrVlvClsdPosnFirstOffsLrnImpoB1" 876 "DFC_ThrVlvClsdPosnOffsLrnImpoB1" 877 "DFC_ThrVlvClsdPosnOffsLrnMaxB1" 878 "DFC_ThrVlvClsdPosnOffsLrnMinB1" 879 "DFC_ThrVlvCtrlDeB1" 880 "DFC_ThrVlvDycB1" 881 "DFC_ThrVlvLimpAirPosnMaxAbsltDriftB1" 882 "DFC_ThrVlvLimpAirPosnMaxB1" 883 "DFC_ThrVlvLimpAirPosnMaxRelDriftB1" 884 "DFC_ThrVlvLimpAirPosnMinB1" 885 "DFC_ThrVlvOpenLoadB1" 886 "DFC_ThrVlvOpenSprgB1" 887 "DFC_ThrVlvOpenSprgSprdB1" 888 "DFC_ThrVlvOpenSprgTwnB1" 889 "DFC_ThrVlvOverTB1" 890 "DFC_ThrVlvRetSprgB1" 891 "DFC_ThrVlvRetSprgSprdB1" 892 "DFC_ThrVlvRetSprgTwnB1" 893 "DFC_ThrVlvSens1MaxB1" 894 "DFC_ThrVlvSens1NplB1" 895 "DFC_ThrVlvSens2MaxB1" 896 "DFC_ThrVlvSens2MinB1" 897 "DFC_ThrVlvSens2NplB1" 898 "DFC_ThrVlvShoCircB1" 899 "DFC_ThrVlvSpiErrB1" 900 "DFC_ThrvlvSens1MinB1" 901 "DFC_TiOffTBasdChkFast" 902 "DFC_TiOffTBasdChkSlow" 903 "DFC_UEGOSnsrMntdS1B1" 904 "DFC_VehVSig" 905 "DFC_VlvLftFbSwtIntk11SpclFail" 906 "DFC_VlvLftFbSwtIntk11StdFail" 907 "DFP_AAA" 908 "DFP_AAV" 909 "DFP_AAVE" 910 "DFP_AGRE" 911 "DFP_AGRS" 912 "DFP_DHFHD" 913 "DFP_DK" 914 "DFP_DK1P" 915 "DFP_DK2P" 916 "DFP_DKVS" 917 "DFP_DSKV" 918 "DFP_DSKVR" 919 "DFP_DSKVS" 920 "DFP_DSS" 921 "DFP_DSU" 922 "DFP_DVEE" 923 "DFP_DVEF" 924 "DFP_DVEFO" 925 "DFP_DVEL" 926 "DFP_DVEN" 927 "DFP_DVER" 928 "DFP_DVEU" 929 "DFP_DVEUB" 930 "DFP_DVEUW" 931 "DFP_DYLSU" 932 "DFP_ENWCS" 933 "DFP_ENWS" 934 "DFP_ENWSE" 935 "DFP_EONV" 936 "DFP_FP1P" 937 "DFP_FP2P" 938 "DFP_FRA" 939 "DFP_FST" 940 "DFP_FSTE" 941 "DFP_FSTR" 942 "DFP_FTDLA" 943 "DFP_HDR" 944 "DFP_HDRKH" 945 "DFP_HDRPL" 946 "DFP_HFM" 947 "DFP_HSH" 948 "DFP_HSHE" 949 "DFP_KAT" 950 "DFP_KPE" 951 "DFP_KS1" 952 "DFP_LLRH" 953 "DFP_LLRKH" 954 "DFP_LM" 955 "DFP_LSH" 956 "DFP_LZSR" 957 "DFP_MD" 958 "DFP_NWS" 959 "DFP_NWSE" 960 "DFP_ORA" 961 "DFP_PLLSU" 962 "DFP_PSR" 963 "DFP_PSR1" 964 "DFP_PSRB" 965 "DFP_PSRE" 966 "DFP_PSRP" 967 "DFP_PU" 968 "DFP_PUE" 969 "DFP_PUPL" 970 "DFP_PUR" 971 "DFP_STHDR" 972 "DFP_TA" 973 "DFP_TANKL" 974 "DFP_TANLCS" 975 "DFP_TANLPRC" 976 "DFP_TANLR" 977 "DFP_TASRCS" 978 "DFP_TASRE" 979 "DFP_TASRPRC" 980 "DFP_TASRR" 981 "DFP_TESF" 982 "DFP_TESG" 983 "DFP_TM" 984 "DFP_TMCS" 985 "DFP_TME" 986 "DFP_TMP" 987 "DFP_UB" 988 "DFP_VFZ" 989 "DFP_ZZZ" DEFAULT_VALUE "---" /end COMPU_VTAB
/begin COMPU_METHOD DFC_Verb "" TAB_VERB "%6.3" "-" COMPU_TAB_REF DFC_Verb /end COMPU_METHOD
/begin COMPU_VTAB DFC_Verb "" TAB_VERB 907 0 "DFC_Unused" 1 "DFC_AAVEmax" 2 "DFC_AAVEmin" 3 "DFC_AAVEsig" 508 "DFC_AAVmin" 379 "DFC_ACEvpTPhysRngHi" 380 "DFC_ACEvpTPhysRngLo" 381 "DFC_ACEvpTSRCMax" 382 "DFC_ACEvpTSRCMin" 288 "DFC_AfsPhyRngHiB1" 289 "DFC_AfsPhyRngLoB1" 510 "DFC_AfsPlausDiagHi" 511 "DFC_AfsPlausDiagLo" 383 "DFC_AfsRawSigRngHiB1" 384 "DFC_AfsRawSigRngLoB1" 415 "DFC_AfsSigErrLineHiB1" 416 "DFC_AfsSigErrLineLoB1" 385 "DFC_AfsSnsrErrB1" 512 "DFC_AfsVrntDiagErrB1" 509 "DFC_AGRSUS" 386 "DFC_AirCClntPAnaSRCMax" 387 "DFC_AirCClntPAnaSRCMin" 290 "DFC_AirCCmprOL" 291 "DFC_AirCCmprOvrTemp" 292 "DFC_AirCCmprSCB" 293 "DFC_AirCCmprSCG" 388 "DFC_AirCSwtNpl" 389 "DFC_AirCSwtSig" 294 "DFC_AltErr" 4 "DFC_AltIOACGFailr" 5 "DFC_AltIOACGHiVltg" 6 "DFC_AltIOACGLoVltg" 7 "DFC_AltIOACGTHi" 8 "DFC_AltIODConnACG" 513 "DFC_AppAllSnsrDfct" 10 "DFC_BattUHiFailr" 11 "DFC_BattULoFailr" 295 "DFC_BattUSRCMax" 296 "DFC_BattUSRCMin" 516 "DFC_BattUStdbyDiaOL" 514 "DFC_BBKRnldg" 515 "DFC_BBKRsyne" 9 "DFC_BGOELWAF" 517 "DFC_BigLeakIntkMnfldEmiInfl" 518 "DFC_BlkdLineTank" 390 "DFC_Brk" 12 "DFC_BrkBstPDriftHiErr" 13 "DFC_BrkBstPDriftLoErr" 14 "DFC_BrkBstPSnsrStuck" 391 "DFC_BrkBstSensSCB" 392 "DFC_BrkBstSensSCG" 15 "DFC_BrkMnSwtContOn" 519 "DFC_BrkMnSwtContOnWarnLmp" 16 "DFC_BrkMnSwtNotStp" 520 "DFC_BrkMnSwtNotStpWarnLmp" 17 "DFC_BrkNpl" 18 "DFC_BrkRdntSwtContOn" 521 "DFC_BrkRdntSwtContOnWarnLmp" 19 "DFC_BrkRdntSwtNotStp" 522 "DFC_BrkRdntSwtNotStpWarnLmp" 393 "DFC_BrkSig" 496 "DFC_BSWM_E_ACTION_FAILED" 497 "DFC_BSWM_E_INTRPTQUEUE_FULL" 472 "DFC_BusDiagCANAPPLBusOff" 473 "DFC_BusDiagCANCANCBusOff" 474 "DFC_BusDiagCANVEHICLEBusOff" 490 "DFC_CAN_E_TIMEOUT" 523 "DFC_CEngDsTColdStrtMax" 524 "DFC_CEngDsTColdStrtMin" 525 "DFC_CEngDsTImps" 526 "DFC_CEngDsTPlausHSC" 527 "DFC_CEngDsTPlausLSC" 528 "DFC_CEngDsTPlausSTC" 531 "DFC_CEngDsTSig" 529 "DFC_CEngDsTSRCMax" 530 "DFC_CEngDsTSRCMin" 532 "DFC_CEngUsTColdStrtMax" 533 "DFC_CEngUsTColdStrtMin" 534 "DFC_CEngUsTLooseCnctn" 535 "DFC_CEngUsTSRCMax" 536 "DFC_CEngUsTSRCMin" 432 "DFC_Clth2ONStuck" 433 "DFC_Clth2ONStuckLdc" 20 "DFC_Clth3ONStuck" 434 "DFC_Clth3ONStuckLdc" 435 "DFC_Clth3ONStuckPostDrv" 21 "DFC_Clth4OFFStuck" 436 "DFC_Clth4ONStuck" 437 "DFC_Clth4ONStuckLdc" 260 "DFC_ClthMax" 412 "DFC_ClthNpl" 22 "DFC_ClthOFFStuck" 23 "DFC_ClthONStuck" 394 "DFC_ClthSig" 24 "DFC_ClthStkFailInfo" 25 "DFC_ComACFailInfo" 26 "DFC_ComATFTValErr" 27 "DFC_ComATMILReq" 28 "DFC_ComAYCAChksum" 29 "DFC_ComAYCARingCnt" 30 "DFC_ComAYCATOut" 31 "DFC_ComAYCDChkSum" 32 "DFC_ComAYCDTOut" 33 "DFC_ComAYCFChksum" 34 "DFC_ComAYCFRingCnt" 35 "DFC_ComAYCFTOut" 36 "DFC_ComAYCGChksum" 37 "DFC_ComAYCGRingCnt" 38 "DFC_ComAYCGTOut" 39 "DFC_ComAYCIChkSum" 40 "DFC_ComAYCIRingCnt" 41 "DFC_ComAYCITOut" 42 "DFC_ComBCM1ChkSum" 43 "DFC_ComBCM1RingCnt" 44 "DFC_ComBCM1TOut" 438 "DFC_ComBCMUnit" 45 "DFC_ComCANABusOffErr" 46 "DFC_ComCANBBusOffErr" 47 "DFC_ComCANCBusOffErr" 48 "DFC_ComCGW1ChkSum" 49 "DFC_ComCGW1RingCnt" 50 "DFC_ComCGW1TOut" 297 "DFC_ComChksTCU1" 298 "DFC_ComChksTCU11" 299 "DFC_ComChksTCU12" 300 "DFC_ComChksTCU13" 301 "DFC_ComChksTCU2" 302 "DFC_ComChksTCU3" 303 "DFC_ComChksTCU4" 304 "DFC_ComCntTCU1" 305 "DFC_ComCntTCU11" 306 "DFC_ComCntTCU12" 307 "DFC_ComCntTCU13" 308 "DFC_ComCntTCU2" 309 "DFC_ComCntTCU3" 310 "DFC_ComCntTCU4" 51 "DFC_ComConvBoostErr" 52 "DFC_ComConvSlipErr" 537 "DFC_ComDCDCACCFailr" 53 "DFC_ComDCDCPrfmncErr" 54 "DFC_ComDCDCTempWarn" 439 "DFC_ComDLCTCU01" 440 "DFC_ComDLCTCU02" 441 "DFC_ComDLCTCU1" 442 "DFC_ComDLCTCU11" 443 "DFC_ComDLCTCU12" 444 "DFC_ComDLCTCU13" 445 "DFC_ComDLCTCU14" 446 "DFC_ComDLCTCU2" 447 "DFC_ComDLCTCU3" 448 "DFC_ComDLCTCU4" 55 "DFC_ComEAT10Chksum" 56 "DFC_ComEAT10RingCnt" 57 "DFC_ComEAT10TOut" 58 "DFC_ComEAT11ChkSum" 59 "DFC_ComEAT11RingCnt" 60 "DFC_ComEAT11TOut" 61 "DFC_ComEAT12ChkSum" 62 "DFC_ComEAT12RingCnt" 63 "DFC_ComEAT12TOut" 64 "DFC_ComEAT13ChkSum" 65 "DFC_ComEAT13RingCnt" 66 "DFC_ComEAT13TOut" 67 "DFC_ComEAT1Chksum" 68 "DFC_ComEAT1RingCnt" 69 "DFC_ComEAT1TOut" 70 "DFC_ComEAT2ChkSum" 71 "DFC_ComEAT2RingCnt" 72 "DFC_ComEAT2TOut" 73 "DFC_ComEAT4ChkSum" 74 "DFC_ComEAT4RingCnt" 75 "DFC_ComEAT4TOut" 76 "DFC_ComEAT6Chksum" 77 "DFC_ComEAT6RingCnt" 78 "DFC_ComEAT6TOut" 79 "DFC_ComEAT7Chksum" 80 "DFC_ComEAT7RingCnt" 81 "DFC_ComEAT7TOut" 82 "DFC_ComEAT8Chksum" 83 "DFC_ComEAT8RingCnt" 84 "DFC_ComEAT8TOut" 85 "DFC_ComEATAChksum" 86 "DFC_ComEATARingCnt" 87 "DFC_ComEATATOut" 88 "DFC_ComEATBChkSum" 89 "DFC_ComEATBRingCnt" 90 "DFC_ComEATBTOut" 91 "DFC_ComEATCChksum" 92 "DFC_ComEATCRingCnt" 93 "DFC_ComEATCTOut" 103 "DFC_ComEngCanRxErr" 94 "DFC_ComEPBBChkSum" 95 "DFC_ComEPBBRingCnt" 96 "DFC_ComEPBBTOut" 97 "DFC_ComEPBChksum" 99 "DFC_ComEPBctRing" 98 "DFC_ComEPBTOut" 100 "DFC_ComEPS1Chksum" 101 "DFC_ComEPS1RingCnt" 102 "DFC_ComEPS1TOut" 449 "DFC_ComEPSUnit" 104 "DFC_ComGrvySnsrErr" 105 "DFC_ComGwIMG1ChkSum" 106 "DFC_ComGwIMG1RingCnt" 107 "DFC_ComGwIMG1TOut" 108 "DFC_ComGwIMG3ChkSum" 109 "DFC_ComGwIMG3RingCnt" 110 "DFC_ComGwIMG3TOut" 111 "DFC_ComGwIMG4ChkSum" 112 "DFC_ComGwIMG4RingCnt" 113 "DFC_ComGwIMG4TOut" 114 "DFC_ComGwIMG5ChkSum" 115 "DFC_ComGwIMG5RingCnt" 116 "DFC_ComGwIMG5TOut" 117 "DFC_ComGwIMG6ChkSum" 118 "DFC_ComGwIMG6RingCnt" 119 "DFC_ComGwIMG6TOut" 120 "DFC_ComIDASBChksum" 121 "DFC_ComIDASBRingCnt" 122 "DFC_ComIDASBTOut" 450 "DFC_ComIDASBUnit" 123 "DFC_ComIMGMILReq" 451 "DFC_ComIMGUnit" 124 "DFC_ComISSPrms" 125 "DFC_ComMETAChksum" 126 "DFC_ComMETAChksumPstDrv" 127 "DFC_ComMETARingCnt" 128 "DFC_ComMETARingCntPstDrv" 129 "DFC_ComMETATOut" 130 "DFC_ComMETATOutPstDrv" 131 "DFC_ComMETCChksum" 132 "DFC_ComMETCRingCnt" 133 "DFC_ComMETCTOut" 134 "DFC_ComMETDChksum" 135 "DFC_ComMETDRingCnt" 136 "DFC_ComMETDTOut" 137 "DFC_ComMETE2Chksum" 138 "DFC_ComMETE2RingCnt" 139 "DFC_ComMETE2TOut" 140 "DFC_ComMETFChksum" 141 "DFC_ComMETFRingCnt" 142 "DFC_ComMETFTOut" 143 "DFC_ComMETGChksum" 144 "DFC_ComMETGRingCnt" 145 "DFC_ComMETGTOut" 146 "DFC_ComMETH2Chksum" 147 "DFC_ComMETH2RingCnt" 148 "DFC_ComMETH2TOut" 149 "DFC_ComMETHChksum" 150 "DFC_ComMETHRingCnt" 151 "DFC_ComMETHTOut" 152 "DFC_ComMETIChksum" 153 "DFC_ComMETIRingCnt" 154 "DFC_ComMETITOut" 155 "DFC_ComMETKChksum" 156 "DFC_ComMETKRingCnt" 157 "DFC_ComMETKTOut" 158 "DFC_ComMETLChksum" 159 "DFC_ComMETLRingCnt" 160 "DFC_ComMETLTOut" 161 "DFC_ComMETMChksum" 162 "DFC_ComMETMRingCnt" 163 "DFC_ComMETMTOut" 164 "DFC_ComMETNChksum" 165 "DFC_ComMETNRingCnt" 166 "DFC_ComMETNTOut" 452 "DFC_ComMETUnit" 167 "DFC_ComMtrCom" 168 "DFC_ComPCUChkSum" 169 "DFC_ComPCURingCnt" 170 "DFC_ComPCUTOut" 171 "DFC_ComSRSAChksum" 172 "DFC_ComSRSARingCnt" 173 "DFC_ComSRSATOut" 174 "DFC_ComSRSBChksum" 175 "DFC_ComSRSBRingCnt" 176 "DFC_ComSRSBTOut" 177 "DFC_ComSRSChksum" 178 "DFC_ComSRSErr" 179 "DFC_ComSRSRingCnt" 180 "DFC_ComSRSTOut" 453 "DFC_ComSRSUnit" 311 "DFC_ComTOutTCU01" 312 "DFC_ComTOutTCU02" 313 "DFC_ComTOutTCU1" 314 "DFC_ComTOutTCU11" 315 "DFC_ComTOutTCU12" 316 "DFC_ComTOutTCU13" 317 "DFC_ComTOutTCU14" 318 "DFC_ComTOutTCU2" 319 "DFC_ComTOutTCU3" 320 "DFC_ComTOutTCU4" 181 "DFC_ComVehSpdPndFltTCU" 454 "DFC_ComVSAUnit" 538 "DFC_DCDCFltDet" 321 "DFC_DevLibBattUHi" 322 "DFC_DevLibBattULo" 357 "DFC_DHFHD" 558 "DFC_DiagCpv1DteskLoLoadStuckClsd" 559 "DFC_DiagCpv1DteskLoLoadStuckOpen" 541 "DFC_DKnpl" 539 "DFC_DKRSA" 540 "DFC_DKVSmax" 542 "DFC_DSKVRmax" 543 "DFC_DSKVRmin" 544 "DFC_DSKVRnpl" 545 "DFC_DSKVRsig" 546 "DFC_DSKVSsig" 547 "DFC_DSSmax" 548 "DFC_DSTDmax" 549 "DFC_DSTEmax" 550 "DFC_DSTEmin" 551 "DFC_DSTOFmax" 552 "DFC_DSTRmax" 553 "DFC_DSTRmin" 554 "DFC_DSTRnpl" 555 "DFC_DSTRsig" 556 "DFC_DSTTI" 557 "DFC_DSUmax" 182 "DFC_EbsChartcCurrErr" 183 "DFC_EbsSelfDiagErr" 455 "DFC_EbsSocFlt" 395 "DFC_EGRVlvCurrLim" 560 "DFC_EGRVlvDrftClsd" 561 "DFC_EGRVlvDrftOpn" 323 "DFC_EGRVlvFailSafeActv" 324 "DFC_EGRVlvGovDvtCld" 562 "DFC_EGRVlvJamVlvClsd" 563 "DFC_EGRVlvJamVlvOpn" 396 "DFC_EGRVlvOL" 397 "DFC_EGRVlvOvrTemp" 325 "DFC_EGRVlvPhysSRCMax" 326 "DFC_EGRVlvPhysSRCMin" 398 "DFC_EGRVlvSCB" 399 "DFC_EGRVlvSCG" 564 "DFC_EGRVlvSprgBrk" 400 "DFC_EGRVlvSRCMax" 401 "DFC_EGRVlvSRCMin" 565 "DFC_EGRVlvTempMdlEEPErr" 566 "DFC_EGRVlvTmpErr" 567 "DFC_EGSDUS2B1LtrDly" 568 "DFC_EGSDUS2B1LtrPT1" 569 "DFC_EGSDUS2B1RtlDly" 570 "DFC_EGSDUS2B1RtlPT1" 571 "DFC_EGSDUS2B1TarLean" 572 "DFC_EGSDUS2B1TarRich" 586 "DFC_EngICO" 587 "DFC_EngPrtOvrSpdMon" 573 "DFC_EONVmax" 588 "DFC_EpmCaSI1ErrSig" 589 "DFC_EpmCaSI1MntErr" 590 "DFC_EpmCaSI1NoSigMax" 591 "DFC_EpmCaSI1NoSigMin" 592 "DFC_EpmCaSI1OfsErr" 593 "DFC_EpmCrSDGI" 594 "DFC_EpmCrSErrSig" 595 "DFC_EpmCrSNoSig" 596 "DFC_EtaEngIdleNonCsers" 597 "DFC_EtaEngPtlNonCsers" 574 "DFC_ETAKHLmax" 575 "DFC_ETAKHTmax" 576 "DFC_ETHSEmax" 577 "DFC_ETHSEmin" 578 "DFC_ETHSFmax" 579 "DFC_ETHSFmin" 580 "DFC_ETHSFsig" 581 "DFC_ETHSNPWmax" 582 "DFC_ETHSNPWmin" 583 "DFC_ETHSNPWsig" 584 "DFC_ETHSPLnpl" 585 "DFC_ETHSTPLnpl" 327 "DFC_FanDIOOL_0" 328 "DFC_FanDIOOL_1" 329 "DFC_FanDIOOvrTemp_0" 330 "DFC_FanDIOOvrTemp_1" 331 "DFC_FanDIOSCB_0" 332 "DFC_FanDIOSCB_1" 333 "DFC_FanDIOSCG_0" 334 "DFC_FanDIOSCG_1" 598 "DFC_FRAmax" 599 "DFC_FRAmin" 600 "DFC_FSTEmax" 601 "DFC_FSTEmin" 605 "DFC_FSTmax" 602 "DFC_FSTRmax" 603 "DFC_FSTRmin" 604 "DFC_FSTRnpl" 606 "DFC_FTDLAmax" 607 "DFC_FTDLAmin" 608 "DFC_FuPHiSnsrEleclmax" 609 "DFC_FuPHiSnsrEleclmin" 610 "DFC_FuPHiSnsrEleclnpl" 611 "DFC_FuPHiSnsrURngMax" 612 "DFC_FuPHiSnsrURngMin" 613 "DFC_FuSnsrPhyRngMaxErr" 614 "DFC_FuSnsrPhyRngMinErr" 188 "DFC_GbxCANDigPlausErr" 189 "DFC_GbxNPos1SRCMax" 190 "DFC_GbxNPos1SRCMin" 191 "DFC_GbxNPos2SRCMax" 192 "DFC_GbxNPos2SRCMin" 193 "DFC_GbxNPosAlvChk" 194 "DFC_GbxNPosSyncErr" 413 "DFC_GbxPNPosnDrvCdn" 414 "DFC_GbxPNPosnPlausy" 618 "DFC_GbxRvsSwtStk" 615 "DFC_GEVlvLockPinDiagIntkB1" 184 "DFC_GEVlvPhaCsersIntkB1" 185 "DFC_GEVlvPhaPsOpenLoadIntkB1" 186 "DFC_GEVlvPhaPsShoToBattIntkB1" 187 "DFC_GEVlvPhaPsShoToGndIntkB1" 616 "DFC_GEVlvPhaSlowIntkB1" 617 "DFC_GEVlvPhaTargIntkB1" 619 "DFC_HDRKHmax" 620 "DFC_HDRKHmin" 623 "DFC_HDRmax" 624 "DFC_HDRmin" 621 "DFC_HDRPLmax" 622 "DFC_HDRPLmin" 625 "DFC_HEGOS2B1ElecMax" 626 "DFC_HEGOS2B1ElecMin" 627 "DFC_HEGOS2B1ElecSig" 628 "DFC_HEGOS2B1HtgNpl" 195 "DFC_HEGOS2B1HtrPsMax" 196 "DFC_HEGOS2B1HtrPsMin" 197 "DFC_HEGOS2B1HtrPsSig" 629 "DFC_HEV00max" 630 "DFC_HEV01max" 631 "DFC_HEV02max" 632 "DFC_HEV03max" 633 "DFC_HEVE0max" 634 "DFC_HEVE1max" 635 "DFC_HFMmax" 636 "DFC_HiPSysHiPMaxLimExcdd" 402 "DFC_HLSDemOvhtEngLim" 456 "DFC_I14229VINErr" 261 "DFC_IgnClPs_DevComErr" 262 "DFC_IgnClPs_LineOl_0" 263 "DFC_IgnClPs_LineOl_1" 264 "DFC_IgnClPs_LineOl_2" 265 "DFC_IgnClPs_LineOl_3" 266 "DFC_IgnClPs_LineScb_0" 267 "DFC_IgnClPs_LineScb_1" 268 "DFC_IgnClPs_LineScb_2" 269 "DFC_IgnClPs_LineScb_3" 270 "DFC_IgnClPs_LineScg_0" 271 "DFC_IgnClPs_LineScg_1" 272 "DFC_IgnClPs_LineScg_2" 273 "DFC_IgnClPs_LineScg_3" 457 "DFC_InjCatHeatgErr" 458 "DFC_InjSysMulInjDiagErr" 358 "DFC_InjVlv_DI_DcDc" 359 "DFC_InjVlv_DI_NoLd_0" 360 "DFC_InjVlv_DI_NoLd_1" 361 "DFC_InjVlv_DI_NoLd_2" 362 "DFC_InjVlv_DI_NoLd_3" 363 "DFC_InjVlv_DI_ScBnk_0" 364 "DFC_InjVlv_DI_ScBnk_1" 365 "DFC_InjVlv_DI_ScBnk_2" 366 "DFC_InjVlv_DI_ScBnk_3" 367 "DFC_InjVlv_DI_ScCyl_0" 368 "DFC_InjVlv_DI_ScCyl_1" 369 "DFC_InjVlv_DI_ScCyl_2" 370 "DFC_InjVlv_DI_ScCyl_3" 371 "DFC_InjVlv_DI_ScHsLs_0" 372 "DFC_InjVlv_DI_ScHsLs_1" 373 "DFC_InjVlv_DI_ScHsLs_2" 374 "DFC_InjVlv_DI_ScHsLs_3" 652 "DFC_IntkAirTAirFltDsCrssMax" 653 "DFC_IntkAirTAirFltDsCrssMin" 654 "DFC_IntkAirTAirFltDsHSCMax" 655 "DFC_IntkAirTAirFltDsImps" 656 "DFC_IntkAirTAirFltDsPRCMax" 657 "DFC_IntkAirTAirFltDsPRCMin" 658 "DFC_IntkAirTAirFltDsSRCMax" 659 "DFC_IntkAirTAirFltDsSRCMin" 660 "DFC_IntkAirTAirFltDsSTC" 661 "DFC_IntkAirTIntkMnfldCrssMax" 662 "DFC_IntkAirTIntkMnfldCrssMin" 663 "DFC_IntkAirTIntkMnfldHSCMax" 664 "DFC_IntkAirTIntkMnfldImps" 665 "DFC_IntkAirTIntkMnfldPRCMax" 666 "DFC_IntkAirTIntkMnfldPRCMin" 667 "DFC_IntkAirTIntkMnfldSRCMax" 668 "DFC_IntkAirTIntkMnfldSRCMin" 669 "DFC_IntkAirTIntkMnfldSTC" 647 "DFC_IVGdiCtl_CvoErr" 648 "DFC_IVGdiCtl_CvoSigPlaus_0" 649 "DFC_IVGdiCtl_CvoSigPlaus_1" 650 "DFC_IVGdiCtl_CvoSigPlaus_2" 651 "DFC_IVGdiCtl_CvoSigPlaus_3" 637 "DFC_IVGdiCtlCvoErrMax_0" 638 "DFC_IVGdiCtlCvoErrMax_1" 639 "DFC_IVGdiCtlCvoErrMax_2" 640 "DFC_IVGdiCtlCvoErrMax_3" 641 "DFC_IVGdiCtlCvoErrMin_0" 642 "DFC_IVGdiCtlCvoErrMin_1" 643 "DFC_IVGdiCtlCvoErrMin_2" 644 "DFC_IVGdiCtlCvoErrMin_3" 645 "DFC_IVGdiCtlCvoErrMinMax" 646 "DFC_IVGdiCtlCvoSigPlausErrSmrCdn" 428 "DFC_KnDetSens1PortAMax" 429 "DFC_KnDetSens1PortAMin" 430 "DFC_KnDetSens1PortBMax" 431 "DFC_KnDetSens1PortBMin" 670 "DFC_KRREGRLMX" 671 "DFC_KRVEKOCVLCI" 672 "DFC_KRVEKOENCHMT" 673 "DFC_KRVEKOENCHMT0" 674 "DFC_KRVEKOENCHMT1" 675 "DFC_KRVEKOENCHMT2" 676 "DFC_KRVEKOENCHMT3" 677 "DFC_KRVEKOENCHMT4" 678 "DFC_KRVEKOENCHMT5" 679 "DFC_KRVEKOENCHMT6" 680 "DFC_KRVEKOENCHMT7" 274 "DFC_KRVEKOEVAB" 275 "DFC_KRVEKOEVAB0" 276 "DFC_KRVEKOEVAB1" 277 "DFC_KRVEKOEVAB2" 278 "DFC_KRVEKOEVAB3" 681 "DFC_KRVEKORLMX" 682 "DFC_KRVEKORLMXL" 683 "DFC_KS1max" 684 "DFC_KS1min" 687 "DFC_LamDynDiagS1B1" 688 "DFC_LeakIntkMnfldEmiInfl" 491 "DFC_LIN_E_TIMEOUT" 465 "DFC_LinACGUnit" 466 "DFC_LinAEVUnit" 198 "DFC_LinCSErrACG" 199 "DFC_LinCSErrAEV" 200 "DFC_LinCSErrDCDC" 201 "DFC_LinCSErrEBS" 467 "DFC_LinEBSUnit" 689 "DFC_LinFrameErrDCDC" 202 "DFC_LinHdrTimeoutErrACG" 203 "DFC_LinHdrTimeoutErrAEV" 204 "DFC_LinHdrTimeoutErrDCDC" 205 "DFC_LinHdrTimeoutErrEBS" 206 "DFC_LinMsgTimeoutErrACG" 207 "DFC_LinMsgTimeoutErrAEV" 208 "DFC_LinMsgTimeoutErrDCDC" 209 "DFC_LinMsgTimeoutErrEBS" 210 "DFC_LinNoStrtComErr" 690 "DFC_LinOverrunErrDCDC" 459 "DFC_LLRHmax" 460 "DFC_LLRHmin" 461 "DFC_LLRHnpl" 462 "DFC_LLRKHmax" 463 "DFC_LLRKHmin" 464 "DFC_LLRKHnpl" 685 "DFC_LMmax" 211 "DFC_LowPresOilP" 686 "DFC_LZSRnpl" 691 "DFC_MD00max" 692 "DFC_MDBmax" 693 "DFC_MDCat" 694 "DFC_MDCatCrit" 695 "DFC_MDCatCurr" 696 "DFC_MDCyl_0" 697 "DFC_MDCyl_1" 698 "DFC_MDCyl_2" 699 "DFC_MDCyl_3" 700 "DFC_MDEmi" 701 "DFC_MDEmiStrt" 702 "DFC_MDFco" 705 "DFC_MDmax" 703 "DFC_MDMpl" 704 "DFC_MDSegTiAdpn" 375 "DFC_MfPsDiaOpenLoad1" 376 "DFC_MfPsDiaScHiS1" 377 "DFC_MfPsDiaScHiSLowS1" 378 "DFC_MfPsDiaScLowS1" 706 "DFC_MFuOilMax" 228 "DFC_MisfDetdVWhlFrntLePlaus" 229 "DFC_MisfDetdVWhlFrntRiPlaus" 230 "DFC_MisfDetdVWhlReLePlaus" 231 "DFC_MisfDetdVWhlReRiPlaus" 212 "DFC_MisfDetVWhlFrntLeOORHi" 213 "DFC_MisfDetVWhlFrntLeRatyHi" 214 "DFC_MisfDetVWhlFrntLeRatyLo" 215 "DFC_MisfDetVWhlFrntLeStuck" 216 "DFC_MisfDetVWhlFrntRiOORHi" 217 "DFC_MisfDetVWhlFrntRiRatyHi" 218 "DFC_MisfDetVWhlFrntRiRatyLo" 219 "DFC_MisfDetVWhlFrntRiStuck" 220 "DFC_MisfDetVWhlReLeOORHi" 221 "DFC_MisfDetVWhlReLeRatyHi" 222 "DFC_MisfDetVWhlReLeRatyLo" 223 "DFC_MisfDetVWhlReLeStuck" 224 "DFC_MisfDetVWhlReRiOORHi" 225 "DFC_MisfDetVWhlReRiRatyHi" 226 "DFC_MisfDetVWhlReRiRatyLo" 227 "DFC_MisfDetVWhlReRiStuck" 801 "DFC_MoCADCNTP" 802 "DFC_MoCADCTst" 803 "DFC_MoCSOPICO" 805 "DFC_MoFAirFilgPrdc" 806 "DFC_MoFAirFlCtOffGdi" 807 "DFC_MoFAirFlCylGdi" 808 "DFC_MoFAirFlFF" 809 "DFC_MoFAirFlIn" 810 "DFC_MoFAirFlMixCtlGdiChkAirFl" 811 "DFC_MoFAirFlMixCtlGdiChkCtrl" 812 "DFC_MoFAirFlMode" 804 "DFC_MoFAPP" 813 "DFC_MoFESpd" 814 "DFC_MoFIACo" 815 "DFC_MoFICOL1" 816 "DFC_MoFICOL2" 817 "DFC_MoFStrt" 818 "DFC_MoFTrqCmp" 819 "DFC_MoFTrqCmpMax" 820 "DFC_MoFTrqCmpMin" 821 "DFC_MoFVarPostBldSel" 707 "DFC_MOXEMM_SMU_ALM0_0" 708 "DFC_MOXEMM_SMU_ALM0_1" 709 "DFC_MOXEMM_SMU_ALM0_10" 710 "DFC_MOXEMM_SMU_ALM0_11" 711 "DFC_MOXEMM_SMU_ALM0_13" 712 "DFC_MOXEMM_SMU_ALM0_14" 713 "DFC_MOXEMM_SMU_ALM0_2" 714 "DFC_MOXEMM_SMU_ALM0_22" 715 "DFC_MOXEMM_SMU_ALM0_23" 716 "DFC_MOXEMM_SMU_ALM0_4" 717 "DFC_MOXEMM_SMU_ALM0_5" 718 "DFC_MOXEMM_SMU_ALM0_7" 719 "DFC_MOXEMM_SMU_ALM0_8" 720 "DFC_MOXEMM_SMU_ALM10_16" 721 "DFC_MOXEMM_SMU_ALM10_17" 722 "DFC_MOXEMM_SMU_ALM10_21" 723 "DFC_MOXEMM_SMU_ALM11_0" 724 "DFC_MOXEMM_SMU_ALM11_1" 725 "DFC_MOXEMM_SMU_ALM11_2" 726 "DFC_MOXEMM_SMU_ALM11_3" 727 "DFC_MOXEMM_SMU_ALM11_4" 728 "DFC_MOXEMM_SMU_ALM11_5" 729 "DFC_MOXEMM_SMU_ALM11_8" 730 "DFC_MOXEMM_SMU_ALM11_9" 731 "DFC_MOXEMM_SMU_ALM1_0" 732 "DFC_MOXEMM_SMU_ALM1_1" 733 "DFC_MOXEMM_SMU_ALM1_10" 734 "DFC_MOXEMM_SMU_ALM1_11" 735 "DFC_MOXEMM_SMU_ALM1_13" 736 "DFC_MOXEMM_SMU_ALM1_14" 737 "DFC_MOXEMM_SMU_ALM1_2" 738 "DFC_MOXEMM_SMU_ALM1_22" 739 "DFC_MOXEMM_SMU_ALM1_23" 740 "DFC_MOXEMM_SMU_ALM1_4" 741 "DFC_MOXEMM_SMU_ALM1_5" 742 "DFC_MOXEMM_SMU_ALM1_7" 743 "DFC_MOXEMM_SMU_ALM1_8" 744 "DFC_MOXEMM_SMU_ALM21_0" 745 "DFC_MOXEMM_SMU_ALM21_16" 746 "DFC_MOXEMM_SMU_ALM21_3" 747 "DFC_MOXEMM_SMU_ALM2_1" 748 "DFC_MOXEMM_SMU_ALM2_10" 749 "DFC_MOXEMM_SMU_ALM2_11" 750 "DFC_MOXEMM_SMU_ALM2_13" 751 "DFC_MOXEMM_SMU_ALM2_14" 752 "DFC_MOXEMM_SMU_ALM2_22" 753 "DFC_MOXEMM_SMU_ALM2_23" 754 "DFC_MOXEMM_SMU_ALM2_4" 755 "DFC_MOXEMM_SMU_ALM2_5" 756 "DFC_MOXEMM_SMU_ALM2_7" 757 "DFC_MOXEMM_SMU_ALM2_8" 758 "DFC_MOXEMM_SMU_ALM6_0" 759 "DFC_MOXEMM_SMU_ALM6_11" 760 "DFC_MOXEMM_SMU_ALM6_12" 761 "DFC_MOXEMM_SMU_ALM6_14" 762 "DFC_MOXEMM_SMU_ALM6_15" 763 "DFC_MOXEMM_SMU_ALM6_17" 764 "DFC_MOXEMM_SMU_ALM6_18" 765 "DFC_MOXEMM_SMU_ALM6_20" 766 "DFC_MOXEMM_SMU_ALM6_21" 767 "DFC_MOXEMM_SMU_ALM6_25" 768 "DFC_MOXEMM_SMU_ALM6_4" 769 "DFC_MOXEMM_SMU_ALM6_5" 770 "DFC_MOXEMM_SMU_ALM6_7" 771 "DFC_MOXEMM_SMU_ALM6_8" 772 "DFC_MOXEMM_SMU_ALM7_1" 773 "DFC_MOXEMM_SMU_ALM7_12" 774 "DFC_MOXEMM_SMU_ALM7_13" 775 "DFC_MOXEMM_SMU_ALM7_14" 776 "DFC_MOXEMM_SMU_ALM7_15" 777 "DFC_MOXEMM_SMU_ALM7_16" 778 "DFC_MOXEMM_SMU_ALM7_17" 779 "DFC_MOXEMM_SMU_ALM7_2" 780 "DFC_MOXEMM_SMU_ALM7_20" 781 "DFC_MOXEMM_SMU_ALM7_25" 782 "DFC_MOXEMM_SMU_ALM7_26" 783 "DFC_MOXEMM_SMU_ALM7_28" 784 "DFC_MOXEMM_SMU_ALM7_29" 785 "DFC_MOXEMM_SMU_ALM7_30" 786 "DFC_MOXEMM_SMU_ALM7_31" 787 "DFC_MOXEMM_SMU_ALM8_0" 788 "DFC_MOXEMM_SMU_ALM8_1" 789 "DFC_MOXEMM_SMU_ALM8_10" 790 "DFC_MOXEMM_SMU_ALM8_11" 791 "DFC_MOXEMM_SMU_ALM8_12" 792 "DFC_MOXEMM_SMU_ALM8_16" 793 "DFC_MOXEMM_SMU_ALM8_18" 794 "DFC_MOXEMM_SMU_ALM8_2" 795 "DFC_MOXEMM_SMU_ALM8_3" 796 "DFC_MOXEMM_SMU_ALM8_31" 797 "DFC_MOXEMM_SMU_ALM8_4" 798 "DFC_MOXEMM_SMU_ALM9_0" 799 "DFC_MOXEMM_SMU_ALM9_15" 800 "DFC_MOXEMM_SMU_ALM9_3" 822 "DFC_MoXEMMHwLTMCUFW" 823 "DFC_MoXEMMHwLTMonBIST" 824 "DFC_MoXEMMHwLTRegMonTest" 825 "DFC_MoXEMMHwLTStbySMUAlvTest" 826 "DFC_MoXEMMHwLTTempSens" 827 "DFC_MoXEMMHwLTUCBCfg" 335 "DFC_MRlyDcOL" 336 "DFC_MRlyDcSCB" 337 "DFC_MRlyDcSCG" 492 "DFC_MRlyOL" 493 "DFC_MRlySCB" 494 "DFC_MRlySCG" 828 "DFC_NWSEmax" 829 "DFC_NWSmax" 830 "DFC_OCWDAABEActv" 831 "DFC_OCWDACom" 832 "DFC_OCWDAErrPin" 833 "DFC_OCWDAOvrVltg" 836 "DFC_OilPPlaus" 403 "DFC_OilPSwmpSRCMax" 404 "DFC_OilPSwmpSRCMin" 834 "DFC_ORAmax" 835 "DFC_ORAmin" 847 "DFC_P_VSE11_OL" 848 "DFC_P_VSE11_SCB" 849 "DFC_P_VSE11_SCG" 417 "DFC_PEnvCcMax" 418 "DFC_PEnvCcMin" 419 "DFC_PEnvRngChkMax" 420 "DFC_PEnvRngChkMin" 232 "DFC_PEnvSigRngMax" 233 "DFC_PEnvSigRngMin" 421 "DFC_PEnvSnsrPlaus" 850 "DFC_PhyHighAPP1" 851 "DFC_PhyHighAPP2" 852 "DFC_PhyLowAPP1" 853 "DFC_PhyLowAPP2" 405 "DFC_PIntkVUsLineHiB1" 406 "DFC_PIntkVUsLineLoB1" 837 "DFC_PLLSUmax" 838 "DFC_PLLSUmin" 338 "DFC_PSPOL" 339 "DFC_PSPOvrTemp" 340 "DFC_PSPSCB" 341 "DFC_PSPSCG" 839 "DFC_PSR1max" 840 "DFC_PSRBmax" 841 "DFC_PSRBmin" 845 "DFC_PSRmax" 842 "DFC_PSRPmax" 843 "DFC_PSRPmin" 844 "DFC_PSRPsig" 846 "DFC_PUmax" 475 "DFC_RBA_IODIAGPWR_rba_IoExtCy329_SignalVltSply_0" 476 "DFC_RBA_IODIAGPWR_rba_IoExtCy329_SignalVltSply_0OT" 477 "DFC_RBA_IODIAGPWR_rba_IoExtCy329_SignalVltSply_0OV" 478 "DFC_RBA_IODIAGPWR_rba_IoExtCy329_SignalVltSply_0SCG" 479 "DFC_RBA_IODIAGPWR_rba_IoExtCy329_SignalVltSply_0UV" 480 "DFC_RBA_IODIAGPWR_rba_IoExtCy329_SignalVltSply_1" 481 "DFC_RBA_IODIAGPWR_rba_IoExtCy329_SignalVltSply_1OT" 482 "DFC_RBA_IODIAGPWR_rba_IoExtCy329_SignalVltSply_1OV" 483 "DFC_RBA_IODIAGPWR_rba_IoExtCy329_SignalVltSply_1SCG" 484 "DFC_RBA_IODIAGPWR_rba_IoExtCy329_SignalVltSply_1UV" 485 "DFC_RBA_IODIAGPWR_rba_IoExtCy329_SignalVltSply_2" 486 "DFC_RBA_IODIAGPWR_rba_IoExtCy329_SignalVltSply_2OT" 487 "DFC_RBA_IODIAGPWR_rba_IoExtCy329_SignalVltSply_2OV" 488 "DFC_RBA_IODIAGPWR_rba_IoExtCy329_SignalVltSply_2SCG" 489 "DFC_RBA_IODIAGPWR_rba_IoExtCy329_SignalVltSply_2UV" 498 "DFC_RBA_IOEXTLIB_KEEPALIVE_DRV" 499 "DFC_RBA_IOEXTLIB_KEEPALIVE_INI" 500 "DFC_rba_IoSigRtc_StopCounter" 502 "DFC_rba_MemDiag_MemReadErr" 503 "DFC_rba_MemDiag_MemWrErr" 501 "DFC_rba_MRly_Diag_Stk_Event" 495 "DFC_rba_MultiStackTrace_Threshold" 504 "DFC_rba_SyC_IrrSwOffTrigEngRun_Event" 505 "DFC_rba_T15_Diag_ComInVld_Event" 506 "DFC_rba_T15_Diag_ComOff_HwOn_Event" 507 "DFC_rba_T15_Diag_ComOn_HwOff_Event" 468 "DFC_RoughRoad" 469 "DFC_SiaEEPRdErr" 470 "DFC_SiaEEPWrngCod" 854 "DFC_SRCHighAPP1" 855 "DFC_SRCHighAPP2" 856 "DFC_SRCLowAPP1" 857 "DFC_SRCLowAPP2" 858 "DFC_SSpMon2" 859 "DFC_STHDRmax" 234 "DFC_StmFault" 236 "DFC_StrtCtlErr" 235 "DFC_StrtCtOffPth" 237 "DFC_StrtFault" 238 "DFC_StrtLckJudg1" 239 "DFC_StrtLckJudg2" 240 "DFC_StrtOL" 241 "DFC_StrtOL2" 242 "DFC_StrtSCB" 243 "DFC_StrtSCB2" 244 "DFC_StrtSCG" 245 "DFC_StrtSCG2" 246 "DFC_StrtStkRly1" 247 "DFC_StrtStkRly2" 860 "DFC_SWReset_0" 861 "DFC_SWReset_1" 862 "DFC_SWReset_2" 863 "DFC_SyncAPP" 342 "DFC_T50Err" 865 "DFC_TAmax_Dummy" 864 "DFC_TANKLnpl" 866 "DFC_TESFmax" 867 "DFC_TESGmax" 248 "DFC_TEVEmax" 249 "DFC_TEVEmin" 250 "DFC_TEVEsig" 875 "DFC_ThrVlvClsdPosnFirstOffsLrnImpoB1" 876 "DFC_ThrVlvClsdPosnOffsLrnImpoB1" 877 "DFC_ThrVlvClsdPosnOffsLrnMaxB1" 878 "DFC_ThrVlvClsdPosnOffsLrnMinB1" 879 "DFC_ThrVlvCtrlDeB1" 880 "DFC_ThrVlvDycB1" 881 "DFC_ThrVlvLimpAirPosnMaxAbsltDriftB1" 882 "DFC_ThrVlvLimpAirPosnMaxB1" 883 "DFC_ThrVlvLimpAirPosnMaxRelDriftB1" 884 "DFC_ThrVlvLimpAirPosnMinB1" 343 "DFC_ThrVlvLoBattB1" 885 "DFC_ThrVlvOpenLoadB1" 886 "DFC_ThrVlvOpenSprgB1" 887 "DFC_ThrVlvOpenSprgSprdB1" 888 "DFC_ThrVlvOpenSprgTwnB1" 889 "DFC_ThrVlvOverTB1" 890 "DFC_ThrVlvRetSprgB1" 891 "DFC_ThrVlvRetSprgSprdB1" 892 "DFC_ThrVlvRetSprgTwnB1" 893 "DFC_ThrVlvSens1MaxB1" 900 "DFC_ThrvlvSens1MinB1" 894 "DFC_ThrVlvSens1NplB1" 895 "DFC_ThrVlvSens2MaxB1" 896 "DFC_ThrVlvSens2MinB1" 897 "DFC_ThrVlvSens2NplB1" 898 "DFC_ThrVlvShoCircB1" 899 "DFC_ThrVlvSpiErrB1" 901 "DFC_TiOffTBasdChkFast" 902 "DFC_TiOffTBasdChkSlow" 868 "DFC_TKAEmax" 869 "DFC_TKAEmin" 870 "DFC_TKARmax" 871 "DFC_TKARnpl" 872 "DFC_TMmax_Dummy" 873 "DFC_TUMmax_Dummy" 874 "DFC_TWCDPriCatB1" 251 "DFC_UegoHeatrPrfmncLoS1B1" 422 "DFC_UEGOHeatrRlyPsOLS1B1" 423 "DFC_UEGOHeatrRlyPsSCBS1B1" 424 "DFC_UEGOHeatrRlyPsSCGS1B1" 471 "DFC_UegoHeatrStrtS1B1" 425 "DFC_UegoHeatrWireOlS1B1" 426 "DFC_UegoHeatrWireScbS1B1" 427 "DFC_UegoHeatrWireScgS1B1" 279 "DFC_UegoSigEcuAsicS1B1" 280 "DFC_UegoSigEcuComS1B1" 344 "DFC_UegoSigOperPlausS1B1" 281 "DFC_UegoSigSnsrS1B1" 282 "DFC_UegoSigWireOlApesS1B1" 283 "DFC_UegoSigWireOlIpeS1B1" 284 "DFC_UegoSigWireOlReS1B1" 285 "DFC_UegoSigWireRCmpS1B1" 286 "DFC_UegoSigWireScbS1B1" 287 "DFC_UegoSigWireScgS1B1" 903 "DFC_UEGOSnsrMntdS1B1" 252 "DFC_VehVAllPlaus" 253 "DFC_VehVNCSnsrElecFailr" 345 "DFC_VehVPhysRngHi" 407 "DFC_VehVPhysRngLo" 254 "DFC_VehVPlausCan" 255 "DFC_VehVPlausFco" 256 "DFC_VehVPlausPwr" 257 "DFC_VehVPlausV2N" 346 "DFC_VehVSclOutOL" 347 "DFC_VehVSclOutOT" 348 "DFC_VehVSclOutSCB" 349 "DFC_VehVSclOutSCG" 904 "DFC_VehVSig" 408 "DFC_VehVSigCan" 409 "DFC_VehVSigCanSafe" 350 "DFC_VehVSigFL" 351 "DFC_VehVSigFR" 352 "DFC_VehVSigRL" 353 "DFC_VehVSigRR" 354 "DFC_VehVSnsrARngHi" 355 "DFC_VehVSnsrBRngHi" 356 "DFC_VehVSpdRtyDiag" 258 "DFC_VehVSpdSnsrAElecFailr" 259 "DFC_VehVSpdSnsrBElecFailr" 410 "DFC_VlvLftFbOilPSnsrIntk11SRCMax" 411 "DFC_VlvLftFbOilPSnsrIntk11SRCMin" 905 "DFC_VlvLftFbSwtIntk11SpclFail" 906 "DFC_VlvLftFbSwtIntk11StdFail" DEFAULT_VALUE "---" /end COMPU_VTAB
/begin COMPU_METHOD DFES_Entry_Verb "" TAB_VERB "%6.3" "" COMPU_TAB_REF DFES_Entry_Verb /end COMPU_METHOD
/begin COMPU_VTAB DFES_Entry_Verb "" TAB_VERB 35 0 "Empty" 1 "Erased" 2 "Erased_PdtcClrd" 3 "Erased_PdtcClrdMinTrip" 4 "Erased_PdtcClrdOk" 5 "FrzFrm" 6 "FrzFrm_PdtcClrd" 7 "FrzFrm_PdtcClrdMinTrip" 8 "FrzFrm_PdtcClrdOk" 9 "Shadow" 10 "Shadow_PdtcClrd" 11 "Shadow_PdtcClrdMinTrip" 12 "Shadow_PdtcClrdOk" 13 "Service" 14 "Service_PdtcClrd" 15 "Service_PdtcClrdMinTrip" 16 "Service_PdtcClrdOk" 17 "Service_Shdw" 18 "Service_ShdwPdtcClrd" 19 "Service_ShdwPdtcClrdMinTrip" 20 "Service_ShdwPdtcClrdOk" 21 "Service_FrzFrm" 22 "Service_FrzFrmPdtcClrd" 23 "Service_FrzFrmPdtcClrdMinTrip" 24 "Service_FrzFrmPdtcClrdOk" 25 "Pending" 26 "Pending_PdtcClrd" 27 "Pending_PdtcClrdMinTrip" 28 "Pending_PdtcClrdOk" 29 "Confirmed" 30 "Confirmed_Pdtc" 31 "ConfirmedHealing" 32 "ConfirmedHealing_Pdtc" 33 "ConfirmedPending" 34 "ConfirmedAging" /end COMPU_VTAB
/begin COMPU_METHOD DFES_Mon_Verb "" TAB_VERB "%6.3" "-" COMPU_TAB_REF DFES_Mon_Verb /end COMPU_METHOD
/begin COMPU_VTAB DFES_Mon_Verb "" TAB_VERB 22 0 "-----" 257 "double entry" 1025 "LDF_Diff DFCst - ORD" 513 "Counter exceeds" 258 "MEM missing" 1032 "retry entry" 514 "DEL Counter Serv ex" 260 "MEM no Entry" 516 "DEL Counter Pend ex" 1026 "Deb ok missing" 520 "DEL Counter OBD ex" 1028 "Deb def missing" 2049 "EepQueOvfl" 2050 "EepIniFailed" 2051 "EepIniNoSucss" 4097 "Erased_prioHigh" 4098 "slow_scan" 8193 "miss diumpr Fid" 16385 "invalid DTR limit" 32770 "event lost due to rollback limit" 32785 "number active InhUdp negative" 32786 "non zero InhUpd counter used" /end COMPU_VTAB
/begin COMPU_METHOD DFES_OneToOne "" RAT_FUNC "%6.2" "-" COEFFS 0 1 0 0 0 1 /end COMPU_METHOD
/begin COMPU_METHOD DFES_stCheck_Verb "" TAB_VERB "%6.3" "-" COMPU_TAB_REF DFES_stCheck_Verb /end COMPU_METHOD
/begin COMPU_VTAB DFES_stCheck_Verb "" TAB_VERB 8 0 "OkNoTst" 1 "OkTested" 2 "OkHealed" 3 "OkRstNoTst" 4 "DefectNoTst" 5 "DefectDelay" 6 "Defect" 7 "DefectRstNoTst" /end COMPU_VTAB
/begin COMPU_METHOD DFES_stCnt_Verb "" TAB_VERB "%6.3" "-" COMPU_TAB_REF DFES_stCnt_Verb /end COMPU_METHOD
/begin COMPU_VTAB DFES_stCnt_Verb "" TAB_VERB 36 0 "SVS_NONE__MIL_NONE" 1 "SVS_NONE__MIL_HLC_TRG" 2 "SVS_NONE__MIL_HLC_ELAP" 3 "SVS_NONE__MIL_FLC_CNT" 4 "SVS_NONE__MIL_FLC_TIME" 5 "SVS_NONE__MIL_HLC_TIME" 16 "SVS_HLC_TRG__MIL_NONE" 17 "SVS_HLC_TRG__MIL_HLC_TRG" 18 "SVS_HLC_TRG__MIL_HLC_ELAP" 19 "SVS_HLC_TRG__MIL_FLC_CNT" 20 "SVS_HLC_TRG__MIL_FLC_TIME" 21 "SVS_HLC_TRG__MIL_HLC_TIME" 32 "SVS_HLC_ELAP__MIL_NONE" 33 "SVS_HLC_ELAP__MIL_HLC_TRG" 34 "SVS_HLC_ELAP__MIL_HLC_ELAP" 35 "SVS_HLC_ELAP__MIL_FLC_CNT" 36 "SVS_HLC_ELAP__MIL_FLC_TIME" 37 "SVS_HLC_ELAP__MIL_HLC_TIME" 48 "SVS_FLC_CNT__MIL_NONE" 49 "SVS_FLC_CNT__MIL_HLC_TRG" 50 "SVS_FLC_CNT__MIL_HLC_ELAP" 51 "SVS_FLC_CNT__MIL_FLC_CNT" 52 "SVS_FLC_CNT__MIL_FLC_TIME" 53 "SVS_FLC_CNT__MIL_HLC_TIME" 64 "SVS_FLC_TIME__MIL_NONE" 65 "SVS_FLC_TIME__MIL_HLC_TRG" 66 "SVS_FLC_TIME__MIL_HLC_ELAP" 67 "SVS_FLC_TIME__MIL_FLC_CNT" 68 "SVS_FLC_TIME__MIL_FLC_TIME" 69 "SVS_FLC_TIME__MIL_HLC_TIME" 80 "SVS_HLC_TIME__MIL_NONE" 81 "SVS_HLC_TIME__MIL_HLC_TRG" 82 "SVS_HLC_TIME__MIL_HLC_ELAP" 83 "SVS_HLC_TIME__MIL_FLC_CNT" 84 "SVS_HLC_TIME__MIL_FLC_TIME" 85 "SVS_HLC_TIME__MIL_HLC_TIME" /end COMPU_VTAB
/begin COMPU_METHOD DFES_stDataImdt_Verb "" TAB_VERB "%6.3" "" COMPU_TAB_REF DFES_stDataImdt_Verb /end COMPU_METHOD
/begin COMPU_VTAB DFES_stDataImdt_Verb "" TAB_VERB 22 0 "ERASED" 1 "ERASED_ACTSEQ_FRZ_ENV" 2 "FRZONLY" 3 "FRZONLY_ACTSEQ_FRZ_ENV" 4 "SHADOW" 5 "SHADOW_ACTSEQ_FRZ_ENV" 12 "OKENTRY" 13 "OKENTRY_ACTSEQ_LCK" 14 "OKENTRY_ACTSEQ_LCK_ENV_LCK" 15 "OKENTRY_ACTSEQ_FRZ_ENV_LCK" 16 "OKENTRY_ACTSEQ_ENV_LCK" 17 "ERROR" 18 "ERROR_ACTSEQ_LCK" 19 "ERROR_ACTSEQ_LCK_ENV_LCK" 20 "ERROR_ACTSEQ_FRZ_ENV_LCK" 21 "ERROR_ACTSEQ_ENV_LCK" 6 "SHADOWFRZ" 7 "SHADOWFRZ_ACTSEQ_FRZ_ENV" 8 "SHADOWOK" 9 "SHADOWOK_ACTSEQ_FRZ_ENV" 10 "SHADOWOKFRZ" 11 "SHADOWOKFRZ_ACTSEQ_FRZ_ENV" /end COMPU_VTAB
/begin COMPU_METHOD DFES_stEntry_Verb "" TAB_VERB "%6.3" "-" COMPU_TAB_REF DFES_stEntry_Verb /end COMPU_METHOD
/begin COMPU_VTAB DFES_stEntry_Verb "" TAB_VERB 240 0 "NoEntry" 1 "Erased" 2 "PrivateTemporary" 3 "SVSOff_FreezeFrameOnly" 4 "SVSOff_DelayActiveDefect" 5 "SVSOff_ServiceNoDefect" 6 "SVSOff_ServiceDefect" 7 "SVSOff_ServiceHistoryDefect" 8 "SVSOff_ServiceHistoryNoDefect" 9 "SVSOff_DelayActiveNoDefect" 10 "SVSOff_PendingDefect" 11 "SVSOff_DebouncedDefect" 12 "SVSOff_HistoryPendingDefect" 13 "SVSOff_HealingNoDefect" 14 "SVSOff_HistoryNoDefect" 16 "DelD_NoEntry" 17 "DelD_Erased" 18 "DelD_PrivateTemporary" 19 "SVSOff_DelD_FreezeFrameOnly" 20 "SVSOff_DelD_DelayActiveDefect" 21 "SVSOff_DelD_ServiceNoDefect" 22 "SVSOff_DelD_ServiceDefect" 23 "SVSOff_DelD_ServiceHistoryDefect" 24 "SVSOff_DelD_ServiceHistoryNoDefect" 25 "SVSOff_DelD_DelayActiveNoDefect" 26 "SVSOff_DelD_PendingDefect" 27 "SVSOff_DelD_DebouncedDefect" 28 "SVSOff_DelD_HistoryPendingDefect" 29 "SVSOff_DelD_HealingNoDefect" 30 "SVSOff_DelD_HistoryNoDefect" 32 "P_NoEntry" 33 "P_Erased" 34 "P_PrivateTemporary" 35 "SVSOff_P_FreezeFrameOnly" 36 "SVSOff_P_DelayActiveDefect" 37 "SVSOff_P_ServiceNoDefect" 38 "SVSOff_P_ServiceDefect" 39 "SVSOff_P_ServiceHistoryDefect" 40 "SVSOff_P_ServiceHistoryNoDefect" 41 "SVSOff_P_DelayActiveNoDefect" 42 "SVSOff_P_PendingDefect" 43 "SVSOff_P_DebouncedDefect" 44 "SVSOff_P_HistoryPendingDefect" 45 "SVSOff_P_HealingNoDefect" 46 "SVSOff_P_HistoryNoDefect" 48 "P_DelD_NoEntry" 49 "P_DelD_Erased" 50 "P_DelD_PrivateTemporary" 51 "SVSOff_P_DelD_FreezeFrameOnly" 52 "SVSOff_P_DelD_DelayActiveDefect" 53 "SVSOff_P_DelD_ServiceNoDefect" 54 "SVSOff_P_DelD_ServiceDefect" 55 "SVSOff_P_DelD_ServiceHistoryDefect" 56 "SVSOff_P_DelD_ServiceHistoryNoDefect" 57 "SVSOff_P_DelD_DelayActiveNoDefect" 58 "SVSOff_P_DelD_PendingDefect" 59 "SVSOff_P_DelD_DebouncedDefect" 60 "SVSOff_P_DelD_HistoryPendingDefect" 61 "SVSOff_P_DelD_HealingNoDefect" 62 "SVSOff_P_DelD_HistoryNoDefect" 64 "PS_NoEntry" 65 "PS_Erased" 66 "PS_PrivateTemporary" 67 "SVSOff_PS_FreezeFrameOnly" 68 "SVSOff_PS_DelayActiveDefect" 69 "SVSOff_PS_ServiceNoDefect" 70 "SVSOff_PS_ServiceDefect" 71 "SVSOff_PS_ServiceHistoryDefect" 72 "SVSOff_PS_ServiceHistoryNoDefect" 73 "SVSOff_PS_DelayActiveNoDefect" 74 "SVSOff_PS_PendingDefect" 75 "SVSOff_PS_DebouncedDefect" 76 "SVSOff_PS_HistoryPendingDefect" 77 "SVSOff_PS_HealingNoDefect" 78 "SVSOff_PS_HistoryNoDefect" 80 "PS_DelD_NoEntry" 81 "PS_DelD_Erased" 82 "PS_DelD_PrivateTemporary" 83 "SVSOff_PS_DelD_FreezeFrameOnly" 84 "SVSOff_PS_DelD_DelayActiveDefect" 85 "SVSOff_PS_DelD_ServiceNoDefect" 86 "SVSOff_PS_DelD_ServiceDefect" 87 "SVSOff_PS_DelD_ServiceHistoryDefect" 88 "SVSOff_PS_DelD_ServiceHistoryNoDefect" 89 "SVSOff_PS_DelD_DelayActiveNoDefect" 90 "SVSOff_PS_DelD_PendingDefect" 91 "SVSOff_PS_DelD_DebouncedDefect" 92 "SVSOff_PS_DelD_HistoryPendingDefect" 93 "SVSOff_PS_DelD_HealingNoDefect" 94 "SVSOff_PS_DelD_HistoryNoDefect" 96 "PS_P_NoEntry" 97 "PS_P_Erased" 98 "PS_P_PrivateTemporary" 99 "SVSOff_PS_P_FreezeFrameOnly" 100 "SVSOff_PS_P_DelayActiveDefect" 101 "SVSOff_PS_P_ServiceNoDefect" 102 "SVSOff_PS_P_ServiceDefect" 103 "SVSOff_PS_P_ServiceHistoryDefect" 104 "SVSOff_PS_P_ServiceHistoryNoDefect" 105 "SVSOff_PS_P_DelayActiveNoDefect" 106 "SVSOff_PS_P_PendingDefect" 107 "SVSOff_PS_P_DebouncedDefect" 108 "SVSOff_PS_P_HistoryPendingDefect" 109 "SVSOff_PS_P_HealingNoDefect" 110 "SVSOff_PS_P_HistoryNoDefect" 112 "PS_P_DelD_NoEntry" 113 "PS_P_DelD_Erased" 114 "PS_P_DelD_PrivateTemporary" 115 "SVSOff_PS_P_DelD_FreezeFrameOnly" 116 "SVSOff_PS_P_DelD_DelayActiveDefect" 117 "SVSOff_PS_P_DelD_ServiceNoDefect" 118 "SVSOff_PS_P_DelD_ServiceDefect" 119 "SVSOff_PS_P_DelD_ServiceHistoryDefect" 120 "SVSOff_PS_P_DelD_ServiceHistoryNoDefect" 121 "SVSOff_PS_P_DelD_DelayActiveNoDefect" 122 "SVSOff_PS_P_DelD_PendingDefect" 123 "SVSOff_PS_P_DelD_DebouncedDefect" 124 "SVSOff_PS_P_DelD_HistoryPendingDefect" 125 "SVSOff_PS_P_DelD_HealingNoDefect" 126 "SVSOff_PS_P_DelD_HistoryNoDefect" 128 "SVSOn_NoEntry" 129 "SVSOn_Erased" 130 "SVSOn_PrivateTemporary" 131 "SVSOn_FreezeFrameOnly" 132 "SVSOn_DelayActiveDefect" 133 "SVSOn_ServiceNoDefect" 134 "SVSOn_ServiceDefect" 135 "SVSOn_ServiceHistoryDefect" 136 "SVSOn_ServiceHistoryNoDefect" 137 "SVSOn_DelayActiveNoDefect" 138 "SVSOn_PendingDefect" 139 "SVSOn_DebouncedDefect" 140 "SVSOn_HistoryPendingDefect" 141 "SVSOn_HealingNoDefect" 142 "SVSOn_HistoryNoDefect" 144 "SVSOn_DelD_NoEntry" 145 "SVSOn_DelD_Erased" 146 "SVSOn_DelD_PrivateTemporary" 147 "SVSOn_DelD_FreezeFrameOnly" 148 "SVSOn_DelD_DelayActiveDefect" 149 "SVSOn_DelD_ServiceNoDefect" 150 "SVSOn_DelD_ServiceDefect" 151 "SVSOn_DelD_ServiceHistoryDefect" 152 "SVSOn_DelD_ServiceHistoryNoDefect" 153 "SVSOn_DelD_DelayActiveNoDefect" 154 "SVSOn_DelD_PendingDefect" 155 "SVSOn_DelD_DebouncedDefect" 156 "SVSOn_DelD_HistoryPendingDefect" 157 "SVSOn_DelD_HealingNoDefect" 158 "SVSOn_DelD_HistoryNoDefect" 160 "SVSOn_P_NoEntry" 161 "SVSOn_P_Erased" 162 "SVSOn_P_PrivateTemporary" 163 "SVSOn_P_FreezeFrameOnly" 164 "SVSOn_P_DelayActiveDefect" 165 "SVSOn_P_ServiceNoDefect" 166 "SVSOn_P_ServiceDefect" 167 "SVSOn_P_ServiceHistoryDefect" 168 "SVSOn_P_ServiceHistoryNoDefect" 169 "SVSOn_P_DelayActiveNoDefect" 170 "SVSOn_P_PendingDefect" 171 "SVSOn_P_DebouncedDefect" 172 "SVSOn_P_HistoryPendingDefect" 173 "SVSOn_P_HealingNoDefect" 174 "SVSOn_P_HistoryNoDefect" 176 "SVSOn_P_DelD_NoEntry" 177 "SVSOn_P_DelD_Erased" 178 "SVSOn_P_DelD_PrivateTemporary" 179 "SVSOn_P_DelD_FreezeFrameOnly" 180 "SVSOn_P_DelD_DelayActiveDefect" 181 "SVSOn_P_DelD_ServiceNoDefect" 182 "SVSOn_P_DelD_ServiceDefect" 183 "SVSOn_P_DelD_ServiceHistoryDefect" 184 "SVSOn_P_DelD_ServiceHistoryNoDefect" 185 "SVSOn_P_DelD_DelayActiveNoDefect" 186 "SVSOn_P_DelD_PendingDefect" 187 "SVSOn_P_DelD_DebouncedDefect" 188 "SVSOn_P_DelD_HistoryPendingDefect" 189 "SVSOn_P_DelD_HealingNoDefect" 190 "SVSOn_P_DelD_HistoryNoDefect" 192 "SVSOn_PS_NoEntry" 193 "SVSOn_PS_Erased" 194 "SVSOn_PS_PrivateTemporary" 195 "SVSOn_PS_FreezeFrameOnly" 196 "SVSOn_PS_DelayActiveDefect" 197 "SVSOn_PS_ServiceNoDefect" 198 "SVSOn_PS_ServiceDefect" 199 "SVSOn_PS_ServiceHistoryDefect" 200 "SVSOn_PS_ServiceHistoryNoDefect" 201 "SVSOn_PS_DelayActiveNoDefect" 202 "SVSOn_PS_PendingDefect" 203 "SVSOn_PS_DebouncedDefect" 204 "SVSOn_PS_HistoryPendingDefect" 205 "SVSOn_PS_HealingNoDefect" 206 "SVSOn_PS_HistoryNoDefect" 208 "SVSOn_PS_DelD_NoEntry" 209 "SVSOn_PS_DelD_Erased" 210 "SVSOn_PS_DelD_PrivateTemporary" 211 "SVSOn_PS_DelD_FreezeFrameOnly" 212 "SVSOn_PS_DelD_DelayActiveDefect" 213 "SVSOn_PS_DelD_ServiceNoDefect" 214 "SVSOn_PS_DelD_ServiceDefect" 215 "SVSOn_PS_DelD_ServiceHistoryDefect" 216 "SVSOn_PS_DelD_ServiceHistoryNoDefect" 217 "SVSOn_PS_DelD_DelayActiveNoDefect" 218 "SVSOn_PS_DelD_PendingDefect" 219 "SVSOn_PS_DelD_DebouncedDefect" 220 "SVSOn_PS_DelD_HistoryPendingDefect" 221 "SVSOn_PS_DelD_HealingNoDefect" 222 "SVSOn_PS_DelD_HistoryNoDefect" 224 "SVSOn_PS_P_NoEntry" 225 "SVSOn_PS_P_Erased" 226 "SVSOn_PS_P_PrivateTemporary" 227 "SVSOn_PS_P_FreezeFrameOnly" 228 "SVSOn_PS_P_DelayActiveDefect" 229 "SVSOn_PS_P_ServiceNoDefect" 230 "SVSOn_PS_P_ServiceDefect" 231 "SVSOn_PS_P_ServiceHistoryDefect" 232 "SVSOn_PS_P_ServiceHistoryNoDefect" 233 "SVSOn_PS_P_DelayActiveNoDefect" 234 "SVSOn_PS_P_PendingDefect" 235 "SVSOn_PS_P_DebouncedDefect" 236 "SVSOn_PS_P_HistoryPendingDefect" 237 "SVSOn_PS_P_HealingNoDefect" 238 "SVSOn_PS_P_HistoryNoDefect" 240 "SVSOn_PS_P_DelD_NoEntry" 241 "SVSOn_PS_P_DelD_Erased" 242 "SVSOn_PS_P_DelD_PrivateTemporary" 243 "SVSOn_PS_P_DelD_FreezeFrameOnly" 244 "SVSOn_PS_P_DelD_DelayActiveDefect" 245 "SVSOn_PS_P_DelD_ServiceNoDefect" 246 "SVSOn_PS_P_DelD_ServiceDefect" 247 "SVSOn_PS_P_DelD_ServiceHistoryDefect" 248 "SVSOn_PS_P_DelD_ServiceHistoryNoDefect" 249 "SVSOn_PS_P_DelD_DelayActiveNoDefect" 250 "SVSOn_PS_P_DelD_PendingDefect" 251 "SVSOn_PS_P_DelD_DebouncedDefect" 252 "SVSOn_PS_P_DelD_HistoryPendingDefect" 253 "SVSOn_PS_P_DelD_HealingNoDefect" 254 "SVSOn_PS_P_DelD_HistoryNoDefect" /end COMPU_VTAB
/begin COMPU_METHOD EPM_DGIDYNCHG_SC_Compu "" TAB_VERB "%6.3" "" COMPU_TAB_REF EPM_DGIDYNCHG_SC_Compu /end COMPU_METHOD
/begin COMPU_VTAB EPM_DGIDYNCHG_SC_Compu "" TAB_VERB 2 0 "DYNCHG_OFF" 1 "DYNCHG_ON" /end COMPU_VTAB
/begin COMPU_METHOD EPM_DGIPLSRNG_SC_Compu "" TAB_VERB "%6.3" "" COMPU_TAB_REF EPM_DGIPLSRNG_SC_Compu /end COMPU_METHOD
/begin COMPU_VTAB EPM_DGIPLSRNG_SC_Compu "" TAB_VERB 2 0 "PLSRNG_OFF" 1 "PLSRNG_ON" /end COMPU_VTAB
/begin COMPU_METHOD OneToOne "" RAT_FUNC "%6.2" "-" COEFFS 0 1 0 0 0 1 /end COMPU_METHOD
/begin RECORD_LAYOUT Val_Wu16 FNC_VALUES 1 UWORD COLUMN_DIR DIRECT /end RECORD_LAYOUT
/begin RECORD_LAYOUT Val_Wu8 FNC_VALUES 1 UBYTE COLUMN_DIR DIRECT /end RECORD_LAYOUT
/end MODULE
/end PROJECT
