ASAP2_VERSION 1 60
/begin PROJECT MG1CS022 "MG1CS022"
/begin HEADER "" VERSION "MG1CS022_62XSC_V037_TPROT" PROJECT_NO MG1CS022 /end HEADER
/begin MODULE DIM ""
/begin MOD_COMMON "" BYTE_ORDER MSB_LAST ALIGNMENT_BYTE 1 ALIGNMENT_WORD 2 ALIGNMENT_LONG 4 ALIGNMENT_INT64 4 ALIGNMENT_FLOAT32_IEEE 4 ALIGNMENT_FLOAT64_IEEE 4 DATA_SIZE 32 /end MOD_COMMON
/begin MEASUREMENT DFC_b.TSC_ComEATATOut "Bit encoding / Ok-Tested Since Clear bit for check DFC_ComEATATOut" UBYTE DFC_OneToOne 1 100 0.00 1.000 BIT_MASK 0x20 FORMAT "%5.3" ECU_ADDRESS 0x60036F11 /end MEASUREMENT
/begin MEASUREMENT DFC_b.TSC_ComEATBChkSum "Bit encoding / Ok-Tested Since Clear bit for check DFC_ComEATBChkSum" UBYTE DFC_OneToOne 1 100 0.00 1.000 BIT_MASK 0x20 FORMAT "%5.3" ECU_ADDRESS 0x60036F12 /end MEASUREMENT
/begin MEASUREMENT DFC_b.TSC_ComEATBRingCnt "Bit encoding / Ok-Tested Since Clear bit for check DFC_ComEATBRingCnt" UBYTE DFC_OneToOne 1 100 0.00 1.000 BIT_MASK 0x20 FORMAT "%5.3" ECU_ADDRESS 0x60036F13 /end MEASUREMENT
/begin MEASUREMENT DFC_b.TSC_ComEATBTOut "Bit encoding / Ok-Tested Since Clear bit for check DFC_ComEATBTOut" UBYTE DFC_OneToOne 1 100 0.00 1.000 BIT_MASK 0x20 FORMAT "%5.3" ECU_ADDRESS 0x60036F14 /end MEASUREMENT
/begin MEASUREMENT DFC_b.TSC_ComEATCChksum "Bit encoding / Ok-Tested Since Clear bit for check DFC_ComEATCChksum" UBYTE DFC_OneToOne 1 100 0.00 1.000 BIT_MASK 0x20 FORMAT "%5.3" ECU_ADDRESS 0x60036F15 /end MEASUREMENT
/begin MEASUREMENT DFC_b.TSC_ComEATCRingCnt "Bit encoding / Ok-Tested Since Clear bit for check DFC_ComEATCRingCnt" UBYTE DFC_OneToOne 1 100 0.00 1.000 BIT_MASK 0x20 FORMAT "%5.3" ECU_ADDRESS 0x60036F16 /end MEASUREMENT
/begin MEASUREMENT DFC_b.TSC_ComEATCTOut "Bit encoding / Ok-Tested Since Clear bit for check DFC_ComEATCTOut" UBYTE DFC_OneToOne 1 100 0.00 1.000 BIT_MASK 0x20 FORMAT "%5.3" ECU_ADDRESS 0x60036F17 /end MEASUREMENT
/begin MEASUREMENT DFC_b.TSC_ComEPBBChkSum "Bit encoding / Ok-Tested Since Clear bit for check DFC_ComEPBBChkSum" UBYTE DFC_OneToOne 1 100 0.00 1.000 BIT_MASK 0x20 FORMAT "%5.3" ECU_ADDRESS 0x60036F18 /end MEASUREMENT
/begin MEASUREMENT DFC_b.TSC_ComEPBBRingCnt "Bit encoding / Ok-Tested Since Clear bit for check DFC_ComEPBBRingCnt" UBYTE DFC_OneToOne 1 100 0.00 1.000 BIT_MASK 0x20 FORMAT "%5.3" ECU_ADDRESS 0x60036F19 /end MEASUREMENT
/begin MEASUREMENT DFC_b.TSC_ComEPBBTOut "Bit encoding / Ok-Tested Since Clear bit for check DFC_ComEPBBTOut" UBYTE DFC_OneToOne 1 100 0.00 1.000 BIT_MASK 0x20 FORMAT "%5.3" ECU_ADDRESS 0x60036F1A /end MEASUREMENT
/begin MEASUREMENT DFC_b.TSC_ComEPBChksum "Bit encoding / Ok-Tested Since Clear bit for check DFC_ComEPBChksum" UBYTE DFC_OneToOne 1 100 0.00 1.000 BIT_MASK 0x20 FORMAT "%5.3" ECU_ADDRESS 0x60036F1B /end MEASUREMENT
/begin MEASUREMENT DFC_b.TSC_ComEPBTOut "Bit encoding / Ok-Tested Since Clear bit for check DFC_ComEPBTOut" UBYTE DFC_OneToOne 1 100 0.00 1.000 BIT_MASK 0x20 FORMAT "%5.3" ECU_ADDRESS 0x60036F1C /end MEASUREMENT
/begin MEASUREMENT DFC_b.TSC_ComEPBctRing "Bit encoding / Ok-Tested Since Clear bit for check DFC_ComEPBctRing" UBYTE DFC_OneToOne 1 100 0.00 1.000 BIT_MASK 0x20 FORMAT "%5.3" ECU_ADDRESS 0x60036F1D /end MEASUREMENT
/begin MEASUREMENT DFC_b.TSC_ComEPS1Chksum "Bit encoding / Ok-Tested Since Clear bit for check DFC_ComEPS1Chksum" UBYTE DFC_OneToOne 1 100 0.00 1.000 BIT_MASK 0x20 FORMAT "%5.3" ECU_ADDRESS 0x60036F1E /end MEASUREMENT
/begin MEASUREMENT DFC_b.TSC_ComEPS1RingCnt "Bit encoding / Ok-Tested Since Clear bit for check DFC_ComEPS1RingCnt" UBYTE DFC_OneToOne 1 100 0.00 1.000 BIT_MASK 0x20 FORMAT "%5.3" ECU_ADDRESS 0x60036F1F /end MEASUREMENT
/begin MEASUREMENT DFC_b.TSC_ComEPS1TOut "Bit encoding / Ok-Tested Since Clear bit for check DFC_ComEPS1TOut" UBYTE DFC_OneToOne 1 100 0.00 1.000 BIT_MASK 0x20 FORMAT "%5.3" ECU_ADDRESS 0x60036F20 /end MEASUREMENT
/begin MEASUREMENT DFC_b.TSC_ComEngCanRxErr "Bit encoding / Ok-Tested Since Clear bit for check DFC_ComEngCanRxErr" UBYTE DFC_OneToOne 1 100 0.00 1.000 BIT_MASK 0x20 FORMAT "%5.3" ECU_ADDRESS 0x60036F21 /end MEASUREMENT
/begin MEASUREMENT DFC_b.TSC_ComGrvySnsrErr "Bit encoding / Ok-Tested Since Clear bit for check DFC_ComGrvySnsrErr" UBYTE DFC_OneToOne 1 100 0.00 1.000 BIT_MASK 0x20 FORMAT "%5.3" ECU_ADDRESS 0x60036F22 /end MEASUREMENT
/begin MEASUREMENT DFC_b.TSC_ComGwIMG1ChkSum "Bit encoding / Ok-Tested Since Clear bit for check DFC_ComGwIMG1ChkSum" UBYTE DFC_OneToOne 1 100 0.00 1.000 BIT_MASK 0x20 FORMAT "%5.3" ECU_ADDRESS 0x60036F23 /end MEASUREMENT
/begin MEASUREMENT DFC_b.TSC_ComGwIMG1RingCnt "Bit encoding / Ok-Tested Since Clear bit for check DFC_ComGwIMG1RingCnt" UBYTE DFC_OneToOne 1 100 0.00 1.000 BIT_MASK 0x20 FORMAT "%5.3" ECU_ADDRESS 0x60036F24 /end MEASUREMENT
/begin MEASUREMENT DFC_b.TSC_ComGwIMG1TOut "Bit encoding / Ok-Tested Since Clear bit for check DFC_ComGwIMG1TOut" UBYTE DFC_OneToOne 1 100 0.00 1.000 BIT_MASK 0x20 FORMAT "%5.3" ECU_ADDRESS 0x60036F25 /end MEASUREMENT
/begin MEASUREMENT DFC_b.TSC_ComGwIMG3ChkSum "Bit encoding / Ok-Tested Since Clear bit for check DFC_ComGwIMG3ChkSum" UBYTE DFC_OneToOne 1 100 0.00 1.000 BIT_MASK 0x20 FORMAT "%5.3" ECU_ADDRESS 0x60036F26 /end MEASUREMENT
/begin MEASUREMENT DFC_b.TSC_ComGwIMG3RingCnt "Bit encoding / Ok-Tested Since Clear bit for check DFC_ComGwIMG3RingCnt" UBYTE DFC_OneToOne 1 100 0.00 1.000 BIT_MASK 0x20 FORMAT "%5.3" ECU_ADDRESS 0x60036F27 /end MEASUREMENT
/begin MEASUREMENT DFC_b.TSC_ComGwIMG3TOut "Bit encoding / Ok-Tested Since Clear bit for check DFC_ComGwIMG3TOut" UBYTE DFC_OneToOne 1 100 0.00 1.000 BIT_MASK 0x20 FORMAT "%5.3" ECU_ADDRESS 0x60036F28 /end MEASUREMENT
/begin MEASUREMENT DFC_b.TSC_ComGwIMG4ChkSum "Bit encoding / Ok-Tested Since Clear bit for check DFC_ComGwIMG4ChkSum" UBYTE DFC_OneToOne 1 100 0.00 1.000 BIT_MASK 0x20 FORMAT "%5.3" ECU_ADDRESS 0x60036F29 /end MEASUREMENT
/begin MEASUREMENT DFC_b.TSC_ComGwIMG4RingCnt "Bit encoding / Ok-Tested Since Clear bit for check DFC_ComGwIMG4RingCnt" UBYTE DFC_OneToOne 1 100 0.00 1.000 BIT_MASK 0x20 FORMAT "%5.3" ECU_ADDRESS 0x60036F2A /end MEASUREMENT
/begin MEASUREMENT DFC_b.TSC_ComGwIMG4TOut "Bit encoding / Ok-Tested Since Clear bit for check DFC_ComGwIMG4TOut" UBYTE DFC_OneToOne 1 100 0.00 1.000 BIT_MASK 0x20 FORMAT "%5.3" ECU_ADDRESS 0x60036F2B /end MEASUREMENT
/begin MEASUREMENT DFC_b.TSC_ComGwIMG5ChkSum "Bit encoding / Ok-Tested Since Clear bit for check DFC_ComGwIMG5ChkSum" UBYTE DFC_OneToOne 1 100 0.00 1.000 BIT_MASK 0x20 FORMAT "%5.3" ECU_ADDRESS 0x60036F2C /end MEASUREMENT
/begin MEASUREMENT DFC_b.TSC_ComGwIMG5RingCnt "Bit encoding / Ok-Tested Since Clear bit for check DFC_ComGwIMG5RingCnt" UBYTE DFC_OneToOne 1 100 0.00 1.000 BIT_MASK 0x20 FORMAT "%5.3" ECU_ADDRESS 0x60036F2D /end MEASUREMENT
/begin MEASUREMENT DFC_b.TSC_ComGwIMG5TOut "Bit encoding / Ok-Tested Since Clear bit for check DFC_ComGwIMG5TOut" UBYTE DFC_OneToOne 1 100 0.00 1.000 BIT_MASK 0x20 FORMAT "%5.3" ECU_ADDRESS 0x60036F2E /end MEASUREMENT
/begin MEASUREMENT DFC_b.TSC_ComGwIMG6ChkSum "Bit encoding / Ok-Tested Since Clear bit for check DFC_ComGwIMG6ChkSum" UBYTE DFC_OneToOne 1 100 0.00 1.000 BIT_MASK 0x20 FORMAT "%5.3" ECU_ADDRESS 0x60036F2F /end MEASUREMENT
/begin MEASUREMENT DFC_b.TSC_ComGwIMG6RingCnt "Bit encoding / Ok-Tested Since Clear bit for check DFC_ComGwIMG6RingCnt" UBYTE DFC_OneToOne 1 100 0.00 1.000 BIT_MASK 0x20 FORMAT "%5.3" ECU_ADDRESS 0x60036F30 /end MEASUREMENT
/begin MEASUREMENT DFC_b.TSC_ComGwIMG6TOut "Bit encoding / Ok-Tested Since Clear bit for check DFC_ComGwIMG6TOut" UBYTE DFC_OneToOne 1 100 0.00 1.000 BIT_MASK 0x20 FORMAT "%5.3" ECU_ADDRESS 0x60036F31 /end MEASUREMENT
/begin MEASUREMENT DFC_b.TSC_ComIDASBChksum "Bit encoding / Ok-Tested Since Clear bit for check DFC_ComIDASBChksum" UBYTE DFC_OneToOne 1 100 0.00 1.000 BIT_MASK 0x20 FORMAT "%5.3" ECU_ADDRESS 0x60036F32 /end MEASUREMENT
/begin MEASUREMENT DFC_b.TSC_ComIDASBRingCnt "Bit encoding / Ok-Tested Since Clear bit for check DFC_ComIDASBRingCnt" UBYTE DFC_OneToOne 1 100 0.00 1.000 BIT_MASK 0x20 FORMAT "%5.3" ECU_ADDRESS 0x60036F33 /end MEASUREMENT
/begin MEASUREMENT DFC_b.TSC_ComIDASBTOut "Bit encoding / Ok-Tested Since Clear bit for check DFC_ComIDASBTOut" UBYTE DFC_OneToOne 1 100 0.00 1.000 BIT_MASK 0x20 FORMAT "%5.3" ECU_ADDRESS 0x60036F34 /end MEASUREMENT
/begin MEASUREMENT DFC_b.TSC_ComIMGMILReq "Bit encoding / Ok-Tested Since Clear bit for check DFC_ComIMGMILReq" UBYTE DFC_OneToOne 1 100 0.00 1.000 BIT_MASK 0x20 FORMAT "%5.3" ECU_ADDRESS 0x60036F35 /end MEASUREMENT
/begin MEASUREMENT DFC_b.TSC_ComISSPrms "Bit encoding / Ok-Tested Since Clear bit for check DFC_ComISSPrms" UBYTE DFC_OneToOne 1 100 0.00 1.000 BIT_MASK 0x20 FORMAT "%5.3" ECU_ADDRESS 0x60036F36 /end MEASUREMENT
/begin MEASUREMENT DFC_b.TSC_ComMETAChksum "Bit encoding / Ok-Tested Since Clear bit for check DFC_ComMETAChksum" UBYTE DFC_OneToOne 1 100 0.00 1.000 BIT_MASK 0x20 FORMAT "%5.3" ECU_ADDRESS 0x60036F37 /end MEASUREMENT
/begin MEASUREMENT DFC_b.TSC_ComMETAChksumPstDrv "Bit encoding / Ok-Tested Since Clear bit for check DFC_ComMETAChksumPstDrv" UBYTE DFC_OneToOne 1 100 0.00 1.000 BIT_MASK 0x20 FORMAT "%5.3" ECU_ADDRESS 0x60036F38 /end MEASUREMENT
/begin MEASUREMENT DFC_b.TSC_ComMETARingCnt "Bit encoding / Ok-Tested Since Clear bit for check DFC_ComMETARingCnt" UBYTE DFC_OneToOne 1 100 0.00 1.000 BIT_MASK 0x20 FORMAT "%5.3" ECU_ADDRESS 0x60036F39 /end MEASUREMENT
/begin MEASUREMENT DFC_b.TSC_ComMETARingCntPstDrv "Bit encoding / Ok-Tested Since Clear bit for check DFC_ComMETARingCntPstDrv" UBYTE DFC_OneToOne 1 100 0.00 1.000 BIT_MASK 0x20 FORMAT "%5.3" ECU_ADDRESS 0x60036F3A /end MEASUREMENT
/begin MEASUREMENT DFC_b.TSC_ComMETATOut "Bit encoding / Ok-Tested Since Clear bit for check DFC_ComMETATOut" UBYTE DFC_OneToOne 1 100 0.00 1.000 BIT_MASK 0x20 FORMAT "%5.3" ECU_ADDRESS 0x60036F3B /end MEASUREMENT
/begin MEASUREMENT DFC_b.TSC_ComMETATOutPstDrv "Bit encoding / Ok-Tested Since Clear bit for check DFC_ComMETATOutPstDrv" UBYTE DFC_OneToOne 1 100 0.00 1.000 BIT_MASK 0x20 FORMAT "%5.3" ECU_ADDRESS 0x60036F3C /end MEASUREMENT
/begin MEASUREMENT DFC_b.TSC_ComMETCChksum "Bit encoding / Ok-Tested Since Clear bit for check DFC_ComMETCChksum" UBYTE DFC_OneToOne 1 100 0.00 1.000 BIT_MASK 0x20 FORMAT "%5.3" ECU_ADDRESS 0x60036F3D /end MEASUREMENT
/begin MEASUREMENT DFC_b.TSC_ComMETCRingCnt "Bit encoding / Ok-Tested Since Clear bit for check DFC_ComMETCRingCnt" UBYTE DFC_OneToOne 1 100 0.00 1.000 BIT_MASK 0x20 FORMAT "%5.3" ECU_ADDRESS 0x60036F3E /end MEASUREMENT
/begin MEASUREMENT DFC_b.TSC_ComMETCTOut "Bit encoding / Ok-Tested Since Clear bit for check DFC_ComMETCTOut" UBYTE DFC_OneToOne 1 100 0.00 1.000 BIT_MASK 0x20 FORMAT "%5.3" ECU_ADDRESS 0x60036F3F /end MEASUREMENT
/begin MEASUREMENT DFC_b.TSC_ComMETDChksum "Bit encoding / Ok-Tested Since Clear bit for check DFC_ComMETDChksum" UBYTE DFC_OneToOne 1 100 0.00 1.000 BIT_MASK 0x20 FORMAT "%5.3" ECU_ADDRESS 0x60036F40 /end MEASUREMENT
/begin MEASUREMENT DFC_b.TSC_ComMETDRingCnt "Bit encoding / Ok-Tested Since Clear bit for check DFC_ComMETDRingCnt" UBYTE DFC_OneToOne 1 100 0.00 1.000 BIT_MASK 0x20 FORMAT "%5.3" ECU_ADDRESS 0x60036F41 /end MEASUREMENT
/begin MEASUREMENT DFC_b.TSC_ComMETDTOut "Bit encoding / Ok-Tested Since Clear bit for check DFC_ComMETDTOut" UBYTE DFC_OneToOne 1 100 0.00 1.000 BIT_MASK 0x20 FORMAT "%5.3" ECU_ADDRESS 0x60036F42 /end MEASUREMENT
/begin MEASUREMENT DFC_b.TSC_ComMETE2Chksum "Bit encoding / Ok-Tested Since Clear bit for check DFC_ComMETE2Chksum" UBYTE DFC_OneToOne 1 100 0.00 1.000 BIT_MASK 0x20 FORMAT "%5.3" ECU_ADDRESS 0x60036F43 /end MEASUREMENT
/begin MEASUREMENT DFC_b.TSC_ComMETE2RingCnt "Bit encoding / Ok-Tested Since Clear bit for check DFC_ComMETE2RingCnt" UBYTE DFC_OneToOne 1 100 0.00 1.000 BIT_MASK 0x20 FORMAT "%5.3" ECU_ADDRESS 0x60036F44 /end MEASUREMENT
/begin MEASUREMENT DFC_b.TSC_ComMETE2TOut "Bit encoding / Ok-Tested Since Clear bit for check DFC_ComMETE2TOut" UBYTE DFC_OneToOne 1 100 0.00 1.000 BIT_MASK 0x20 FORMAT "%5.3" ECU_ADDRESS 0x60036F45 /end MEASUREMENT
/begin MEASUREMENT DFC_b.TSC_ComMETFChksum "Bit encoding / Ok-Tested Since Clear bit for check DFC_ComMETFChksum" UBYTE DFC_OneToOne 1 100 0.00 1.000 BIT_MASK 0x20 FORMAT "%5.3" ECU_ADDRESS 0x60036F46 /end MEASUREMENT
/begin MEASUREMENT DFC_b.TSC_ComMETFRingCnt "Bit encoding / Ok-Tested Since Clear bit for check DFC_ComMETFRingCnt" UBYTE DFC_OneToOne 1 100 0.00 1.000 BIT_MASK 0x20 FORMAT "%5.3" ECU_ADDRESS 0x60036F47 /end MEASUREMENT
/begin MEASUREMENT DFC_b.TSC_ComMETFTOut "Bit encoding / Ok-Tested Since Clear bit for check DFC_ComMETFTOut" UBYTE DFC_OneToOne 1 100 0.00 1.000 BIT_MASK 0x20 FORMAT "%5.3" ECU_ADDRESS 0x60036F48 /end MEASUREMENT
/begin MEASUREMENT DFC_b.TSC_ComMETGChksum "Bit encoding / Ok-Tested Since Clear bit for check DFC_ComMETGChksum" UBYTE DFC_OneToOne 1 100 0.00 1.000 BIT_MASK 0x20 FORMAT "%5.3" ECU_ADDRESS 0x60036F49 /end MEASUREMENT
/begin MEASUREMENT DFC_b.TSC_ComMETGRingCnt "Bit encoding / Ok-Tested Since Clear bit for check DFC_ComMETGRingCnt" UBYTE DFC_OneToOne 1 100 0.00 1.000 BIT_MASK 0x20 FORMAT "%5.3" ECU_ADDRESS 0x60036F4A /end MEASUREMENT
/begin MEASUREMENT DFC_b.TSC_ComMETGTOut "Bit encoding / Ok-Tested Since Clear bit for check DFC_ComMETGTOut" UBYTE DFC_OneToOne 1 100 0.00 1.000 BIT_MASK 0x20 FORMAT "%5.3" ECU_ADDRESS 0x60036F4B /end MEASUREMENT
/begin MEASUREMENT DFC_b.TSC_ComMETH2Chksum "Bit encoding / Ok-Tested Since Clear bit for check DFC_ComMETH2Chksum" UBYTE DFC_OneToOne 1 100 0.00 1.000 BIT_MASK 0x20 FORMAT "%5.3" ECU_ADDRESS 0x60036F4C /end MEASUREMENT
/begin MEASUREMENT DFC_b.TSC_ComMETH2RingCnt "Bit encoding / Ok-Tested Since Clear bit for check DFC_ComMETH2RingCnt" UBYTE DFC_OneToOne 1 100 0.00 1.000 BIT_MASK 0x20 FORMAT "%5.3" ECU_ADDRESS 0x60036F4D /end MEASUREMENT
/begin MEASUREMENT DFC_b.TSC_ComMETH2TOut "Bit encoding / Ok-Tested Since Clear bit for check DFC_ComMETH2TOut" UBYTE DFC_OneToOne 1 100 0.00 1.000 BIT_MASK 0x20 FORMAT "%5.3" ECU_ADDRESS 0x60036F4E /end MEASUREMENT
/begin MEASUREMENT DFC_b.TSC_ComMETHChksum "Bit encoding / Ok-Tested Since Clear bit for check DFC_ComMETHChksum" UBYTE DFC_OneToOne 1 100 0.00 1.000 BIT_MASK 0x20 FORMAT "%5.3" ECU_ADDRESS 0x60036F4F /end MEASUREMENT
/begin MEASUREMENT DFC_b.TSC_ComMETHRingCnt "Bit encoding / Ok-Tested Since Clear bit for check DFC_ComMETHRingCnt" UBYTE DFC_OneToOne 1 100 0.00 1.000 BIT_MASK 0x20 FORMAT "%5.3" ECU_ADDRESS 0x60036F50 /end MEASUREMENT
/begin MEASUREMENT DFC_b.TSC_ComMETHTOut "Bit encoding / Ok-Tested Since Clear bit for check DFC_ComMETHTOut" UBYTE DFC_OneToOne 1 100 0.00 1.000 BIT_MASK 0x20 FORMAT "%5.3" ECU_ADDRESS 0x60036F51 /end MEASUREMENT
/begin MEASUREMENT DFC_b.TSC_ComMETIChksum "Bit encoding / Ok-Tested Since Clear bit for check DFC_ComMETIChksum" UBYTE DFC_OneToOne 1 100 0.00 1.000 BIT_MASK 0x20 FORMAT "%5.3" ECU_ADDRESS 0x60036F52 /end MEASUREMENT
/begin MEASUREMENT DFC_b.TSC_ComMETIRingCnt "Bit encoding / Ok-Tested Since Clear bit for check DFC_ComMETIRingCnt" UBYTE DFC_OneToOne 1 100 0.00 1.000 BIT_MASK 0x20 FORMAT "%5.3" ECU_ADDRESS 0x60036F53 /end MEASUREMENT
/begin MEASUREMENT DFC_b.TSC_ComMETITOut "Bit encoding / Ok-Tested Since Clear bit for check DFC_ComMETITOut" UBYTE DFC_OneToOne 1 100 0.00 1.000 BIT_MASK 0x20 FORMAT "%5.3" ECU_ADDRESS 0x60036F54 /end MEASUREMENT
/begin MEASUREMENT DFC_b.TSC_ComMETKChksum "Bit encoding / Ok-Tested Since Clear bit for check DFC_ComMETKChksum" UBYTE DFC_OneToOne 1 100 0.00 1.000 BIT_MASK 0x20 FORMAT "%5.3" ECU_ADDRESS 0x60036F55 /end MEASUREMENT
/begin MEASUREMENT DFC_b.TSC_ComMETKRingCnt "Bit encoding / Ok-Tested Since Clear bit for check DFC_ComMETKRingCnt" UBYTE DFC_OneToOne 1 100 0.00 1.000 BIT_MASK 0x20 FORMAT "%5.3" ECU_ADDRESS 0x60036F56 /end MEASUREMENT
/begin MEASUREMENT DFC_b.TSC_ComMETKTOut "Bit encoding / Ok-Tested Since Clear bit for check DFC_ComMETKTOut" UBYTE DFC_OneToOne 1 100 0.00 1.000 BIT_MASK 0x20 FORMAT "%5.3" ECU_ADDRESS 0x60036F57 /end MEASUREMENT
/begin MEASUREMENT DFC_b.TSC_ComMETLChksum "Bit encoding / Ok-Tested Since Clear bit for check DFC_ComMETLChksum" UBYTE DFC_OneToOne 1 100 0.00 1.000 BIT_MASK 0x20 FORMAT "%5.3" ECU_ADDRESS 0x60036F58 /end MEASUREMENT
/begin MEASUREMENT DFC_b.TSC_ComMETLRingCnt "Bit encoding / Ok-Tested Since Clear bit for check DFC_ComMETLRingCnt" UBYTE DFC_OneToOne 1 100 0.00 1.000 BIT_MASK 0x20 FORMAT "%5.3" ECU_ADDRESS 0x60036F59 /end MEASUREMENT
/begin MEASUREMENT DFC_b.TSC_ComMETLTOut "Bit encoding / Ok-Tested Since Clear bit for check DFC_ComMETLTOut" UBYTE DFC_OneToOne 1 100 0.00 1.000 BIT_MASK 0x20 FORMAT "%5.3" ECU_ADDRESS 0x60036F5A /end MEASUREMENT
/begin MEASUREMENT DFC_b.TSC_ComMETMChksum "Bit encoding / Ok-Tested Since Clear bit for check DFC_ComMETMChksum" UBYTE DFC_OneToOne 1 100 0.00 1.000 BIT_MASK 0x20 FORMAT "%5.3" ECU_ADDRESS 0x60036F5B /end MEASUREMENT
/begin MEASUREMENT DFC_b.TSC_ComMETMRingCnt "Bit encoding / Ok-Tested Since Clear bit for check DFC_ComMETMRingCnt" UBYTE DFC_OneToOne 1 100 0.00 1.000 BIT_MASK 0x20 FORMAT "%5.3" ECU_ADDRESS 0x60036F5C /end MEASUREMENT
/begin MEASUREMENT DFC_b.TSC_ComMETMTOut "Bit encoding / Ok-Tested Since Clear bit for check DFC_ComMETMTOut" UBYTE DFC_OneToOne 1 100 0.00 1.000 BIT_MASK 0x20 FORMAT "%5.3" ECU_ADDRESS 0x60036F5D /end MEASUREMENT
/begin MEASUREMENT DFC_b.TSC_ComMETNChksum "Bit encoding / Ok-Tested Since Clear bit for check DFC_ComMETNChksum" UBYTE DFC_OneToOne 1 100 0.00 1.000 BIT_MASK 0x20 FORMAT "%5.3" ECU_ADDRESS 0x60036F5E /end MEASUREMENT
/begin MEASUREMENT DFC_b.TSC_ComMETNRingCnt "Bit encoding / Ok-Tested Since Clear bit for check DFC_ComMETNRingCnt" UBYTE DFC_OneToOne 1 100 0.00 1.000 BIT_MASK 0x20 FORMAT "%5.3" ECU_ADDRESS 0x60036F5F /end MEASUREMENT
/begin MEASUREMENT DFC_b.TSC_ComMETNTOut "Bit encoding / Ok-Tested Since Clear bit for check DFC_ComMETNTOut" UBYTE DFC_OneToOne 1 100 0.00 1.000 BIT_MASK 0x20 FORMAT "%5.3" ECU_ADDRESS 0x60036F60 /end MEASUREMENT
/begin MEASUREMENT DFC_b.TSC_ComMtrCom "Bit encoding / Ok-Tested Since Clear bit for check DFC_ComMtrCom" UBYTE DFC_OneToOne 1 100 0.00 1.000 BIT_MASK 0x20 FORMAT "%5.3" ECU_ADDRESS 0x60036F61 /end MEASUREMENT
/begin MEASUREMENT DFC_b.TSC_ComPCUChkSum "Bit encoding / Ok-Tested Since Clear bit for check DFC_ComPCUChkSum" UBYTE DFC_OneToOne 1 100 0.00 1.000 BIT_MASK 0x20 FORMAT "%5.3" ECU_ADDRESS 0x60036F62 /end MEASUREMENT
/begin MEASUREMENT DFC_b.TSC_ComPCURingCnt "Bit encoding / Ok-Tested Since Clear bit for check DFC_ComPCURingCnt" UBYTE DFC_OneToOne 1 100 0.00 1.000 BIT_MASK 0x20 FORMAT "%5.3" ECU_ADDRESS 0x60036F63 /end MEASUREMENT
/begin MEASUREMENT DFC_b.TSC_ComPCUTOut "Bit encoding / Ok-Tested Since Clear bit for check DFC_ComPCUTOut" UBYTE DFC_OneToOne 1 100 0.00 1.000 BIT_MASK 0x20 FORMAT "%5.3" ECU_ADDRESS 0x60036F64 /end MEASUREMENT
/begin MEASUREMENT DFC_b.TSC_ComSRSAChksum "Bit encoding / Ok-Tested Since Clear bit for check DFC_ComSRSAChksum" UBYTE DFC_OneToOne 1 100 0.00 1.000 BIT_MASK 0x20 FORMAT "%5.3" ECU_ADDRESS 0x60036F65 /end MEASUREMENT
/begin MEASUREMENT DFC_b.TSC_ComSRSARingCnt "Bit encoding / Ok-Tested Since Clear bit for check DFC_ComSRSARingCnt" UBYTE DFC_OneToOne 1 100 0.00 1.000 BIT_MASK 0x20 FORMAT "%5.3" ECU_ADDRESS 0x60036F66 /end MEASUREMENT
/begin MEASUREMENT DFC_b.TSC_ComSRSATOut "Bit encoding / Ok-Tested Since Clear bit for check DFC_ComSRSATOut" UBYTE DFC_OneToOne 1 100 0.00 1.000 BIT_MASK 0x20 FORMAT "%5.3" ECU_ADDRESS 0x60036F67 /end MEASUREMENT
/begin MEASUREMENT DFC_b.TSC_ComSRSBChksum "Bit encoding / Ok-Tested Since Clear bit for check DFC_ComSRSBChksum" UBYTE DFC_OneToOne 1 100 0.00 1.000 BIT_MASK 0x20 FORMAT "%5.3" ECU_ADDRESS 0x60036F68 /end MEASUREMENT
/begin MEASUREMENT DFC_b.TSC_ComSRSBRingCnt "Bit encoding / Ok-Tested Since Clear bit for check DFC_ComSRSBRingCnt" UBYTE DFC_OneToOne 1 100 0.00 1.000 BIT_MASK 0x20 FORMAT "%5.3" ECU_ADDRESS 0x60036F69 /end MEASUREMENT
/begin MEASUREMENT DFC_b.TSC_ComSRSBTOut "Bit encoding / Ok-Tested Since Clear bit for check DFC_ComSRSBTOut" UBYTE DFC_OneToOne 1 100 0.00 1.000 BIT_MASK 0x20 FORMAT "%5.3" ECU_ADDRESS 0x60036F6A /end MEASUREMENT
/begin MEASUREMENT DFC_b.TSC_ComSRSChksum "Bit encoding / Ok-Tested Since Clear bit for check DFC_ComSRSChksum" UBYTE DFC_OneToOne 1 100 0.00 1.000 BIT_MASK 0x20 FORMAT "%5.3" ECU_ADDRESS 0x60036F6B /end MEASUREMENT
/begin MEASUREMENT DFC_b.TSC_ComSRSErr "Bit encoding / Ok-Tested Since Clear bit for check DFC_ComSRSErr" UBYTE DFC_OneToOne 1 100 0.00 1.000 BIT_MASK 0x20 FORMAT "%5.3" ECU_ADDRESS 0x60036F6C /end MEASUREMENT
/begin MEASUREMENT DFC_b.TSC_ComSRSRingCnt "Bit encoding / Ok-Tested Since Clear bit for check DFC_ComSRSRingCnt" UBYTE DFC_OneToOne 1 100 0.00 1.000 BIT_MASK 0x20 FORMAT "%5.3" ECU_ADDRESS 0x60036F6D /end MEASUREMENT
/begin MEASUREMENT DFC_b.TSC_ComSRSTOut "Bit encoding / Ok-Tested Since Clear bit for check DFC_ComSRSTOut" UBYTE DFC_OneToOne 1 100 0.00 1.000 BIT_MASK 0x20 FORMAT "%5.3" ECU_ADDRESS 0x60036F6E /end MEASUREMENT
/begin MEASUREMENT DFC_b.TSC_ComVehSpdPndFltTCU "Bit encoding / Ok-Tested Since Clear bit for check DFC_ComVehSpdPndFltTCU" UBYTE DFC_OneToOne 1 100 0.00 1.000 BIT_MASK 0x20 FORMAT "%5.3" ECU_ADDRESS 0x60036F6F /end MEASUREMENT
/begin MEASUREMENT DFC_b.TSC_EbsChartcCurrErr "Bit encoding / Ok-Tested Since Clear bit for check DFC_EbsChartcCurrErr" UBYTE DFC_OneToOne 1 100 0.00 1.000 BIT_MASK 0x20 FORMAT "%5.3" ECU_ADDRESS 0x60036F70 /end MEASUREMENT
/begin MEASUREMENT DFC_b.TSC_EbsSelfDiagErr "Bit encoding / Ok-Tested Since Clear bit for check DFC_EbsSelfDiagErr" UBYTE DFC_OneToOne 1 100 0.00 1.000 BIT_MASK 0x20 FORMAT "%5.3" ECU_ADDRESS 0x60036F71 /end MEASUREMENT
/begin MEASUREMENT DFC_b.TSC_GEVlvPhaCsersIntkB1 "Bit encoding / Ok-Tested Since Clear bit for check DFC_GEVlvPhaCsersIntkB1" UBYTE DFC_OneToOne 1 100 0.00 1.000 BIT_MASK 0x20 FORMAT "%5.3" ECU_ADDRESS 0x60036F72 /end MEASUREMENT
/begin MEASUREMENT DFC_b.TSC_GEVlvPhaPsOpenLoadIntkB1 "Bit encoding / Ok-Tested Since Clear bit for check DFC_GEVlvPhaPsOpenLoadIntkB1" UBYTE DFC_OneToOne 1 100 0.00 1.000 BIT_MASK 0x20 FORMAT "%5.3" ECU_ADDRESS 0x60036F73 /end MEASUREMENT
/begin MEASUREMENT DFC_b.TSC_GEVlvPhaPsShoToBattIntkB1 "Bit encoding / Ok-Tested Since Clear bit for check DFC_GEVlvPhaPsShoToBattIntkB1" UBYTE DFC_OneToOne 1 100 0.00 1.000 BIT_MASK 0x20 FORMAT "%5.3" ECU_ADDRESS 0x60036F74 /end MEASUREMENT
/begin MEASUREMENT DFC_b.TSC_GEVlvPhaPsShoToGndIntkB1 "Bit encoding / Ok-Tested Since Clear bit for check DFC_GEVlvPhaPsShoToGndIntkB1" UBYTE DFC_OneToOne 1 100 0.00 1.000 BIT_MASK 0x20 FORMAT "%5.3" ECU_ADDRESS 0x60036F75 /end MEASUREMENT
/begin MEASUREMENT DFC_b.TSC_GbxCANDigPlausErr "Bit encoding / Ok-Tested Since Clear bit for check DFC_GbxCANDigPlausErr" UBYTE DFC_OneToOne 1 100 0.00 1.000 BIT_MASK 0x20 FORMAT "%5.3" ECU_ADDRESS 0x60036F76 /end MEASUREMENT
/begin MEASUREMENT DFC_b.TSC_GbxNPos1SRCMax "Bit encoding / Ok-Tested Since Clear bit for check DFC_GbxNPos1SRCMax" UBYTE DFC_OneToOne 1 100 0.00 1.000 BIT_MASK 0x20 FORMAT "%5.3" ECU_ADDRESS 0x60036F77 /end MEASUREMENT
/begin MEASUREMENT DFC_b.TSC_GbxNPos1SRCMin "Bit encoding / Ok-Tested Since Clear bit for check DFC_GbxNPos1SRCMin" UBYTE DFC_OneToOne 1 100 0.00 1.000 BIT_MASK 0x20 FORMAT "%5.3" ECU_ADDRESS 0x60036F78 /end MEASUREMENT
/begin MEASUREMENT DFC_b.TSC_GbxNPos2SRCMax "Bit encoding / Ok-Tested Since Clear bit for check DFC_GbxNPos2SRCMax" UBYTE DFC_OneToOne 1 100 0.00 1.000 BIT_MASK 0x20 FORMAT "%5.3" ECU_ADDRESS 0x60036F79 /end MEASUREMENT
/begin MEASUREMENT DFC_b.TSC_GbxNPos2SRCMin "Bit encoding / Ok-Tested Since Clear bit for check DFC_GbxNPos2SRCMin" UBYTE DFC_OneToOne 1 100 0.00 1.000 BIT_MASK 0x20 FORMAT "%5.3" ECU_ADDRESS 0x60036F7A /end MEASUREMENT
/begin MEASUREMENT DFC_b.TSC_GbxNPosAlvChk "Bit encoding / Ok-Tested Since Clear bit for check DFC_GbxNPosAlvChk" UBYTE DFC_OneToOne 1 100 0.00 1.000 BIT_MASK 0x20 FORMAT "%5.3" ECU_ADDRESS 0x60036F7B /end MEASUREMENT
/begin MEASUREMENT DFC_b.TSC_GbxNPosSyncErr "Bit encoding / Ok-Tested Since Clear bit for check DFC_GbxNPosSyncErr" UBYTE DFC_OneToOne 1 100 0.00 1.000 BIT_MASK 0x20 FORMAT "%5.3" ECU_ADDRESS 0x60036F7C /end MEASUREMENT
/begin MEASUREMENT DFC_b.TSC_HEGOS2B1HtrPsMax "Bit encoding / Ok-Tested Since Clear bit for check DFC_HEGOS2B1HtrPsMax" UBYTE DFC_OneToOne 1 100 0.00 1.000 BIT_MASK 0x20 FORMAT "%5.3" ECU_ADDRESS 0x60036F7D /end MEASUREMENT
/begin MEASUREMENT DFC_b.TSC_HEGOS2B1HtrPsMin "Bit encoding / Ok-Tested Since Clear bit for check DFC_HEGOS2B1HtrPsMin" UBYTE DFC_OneToOne 1 100 0.00 1.000 BIT_MASK 0x20 FORMAT "%5.3" ECU_ADDRESS 0x60036F7E /end MEASUREMENT
/begin MEASUREMENT DFC_b.TSC_HEGOS2B1HtrPsSig "Bit encoding / Ok-Tested Since Clear bit for check DFC_HEGOS2B1HtrPsSig" UBYTE DFC_OneToOne 1 100 0.00 1.000 BIT_MASK 0x20 FORMAT "%5.3" ECU_ADDRESS 0x60036F7F /end MEASUREMENT
/begin MEASUREMENT DFC_b.TSC_LinCSErrACG "Bit encoding / Ok-Tested Since Clear bit for check DFC_LinCSErrACG" UBYTE DFC_OneToOne 1 100 0.00 1.000 BIT_MASK 0x20 FORMAT "%5.3" ECU_ADDRESS 0x60036F80 /end MEASUREMENT
/begin MEASUREMENT DFC_b.TSC_LinCSErrAEV "Bit encoding / Ok-Tested Since Clear bit for check DFC_LinCSErrAEV" UBYTE DFC_OneToOne 1 100 0.00 1.000 BIT_MASK 0x20 FORMAT "%5.3" ECU_ADDRESS 0x60036F81 /end MEASUREMENT
/begin MEASUREMENT DFC_b.TSC_LinCSErrDCDC "Bit encoding / Ok-Tested Since Clear bit for check DFC_LinCSErrDCDC" UBYTE DFC_OneToOne 1 100 0.00 1.000 BIT_MASK 0x20 FORMAT "%5.3" ECU_ADDRESS 0x60036F82 /end MEASUREMENT
/begin MEASUREMENT DFC_b.TSC_LinCSErrEBS "Bit encoding / Ok-Tested Since Clear bit for check DFC_LinCSErrEBS" UBYTE DFC_OneToOne 1 100 0.00 1.000 BIT_MASK 0x20 FORMAT "%5.3" ECU_ADDRESS 0x60036F83 /end MEASUREMENT
/begin MEASUREMENT DFC_b.TSC_LinHdrTimeoutErrACG "Bit encoding / Ok-Tested Since Clear bit for check DFC_LinHdrTimeoutErrACG" UBYTE DFC_OneToOne 1 100 0.00 1.000 BIT_MASK 0x20 FORMAT "%5.3" ECU_ADDRESS 0x60036F84 /end MEASUREMENT
/begin MEASUREMENT DFC_b.TSC_LinHdrTimeoutErrAEV "Bit encoding / Ok-Tested Since Clear bit for check DFC_LinHdrTimeoutErrAEV" UBYTE DFC_OneToOne 1 100 0.00 1.000 BIT_MASK 0x20 FORMAT "%5.3" ECU_ADDRESS 0x60036F85 /end MEASUREMENT
/begin MEASUREMENT DFC_b.TSC_LinHdrTimeoutErrDCDC "Bit encoding / Ok-Tested Since Clear bit for check DFC_LinHdrTimeoutErrDCDC" UBYTE DFC_OneToOne 1 100 0.00 1.000 BIT_MASK 0x20 FORMAT "%5.3" ECU_ADDRESS 0x60036F86 /end MEASUREMENT
/begin MEASUREMENT DFC_b.TSC_LinHdrTimeoutErrEBS "Bit encoding / Ok-Tested Since Clear bit for check DFC_LinHdrTimeoutErrEBS" UBYTE DFC_OneToOne 1 100 0.00 1.000 BIT_MASK 0x20 FORMAT "%5.3" ECU_ADDRESS 0x60036F87 /end MEASUREMENT
/begin MEASUREMENT DFC_b.TSC_LinMsgTimeoutErrACG "Bit encoding / Ok-Tested Since Clear bit for check DFC_LinMsgTimeoutErrACG" UBYTE DFC_OneToOne 1 100 0.00 1.000 BIT_MASK 0x20 FORMAT "%5.3" ECU_ADDRESS 0x60036F88 /end MEASUREMENT
/begin MEASUREMENT DFC_b.TSC_LinMsgTimeoutErrAEV "Bit encoding / Ok-Tested Since Clear bit for check DFC_LinMsgTimeoutErrAEV" UBYTE DFC_OneToOne 1 100 0.00 1.000 BIT_MASK 0x20 FORMAT "%5.3" ECU_ADDRESS 0x60036F89 /end MEASUREMENT
/begin MEASUREMENT DFC_b.TSC_LinMsgTimeoutErrDCDC "Bit encoding / Ok-Tested Since Clear bit for check DFC_LinMsgTimeoutErrDCDC" UBYTE DFC_OneToOne 1 100 0.00 1.000 BIT_MASK 0x20 FORMAT "%5.3" ECU_ADDRESS 0x60036F8A /end MEASUREMENT
/begin MEASUREMENT DFC_b.TSC_LinMsgTimeoutErrEBS "Bit encoding / Ok-Tested Since Clear bit for check DFC_LinMsgTimeoutErrEBS" UBYTE DFC_OneToOne 1 100 0.00 1.000 BIT_MASK 0x20 FORMAT "%5.3" ECU_ADDRESS 0x60036F8B /end MEASUREMENT
/begin MEASUREMENT DFC_b.TSC_LinNoStrtComErr "Bit encoding / Ok-Tested Since Clear bit for check DFC_LinNoStrtComErr" UBYTE DFC_OneToOne 1 100 0.00 1.000 BIT_MASK 0x20 FORMAT "%5.3" ECU_ADDRESS 0x60036F8C /end MEASUREMENT
/begin MEASUREMENT DFC_b.TSC_LowPresOilP "Bit encoding / Ok-Tested Since Clear bit for check DFC_LowPresOilP" UBYTE DFC_OneToOne 1 100 0.00 1.000 BIT_MASK 0x20 FORMAT "%5.3" ECU_ADDRESS 0x60036F8D /end MEASUREMENT
/begin MEASUREMENT DFC_b.TSC_MisfDetVWhlFrntLeOORHi "Bit encoding / Ok-Tested Since Clear bit for check DFC_MisfDetVWhlFrntLeOORHi" UBYTE DFC_OneToOne 1 100 0.00 1.000 BIT_MASK 0x20 FORMAT "%5.3" ECU_ADDRESS 0x60036F8E /end MEASUREMENT
/begin MEASUREMENT DFC_b.TSC_MisfDetVWhlFrntLeRatyHi "Bit encoding / Ok-Tested Since Clear bit for check DFC_MisfDetVWhlFrntLeRatyHi" UBYTE DFC_OneToOne 1 100 0.00 1.000 BIT_MASK 0x20 FORMAT "%5.3" ECU_ADDRESS 0x60036F8F /end MEASUREMENT
/begin MEASUREMENT DFC_b.TSC_MisfDetVWhlFrntLeRatyLo "Bit encoding / Ok-Tested Since Clear bit for check DFC_MisfDetVWhlFrntLeRatyLo" UBYTE DFC_OneToOne 1 100 0.00 1.000 BIT_MASK 0x20 FORMAT "%5.3" ECU_ADDRESS 0x60036F90 /end MEASUREMENT
/begin MEASUREMENT DFC_b.TSC_MisfDetVWhlFrntLeStuck "Bit encoding / Ok-Tested Since Clear bit for check DFC_MisfDetVWhlFrntLeStuck" UBYTE DFC_OneToOne 1 100 0.00 1.000 BIT_MASK 0x20 FORMAT "%5.3" ECU_ADDRESS 0x60036F91 /end MEASUREMENT
/begin MEASUREMENT DFC_b.TSC_MisfDetVWhlFrntRiOORHi "Bit encoding / Ok-Tested Since Clear bit for check DFC_MisfDetVWhlFrntRiOORHi" UBYTE DFC_OneToOne 1 100 0.00 1.000 BIT_MASK 0x20 FORMAT "%5.3" ECU_ADDRESS 0x60036F92 /end MEASUREMENT
/begin MEASUREMENT DFC_b.TSC_MisfDetVWhlFrntRiRatyHi "Bit encoding / Ok-Tested Since Clear bit for check DFC_MisfDetVWhlFrntRiRatyHi" UBYTE DFC_OneToOne 1 100 0.00 1.000 BIT_MASK 0x20 FORMAT "%5.3" ECU_ADDRESS 0x60036F93 /end MEASUREMENT
/begin MEASUREMENT DFC_b.TSC_MisfDetVWhlFrntRiRatyLo "Bit encoding / Ok-Tested Since Clear bit for check DFC_MisfDetVWhlFrntRiRatyLo" UBYTE DFC_OneToOne 1 100 0.00 1.000 BIT_MASK 0x20 FORMAT "%5.3" ECU_ADDRESS 0x60036F94 /end MEASUREMENT
/begin MEASUREMENT DFC_b.TSC_MisfDetVWhlFrntRiStuck "Bit encoding / Ok-Tested Since Clear bit for check DFC_MisfDetVWhlFrntRiStuck" UBYTE DFC_OneToOne 1 100 0.00 1.000 BIT_MASK 0x20 FORMAT "%5.3" ECU_ADDRESS 0x60036F95 /end MEASUREMENT
/begin MEASUREMENT DFC_b.TSC_MisfDetVWhlReLeOORHi "Bit encoding / Ok-Tested Since Clear bit for check DFC_MisfDetVWhlReLeOORHi" UBYTE DFC_OneToOne 1 100 0.00 1.000 BIT_MASK 0x20 FORMAT "%5.3" ECU_ADDRESS 0x60036F96 /end MEASUREMENT
/begin MEASUREMENT DFC_b.TSC_MisfDetVWhlReLeRatyHi "Bit encoding / Ok-Tested Since Clear bit for check DFC_MisfDetVWhlReLeRatyHi" UBYTE DFC_OneToOne 1 100 0.00 1.000 BIT_MASK 0x20 FORMAT "%5.3" ECU_ADDRESS 0x60036F97 /end MEASUREMENT
/begin MEASUREMENT DFC_b.TSC_MisfDetVWhlReLeRatyLo "Bit encoding / Ok-Tested Since Clear bit for check DFC_MisfDetVWhlReLeRatyLo" UBYTE DFC_OneToOne 1 100 0.00 1.000 BIT_MASK 0x20 FORMAT "%5.3" ECU_ADDRESS 0x60036F98 /end MEASUREMENT
/begin MEASUREMENT DFC_b.TSC_MisfDetVWhlReLeStuck "Bit encoding / Ok-Tested Since Clear bit for check DFC_MisfDetVWhlReLeStuck" UBYTE DFC_OneToOne 1 100 0.00 1.000 BIT_MASK 0x20 FORMAT "%5.3" ECU_ADDRESS 0x60036F99 /end MEASUREMENT
/begin MEASUREMENT DFC_b.TSC_MisfDetVWhlReRiOORHi "Bit encoding / Ok-Tested Since Clear bit for check DFC_MisfDetVWhlReRiOORHi" UBYTE DFC_OneToOne 1 100 0.00 1.000 BIT_MASK 0x20 FORMAT "%5.3" ECU_ADDRESS 0x60036F9A /end MEASUREMENT
/begin MEASUREMENT DFC_b.TSC_MisfDetVWhlReRiRatyHi "Bit encoding / Ok-Tested Since Clear bit for check DFC_MisfDetVWhlReRiRatyHi" UBYTE DFC_OneToOne 1 100 0.00 1.000 BIT_MASK 0x20 FORMAT "%5.3" ECU_ADDRESS 0x60036F9B /end MEASUREMENT
/begin MEASUREMENT DFC_b.TSC_MisfDetVWhlReRiRatyLo "Bit encoding / Ok-Tested Since Clear bit for check DFC_MisfDetVWhlReRiRatyLo" UBYTE DFC_OneToOne 1 100 0.00 1.000 BIT_MASK 0x20 FORMAT "%5.3" ECU_ADDRESS 0x60036F9C /end MEASUREMENT
/begin MEASUREMENT DFC_b.TSC_MisfDetVWhlReRiStuck "Bit encoding / Ok-Tested Since Clear bit for check DFC_MisfDetVWhlReRiStuck" UBYTE DFC_OneToOne 1 100 0.00 1.000 BIT_MASK 0x20 FORMAT "%5.3" ECU_ADDRESS 0x60036F9D /end MEASUREMENT
/begin MEASUREMENT DFC_b.TSC_MisfDetdVWhlFrntLePlaus "Bit encoding / Ok-Tested Since Clear bit for check DFC_MisfDetdVWhlFrntLePlaus" UBYTE DFC_OneToOne 1 100 0.00 1.000 BIT_MASK 0x20 FORMAT "%5.3" ECU_ADDRESS 0x60036F9E /end MEASUREMENT
/begin MEASUREMENT DFC_b.TSC_MisfDetdVWhlFrntRiPlaus "Bit encoding / Ok-Tested Since Clear bit for check DFC_MisfDetdVWhlFrntRiPlaus" UBYTE DFC_OneToOne 1 100 0.00 1.000 BIT_MASK 0x20 FORMAT "%5.3" ECU_ADDRESS 0x60036F9F /end MEASUREMENT
/begin MEASUREMENT DFC_b.TSC_MisfDetdVWhlReLePlaus "Bit encoding / Ok-Tested Since Clear bit for check DFC_MisfDetdVWhlReLePlaus" UBYTE DFC_OneToOne 1 100 0.00 1.000 BIT_MASK 0x20 FORMAT "%5.3" ECU_ADDRESS 0x60036FA0 /end MEASUREMENT
/begin MEASUREMENT DFC_b.TSC_MisfDetdVWhlReRiPlaus "Bit encoding / Ok-Tested Since Clear bit for check DFC_MisfDetdVWhlReRiPlaus" UBYTE DFC_OneToOne 1 100 0.00 1.000 BIT_MASK 0x20 FORMAT "%5.3" ECU_ADDRESS 0x60036FA1 /end MEASUREMENT
/begin MEASUREMENT DFC_b.TSC_PEnvSigRngMax "Bit encoding / Ok-Tested Since Clear bit for check DFC_PEnvSigRngMax" UBYTE DFC_OneToOne 1 100 0.00 1.000 BIT_MASK 0x20 FORMAT "%5.3" ECU_ADDRESS 0x60036FA2 /end MEASUREMENT
/begin MEASUREMENT DFC_b.TSC_PEnvSigRngMin "Bit encoding / Ok-Tested Since Clear bit for check DFC_PEnvSigRngMin" UBYTE DFC_OneToOne 1 100 0.00 1.000 BIT_MASK 0x20 FORMAT "%5.3" ECU_ADDRESS 0x60036FA3 /end MEASUREMENT
/begin MEASUREMENT DFC_b.TSC_StmFault "Bit encoding / Ok-Tested Since Clear bit for check DFC_StmFault" UBYTE DFC_OneToOne 1 100 0.00 1.000 BIT_MASK 0x20 FORMAT "%5.3" ECU_ADDRESS 0x60036FA4 /end MEASUREMENT
/begin MEASUREMENT DFC_b.TSC_StrtCtOffPth "Bit encoding / Ok-Tested Since Clear bit for check DFC_StrtCtOffPth" UBYTE DFC_OneToOne 1 100 0.00 1.000 BIT_MASK 0x20 FORMAT "%5.3" ECU_ADDRESS 0x60036FA5 /end MEASUREMENT
/begin MEASUREMENT DFC_b.TSC_StrtCtlErr "Bit encoding / Ok-Tested Since Clear bit for check DFC_StrtCtlErr" UBYTE DFC_OneToOne 1 100 0.00 1.000 BIT_MASK 0x20 FORMAT "%5.3" ECU_ADDRESS 0x60036FA6 /end MEASUREMENT
/begin MEASUREMENT DFC_b.TSC_StrtFault "Bit encoding / Ok-Tested Since Clear bit for check DFC_StrtFault" UBYTE DFC_OneToOne 1 100 0.00 1.000 BIT_MASK 0x20 FORMAT "%5.3" ECU_ADDRESS 0x60036FA7 /end MEASUREMENT
/begin MEASUREMENT DFC_b.TSC_StrtLckJudg1 "Bit encoding / Ok-Tested Since Clear bit for check DFC_StrtLckJudg1" UBYTE DFC_OneToOne 1 100 0.00 1.000 BIT_MASK 0x20 FORMAT "%5.3" ECU_ADDRESS 0x60036FA8 /end MEASUREMENT
/begin MEASUREMENT DFC_b.TSC_StrtLckJudg2 "Bit encoding / Ok-Tested Since Clear bit for check DFC_StrtLckJudg2" UBYTE DFC_OneToOne 1 100 0.00 1.000 BIT_MASK 0x20 FORMAT "%5.3" ECU_ADDRESS 0x60036FA9 /end MEASUREMENT
/begin MEASUREMENT DFC_b.TSC_StrtOL "Bit encoding / Ok-Tested Since Clear bit for check DFC_StrtOL" UBYTE DFC_OneToOne 1 100 0.00 1.000 BIT_MASK 0x20 FORMAT "%5.3" ECU_ADDRESS 0x60036FAA /end MEASUREMENT
/begin MEASUREMENT DFC_b.TSC_StrtOL2 "Bit encoding / Ok-Tested Since Clear bit for check DFC_StrtOL2" UBYTE DFC_OneToOne 1 100 0.00 1.000 BIT_MASK 0x20 FORMAT "%5.3" ECU_ADDRESS 0x60036FAB /end MEASUREMENT
/begin MEASUREMENT DFC_b.TSC_StrtSCB "Bit encoding / Ok-Tested Since Clear bit for check DFC_StrtSCB" UBYTE DFC_OneToOne 1 100 0.00 1.000 BIT_MASK 0x20 FORMAT "%5.3" ECU_ADDRESS 0x60036FAC /end MEASUREMENT
/begin MEASUREMENT DFC_b.TSC_StrtSCB2 "Bit encoding / Ok-Tested Since Clear bit for check DFC_StrtSCB2" UBYTE DFC_OneToOne 1 100 0.00 1.000 BIT_MASK 0x20 FORMAT "%5.3" ECU_ADDRESS 0x60036FAD /end MEASUREMENT
/begin MEASUREMENT DFC_b.TSC_StrtSCG "Bit encoding / Ok-Tested Since Clear bit for check DFC_StrtSCG" UBYTE DFC_OneToOne 1 100 0.00 1.000 BIT_MASK 0x20 FORMAT "%5.3" ECU_ADDRESS 0x60036FAE /end MEASUREMENT
/begin MEASUREMENT DFC_b.TSC_StrtSCG2 "Bit encoding / Ok-Tested Since Clear bit for check DFC_StrtSCG2" UBYTE DFC_OneToOne 1 100 0.00 1.000 BIT_MASK 0x20 FORMAT "%5.3" ECU_ADDRESS 0x60036FAF /end MEASUREMENT
/begin MEASUREMENT DFC_b.TSC_StrtStkRly1 "Bit encoding / Ok-Tested Since Clear bit for check DFC_StrtStkRly1" UBYTE DFC_OneToOne 1 100 0.00 1.000 BIT_MASK 0x20 FORMAT "%5.3" ECU_ADDRESS 0x60036FB0 /end MEASUREMENT
/begin MEASUREMENT DFC_b.TSC_StrtStkRly2 "Bit encoding / Ok-Tested Since Clear bit for check DFC_StrtStkRly2" UBYTE DFC_OneToOne 1 100 0.00 1.000 BIT_MASK 0x20 FORMAT "%5.3" ECU_ADDRESS 0x60036FB1 /end MEASUREMENT
/begin MEASUREMENT DFC_b.TSC_TEVEmax "Bit encoding / Ok-Tested Since Clear bit for check DFC_TEVEmax" UBYTE DFC_OneToOne 1 100 0.00 1.000 BIT_MASK 0x20 FORMAT "%5.3" ECU_ADDRESS 0x60036FB2 /end MEASUREMENT
/begin MEASUREMENT DFC_b.TSC_TEVEmin "Bit encoding / Ok-Tested Since Clear bit for check DFC_TEVEmin" UBYTE DFC_OneToOne 1 100 0.00 1.000 BIT_MASK 0x20 FORMAT "%5.3" ECU_ADDRESS 0x60036FB3 /end MEASUREMENT
/begin MEASUREMENT DFC_b.TSC_TEVEsig "Bit encoding / Ok-Tested Since Clear bit for check DFC_TEVEsig" UBYTE DFC_OneToOne 1 100 0.00 1.000 BIT_MASK 0x20 FORMAT "%5.3" ECU_ADDRESS 0x60036FB4 /end MEASUREMENT
/begin MEASUREMENT DFC_b.TSC_UegoHeatrPrfmncLoS1B1 "Bit encoding / Ok-Tested Since Clear bit for check DFC_UegoHeatrPrfmncLoS1B1" UBYTE DFC_OneToOne 1 100 0.00 1.000 BIT_MASK 0x20 FORMAT "%5.3" ECU_ADDRESS 0x60036FB5 /end MEASUREMENT
/begin MEASUREMENT DFC_b.TSC_VehVAllPlaus "Bit encoding / Ok-Tested Since Clear bit for check DFC_VehVAllPlaus" UBYTE DFC_OneToOne 1 100 0.00 1.000 BIT_MASK 0x20 FORMAT "%5.3" ECU_ADDRESS 0x60036FB6 /end MEASUREMENT
/begin MEASUREMENT DFC_b.TSC_VehVNCSnsrElecFailr "Bit encoding / Ok-Tested Since Clear bit for check DFC_VehVNCSnsrElecFailr" UBYTE DFC_OneToOne 1 100 0.00 1.000 BIT_MASK 0x20 FORMAT "%5.3" ECU_ADDRESS 0x60036FB7 /end MEASUREMENT
/begin MEASUREMENT DFC_b.TSC_VehVPlausCan "Bit encoding / Ok-Tested Since Clear bit for check DFC_VehVPlausCan" UBYTE DFC_OneToOne 1 100 0.00 1.000 BIT_MASK 0x20 FORMAT "%5.3" ECU_ADDRESS 0x60036FB8 /end MEASUREMENT
/begin MEASUREMENT DFC_b.TSC_VehVPlausFco "Bit encoding / Ok-Tested Since Clear bit for check DFC_VehVPlausFco" UBYTE DFC_OneToOne 1 100 0.00 1.000 BIT_MASK 0x20 FORMAT "%5.3" ECU_ADDRESS 0x60036FB9 /end MEASUREMENT
/begin MEASUREMENT DFC_b.TSC_VehVPlausPwr "Bit encoding / Ok-Tested Since Clear bit for check DFC_VehVPlausPwr" UBYTE DFC_OneToOne 1 100 0.00 1.000 BIT_MASK 0x20 FORMAT "%5.3" ECU_ADDRESS 0x60036FBA /end MEASUREMENT
/begin MEASUREMENT DFC_b.TSC_VehVPlausV2N "Bit encoding / Ok-Tested Since Clear bit for check DFC_VehVPlausV2N" UBYTE DFC_OneToOne 1 100 0.00 1.000 BIT_MASK 0x20 FORMAT "%5.3" ECU_ADDRESS 0x60036FBB /end MEASUREMENT
/begin MEASUREMENT DFC_b.TSC_VehVSpdSnsrAElecFailr "Bit encoding / Ok-Tested Since Clear bit for check DFC_VehVSpdSnsrAElecFailr" UBYTE DFC_OneToOne 1 100 0.00 1.000 BIT_MASK 0x20 FORMAT "%5.3" ECU_ADDRESS 0x60036FBC /end MEASUREMENT
/begin MEASUREMENT DFC_b.TSC_VehVSpdSnsrBElecFailr "Bit encoding / Ok-Tested Since Clear bit for check DFC_VehVSpdSnsrBElecFailr" UBYTE DFC_OneToOne 1 100 0.00 1.000 BIT_MASK 0x20 FORMAT "%5.3" ECU_ADDRESS 0x60036FBD /end MEASUREMENT
/begin MEASUREMENT DFC_b.TSC_ClthMax "Bit encoding / Ok-Tested Since Clear bit for check DFC_ClthMax" UBYTE DFC_OneToOne 1 100 0.00 1.000 BIT_MASK 0x20 FORMAT "%5.3" ECU_ADDRESS 0x60036FBE /end MEASUREMENT
/begin MEASUREMENT DFC_b.TSC_IgnClPs_DevComErr "Bit encoding / Ok-Tested Since Clear bit for check DFC_IgnClPs_DevComErr" UBYTE DFC_OneToOne 1 100 0.00 1.000 BIT_MASK 0x20 FORMAT "%5.3" ECU_ADDRESS 0x60036FBF /end MEASUREMENT
/begin MEASUREMENT DFC_b.TSC_IgnClPs_LineOl_0 "Bit encoding / Ok-Tested Since Clear bit for check DFC_IgnClPs_LineOl_0" UBYTE DFC_OneToOne 1 100 0.00 1.000 BIT_MASK 0x20 FORMAT "%5.3" ECU_ADDRESS 0x60036FC0 /end MEASUREMENT
/begin MEASUREMENT DFC_b.TSC_IgnClPs_LineOl_1 "Bit encoding / Ok-Tested Since Clear bit for check DFC_IgnClPs_LineOl_1" UBYTE DFC_OneToOne 1 100 0.00 1.000 BIT_MASK 0x20 FORMAT "%5.3" ECU_ADDRESS 0x60036FC1 /end MEASUREMENT
/begin MEASUREMENT DFC_b.TSC_IgnClPs_LineOl_2 "Bit encoding / Ok-Tested Since Clear bit for check DFC_IgnClPs_LineOl_2" UBYTE DFC_OneToOne 1 100 0.00 1.000 BIT_MASK 0x20 FORMAT "%5.3" ECU_ADDRESS 0x60036FC2 /end MEASUREMENT
/begin MEASUREMENT DFC_b.TSC_IgnClPs_LineOl_3 "Bit encoding / Ok-Tested Since Clear bit for check DFC_IgnClPs_LineOl_3" UBYTE DFC_OneToOne 1 100 0.00 1.000 BIT_MASK 0x20 FORMAT "%5.3" ECU_ADDRESS 0x60036FC3 /end MEASUREMENT
/begin MEASUREMENT DFC_b.TSC_IgnClPs_LineScb_0 "Bit encoding / Ok-Tested Since Clear bit for check DFC_IgnClPs_LineScb_0" UBYTE DFC_OneToOne 1 100 0.00 1.000 BIT_MASK 0x20 FORMAT "%5.3" ECU_ADDRESS 0x60036FC4 /end MEASUREMENT
/begin MEASUREMENT DFC_b.TSC_IgnClPs_LineScb_1 "Bit encoding / Ok-Tested Since Clear bit for check DFC_IgnClPs_LineScb_1" UBYTE DFC_OneToOne 1 100 0.00 1.000 BIT_MASK 0x20 FORMAT "%5.3" ECU_ADDRESS 0x60036FC5 /end MEASUREMENT
/begin MEASUREMENT DFC_b.TSC_IgnClPs_LineScb_2 "Bit encoding / Ok-Tested Since Clear bit for check DFC_IgnClPs_LineScb_2" UBYTE DFC_OneToOne 1 100 0.00 1.000 BIT_MASK 0x20 FORMAT "%5.3" ECU_ADDRESS 0x60036FC6 /end MEASUREMENT
/begin MEASUREMENT DFC_b.TSC_IgnClPs_LineScb_3 "Bit encoding / Ok-Tested Since Clear bit for check DFC_IgnClPs_LineScb_3" UBYTE DFC_OneToOne 1 100 0.00 1.000 BIT_MASK 0x20 FORMAT "%5.3" ECU_ADDRESS 0x60036FC7 /end MEASUREMENT
/begin MEASUREMENT DFC_b.TSC_IgnClPs_LineScg_0 "Bit encoding / Ok-Tested Since Clear bit for check DFC_IgnClPs_LineScg_0" UBYTE DFC_OneToOne 1 100 0.00 1.000 BIT_MASK 0x20 FORMAT "%5.3" ECU_ADDRESS 0x60036FC8 /end MEASUREMENT
/begin MEASUREMENT DFC_b.TSC_IgnClPs_LineScg_1 "Bit encoding / Ok-Tested Since Clear bit for check DFC_IgnClPs_LineScg_1" UBYTE DFC_OneToOne 1 100 0.00 1.000 BIT_MASK 0x20 FORMAT "%5.3" ECU_ADDRESS 0x60036FC9 /end MEASUREMENT
/begin MEASUREMENT DFC_b.TSC_IgnClPs_LineScg_2 "Bit encoding / Ok-Tested Since Clear bit for check DFC_IgnClPs_LineScg_2" UBYTE DFC_OneToOne 1 100 0.00 1.000 BIT_MASK 0x20 FORMAT "%5.3" ECU_ADDRESS 0x60036FCA /end MEASUREMENT
/begin MEASUREMENT DFC_b.TSC_IgnClPs_LineScg_3 "Bit encoding / Ok-Tested Since Clear bit for check DFC_IgnClPs_LineScg_3" UBYTE DFC_OneToOne 1 100 0.00 1.000 BIT_MASK 0x20 FORMAT "%5.3" ECU_ADDRESS 0x60036FCB /end MEASUREMENT
/begin MEASUREMENT DFC_b.TSC_KRVEKOEVAB "Bit encoding / Ok-Tested Since Clear bit for check DFC_KRVEKOEVAB" UBYTE DFC_OneToOne 1 100 0.00 1.000 BIT_MASK 0x20 FORMAT "%5.3" ECU_ADDRESS 0x60036FCC /end MEASUREMENT
/begin MEASUREMENT DFC_b.TSC_KRVEKOEVAB0 "Bit encoding / Ok-Tested Since Clear bit for check DFC_KRVEKOEVAB0" UBYTE DFC_OneToOne 1 100 0.00 1.000 BIT_MASK 0x20 FORMAT "%5.3" ECU_ADDRESS 0x60036FCD /end MEASUREMENT
/begin MEASUREMENT DFC_b.TSC_KRVEKOEVAB1 "Bit encoding / Ok-Tested Since Clear bit for check DFC_KRVEKOEVAB1" UBYTE DFC_OneToOne 1 100 0.00 1.000 BIT_MASK 0x20 FORMAT "%5.3" ECU_ADDRESS 0x60036FCE /end MEASUREMENT
/begin MEASUREMENT DFC_b.TSC_KRVEKOEVAB2 "Bit encoding / Ok-Tested Since Clear bit for check DFC_KRVEKOEVAB2" UBYTE DFC_OneToOne 1 100 0.00 1.000 BIT_MASK 0x20 FORMAT "%5.3" ECU_ADDRESS 0x60036FCF /end MEASUREMENT
/begin MEASUREMENT DFC_b.TSC_KRVEKOEVAB3 "Bit encoding / Ok-Tested Since Clear bit for check DFC_KRVEKOEVAB3" UBYTE DFC_OneToOne 1 100 0.00 1.000 BIT_MASK 0x20 FORMAT "%5.3" ECU_ADDRESS 0x60036FD0 /end MEASUREMENT
/begin MEASUREMENT DFC_b.TSC_UegoSigEcuAsicS1B1 "Bit encoding / Ok-Tested Since Clear bit for check DFC_UegoSigEcuAsicS1B1" UBYTE DFC_OneToOne 1 100 0.00 1.000 BIT_MASK 0x20 FORMAT "%5.3" ECU_ADDRESS 0x60036FD1 /end MEASUREMENT
/begin MEASUREMENT DFC_b.TSC_UegoSigEcuComS1B1 "Bit encoding / Ok-Tested Since Clear bit for check DFC_UegoSigEcuComS1B1" UBYTE DFC_OneToOne 1 100 0.00 1.000 BIT_MASK 0x20 FORMAT "%5.3" ECU_ADDRESS 0x60036FD2 /end MEASUREMENT
/begin MEASUREMENT DFC_b.TSC_UegoSigSnsrS1B1 "Bit encoding / Ok-Tested Since Clear bit for check DFC_UegoSigSnsrS1B1" UBYTE DFC_OneToOne 1 100 0.00 1.000 BIT_MASK 0x20 FORMAT "%5.3" ECU_ADDRESS 0x60036FD3 /end MEASUREMENT
/begin MEASUREMENT DFC_b.TSC_UegoSigWireOlApesS1B1 "Bit encoding / Ok-Tested Since Clear bit for check DFC_UegoSigWireOlApesS1B1" UBYTE DFC_OneToOne 1 100 0.00 1.000 BIT_MASK 0x20 FORMAT "%5.3" ECU_ADDRESS 0x60036FD4 /end MEASUREMENT
/begin MEASUREMENT DFC_b.TSC_UegoSigWireOlIpeS1B1 "Bit encoding / Ok-Tested Since Clear bit for check DFC_UegoSigWireOlIpeS1B1" UBYTE DFC_OneToOne 1 100 0.00 1.000 BIT_MASK 0x20 FORMAT "%5.3" ECU_ADDRESS 0x60036FD5 /end MEASUREMENT
/begin MEASUREMENT DFC_b.TSC_UegoSigWireOlReS1B1 "Bit encoding / Ok-Tested Since Clear bit for check DFC_UegoSigWireOlReS1B1" UBYTE DFC_OneToOne 1 100 0.00 1.000 BIT_MASK 0x20 FORMAT "%5.3" ECU_ADDRESS 0x60036FD6 /end MEASUREMENT
/begin MEASUREMENT DFC_b.TSC_UegoSigWireRCmpS1B1 "Bit encoding / Ok-Tested Since Clear bit for check DFC_UegoSigWireRCmpS1B1" UBYTE DFC_OneToOne 1 100 0.00 1.000 BIT_MASK 0x20 FORMAT "%5.3" ECU_ADDRESS 0x60036FD7 /end MEASUREMENT
/begin MEASUREMENT DFC_b.TSC_UegoSigWireScbS1B1 "Bit encoding / Ok-Tested Since Clear bit for check DFC_UegoSigWireScbS1B1" UBYTE DFC_OneToOne 1 100 0.00 1.000 BIT_MASK 0x20 FORMAT "%5.3" ECU_ADDRESS 0x60036FD8 /end MEASUREMENT
/begin MEASUREMENT DFC_b.TSC_UegoSigWireScgS1B1 "Bit encoding / Ok-Tested Since Clear bit for check DFC_UegoSigWireScgS1B1" UBYTE DFC_OneToOne 1 100 0.00 1.000 BIT_MASK 0x20 FORMAT "%5.3" ECU_ADDRESS 0x60036FD9 /end MEASUREMENT
/begin MEASUREMENT DFC_b.TSC_AfsPhyRngHiB1 "Bit encoding / Ok-Tested Since Clear bit for check DFC_AfsPhyRngHiB1" UBYTE DFC_OneToOne 1 100 0.00 1.000 BIT_MASK 0x20 FORMAT "%5.3" ECU_ADDRESS 0x60036FDA /end MEASUREMENT
/begin MEASUREMENT DFC_b.TSC_AfsPhyRngLoB1 "Bit encoding / Ok-Tested Since Clear bit for check DFC_AfsPhyRngLoB1" UBYTE DFC_OneToOne 1 100 0.00 1.000 BIT_MASK 0x20 FORMAT "%5.3" ECU_ADDRESS 0x60036FDB /end MEASUREMENT
/begin MEASUREMENT DFC_b.TSC_AirCCmprOL "Bit encoding / Ok-Tested Since Clear bit for check DFC_AirCCmprOL" UBYTE DFC_OneToOne 1 100 0.00 1.000 BIT_MASK 0x20 FORMAT "%5.3" ECU_ADDRESS 0x60036FDC /end MEASUREMENT
/begin MEASUREMENT DFC_b.TSC_AirCCmprOvrTemp "Bit encoding / Ok-Tested Since Clear bit for check DFC_AirCCmprOvrTemp" UBYTE DFC_OneToOne 1 100 0.00 1.000 BIT_MASK 0x20 FORMAT "%5.3" ECU_ADDRESS 0x60036FDD /end MEASUREMENT
/begin MEASUREMENT DFC_b.TSC_AirCCmprSCB "Bit encoding / Ok-Tested Since Clear bit for check DFC_AirCCmprSCB" UBYTE DFC_OneToOne 1 100 0.00 1.000 BIT_MASK 0x20 FORMAT "%5.3" ECU_ADDRESS 0x60036FDE /end MEASUREMENT
/begin MEASUREMENT DFC_b.TSC_AirCCmprSCG "Bit encoding / Ok-Tested Since Clear bit for check DFC_AirCCmprSCG" UBYTE DFC_OneToOne 1 100 0.00 1.000 BIT_MASK 0x20 FORMAT "%5.3" ECU_ADDRESS 0x60036FDF /end MEASUREMENT
/begin MEASUREMENT DFC_b.TSC_AltErr "Bit encoding / Ok-Tested Since Clear bit for check DFC_AltErr" UBYTE DFC_OneToOne 1 100 0.00 1.000 BIT_MASK 0x20 FORMAT "%5.3" ECU_ADDRESS 0x60036FE0 /end MEASUREMENT
/begin MEASUREMENT DFC_b.TSC_BattUSRCMax "Bit encoding / Ok-Tested Since Clear bit for check DFC_BattUSRCMax" UBYTE DFC_OneToOne 1 100 0.00 1.000 BIT_MASK 0x20 FORMAT "%5.3" ECU_ADDRESS 0x60036FE1 /end MEASUREMENT
/begin MEASUREMENT DFC_b.TSC_BattUSRCMin "Bit encoding / Ok-Tested Since Clear bit for check DFC_BattUSRCMin" UBYTE DFC_OneToOne 1 100 0.00 1.000 BIT_MASK 0x20 FORMAT "%5.3" ECU_ADDRESS 0x60036FE2 /end MEASUREMENT
/begin MEASUREMENT DFC_b.TSC_ComChksTCU1 "Bit encoding / Ok-Tested Since Clear bit for check DFC_ComChksTCU1" UBYTE DFC_OneToOne 1 100 0.00 1.000 BIT_MASK 0x20 FORMAT "%5.3" ECU_ADDRESS 0x60036FE3 /end MEASUREMENT
/begin MEASUREMENT DFC_b.TSC_ComChksTCU11 "Bit encoding / Ok-Tested Since Clear bit for check DFC_ComChksTCU11" UBYTE DFC_OneToOne 1 100 0.00 1.000 BIT_MASK 0x20 FORMAT "%5.3" ECU_ADDRESS 0x60036FE4 /end MEASUREMENT
/begin MEASUREMENT DFC_b.TSC_ComChksTCU12 "Bit encoding / Ok-Tested Since Clear bit for check DFC_ComChksTCU12" UBYTE DFC_OneToOne 1 100 0.00 1.000 BIT_MASK 0x20 FORMAT "%5.3" ECU_ADDRESS 0x60036FE5 /end MEASUREMENT
/begin MEASUREMENT DFC_b.TSC_ComChksTCU13 "Bit encoding / Ok-Tested Since Clear bit for check DFC_ComChksTCU13" UBYTE DFC_OneToOne 1 100 0.00 1.000 BIT_MASK 0x20 FORMAT "%5.3" ECU_ADDRESS 0x60036FE6 /end MEASUREMENT
/begin MEASUREMENT DFC_b.TSC_ComChksTCU2 "Bit encoding / Ok-Tested Since Clear bit for check DFC_ComChksTCU2" UBYTE DFC_OneToOne 1 100 0.00 1.000 BIT_MASK 0x20 FORMAT "%5.3" ECU_ADDRESS 0x60036FE7 /end MEASUREMENT
/begin MEASUREMENT DFC_b.TSC_ComChksTCU3 "Bit encoding / Ok-Tested Since Clear bit for check DFC_ComChksTCU3" UBYTE DFC_OneToOne 1 100 0.00 1.000 BIT_MASK 0x20 FORMAT "%5.3" ECU_ADDRESS 0x60036FE8 /end MEASUREMENT
/begin MEASUREMENT DFC_b.TSC_ComChksTCU4 "Bit encoding / Ok-Tested Since Clear bit for check DFC_ComChksTCU4" UBYTE DFC_OneToOne 1 100 0.00 1.000 BIT_MASK 0x20 FORMAT "%5.3" ECU_ADDRESS 0x60036FE9 /end MEASUREMENT
/begin MEASUREMENT DFC_b.TSC_ComCntTCU1 "Bit encoding / Ok-Tested Since Clear bit for check DFC_ComCntTCU1" UBYTE DFC_OneToOne 1 100 0.00 1.000 BIT_MASK 0x20 FORMAT "%5.3" ECU_ADDRESS 0x60036FEA /end MEASUREMENT
/begin MEASUREMENT DFC_b.TSC_ComCntTCU11 "Bit encoding / Ok-Tested Since Clear bit for check DFC_ComCntTCU11" UBYTE DFC_OneToOne 1 100 0.00 1.000 BIT_MASK 0x20 FORMAT "%5.3" ECU_ADDRESS 0x60036FEB /end MEASUREMENT
/begin MEASUREMENT DFC_b.TSC_ComCntTCU12 "Bit encoding / Ok-Tested Since Clear bit for check DFC_ComCntTCU12" UBYTE DFC_OneToOne 1 100 0.00 1.000 BIT_MASK 0x20 FORMAT "%5.3" ECU_ADDRESS 0x60036FEC /end MEASUREMENT
/begin MEASUREMENT DFC_b.TSC_ComCntTCU13 "Bit encoding / Ok-Tested Since Clear bit for check DFC_ComCntTCU13" UBYTE DFC_OneToOne 1 100 0.00 1.000 BIT_MASK 0x20 FORMAT "%5.3" ECU_ADDRESS 0x60036FED /end MEASUREMENT
/begin MEASUREMENT DFC_b.TSC_ComCntTCU2 "Bit encoding / Ok-Tested Since Clear bit for check DFC_ComCntTCU2" UBYTE DFC_OneToOne 1 100 0.00 1.000 BIT_MASK 0x20 FORMAT "%5.3" ECU_ADDRESS 0x60036FEE /end MEASUREMENT
/begin MEASUREMENT DFC_b.TSC_ComCntTCU3 "Bit encoding / Ok-Tested Since Clear bit for check DFC_ComCntTCU3" UBYTE DFC_OneToOne 1 100 0.00 1.000 BIT_MASK 0x20 FORMAT "%5.3" ECU_ADDRESS 0x60036FEF /end MEASUREMENT
/begin MEASUREMENT DFC_b.TSC_ComCntTCU4 "Bit encoding / Ok-Tested Since Clear bit for check DFC_ComCntTCU4" UBYTE DFC_OneToOne 1 100 0.00 1.000 BIT_MASK 0x20 FORMAT "%5.3" ECU_ADDRESS 0x60036FF0 /end MEASUREMENT
/begin MEASUREMENT DFC_b.TSC_ComTOutTCU01 "Bit encoding / Ok-Tested Since Clear bit for check DFC_ComTOutTCU01" UBYTE DFC_OneToOne 1 100 0.00 1.000 BIT_MASK 0x20 FORMAT "%5.3" ECU_ADDRESS 0x60036FF1 /end MEASUREMENT
/begin MEASUREMENT DFC_b.TSC_ComTOutTCU02 "Bit encoding / Ok-Tested Since Clear bit for check DFC_ComTOutTCU02" UBYTE DFC_OneToOne 1 100 0.00 1.000 BIT_MASK 0x20 FORMAT "%5.3" ECU_ADDRESS 0x60036FF2 /end MEASUREMENT
/begin MEASUREMENT DFC_b.TSC_ComTOutTCU1 "Bit encoding / Ok-Tested Since Clear bit for check DFC_ComTOutTCU1" UBYTE DFC_OneToOne 1 100 0.00 1.000 BIT_MASK 0x20 FORMAT "%5.3" ECU_ADDRESS 0x60036FF3 /end MEASUREMENT
/begin MEASUREMENT DFC_b.TSC_ComTOutTCU11 "Bit encoding / Ok-Tested Since Clear bit for check DFC_ComTOutTCU11" UBYTE DFC_OneToOne 1 100 0.00 1.000 BIT_MASK 0x20 FORMAT "%5.3" ECU_ADDRESS 0x60036FF4 /end MEASUREMENT
/begin MEASUREMENT DFC_b.TSC_ComTOutTCU12 "Bit encoding / Ok-Tested Since Clear bit for check DFC_ComTOutTCU12" UBYTE DFC_OneToOne 1 100 0.00 1.000 BIT_MASK 0x20 FORMAT "%5.3" ECU_ADDRESS 0x60036FF5 /end MEASUREMENT
/begin MEASUREMENT DFC_b.TSC_ComTOutTCU13 "Bit encoding / Ok-Tested Since Clear bit for check DFC_ComTOutTCU13" UBYTE DFC_OneToOne 1 100 0.00 1.000 BIT_MASK 0x20 FORMAT "%5.3" ECU_ADDRESS 0x60036FF6 /end MEASUREMENT
/begin MEASUREMENT DFC_b.TSC_ComTOutTCU14 "Bit encoding / Ok-Tested Since Clear bit for check DFC_ComTOutTCU14" UBYTE DFC_OneToOne 1 100 0.00 1.000 BIT_MASK 0x20 FORMAT "%5.3" ECU_ADDRESS 0x60036FF7 /end MEASUREMENT
/begin MEASUREMENT DFC_b.TSC_ComTOutTCU2 "Bit encoding / Ok-Tested Since Clear bit for check DFC_ComTOutTCU2" UBYTE DFC_OneToOne 1 100 0.00 1.000 BIT_MASK 0x20 FORMAT "%5.3" ECU_ADDRESS 0x60036FF8 /end MEASUREMENT
/begin MEASUREMENT DFC_b.TSC_ComTOutTCU3 "Bit encoding / Ok-Tested Since Clear bit for check DFC_ComTOutTCU3" UBYTE DFC_OneToOne 1 100 0.00 1.000 BIT_MASK 0x20 FORMAT "%5.3" ECU_ADDRESS 0x60036FF9 /end MEASUREMENT
/begin MEASUREMENT DFC_b.TSC_ComTOutTCU4 "Bit encoding / Ok-Tested Since Clear bit for check DFC_ComTOutTCU4" UBYTE DFC_OneToOne 1 100 0.00 1.000 BIT_MASK 0x20 FORMAT "%5.3" ECU_ADDRESS 0x60036FFA /end MEASUREMENT
/begin MEASUREMENT DFC_b.TSC_DevLibBattUHi "Bit encoding / Ok-Tested Since Clear bit for check DFC_DevLibBattUHi" UBYTE DFC_OneToOne 1 100 0.00 1.000 BIT_MASK 0x20 FORMAT "%5.3" ECU_ADDRESS 0x60036FFB /end MEASUREMENT
/begin MEASUREMENT DFC_b.TSC_DevLibBattULo "Bit encoding / Ok-Tested Since Clear bit for check DFC_DevLibBattULo" UBYTE DFC_OneToOne 1 100 0.00 1.000 BIT_MASK 0x20 FORMAT "%5.3" ECU_ADDRESS 0x60036FFC /end MEASUREMENT
/begin MEASUREMENT DFC_b.TSC_EGRVlvFailSafeActv "Bit encoding / Ok-Tested Since Clear bit for check DFC_EGRVlvFailSafeActv" UBYTE DFC_OneToOne 1 100 0.00 1.000 BIT_MASK 0x20 FORMAT "%5.3" ECU_ADDRESS 0x60036FFD /end MEASUREMENT
/begin MEASUREMENT DFC_b.TSC_EGRVlvGovDvtCld "Bit encoding / Ok-Tested Since Clear bit for check DFC_EGRVlvGovDvtCld" UBYTE DFC_OneToOne 1 100 0.00 1.000 BIT_MASK 0x20 FORMAT "%5.3" ECU_ADDRESS 0x60036FFE /end MEASUREMENT
/begin MEASUREMENT DFC_b.TSC_EGRVlvPhysSRCMax "Bit encoding / Ok-Tested Since Clear bit for check DFC_EGRVlvPhysSRCMax" UBYTE DFC_OneToOne 1 100 0.00 1.000 BIT_MASK 0x20 FORMAT "%5.3" ECU_ADDRESS 0x60036FFF /end MEASUREMENT
/begin MEASUREMENT DFC_b.TSC_EGRVlvPhysSRCMin "Bit encoding / Ok-Tested Since Clear bit for check DFC_EGRVlvPhysSRCMin" UBYTE DFC_OneToOne 1 100 0.00 1.000 BIT_MASK 0x20 FORMAT "%5.3" ECU_ADDRESS 0x60037000 /end MEASUREMENT
/begin MEASUREMENT DFC_b.TSC_FanDIOOL_0 "Bit encoding / Ok-Tested Since Clear bit for check DFC_FanDIOOL_0" UBYTE DFC_OneToOne 1 100 0.00 1.000 BIT_MASK 0x20 FORMAT "%5.3" ECU_ADDRESS 0x60037001 /end MEASUREMENT
/begin MEASUREMENT DFC_b.TSC_FanDIOOL_1 "Bit encoding / Ok-Tested Since Clear bit for check DFC_FanDIOOL_1" UBYTE DFC_OneToOne 1 100 0.00 1.000 BIT_MASK 0x20 FORMAT "%5.3" ECU_ADDRESS 0x60037002 /end MEASUREMENT
/begin MEASUREMENT DFC_b.TSC_FanDIOOvrTemp_0 "Bit encoding / Ok-Tested Since Clear bit for check DFC_FanDIOOvrTemp_0" UBYTE DFC_OneToOne 1 100 0.00 1.000 BIT_MASK 0x20 FORMAT "%5.3" ECU_ADDRESS 0x60037003 /end MEASUREMENT
/begin MEASUREMENT DFC_b.TSC_FanDIOOvrTemp_1 "Bit encoding / Ok-Tested Since Clear bit for check DFC_FanDIOOvrTemp_1" UBYTE DFC_OneToOne 1 100 0.00 1.000 BIT_MASK 0x20 FORMAT "%5.3" ECU_ADDRESS 0x60037004 /end MEASUREMENT
/begin MEASUREMENT DFC_b.TSC_FanDIOSCB_0 "Bit encoding / Ok-Tested Since Clear bit for check DFC_FanDIOSCB_0" UBYTE DFC_OneToOne 1 100 0.00 1.000 BIT_MASK 0x20 FORMAT "%5.3" ECU_ADDRESS 0x60037005 /end MEASUREMENT
/begin MEASUREMENT DFC_b.TSC_FanDIOSCB_1 "Bit encoding / Ok-Tested Since Clear bit for check DFC_FanDIOSCB_1" UBYTE DFC_OneToOne 1 100 0.00 1.000 BIT_MASK 0x20 FORMAT "%5.3" ECU_ADDRESS 0x60037006 /end MEASUREMENT
/begin MEASUREMENT DFC_b.TSC_FanDIOSCG_0 "Bit encoding / Ok-Tested Since Clear bit for check DFC_FanDIOSCG_0" UBYTE DFC_OneToOne 1 100 0.00 1.000 BIT_MASK 0x20 FORMAT "%5.3" ECU_ADDRESS 0x60037007 /end MEASUREMENT
/begin MEASUREMENT DFC_b.TSC_FanDIOSCG_1 "Bit encoding / Ok-Tested Since Clear bit for check DFC_FanDIOSCG_1" UBYTE DFC_OneToOne 1 100 0.00 1.000 BIT_MASK 0x20 FORMAT "%5.3" ECU_ADDRESS 0x60037008 /end MEASUREMENT
/begin MEASUREMENT DFC_b.TSC_MRlyDcOL "Bit encoding / Ok-Tested Since Clear bit for check DFC_MRlyDcOL" UBYTE DFC_OneToOne 1 100 0.00 1.000 BIT_MASK 0x20 FORMAT "%5.3" ECU_ADDRESS 0x60037009 /end MEASUREMENT
/begin MEASUREMENT DFC_b.TSC_MRlyDcSCB "Bit encoding / Ok-Tested Since Clear bit for check DFC_MRlyDcSCB" UBYTE DFC_OneToOne 1 100 0.00 1.000 BIT_MASK 0x20 FORMAT "%5.3" ECU_ADDRESS 0x6003700A /end MEASUREMENT
/begin MEASUREMENT DFC_b.TSC_MRlyDcSCG "Bit encoding / Ok-Tested Since Clear bit for check DFC_MRlyDcSCG" UBYTE DFC_OneToOne 1 100 0.00 1.000 BIT_MASK 0x20 FORMAT "%5.3" ECU_ADDRESS 0x6003700B /end MEASUREMENT
/begin MEASUREMENT DFC_b.TSC_PSPOL "Bit encoding / Ok-Tested Since Clear bit for check DFC_PSPOL" UBYTE DFC_OneToOne 1 100 0.00 1.000 BIT_MASK 0x20 FORMAT "%5.3" ECU_ADDRESS 0x6003700C /end MEASUREMENT
/begin MEASUREMENT DFC_b.TSC_PSPOvrTemp "Bit encoding / Ok-Tested Since Clear bit for check DFC_PSPOvrTemp" UBYTE DFC_OneToOne 1 100 0.00 1.000 BIT_MASK 0x20 FORMAT "%5.3" ECU_ADDRESS 0x6003700D /end MEASUREMENT
/begin MEASUREMENT DFC_b.TSC_PSPSCB "Bit encoding / Ok-Tested Since Clear bit for check DFC_PSPSCB" UBYTE DFC_OneToOne 1 100 0.00 1.000 BIT_MASK 0x20 FORMAT "%5.3" ECU_ADDRESS 0x6003700E /end MEASUREMENT
/begin MEASUREMENT DFC_b.TSC_PSPSCG "Bit encoding / Ok-Tested Since Clear bit for check DFC_PSPSCG" UBYTE DFC_OneToOne 1 100 0.00 1.000 BIT_MASK 0x20 FORMAT "%5.3" ECU_ADDRESS 0x6003700F /end MEASUREMENT
/begin MEASUREMENT DFC_b.TSC_T50Err "Bit encoding / Ok-Tested Since Clear bit for check DFC_T50Err" UBYTE DFC_OneToOne 1 100 0.00 1.000 BIT_MASK 0x20 FORMAT "%5.3" ECU_ADDRESS 0x60037010 /end MEASUREMENT
/begin MEASUREMENT DFC_b.TSC_ThrVlvLoBattB1 "Bit encoding / Ok-Tested Since Clear bit for check DFC_ThrVlvLoBattB1" UBYTE DFC_OneToOne 1 100 0.00 1.000 BIT_MASK 0x20 FORMAT "%5.3" ECU_ADDRESS 0x60037011 /end MEASUREMENT
/begin MEASUREMENT DFC_b.TSC_UegoSigOperPlausS1B1 "Bit encoding / Ok-Tested Since Clear bit for check DFC_UegoSigOperPlausS1B1" UBYTE DFC_OneToOne 1 100 0.00 1.000 BIT_MASK 0x20 FORMAT "%5.3" ECU_ADDRESS 0x60037012 /end MEASUREMENT
/begin MEASUREMENT DFC_b.TSC_VehVPhysRngHi "Bit encoding / Ok-Tested Since Clear bit for check DFC_VehVPhysRngHi" UBYTE DFC_OneToOne 1 100 0.00 1.000 BIT_MASK 0x20 FORMAT "%5.3" ECU_ADDRESS 0x60037013 /end MEASUREMENT
/begin MEASUREMENT DFC_b.TSC_VehVSclOutOL "Bit encoding / Ok-Tested Since Clear bit for check DFC_VehVSclOutOL" UBYTE DFC_OneToOne 1 100 0.00 1.000 BIT_MASK 0x20 FORMAT "%5.3" ECU_ADDRESS 0x60037014 /end MEASUREMENT
/begin MEASUREMENT DFC_b.TSC_VehVSclOutOT "Bit encoding / Ok-Tested Since Clear bit for check DFC_VehVSclOutOT" UBYTE DFC_OneToOne 1 100 0.00 1.000 BIT_MASK 0x20 FORMAT "%5.3" ECU_ADDRESS 0x60037015 /end MEASUREMENT
/begin MEASUREMENT DFC_b.TSC_VehVSclOutSCB "Bit encoding / Ok-Tested Since Clear bit for check DFC_VehVSclOutSCB" UBYTE DFC_OneToOne 1 100 0.00 1.000 BIT_MASK 0x20 FORMAT "%5.3" ECU_ADDRESS 0x60037016 /end MEASUREMENT
/begin MEASUREMENT DFC_b.TSC_VehVSclOutSCG "Bit encoding / Ok-Tested Since Clear bit for check DFC_VehVSclOutSCG" UBYTE DFC_OneToOne 1 100 0.00 1.000 BIT_MASK 0x20 FORMAT "%5.3" ECU_ADDRESS 0x60037017 /end MEASUREMENT
/begin MEASUREMENT DFC_b.TSC_VehVSigFL "Bit encoding / Ok-Tested Since Clear bit for check DFC_VehVSigFL" UBYTE DFC_OneToOne 1 100 0.00 1.000 BIT_MASK 0x20 FORMAT "%5.3" ECU_ADDRESS 0x60037018 /end MEASUREMENT
/begin MEASUREMENT DFC_b.TSC_VehVSigFR "Bit encoding / Ok-Tested Since Clear bit for check DFC_VehVSigFR" UBYTE DFC_OneToOne 1 100 0.00 1.000 BIT_MASK 0x20 FORMAT "%5.3" ECU_ADDRESS 0x60037019 /end MEASUREMENT
/begin MEASUREMENT DFC_b.TSC_VehVSigRL "Bit encoding / Ok-Tested Since Clear bit for check DFC_VehVSigRL" UBYTE DFC_OneToOne 1 100 0.00 1.000 BIT_MASK 0x20 FORMAT "%5.3" ECU_ADDRESS 0x6003701A /end MEASUREMENT
/begin MEASUREMENT DFC_b.TSC_VehVSigRR "Bit encoding / Ok-Tested Since Clear bit for check DFC_VehVSigRR" UBYTE DFC_OneToOne 1 100 0.00 1.000 BIT_MASK 0x20 FORMAT "%5.3" ECU_ADDRESS 0x6003701B /end MEASUREMENT
/begin MEASUREMENT DFC_b.TSC_VehVSnsrARngHi "Bit encoding / Ok-Tested Since Clear bit for check DFC_VehVSnsrARngHi" UBYTE DFC_OneToOne 1 100 0.00 1.000 BIT_MASK 0x20 FORMAT "%5.3" ECU_ADDRESS 0x6003701C /end MEASUREMENT
/begin MEASUREMENT DFC_b.TSC_VehVSnsrBRngHi "Bit encoding / Ok-Tested Since Clear bit for check DFC_VehVSnsrBRngHi" UBYTE DFC_OneToOne 1 100 0.00 1.000 BIT_MASK 0x20 FORMAT "%5.3" ECU_ADDRESS 0x6003701D /end MEASUREMENT
/begin MEASUREMENT DFC_b.TSC_VehVSpdRtyDiag "Bit encoding / Ok-Tested Since Clear bit for check DFC_VehVSpdRtyDiag" UBYTE DFC_OneToOne 1 100 0.00 1.000 BIT_MASK 0x20 FORMAT "%5.3" ECU_ADDRESS 0x6003701E /end MEASUREMENT
/begin MEASUREMENT DFC_b.TSC_DHFHD "Bit encoding / Ok-Tested Since Clear bit for check DFC_DHFHD" UBYTE DFC_OneToOne 1 100 0.00 1.000 BIT_MASK 0x20 FORMAT "%5.3" ECU_ADDRESS 0x6003701F /end MEASUREMENT
/begin MEASUREMENT DFC_b.TSC_InjVlv_DI_DcDc "Bit encoding / Ok-Tested Since Clear bit for check DFC_InjVlv_DI_DcDc" UBYTE DFC_OneToOne 1 100 0.00 1.000 BIT_MASK 0x20 FORMAT "%5.3" ECU_ADDRESS 0x60037020 /end MEASUREMENT
/begin MEASUREMENT DFC_b.TSC_InjVlv_DI_NoLd_0 "Bit encoding / Ok-Tested Since Clear bit for check DFC_InjVlv_DI_NoLd_0" UBYTE DFC_OneToOne 1 100 0.00 1.000 BIT_MASK 0x20 FORMAT "%5.3" ECU_ADDRESS 0x60037021 /end MEASUREMENT
/begin MEASUREMENT DFC_b.TSC_InjVlv_DI_NoLd_1 "Bit encoding / Ok-Tested Since Clear bit for check DFC_InjVlv_DI_NoLd_1" UBYTE DFC_OneToOne 1 100 0.00 1.000 BIT_MASK 0x20 FORMAT "%5.3" ECU_ADDRESS 0x60037022 /end MEASUREMENT
/begin MEASUREMENT DFC_b.TSC_InjVlv_DI_NoLd_2 "Bit encoding / Ok-Tested Since Clear bit for check DFC_InjVlv_DI_NoLd_2" UBYTE DFC_OneToOne 1 100 0.00 1.000 BIT_MASK 0x20 FORMAT "%5.3" ECU_ADDRESS 0x60037023 /end MEASUREMENT
/begin MEASUREMENT DFC_b.TSC_InjVlv_DI_NoLd_3 "Bit encoding / Ok-Tested Since Clear bit for check DFC_InjVlv_DI_NoLd_3" UBYTE DFC_OneToOne 1 100 0.00 1.000 BIT_MASK 0x20 FORMAT "%5.3" ECU_ADDRESS 0x60037024 /end MEASUREMENT
/begin MEASUREMENT DFC_b.TSC_InjVlv_DI_ScBnk_0 "Bit encoding / Ok-Tested Since Clear bit for check DFC_InjVlv_DI_ScBnk_0" UBYTE DFC_OneToOne 1 100 0.00 1.000 BIT_MASK 0x20 FORMAT "%5.3" ECU_ADDRESS 0x60037025 /end MEASUREMENT
/begin MEASUREMENT DFC_b.TSC_InjVlv_DI_ScBnk_1 "Bit encoding / Ok-Tested Since Clear bit for check DFC_InjVlv_DI_ScBnk_1" UBYTE DFC_OneToOne 1 100 0.00 1.000 BIT_MASK 0x20 FORMAT "%5.3" ECU_ADDRESS 0x60037026 /end MEASUREMENT
/begin MEASUREMENT DFC_b.TSC_InjVlv_DI_ScBnk_2 "Bit encoding / Ok-Tested Since Clear bit for check DFC_InjVlv_DI_ScBnk_2" UBYTE DFC_OneToOne 1 100 0.00 1.000 BIT_MASK 0x20 FORMAT "%5.3" ECU_ADDRESS 0x60037027 /end MEASUREMENT
/begin MEASUREMENT DFC_b.TSC_InjVlv_DI_ScBnk_3 "Bit encoding / Ok-Tested Since Clear bit for check DFC_InjVlv_DI_ScBnk_3" UBYTE DFC_OneToOne 1 100 0.00 1.000 BIT_MASK 0x20 FORMAT "%5.3" ECU_ADDRESS 0x60037028 /end MEASUREMENT
/begin MEASUREMENT DFC_b.TSC_InjVlv_DI_ScCyl_0 "Bit encoding / Ok-Tested Since Clear bit for check DFC_InjVlv_DI_ScCyl_0" UBYTE DFC_OneToOne 1 100 0.00 1.000 BIT_MASK 0x20 FORMAT "%5.3" ECU_ADDRESS 0x60037029 /end MEASUREMENT
/begin MEASUREMENT DFC_b.TSC_InjVlv_DI_ScCyl_1 "Bit encoding / Ok-Tested Since Clear bit for check DFC_InjVlv_DI_ScCyl_1" UBYTE DFC_OneToOne 1 100 0.00 1.000 BIT_MASK 0x20 FORMAT "%5.3" ECU_ADDRESS 0x6003702A /end MEASUREMENT
/begin MEASUREMENT DFC_b.TSC_InjVlv_DI_ScCyl_2 "Bit encoding / Ok-Tested Since Clear bit for check DFC_InjVlv_DI_ScCyl_2" UBYTE DFC_OneToOne 1 100 0.00 1.000 BIT_MASK 0x20 FORMAT "%5.3" ECU_ADDRESS 0x6003702B /end MEASUREMENT
/begin MEASUREMENT DFC_b.TSC_InjVlv_DI_ScCyl_3 "Bit encoding / Ok-Tested Since Clear bit for check DFC_InjVlv_DI_ScCyl_3" UBYTE DFC_OneToOne 1 100 0.00 1.000 BIT_MASK 0x20 FORMAT "%5.3" ECU_ADDRESS 0x6003702C /end MEASUREMENT
/begin MEASUREMENT DFC_b.TSC_InjVlv_DI_ScHsLs_0 "Bit encoding / Ok-Tested Since Clear bit for check DFC_InjVlv_DI_ScHsLs_0" UBYTE DFC_OneToOne 1 100 0.00 1.000 BIT_MASK 0x20 FORMAT "%5.3" ECU_ADDRESS 0x6003702D /end MEASUREMENT
/begin MEASUREMENT DFC_b.TSC_InjVlv_DI_ScHsLs_1 "Bit encoding / Ok-Tested Since Clear bit for check DFC_InjVlv_DI_ScHsLs_1" UBYTE DFC_OneToOne 1 100 0.00 1.000 BIT_MASK 0x20 FORMAT "%5.3" ECU_ADDRESS 0x6003702E /end MEASUREMENT
/begin MEASUREMENT DFC_b.TSC_InjVlv_DI_ScHsLs_2 "Bit encoding / Ok-Tested Since Clear bit for check DFC_InjVlv_DI_ScHsLs_2" UBYTE DFC_OneToOne 1 100 0.00 1.000 BIT_MASK 0x20 FORMAT "%5.3" ECU_ADDRESS 0x6003702F /end MEASUREMENT
/begin MEASUREMENT DFC_b.TSC_InjVlv_DI_ScHsLs_3 "Bit encoding / Ok-Tested Since Clear bit for check DFC_InjVlv_DI_ScHsLs_3" UBYTE DFC_OneToOne 1 100 0.00 1.000 BIT_MASK 0x20 FORMAT "%5.3" ECU_ADDRESS 0x60037030 /end MEASUREMENT
/begin MEASUREMENT DFC_b.TSC_MfPsDiaOpenLoad1 "Bit encoding / Ok-Tested Since Clear bit for check DFC_MfPsDiaOpenLoad1" UBYTE DFC_OneToOne 1 100 0.00 1.000 BIT_MASK 0x20 FORMAT "%5.3" ECU_ADDRESS 0x60037031 /end MEASUREMENT
/begin MEASUREMENT DFC_b.TSC_MfPsDiaScHiS1 "Bit encoding / Ok-Tested Since Clear bit for check DFC_MfPsDiaScHiS1" UBYTE DFC_OneToOne 1 100 0.00 1.000 BIT_MASK 0x20 FORMAT "%5.3" ECU_ADDRESS 0x60037032 /end MEASUREMENT
/begin MEASUREMENT DFC_b.TSC_MfPsDiaScHiSLowS1 "Bit encoding / Ok-Tested Since Clear bit for check DFC_MfPsDiaScHiSLowS1" UBYTE DFC_OneToOne 1 100 0.00 1.000 BIT_MASK 0x20 FORMAT "%5.3" ECU_ADDRESS 0x60037033 /end MEASUREMENT
/begin MEASUREMENT DFC_b.TSC_MfPsDiaScLowS1 "Bit encoding / Ok-Tested Since Clear bit for check DFC_MfPsDiaScLowS1" UBYTE DFC_OneToOne 1 100 0.00 1.000 BIT_MASK 0x20 FORMAT "%5.3" ECU_ADDRESS 0x60037034 /end MEASUREMENT
/begin MEASUREMENT DFC_b.TSC_ACEvpTPhysRngHi "Bit encoding / Ok-Tested Since Clear bit for check DFC_ACEvpTPhysRngHi" UBYTE DFC_OneToOne 1 100 0.00 1.000 BIT_MASK 0x20 FORMAT "%5.3" ECU_ADDRESS 0x60037035 /end MEASUREMENT
/begin MEASUREMENT DFC_b.TSC_ACEvpTPhysRngLo "Bit encoding / Ok-Tested Since Clear bit for check DFC_ACEvpTPhysRngLo" UBYTE DFC_OneToOne 1 100 0.00 1.000 BIT_MASK 0x20 FORMAT "%5.3" ECU_ADDRESS 0x60037036 /end MEASUREMENT
/begin MEASUREMENT DFC_b.TSC_ACEvpTSRCMax "Bit encoding / Ok-Tested Since Clear bit for check DFC_ACEvpTSRCMax" UBYTE DFC_OneToOne 1 100 0.00 1.000 BIT_MASK 0x20 FORMAT "%5.3" ECU_ADDRESS 0x60037037 /end MEASUREMENT
/begin MEASUREMENT DFC_b.TSC_ACEvpTSRCMin "Bit encoding / Ok-Tested Since Clear bit for check DFC_ACEvpTSRCMin" UBYTE DFC_OneToOne 1 100 0.00 1.000 BIT_MASK 0x20 FORMAT "%5.3" ECU_ADDRESS 0x60037038 /end MEASUREMENT
/begin MEASUREMENT DFC_b.TSC_AfsRawSigRngHiB1 "Bit encoding / Ok-Tested Since Clear bit for check DFC_AfsRawSigRngHiB1" UBYTE DFC_OneToOne 1 100 0.00 1.000 BIT_MASK 0x20 FORMAT "%5.3" ECU_ADDRESS 0x60037039 /end MEASUREMENT
/begin MEASUREMENT DFC_b.TSC_AfsRawSigRngLoB1 "Bit encoding / Ok-Tested Since Clear bit for check DFC_AfsRawSigRngLoB1" UBYTE DFC_OneToOne 1 100 0.00 1.000 BIT_MASK 0x20 FORMAT "%5.3" ECU_ADDRESS 0x6003703A /end MEASUREMENT
/begin MEASUREMENT DFC_b.TSC_AfsSnsrErrB1 "Bit encoding / Ok-Tested Since Clear bit for check DFC_AfsSnsrErrB1" UBYTE DFC_OneToOne 1 100 0.00 1.000 BIT_MASK 0x20 FORMAT "%5.3" ECU_ADDRESS 0x6003703B /end MEASUREMENT
/begin MEASUREMENT DFC_b.TSC_AirCClntPAnaSRCMax "Bit encoding / Ok-Tested Since Clear bit for check DFC_AirCClntPAnaSRCMax" UBYTE DFC_OneToOne 1 100 0.00 1.000 BIT_MASK 0x20 FORMAT "%5.3" ECU_ADDRESS 0x6003703C /end MEASUREMENT
/begin MEASUREMENT DFC_b.TSC_AirCClntPAnaSRCMin "Bit encoding / Ok-Tested Since Clear bit for check DFC_AirCClntPAnaSRCMin" UBYTE DFC_OneToOne 1 100 0.00 1.000 BIT_MASK 0x20 FORMAT "%5.3" ECU_ADDRESS 0x6003703D /end MEASUREMENT
/begin MEASUREMENT DFC_b.TSC_AirCSwtNpl "Bit encoding / Ok-Tested Since Clear bit for check DFC_AirCSwtNpl" UBYTE DFC_OneToOne 1 100 0.00 1.000 BIT_MASK 0x20 FORMAT "%5.3" ECU_ADDRESS 0x6003703E /end MEASUREMENT
/begin MEASUREMENT DFC_b.TSC_AirCSwtSig "Bit encoding / Ok-Tested Since Clear bit for check DFC_AirCSwtSig" UBYTE DFC_OneToOne 1 100 0.00 1.000 BIT_MASK 0x20 FORMAT "%5.3" ECU_ADDRESS 0x6003703F /end MEASUREMENT
/begin MEASUREMENT DFC_b.TSC_Brk "Bit encoding / Ok-Tested Since Clear bit for check DFC_Brk" UBYTE DFC_OneToOne 1 100 0.00 1.000 BIT_MASK 0x20 FORMAT "%5.3" ECU_ADDRESS 0x60037040 /end MEASUREMENT
/begin MEASUREMENT DFC_b.TSC_BrkBstSensSCB "Bit encoding / Ok-Tested Since Clear bit for check DFC_BrkBstSensSCB" UBYTE DFC_OneToOne 1 100 0.00 1.000 BIT_MASK 0x20 FORMAT "%5.3" ECU_ADDRESS 0x60037041 /end MEASUREMENT
/begin MEASUREMENT DFC_b.TSC_BrkBstSensSCG "Bit encoding / Ok-Tested Since Clear bit for check DFC_BrkBstSensSCG" UBYTE DFC_OneToOne 1 100 0.00 1.000 BIT_MASK 0x20 FORMAT "%5.3" ECU_ADDRESS 0x60037042 /end MEASUREMENT
/begin MEASUREMENT DFC_b.TSC_BrkSig "Bit encoding / Ok-Tested Since Clear bit for check DFC_BrkSig" UBYTE DFC_OneToOne 1 100 0.00 1.000 BIT_MASK 0x20 FORMAT "%5.3" ECU_ADDRESS 0x60037043 /end MEASUREMENT
/begin MEASUREMENT DFC_b.TSC_ClthSig "Bit encoding / Ok-Tested Since Clear bit for check DFC_ClthSig" UBYTE DFC_OneToOne 1 100 0.00 1.000 BIT_MASK 0x20 FORMAT "%5.3" ECU_ADDRESS 0x60037044 /end MEASUREMENT
/begin MEASUREMENT DFC_b.TSC_EGRVlvCurrLim "Bit encoding / Ok-Tested Since Clear bit for check DFC_EGRVlvCurrLim" UBYTE DFC_OneToOne 1 100 0.00 1.000 BIT_MASK 0x20 FORMAT "%5.3" ECU_ADDRESS 0x60037045 /end MEASUREMENT
/begin MEASUREMENT DFC_b.TSC_EGRVlvOL "Bit encoding / Ok-Tested Since Clear bit for check DFC_EGRVlvOL" UBYTE DFC_OneToOne 1 100 0.00 1.000 BIT_MASK 0x20 FORMAT "%5.3" ECU_ADDRESS 0x60037046 /end MEASUREMENT
/begin MEASUREMENT DFC_b.TSC_EGRVlvOvrTemp "Bit encoding / Ok-Tested Since Clear bit for check DFC_EGRVlvOvrTemp" UBYTE DFC_OneToOne 1 100 0.00 1.000 BIT_MASK 0x20 FORMAT "%5.3" ECU_ADDRESS 0x60037047 /end MEASUREMENT
/begin MEASUREMENT DFC_b.TSC_EGRVlvSCB "Bit encoding / Ok-Tested Since Clear bit for check DFC_EGRVlvSCB" UBYTE DFC_OneToOne 1 100 0.00 1.000 BIT_MASK 0x20 FORMAT "%5.3" ECU_ADDRESS 0x60037048 /end MEASUREMENT
/begin MEASUREMENT DFC_b.TSC_EGRVlvSCG "Bit encoding / Ok-Tested Since Clear bit for check DFC_EGRVlvSCG" UBYTE DFC_OneToOne 1 100 0.00 1.000 BIT_MASK 0x20 FORMAT "%5.3" ECU_ADDRESS 0x60037049 /end MEASUREMENT
/begin MEASUREMENT DFC_b.TSC_EGRVlvSRCMax "Bit encoding / Ok-Tested Since Clear bit for check DFC_EGRVlvSRCMax" UBYTE DFC_OneToOne 1 100 0.00 1.000 BIT_MASK 0x20 FORMAT "%5.3" ECU_ADDRESS 0x6003704A /end MEASUREMENT
/begin MEASUREMENT DFC_b.TSC_EGRVlvSRCMin "Bit encoding / Ok-Tested Since Clear bit for check DFC_EGRVlvSRCMin" UBYTE DFC_OneToOne 1 100 0.00 1.000 BIT_MASK 0x20 FORMAT "%5.3" ECU_ADDRESS 0x6003704B /end MEASUREMENT
/begin MEASUREMENT DFC_b.TSC_HLSDemOvhtEngLim "Bit encoding / Ok-Tested Since Clear bit for check DFC_HLSDemOvhtEngLim" UBYTE DFC_OneToOne 1 100 0.00 1.000 BIT_MASK 0x20 FORMAT "%5.3" ECU_ADDRESS 0x6003704C /end MEASUREMENT
/begin MEASUREMENT DFC_b.TSC_OilPSwmpSRCMax "Bit encoding / Ok-Tested Since Clear bit for check DFC_OilPSwmpSRCMax" UBYTE DFC_OneToOne 1 100 0.00 1.000 BIT_MASK 0x20 FORMAT "%5.3" ECU_ADDRESS 0x6003704D /end MEASUREMENT
/begin MEASUREMENT DFC_b.TSC_OilPSwmpSRCMin "Bit encoding / Ok-Tested Since Clear bit for check DFC_OilPSwmpSRCMin" UBYTE DFC_OneToOne 1 100 0.00 1.000 BIT_MASK 0x20 FORMAT "%5.3" ECU_ADDRESS 0x6003704E /end MEASUREMENT
/begin MEASUREMENT DFC_b.TSC_PIntkVUsLineHiB1 "Bit encoding / Ok-Tested Since Clear bit for check DFC_PIntkVUsLineHiB1" UBYTE DFC_OneToOne 1 100 0.00 1.000 BIT_MASK 0x20 FORMAT "%5.3" ECU_ADDRESS 0x6003704F /end MEASUREMENT
/begin MEASUREMENT DFC_b.TSC_PIntkVUsLineLoB1 "Bit encoding / Ok-Tested Since Clear bit for check DFC_PIntkVUsLineLoB1" UBYTE DFC_OneToOne 1 100 0.00 1.000 BIT_MASK 0x20 FORMAT "%5.3" ECU_ADDRESS 0x60037050 /end MEASUREMENT
/begin MEASUREMENT DFC_b.TSC_VehVPhysRngLo "Bit encoding / Ok-Tested Since Clear bit for check DFC_VehVPhysRngLo" UBYTE DFC_OneToOne 1 100 0.00 1.000 BIT_MASK 0x20 FORMAT "%5.3" ECU_ADDRESS 0x60037051 /end MEASUREMENT
/begin MEASUREMENT DFC_b.TSC_VehVSigCan "Bit encoding / Ok-Tested Since Clear bit for check DFC_VehVSigCan" UBYTE DFC_OneToOne 1 100 0.00 1.000 BIT_MASK 0x20 FORMAT "%5.3" ECU_ADDRESS 0x60037052 /end MEASUREMENT
/begin MEASUREMENT DFC_b.TSC_VehVSigCanSafe "Bit encoding / Ok-Tested Since Clear bit for check DFC_VehVSigCanSafe" UBYTE DFC_OneToOne 1 100 0.00 1.000 BIT_MASK 0x20 FORMAT "%5.3" ECU_ADDRESS 0x60037053 /end MEASUREMENT
/begin MEASUREMENT DFC_b.TSC_VlvLftFbOilPSnsrIntk11SRCMax "Bit encoding / Ok-Tested Since Clear bit for check DFC_VlvLftFbOilPSnsrIntk11SRCMax" UBYTE DFC_OneToOne 1 100 0.00 1.000 BIT_MASK 0x20 FORMAT "%5.3" ECU_ADDRESS 0x60037054 /end MEASUREMENT
/begin MEASUREMENT DFC_b.TSC_VlvLftFbOilPSnsrIntk11SRCMin "Bit encoding / Ok-Tested Since Clear bit for check DFC_VlvLftFbOilPSnsrIntk11SRCMin" UBYTE DFC_OneToOne 1 100 0.00 1.000 BIT_MASK 0x20 FORMAT "%5.3" ECU_ADDRESS 0x60037055 /end MEASUREMENT
/begin MEASUREMENT DFC_b.TSC_ClthNpl "Bit encoding / Ok-Tested Since Clear bit for check DFC_ClthNpl" UBYTE DFC_OneToOne 1 100 0.00 1.000 BIT_MASK 0x20 FORMAT "%5.3" ECU_ADDRESS 0x60037056 /end MEASUREMENT
/begin MEASUREMENT DFC_b.TSC_GbxPNPosnDrvCdn "Bit encoding / Ok-Tested Since Clear bit for check DFC_GbxPNPosnDrvCdn" UBYTE DFC_OneToOne 1 100 0.00 1.000 BIT_MASK 0x20 FORMAT "%5.3" ECU_ADDRESS 0x60037057 /end MEASUREMENT
/begin MEASUREMENT DFC_b.TSC_GbxPNPosnPlausy "Bit encoding / Ok-Tested Since Clear bit for check DFC_GbxPNPosnPlausy" UBYTE DFC_OneToOne 1 100 0.00 1.000 BIT_MASK 0x20 FORMAT "%5.3" ECU_ADDRESS 0x60037058 /end MEASUREMENT
/begin MEASUREMENT DFC_b.TSC_AfsSigErrLineHiB1 "Bit encoding / Ok-Tested Since Clear bit for check DFC_AfsSigErrLineHiB1" UBYTE DFC_OneToOne 1 100 0.00 1.000 BIT_MASK 0x20 FORMAT "%5.3" ECU_ADDRESS 0x60037059 /end MEASUREMENT
/begin MEASUREMENT DFC_b.TSC_AfsSigErrLineLoB1 "Bit encoding / Ok-Tested Since Clear bit for check DFC_AfsSigErrLineLoB1" UBYTE DFC_OneToOne 1 100 0.00 1.000 BIT_MASK 0x20 FORMAT "%5.3" ECU_ADDRESS 0x6003705A /end MEASUREMENT
/begin MEASUREMENT DFC_b.TSC_PEnvCcMax "Bit encoding / Ok-Tested Since Clear bit for check DFC_PEnvCcMax" UBYTE DFC_OneToOne 1 100 0.00 1.000 BIT_MASK 0x20 FORMAT "%5.3" ECU_ADDRESS 0x6003705B /end MEASUREMENT
/begin MEASUREMENT DFC_b.TSC_PEnvCcMin "Bit encoding / Ok-Tested Since Clear bit for check DFC_PEnvCcMin" UBYTE DFC_OneToOne 1 100 0.00 1.000 BIT_MASK 0x20 FORMAT "%5.3" ECU_ADDRESS 0x6003705C /end MEASUREMENT
/begin MEASUREMENT DFC_b.TSC_PEnvRngChkMax "Bit encoding / Ok-Tested Since Clear bit for check DFC_PEnvRngChkMax" UBYTE DFC_OneToOne 1 100 0.00 1.000 BIT_MASK 0x20 FORMAT "%5.3" ECU_ADDRESS 0x6003705D /end MEASUREMENT
/begin MEASUREMENT DFC_b.TSC_PEnvRngChkMin "Bit encoding / Ok-Tested Since Clear bit for check DFC_PEnvRngChkMin" UBYTE DFC_OneToOne 1 100 0.00 1.000 BIT_MASK 0x20 FORMAT "%5.3" ECU_ADDRESS 0x6003705E /end MEASUREMENT
/begin MEASUREMENT DFC_b.TSC_PEnvSnsrPlaus "Bit encoding / Ok-Tested Since Clear bit for check DFC_PEnvSnsrPlaus" UBYTE DFC_OneToOne 1 100 0.00 1.000 BIT_MASK 0x20 FORMAT "%5.3" ECU_ADDRESS 0x6003705F /end MEASUREMENT
/begin MEASUREMENT DFC_b.TSC_UEGOHeatrRlyPsOLS1B1 "Bit encoding / Ok-Tested Since Clear bit for check DFC_UEGOHeatrRlyPsOLS1B1" UBYTE DFC_OneToOne 1 100 0.00 1.000 BIT_MASK 0x20 FORMAT "%5.3" ECU_ADDRESS 0x60037060 /end MEASUREMENT
/begin MEASUREMENT DFC_b.TSC_UEGOHeatrRlyPsSCBS1B1 "Bit encoding / Ok-Tested Since Clear bit for check DFC_UEGOHeatrRlyPsSCBS1B1" UBYTE DFC_OneToOne 1 100 0.00 1.000 BIT_MASK 0x20 FORMAT "%5.3" ECU_ADDRESS 0x60037061 /end MEASUREMENT
/begin MEASUREMENT DFC_b.TSC_UEGOHeatrRlyPsSCGS1B1 "Bit encoding / Ok-Tested Since Clear bit for check DFC_UEGOHeatrRlyPsSCGS1B1" UBYTE DFC_OneToOne 1 100 0.00 1.000 BIT_MASK 0x20 FORMAT "%5.3" ECU_ADDRESS 0x60037062 /end MEASUREMENT
/begin MEASUREMENT DFC_b.TSC_UegoHeatrWireOlS1B1 "Bit encoding / Ok-Tested Since Clear bit for check DFC_UegoHeatrWireOlS1B1" UBYTE DFC_OneToOne 1 100 0.00 1.000 BIT_MASK 0x20 FORMAT "%5.3" ECU_ADDRESS 0x60037063 /end MEASUREMENT
/begin MEASUREMENT DFC_b.TSC_UegoHeatrWireScbS1B1 "Bit encoding / Ok-Tested Since Clear bit for check DFC_UegoHeatrWireScbS1B1" UBYTE DFC_OneToOne 1 100 0.00 1.000 BIT_MASK 0x20 FORMAT "%5.3" ECU_ADDRESS 0x60037064 /end MEASUREMENT
/begin MEASUREMENT DFC_b.TSC_UegoHeatrWireScgS1B1 "Bit encoding / Ok-Tested Since Clear bit for check DFC_UegoHeatrWireScgS1B1" UBYTE DFC_OneToOne 1 100 0.00 1.000 BIT_MASK 0x20 FORMAT "%5.3" ECU_ADDRESS 0x60037065 /end MEASUREMENT
/begin MEASUREMENT DFC_b.TSC_KnDetSens1PortAMax "Bit encoding / Ok-Tested Since Clear bit for check DFC_KnDetSens1PortAMax" UBYTE DFC_OneToOne 1 100 0.00 1.000 BIT_MASK 0x20 FORMAT "%5.3" ECU_ADDRESS 0x60037066 /end MEASUREMENT
/begin MEASUREMENT DFC_b.TSC_KnDetSens1PortAMin "Bit encoding / Ok-Tested Since Clear bit for check DFC_KnDetSens1PortAMin" UBYTE DFC_OneToOne 1 100 0.00 1.000 BIT_MASK 0x20 FORMAT "%5.3" ECU_ADDRESS 0x60037067 /end MEASUREMENT
/begin MEASUREMENT DFC_b.TSC_KnDetSens1PortBMax "Bit encoding / Ok-Tested Since Clear bit for check DFC_KnDetSens1PortBMax" UBYTE DFC_OneToOne 1 100 0.00 1.000 BIT_MASK 0x20 FORMAT "%5.3" ECU_ADDRESS 0x60037068 /end MEASUREMENT
/begin MEASUREMENT DFC_b.TSC_KnDetSens1PortBMin "Bit encoding / Ok-Tested Since Clear bit for check DFC_KnDetSens1PortBMin" UBYTE DFC_OneToOne 1 100 0.00 1.000 BIT_MASK 0x20 FORMAT "%5.3" ECU_ADDRESS 0x60037069 /end MEASUREMENT
/begin MEASUREMENT DFC_b.TSC_Clth2ONStuck "Bit encoding / Ok-Tested Since Clear bit for check DFC_Clth2ONStuck" UBYTE DFC_OneToOne 1 100 0.00 1.000 BIT_MASK 0x20 FORMAT "%5.3" ECU_ADDRESS 0x6003706A /end MEASUREMENT
/begin MEASUREMENT DFC_b.TSC_Clth2ONStuckLdc "Bit encoding / Ok-Tested Since Clear bit for check DFC_Clth2ONStuckLdc" UBYTE DFC_OneToOne 1 100 0.00 1.000 BIT_MASK 0x20 FORMAT "%5.3" ECU_ADDRESS 0x6003706B /end MEASUREMENT
/begin MEASUREMENT DFC_b.TSC_Clth3ONStuckLdc "Bit encoding / Ok-Tested Since Clear bit for check DFC_Clth3ONStuckLdc" UBYTE DFC_OneToOne 1 100 0.00 1.000 BIT_MASK 0x20 FORMAT "%5.3" ECU_ADDRESS 0x6003706C /end MEASUREMENT
/begin MEASUREMENT DFC_b.TSC_Clth3ONStuckPostDrv "Bit encoding / Ok-Tested Since Clear bit for check DFC_Clth3ONStuckPostDrv" UBYTE DFC_OneToOne 1 100 0.00 1.000 BIT_MASK 0x20 FORMAT "%5.3" ECU_ADDRESS 0x6003706D /end MEASUREMENT
/begin MEASUREMENT DFC_b.TSC_Clth4ONStuck "Bit encoding / Ok-Tested Since Clear bit for check DFC_Clth4ONStuck" UBYTE DFC_OneToOne 1 100 0.00 1.000 BIT_MASK 0x20 FORMAT "%5.3" ECU_ADDRESS 0x6003706E /end MEASUREMENT
/begin MEASUREMENT DFC_b.TSC_Clth4ONStuckLdc "Bit encoding / Ok-Tested Since Clear bit for check DFC_Clth4ONStuckLdc" UBYTE DFC_OneToOne 1 100 0.00 1.000 BIT_MASK 0x20 FORMAT "%5.3" ECU_ADDRESS 0x6003706F /end MEASUREMENT
/begin MEASUREMENT DFC_b.TSC_ComBCMUnit "Bit encoding / Ok-Tested Since Clear bit for check DFC_ComBCMUnit" UBYTE DFC_OneToOne 1 100 0.00 1.000 BIT_MASK 0x20 FORMAT "%5.3" ECU_ADDRESS 0x60037070 /end MEASUREMENT
/begin MEASUREMENT DFC_b.TSC_ComDLCTCU01 "Bit encoding / Ok-Tested Since Clear bit for check DFC_ComDLCTCU01" UBYTE DFC_OneToOne 1 100 0.00 1.000 BIT_MASK 0x20 FORMAT "%5.3" ECU_ADDRESS 0x60037071 /end MEASUREMENT
/begin MEASUREMENT DFC_b.TSC_ComDLCTCU02 "Bit encoding / Ok-Tested Since Clear bit for check DFC_ComDLCTCU02" UBYTE DFC_OneToOne 1 100 0.00 1.000 BIT_MASK 0x20 FORMAT "%5.3" ECU_ADDRESS 0x60037072 /end MEASUREMENT
/begin MEASUREMENT DFC_b.TSC_ComDLCTCU1 "Bit encoding / Ok-Tested Since Clear bit for check DFC_ComDLCTCU1" UBYTE DFC_OneToOne 1 100 0.00 1.000 BIT_MASK 0x20 FORMAT "%5.3" ECU_ADDRESS 0x60037073 /end MEASUREMENT
/begin MEASUREMENT DFC_b.TSC_ComDLCTCU11 "Bit encoding / Ok-Tested Since Clear bit for check DFC_ComDLCTCU11" UBYTE DFC_OneToOne 1 100 0.00 1.000 BIT_MASK 0x20 FORMAT "%5.3" ECU_ADDRESS 0x60037074 /end MEASUREMENT
/begin MEASUREMENT DFC_b.TSC_ComDLCTCU12 "Bit encoding / Ok-Tested Since Clear bit for check DFC_ComDLCTCU12" UBYTE DFC_OneToOne 1 100 0.00 1.000 BIT_MASK 0x20 FORMAT "%5.3" ECU_ADDRESS 0x60037075 /end MEASUREMENT
/begin MEASUREMENT DFC_b.TSC_ComDLCTCU13 "Bit encoding / Ok-Tested Since Clear bit for check DFC_ComDLCTCU13" UBYTE DFC_OneToOne 1 100 0.00 1.000 BIT_MASK 0x20 FORMAT "%5.3" ECU_ADDRESS 0x60037076 /end MEASUREMENT
/begin MEASUREMENT DFC_b.TSC_ComDLCTCU14 "Bit encoding / Ok-Tested Since Clear bit for check DFC_ComDLCTCU14" UBYTE DFC_OneToOne 1 100 0.00 1.000 BIT_MASK 0x20 FORMAT "%5.3" ECU_ADDRESS 0x60037077 /end MEASUREMENT
/begin MEASUREMENT DFC_b.TSC_ComDLCTCU2 "Bit encoding / Ok-Tested Since Clear bit for check DFC_ComDLCTCU2" UBYTE DFC_OneToOne 1 100 0.00 1.000 BIT_MASK 0x20 FORMAT "%5.3" ECU_ADDRESS 0x60037078 /end MEASUREMENT
/begin MEASUREMENT DFC_b.TSC_ComDLCTCU3 "Bit encoding / Ok-Tested Since Clear bit for check DFC_ComDLCTCU3" UBYTE DFC_OneToOne 1 100 0.00 1.000 BIT_MASK 0x20 FORMAT "%5.3" ECU_ADDRESS 0x60037079 /end MEASUREMENT
/begin MEASUREMENT DFC_b.TSC_ComDLCTCU4 "Bit encoding / Ok-Tested Since Clear bit for check DFC_ComDLCTCU4" UBYTE DFC_OneToOne 1 100 0.00 1.000 BIT_MASK 0x20 FORMAT "%5.3" ECU_ADDRESS 0x6003707A /end MEASUREMENT
/begin MEASUREMENT DFC_b.TSC_ComEPSUnit "Bit encoding / Ok-Tested Since Clear bit for check DFC_ComEPSUnit" UBYTE DFC_OneToOne 1 100 0.00 1.000 BIT_MASK 0x20 FORMAT "%5.3" ECU_ADDRESS 0x6003707B /end MEASUREMENT
/begin MEASUREMENT DFC_b.TSC_ComIDASBUnit "Bit encoding / Ok-Tested Since Clear bit for check DFC_ComIDASBUnit" UBYTE DFC_OneToOne 1 100 0.00 1.000 BIT_MASK 0x20 FORMAT "%5.3" ECU_ADDRESS 0x6003707C /end MEASUREMENT
/begin MEASUREMENT DFC_b.TSC_ComIMGUnit "Bit encoding / Ok-Tested Since Clear bit for check DFC_ComIMGUnit" UBYTE DFC_OneToOne 1 100 0.00 1.000 BIT_MASK 0x20 FORMAT "%5.3" ECU_ADDRESS 0x6003707D /end MEASUREMENT
/begin MEASUREMENT DFC_b.TSC_ComMETUnit "Bit encoding / Ok-Tested Since Clear bit for check DFC_ComMETUnit" UBYTE DFC_OneToOne 1 100 0.00 1.000 BIT_MASK 0x20 FORMAT "%5.3" ECU_ADDRESS 0x6003707E /end MEASUREMENT
/begin MEASUREMENT DFC_b.TSC_ComSRSUnit "Bit encoding / Ok-Tested Since Clear bit for check DFC_ComSRSUnit" UBYTE DFC_OneToOne 1 100 0.00 1.000 BIT_MASK 0x20 FORMAT "%5.3" ECU_ADDRESS 0x6003707F /end MEASUREMENT
/begin MEASUREMENT DFC_b.TSC_ComVSAUnit "Bit encoding / Ok-Tested Since Clear bit for check DFC_ComVSAUnit" UBYTE DFC_OneToOne 1 100 0.00 1.000 BIT_MASK 0x20 FORMAT "%5.3" ECU_ADDRESS 0x60037080 /end MEASUREMENT
/begin MEASUREMENT DFC_b.TSC_EbsSocFlt "Bit encoding / Ok-Tested Since Clear bit for check DFC_EbsSocFlt" UBYTE DFC_OneToOne 1 100 0.00 1.000 BIT_MASK 0x20 FORMAT "%5.3" ECU_ADDRESS 0x60037081 /end MEASUREMENT
/begin MEASUREMENT DFC_b.TSC_I14229VINErr "Bit encoding / Ok-Tested Since Clear bit for check DFC_I14229VINErr" UBYTE DFC_OneToOne 1 100 0.00 1.000 BIT_MASK 0x20 FORMAT "%5.3" ECU_ADDRESS 0x60037082 /end MEASUREMENT
/begin MEASUREMENT DFC_b.TSC_InjCatHeatgErr "Bit encoding / Ok-Tested Since Clear bit for check DFC_InjCatHeatgErr" UBYTE DFC_OneToOne 1 100 0.00 1.000 BIT_MASK 0x20 FORMAT "%5.3" ECU_ADDRESS 0x60037083 /end MEASUREMENT
/begin MEASUREMENT DFC_b.TSC_InjSysMulInjDiagErr "Bit encoding / Ok-Tested Since Clear bit for check DFC_InjSysMulInjDiagErr" UBYTE DFC_OneToOne 1 100 0.00 1.000 BIT_MASK 0x20 FORMAT "%5.3" ECU_ADDRESS 0x60037084 /end MEASUREMENT
/begin MEASUREMENT DFC_b.TSC_LLRHmax "Bit encoding / Ok-Tested Since Clear bit for check DFC_LLRHmax" UBYTE DFC_OneToOne 1 100 0.00 1.000 BIT_MASK 0x20 FORMAT "%5.3" ECU_ADDRESS 0x60037085 /end MEASUREMENT
/begin MEASUREMENT DFC_b.TSC_LLRHmin "Bit encoding / Ok-Tested Since Clear bit for check DFC_LLRHmin" UBYTE DFC_OneToOne 1 100 0.00 1.000 BIT_MASK 0x20 FORMAT "%5.3" ECU_ADDRESS 0x60037086 /end MEASUREMENT
/begin MEASUREMENT DFC_b.TSC_LLRHnpl "Bit encoding / Ok-Tested Since Clear bit for check DFC_LLRHnpl" UBYTE DFC_OneToOne 1 100 0.00 1.000 BIT_MASK 0x20 FORMAT "%5.3" ECU_ADDRESS 0x60037087 /end MEASUREMENT
/begin MEASUREMENT DFC_b.TSC_LLRKHmax "Bit encoding / Ok-Tested Since Clear bit for check DFC_LLRKHmax" UBYTE DFC_OneToOne 1 100 0.00 1.000 BIT_MASK 0x20 FORMAT "%5.3" ECU_ADDRESS 0x60037088 /end MEASUREMENT
/begin MEASUREMENT DFC_b.TSC_LLRKHmin "Bit encoding / Ok-Tested Since Clear bit for check DFC_LLRKHmin" UBYTE DFC_OneToOne 1 100 0.00 1.000 BIT_MASK 0x20 FORMAT "%5.3" ECU_ADDRESS 0x60037089 /end MEASUREMENT
/begin MEASUREMENT DFC_b.TSC_LLRKHnpl "Bit encoding / Ok-Tested Since Clear bit for check DFC_LLRKHnpl" UBYTE DFC_OneToOne 1 100 0.00 1.000 BIT_MASK 0x20 FORMAT "%5.3" ECU_ADDRESS 0x6003708A /end MEASUREMENT
/begin MEASUREMENT DFC_b.TSC_LinACGUnit "Bit encoding / Ok-Tested Since Clear bit for check DFC_LinACGUnit" UBYTE DFC_OneToOne 1 100 0.00 1.000 BIT_MASK 0x20 FORMAT "%5.3" ECU_ADDRESS 0x6003708B /end MEASUREMENT
/begin MEASUREMENT DFC_b.TSC_LinAEVUnit "Bit encoding / Ok-Tested Since Clear bit for check DFC_LinAEVUnit" UBYTE DFC_OneToOne 1 100 0.00 1.000 BIT_MASK 0x20 FORMAT "%5.3" ECU_ADDRESS 0x6003708C /end MEASUREMENT
/begin MEASUREMENT DFC_b.TSC_LinEBSUnit "Bit encoding / Ok-Tested Since Clear bit for check DFC_LinEBSUnit" UBYTE DFC_OneToOne 1 100 0.00 1.000 BIT_MASK 0x20 FORMAT "%5.3" ECU_ADDRESS 0x6003708D /end MEASUREMENT
/begin MEASUREMENT DFC_b.TSC_RoughRoad "Bit encoding / Ok-Tested Since Clear bit for check DFC_RoughRoad" UBYTE DFC_OneToOne 1 100 0.00 1.000 BIT_MASK 0x20 FORMAT "%5.3" ECU_ADDRESS 0x6003708E /end MEASUREMENT
/begin MEASUREMENT DFC_b.TSC_SiaEEPRdErr "Bit encoding / Ok-Tested Since Clear bit for check DFC_SiaEEPRdErr" UBYTE DFC_OneToOne 1 100 0.00 1.000 BIT_MASK 0x20 FORMAT "%5.3" ECU_ADDRESS 0x6003708F /end MEASUREMENT
/begin MEASUREMENT DFC_b.TSC_SiaEEPWrngCod "Bit encoding / Ok-Tested Since Clear bit for check DFC_SiaEEPWrngCod" UBYTE DFC_OneToOne 1 100 0.00 1.000 BIT_MASK 0x20 FORMAT "%5.3" ECU_ADDRESS 0x60037090 /end MEASUREMENT
/begin MEASUREMENT DFC_b.TSC_UegoHeatrStrtS1B1 "Bit encoding / Ok-Tested Since Clear bit for check DFC_UegoHeatrStrtS1B1" UBYTE DFC_OneToOne 1 100 0.00 1.000 BIT_MASK 0x20 FORMAT "%5.3" ECU_ADDRESS 0x60037091 /end MEASUREMENT
/begin MEASUREMENT DFC_b.TSC_BusDiagCANAPPLBusOff "Bit encoding / Ok-Tested Since Clear bit for check DFC_BusDiagCANAPPLBusOff" UBYTE DFC_OneToOne 1 100 0.00 1.000 BIT_MASK 0x20 FORMAT "%5.3" ECU_ADDRESS 0x60037092 /end MEASUREMENT
/begin MEASUREMENT DFC_b.TSC_BusDiagCANCANCBusOff "Bit encoding / Ok-Tested Since Clear bit for check DFC_BusDiagCANCANCBusOff" UBYTE DFC_OneToOne 1 100 0.00 1.000 BIT_MASK 0x20 FORMAT "%5.3" ECU_ADDRESS 0x60037093 /end MEASUREMENT
/begin MEASUREMENT DFC_b.TSC_BusDiagCANVEHICLEBusOff "Bit encoding / Ok-Tested Since Clear bit for check DFC_BusDiagCANVEHICLEBusOff" UBYTE DFC_OneToOne 1 100 0.00 1.000 BIT_MASK 0x20 FORMAT "%5.3" ECU_ADDRESS 0x60037094 /end MEASUREMENT
/begin MEASUREMENT DFC_b.TSC_RBA_IODIAGPWR_rba_IoExtCy329_SignalVltSply_0 "Bit encoding / Ok-Tested Since Clear bit for check DFC_RBA_IODIAGPWR_rba_IoExtCy329_SignalVltSply_0" UBYTE DFC_OneToOne 1 100 0.00 1.000 BIT_MASK 0x20 FORMAT "%5.3" ECU_ADDRESS 0x60037095 /end MEASUREMENT
/begin MEASUREMENT DFC_b.TSC_RBA_IODIAGPWR_rba_IoExtCy329_SignalVltSply_0OT "Bit encoding / Ok-Tested Since Clear bit for check DFC_RBA_IODIAGPWR_rba_IoExtCy329_SignalVltSply_0OT" UBYTE DFC_OneToOne 1 100 0.00 1.000 BIT_MASK 0x20 FORMAT "%5.3" ECU_ADDRESS 0x60037096 /end MEASUREMENT
/begin MEASUREMENT DFC_b.TSC_RBA_IODIAGPWR_rba_IoExtCy329_SignalVltSply_0OV "Bit encoding / Ok-Tested Since Clear bit for check DFC_RBA_IODIAGPWR_rba_IoExtCy329_SignalVltSply_0OV" UBYTE DFC_OneToOne 1 100 0.00 1.000 BIT_MASK 0x20 FORMAT "%5.3" ECU_ADDRESS 0x60037097 /end MEASUREMENT
/begin MEASUREMENT DFC_b.TSC_RBA_IODIAGPWR_rba_IoExtCy329_SignalVltSply_0SCG "Bit encoding / Ok-Tested Since Clear bit for check DFC_RBA_IODIAGPWR_rba_IoExtCy329_SignalVltSply_0SCG" UBYTE DFC_OneToOne 1 100 0.00 1.000 BIT_MASK 0x20 FORMAT "%5.3" ECU_ADDRESS 0x60037098 /end MEASUREMENT
/begin MEASUREMENT DFC_b.TSC_RBA_IODIAGPWR_rba_IoExtCy329_SignalVltSply_0UV "Bit encoding / Ok-Tested Since Clear bit for check DFC_RBA_IODIAGPWR_rba_IoExtCy329_SignalVltSply_0UV" UBYTE DFC_OneToOne 1 100 0.00 1.000 BIT_MASK 0x20 FORMAT "%5.3" ECU_ADDRESS 0x60037099 /end MEASUREMENT
/begin MEASUREMENT DFC_b.TSC_RBA_IODIAGPWR_rba_IoExtCy329_SignalVltSply_1 "Bit encoding / Ok-Tested Since Clear bit for check DFC_RBA_IODIAGPWR_rba_IoExtCy329_SignalVltSply_1" UBYTE DFC_OneToOne 1 100 0.00 1.000 BIT_MASK 0x20 FORMAT "%5.3" ECU_ADDRESS 0x6003709A /end MEASUREMENT
/begin MEASUREMENT DFC_b.TSC_RBA_IODIAGPWR_rba_IoExtCy329_SignalVltSply_1OT "Bit encoding / Ok-Tested Since Clear bit for check DFC_RBA_IODIAGPWR_rba_IoExtCy329_SignalVltSply_1OT" UBYTE DFC_OneToOne 1 100 0.00 1.000 BIT_MASK 0x20 FORMAT "%5.3" ECU_ADDRESS 0x6003709B /end MEASUREMENT
/begin MEASUREMENT DFC_b.TSC_RBA_IODIAGPWR_rba_IoExtCy329_SignalVltSply_1OV "Bit encoding / Ok-Tested Since Clear bit for check DFC_RBA_IODIAGPWR_rba_IoExtCy329_SignalVltSply_1OV" UBYTE DFC_OneToOne 1 100 0.00 1.000 BIT_MASK 0x20 FORMAT "%5.3" ECU_ADDRESS 0x6003709C /end MEASUREMENT
/begin MEASUREMENT DFC_b.TSC_RBA_IODIAGPWR_rba_IoExtCy329_SignalVltSply_1SCG "Bit encoding / Ok-Tested Since Clear bit for check DFC_RBA_IODIAGPWR_rba_IoExtCy329_SignalVltSply_1SCG" UBYTE DFC_OneToOne 1 100 0.00 1.000 BIT_MASK 0x20 FORMAT "%5.3" ECU_ADDRESS 0x6003709D /end MEASUREMENT
/begin MEASUREMENT DFC_b.TSC_RBA_IODIAGPWR_rba_IoExtCy329_SignalVltSply_1UV "Bit encoding / Ok-Tested Since Clear bit for check DFC_RBA_IODIAGPWR_rba_IoExtCy329_SignalVltSply_1UV" UBYTE DFC_OneToOne 1 100 0.00 1.000 BIT_MASK 0x20 FORMAT "%5.3" ECU_ADDRESS 0x6003709E /end MEASUREMENT
/begin MEASUREMENT DFC_b.TSC_RBA_IODIAGPWR_rba_IoExtCy329_SignalVltSply_2 "Bit encoding / Ok-Tested Since Clear bit for check DFC_RBA_IODIAGPWR_rba_IoExtCy329_SignalVltSply_2" UBYTE DFC_OneToOne 1 100 0.00 1.000 BIT_MASK 0x20 FORMAT "%5.3" ECU_ADDRESS 0x6003709F /end MEASUREMENT
/begin MEASUREMENT DFC_b.TSC_RBA_IODIAGPWR_rba_IoExtCy329_SignalVltSply_2OT "Bit encoding / Ok-Tested Since Clear bit for check DFC_RBA_IODIAGPWR_rba_IoExtCy329_SignalVltSply_2OT" UBYTE DFC_OneToOne 1 100 0.00 1.000 BIT_MASK 0x20 FORMAT "%5.3" ECU_ADDRESS 0x600370A0 /end MEASUREMENT
/begin MEASUREMENT DFC_b.TSC_RBA_IODIAGPWR_rba_IoExtCy329_SignalVltSply_2OV "Bit encoding / Ok-Tested Since Clear bit for check DFC_RBA_IODIAGPWR_rba_IoExtCy329_SignalVltSply_2OV" UBYTE DFC_OneToOne 1 100 0.00 1.000 BIT_MASK 0x20 FORMAT "%5.3" ECU_ADDRESS 0x600370A1 /end MEASUREMENT
/begin MEASUREMENT DFC_b.TSC_RBA_IODIAGPWR_rba_IoExtCy329_SignalVltSply_2SCG "Bit encoding / Ok-Tested Since Clear bit for check DFC_RBA_IODIAGPWR_rba_IoExtCy329_SignalVltSply_2SCG" UBYTE DFC_OneToOne 1 100 0.00 1.000 BIT_MASK 0x20 FORMAT "%5.3" ECU_ADDRESS 0x600370A2 /end MEASUREMENT
/begin MEASUREMENT DFC_b.TSC_RBA_IODIAGPWR_rba_IoExtCy329_SignalVltSply_2UV "Bit encoding / Ok-Tested Since Clear bit for check DFC_RBA_IODIAGPWR_rba_IoExtCy329_SignalVltSply_2UV" UBYTE DFC_OneToOne 1 100 0.00 1.000 BIT_MASK 0x20 FORMAT "%5.3" ECU_ADDRESS 0x600370A3 /end MEASUREMENT
/begin MEASUREMENT DFC_b.TSC_CAN_E_TIMEOUT "Bit encoding / Ok-Tested Since Clear bit for check DFC_CAN_E_TIMEOUT" UBYTE DFC_OneToOne 1 100 0.00 1.000 BIT_MASK 0x20 FORMAT "%5.3" ECU_ADDRESS 0x600370A4 /end MEASUREMENT
/begin MEASUREMENT DFC_b.TSC_LIN_E_TIMEOUT "Bit encoding / Ok-Tested Since Clear bit for check DFC_LIN_E_TIMEOUT" UBYTE DFC_OneToOne 1 100 0.00 1.000 BIT_MASK 0x20 FORMAT "%5.3" ECU_ADDRESS 0x600370A5 /end MEASUREMENT
/begin MEASUREMENT DFC_b.TSC_MRlyOL "Bit encoding / Ok-Tested Since Clear bit for check DFC_MRlyOL" UBYTE DFC_OneToOne 1 100 0.00 1.000 BIT_MASK 0x20 FORMAT "%5.3" ECU_ADDRESS 0x600370A6 /end MEASUREMENT
/begin MEASUREMENT DFC_b.TSC_MRlySCB "Bit encoding / Ok-Tested Since Clear bit for check DFC_MRlySCB" UBYTE DFC_OneToOne 1 100 0.00 1.000 BIT_MASK 0x20 FORMAT "%5.3" ECU_ADDRESS 0x600370A7 /end MEASUREMENT
/begin MEASUREMENT DFC_b.TSC_MRlySCG "Bit encoding / Ok-Tested Since Clear bit for check DFC_MRlySCG" UBYTE DFC_OneToOne 1 100 0.00 1.000 BIT_MASK 0x20 FORMAT "%5.3" ECU_ADDRESS 0x600370A8 /end MEASUREMENT
/begin MEASUREMENT DFC_b.TSC_rba_MultiStackTrace_Threshold "Bit encoding / Ok-Tested Since Clear bit for check DFC_rba_MultiStackTrace_Threshold" UBYTE DFC_OneToOne 1 100 0.00 1.000 BIT_MASK 0x20 FORMAT "%5.3" ECU_ADDRESS 0x600370A9 /end MEASUREMENT
/begin MEASUREMENT DFC_b.TSC_BSWM_E_ACTION_FAILED "Bit encoding / Ok-Tested Since Clear bit for check DFC_BSWM_E_ACTION_FAILED" UBYTE DFC_OneToOne 1 100 0.00 1.000 BIT_MASK 0x20 FORMAT "%5.3" ECU_ADDRESS 0x600370AA /end MEASUREMENT
/begin MEASUREMENT DFC_b.TSC_BSWM_E_INTRPTQUEUE_FULL "Bit encoding / Ok-Tested Since Clear bit for check DFC_BSWM_E_INTRPTQUEUE_FULL" UBYTE DFC_OneToOne 1 100 0.00 1.000 BIT_MASK 0x20 FORMAT "%5.3" ECU_ADDRESS 0x600370AB /end MEASUREMENT
/begin MEASUREMENT DFC_b.TSC_RBA_IOEXTLIB_KEEPALIVE_DRV "Bit encoding / Ok-Tested Since Clear bit for check DFC_RBA_IOEXTLIB_KEEPALIVE_DRV" UBYTE DFC_OneToOne 1 100 0.00 1.000 BIT_MASK 0x20 FORMAT "%5.3" ECU_ADDRESS 0x600370AC /end MEASUREMENT
/begin MEASUREMENT DFC_b.TSC_RBA_IOEXTLIB_KEEPALIVE_INI "Bit encoding / Ok-Tested Since Clear bit for check DFC_RBA_IOEXTLIB_KEEPALIVE_INI" UBYTE DFC_OneToOne 1 100 0.00 1.000 BIT_MASK 0x20 FORMAT "%5.3" ECU_ADDRESS 0x600370AD /end MEASUREMENT
/begin MEASUREMENT DFC_b.TSC_rba_IoSigRtc_StopCounter "Bit encoding / Ok-Tested Since Clear bit for check DFC_rba_IoSigRtc_StopCounter" UBYTE DFC_OneToOne 1 100 0.00 1.000 BIT_MASK 0x20 FORMAT "%5.3" ECU_ADDRESS 0x600370AE /end MEASUREMENT
/begin MEASUREMENT DFC_b.TSC_rba_MRly_Diag_Stk_Event "Bit encoding / Ok-Tested Since Clear bit for check DFC_rba_MRly_Diag_Stk_Event" UBYTE DFC_OneToOne 1 100 0.00 1.000 BIT_MASK 0x20 FORMAT "%5.3" ECU_ADDRESS 0x600370AF /end MEASUREMENT
/begin MEASUREMENT DFC_b.TSC_rba_MemDiag_MemReadErr "Bit encoding / Ok-Tested Since Clear bit for check DFC_rba_MemDiag_MemReadErr" UBYTE DFC_OneToOne 1 100 0.00 1.000 BIT_MASK 0x20 FORMAT "%5.3" ECU_ADDRESS 0x600370B0 /end MEASUREMENT
/begin MEASUREMENT DFC_b.TSC_rba_MemDiag_MemWrErr "Bit encoding / Ok-Tested Since Clear bit for check DFC_rba_MemDiag_MemWrErr" UBYTE DFC_OneToOne 1 100 0.00 1.000 BIT_MASK 0x20 FORMAT "%5.3" ECU_ADDRESS 0x600370B1 /end MEASUREMENT
/begin MEASUREMENT DFC_b.TSC_rba_SyC_IrrSwOffTrigEngRun_Event "Bit encoding / Ok-Tested Since Clear bit for check DFC_rba_SyC_IrrSwOffTrigEngRun_Event" UBYTE DFC_OneToOne 1 100 0.00 1.000 BIT_MASK 0x20 FORMAT "%5.3" ECU_ADDRESS 0x600370B2 /end MEASUREMENT
/begin MEASUREMENT DFC_b.TSC_rba_T15_Diag_ComInVld_Event "Bit encoding / Ok-Tested Since Clear bit for check DFC_rba_T15_Diag_ComInVld_Event" UBYTE DFC_OneToOne 1 100 0.00 1.000 BIT_MASK 0x20 FORMAT "%5.3" ECU_ADDRESS 0x600370B3 /end MEASUREMENT
/begin MEASUREMENT DFC_b.TSC_rba_T15_Diag_ComOff_HwOn_Event "Bit encoding / Ok-Tested Since Clear bit for check DFC_rba_T15_Diag_ComOff_HwOn_Event" UBYTE DFC_OneToOne 1 100 0.00 1.000 BIT_MASK 0x20 FORMAT "%5.3" ECU_ADDRESS 0x600370B4 /end MEASUREMENT
/begin MEASUREMENT DFC_b.TSC_rba_T15_Diag_ComOn_HwOff_Event "Bit encoding / Ok-Tested Since Clear bit for check DFC_rba_T15_Diag_ComOn_HwOff_Event" UBYTE DFC_OneToOne 1 100 0.00 1.000 BIT_MASK 0x20 FORMAT "%5.3" ECU_ADDRESS 0x600370B5 /end MEASUREMENT
/begin MEASUREMENT DFC_b.TSC_AAVmin "Bit encoding / Ok-Tested Since Clear bit for check DFC_AAVmin" UBYTE DFC_OneToOne 1 100 0.00 1.000 BIT_MASK 0x20 FORMAT "%5.3" ECU_ADDRESS 0x600370B6 /end MEASUREMENT
/begin MEASUREMENT DFC_b.TSC_AGRSUS "Bit encoding / Ok-Tested Since Clear bit for check DFC_AGRSUS" UBYTE DFC_OneToOne 1 100 0.00 1.000 BIT_MASK 0x20 FORMAT "%5.3" ECU_ADDRESS 0x600370B7 /end MEASUREMENT
/begin MEASUREMENT DFC_b.TSC_AfsPlausDiagHi "Bit encoding / Ok-Tested Since Clear bit for check DFC_AfsPlausDiagHi" UBYTE DFC_OneToOne 1 100 0.00 1.000 BIT_MASK 0x20 FORMAT "%5.3" ECU_ADDRESS 0x600370B8 /end MEASUREMENT
/begin MEASUREMENT DFC_b.TSC_AfsPlausDiagLo "Bit encoding / Ok-Tested Since Clear bit for check DFC_AfsPlausDiagLo" UBYTE DFC_OneToOne 1 100 0.00 1.000 BIT_MASK 0x20 FORMAT "%5.3" ECU_ADDRESS 0x600370B9 /end MEASUREMENT
/begin MEASUREMENT DFC_b.TSC_AfsVrntDiagErrB1 "Bit encoding / Ok-Tested Since Clear bit for check DFC_AfsVrntDiagErrB1" UBYTE DFC_OneToOne 1 100 0.00 1.000 BIT_MASK 0x20 FORMAT "%5.3" ECU_ADDRESS 0x600370BA /end MEASUREMENT
/begin MEASUREMENT DFC_b.TSC_AppAllSnsrDfct "Bit encoding / Ok-Tested Since Clear bit for check DFC_AppAllSnsrDfct" UBYTE DFC_OneToOne 1 100 0.00 1.000 BIT_MASK 0x20 FORMAT "%5.3" ECU_ADDRESS 0x600370BB /end MEASUREMENT
/begin MEASUREMENT DFC_b.TSC_BBKRnldg "Bit encoding / Ok-Tested Since Clear bit for check DFC_BBKRnldg" UBYTE DFC_OneToOne 1 100 0.00 1.000 BIT_MASK 0x20 FORMAT "%5.3" ECU_ADDRESS 0x600370BC /end MEASUREMENT
/begin MEASUREMENT DFC_b.TSC_BBKRsyne "Bit encoding / Ok-Tested Since Clear bit for check DFC_BBKRsyne" UBYTE DFC_OneToOne 1 100 0.00 1.000 BIT_MASK 0x20 FORMAT "%5.3" ECU_ADDRESS 0x600370BD /end MEASUREMENT
/begin MEASUREMENT DFC_b.TSC_BattUStdbyDiaOL "Bit encoding / Ok-Tested Since Clear bit for check DFC_BattUStdbyDiaOL" UBYTE DFC_OneToOne 1 100 0.00 1.000 BIT_MASK 0x20 FORMAT "%5.3" ECU_ADDRESS 0x600370BE /end MEASUREMENT
/begin MEASUREMENT DFC_b.TSC_BigLeakIntkMnfldEmiInfl "Bit encoding / Ok-Tested Since Clear bit for check DFC_BigLeakIntkMnfldEmiInfl" UBYTE DFC_OneToOne 1 100 0.00 1.000 BIT_MASK 0x20 FORMAT "%5.3" ECU_ADDRESS 0x600370BF /end MEASUREMENT
/begin MEASUREMENT DFC_b.TSC_BlkdLineTank "Bit encoding / Ok-Tested Since Clear bit for check DFC_BlkdLineTank" UBYTE DFC_OneToOne 1 100 0.00 1.000 BIT_MASK 0x20 FORMAT "%5.3" ECU_ADDRESS 0x600370C0 /end MEASUREMENT
/begin MEASUREMENT DFC_b.TSC_BrkMnSwtContOnWarnLmp "Bit encoding / Ok-Tested Since Clear bit for check DFC_BrkMnSwtContOnWarnLmp" UBYTE DFC_OneToOne 1 100 0.00 1.000 BIT_MASK 0x20 FORMAT "%5.3" ECU_ADDRESS 0x600370C1 /end MEASUREMENT
/begin MEASUREMENT DFC_b.TSC_BrkMnSwtNotStpWarnLmp "Bit encoding / Ok-Tested Since Clear bit for check DFC_BrkMnSwtNotStpWarnLmp" UBYTE DFC_OneToOne 1 100 0.00 1.000 BIT_MASK 0x20 FORMAT "%5.3" ECU_ADDRESS 0x600370C2 /end MEASUREMENT
/begin MEASUREMENT DFC_b.TSC_BrkRdntSwtContOnWarnLmp "Bit encoding / Ok-Tested Since Clear bit for check DFC_BrkRdntSwtContOnWarnLmp" UBYTE DFC_OneToOne 1 100 0.00 1.000 BIT_MASK 0x20 FORMAT "%5.3" ECU_ADDRESS 0x600370C3 /end MEASUREMENT
/begin MEASUREMENT DFC_b.TSC_BrkRdntSwtNotStpWarnLmp "Bit encoding / Ok-Tested Since Clear bit for check DFC_BrkRdntSwtNotStpWarnLmp" UBYTE DFC_OneToOne 1 100 0.00 1.000 BIT_MASK 0x20 FORMAT "%5.3" ECU_ADDRESS 0x600370C4 /end MEASUREMENT
/begin MEASUREMENT DFC_b.TSC_CEngDsTColdStrtMax "Bit encoding / Ok-Tested Since Clear bit for check DFC_CEngDsTColdStrtMax" UBYTE DFC_OneToOne 1 100 0.00 1.000 BIT_MASK 0x20 FORMAT "%5.3" ECU_ADDRESS 0x600370C5 /end MEASUREMENT
/begin MEASUREMENT DFC_b.TSC_CEngDsTColdStrtMin "Bit encoding / Ok-Tested Since Clear bit for check DFC_CEngDsTColdStrtMin" UBYTE DFC_OneToOne 1 100 0.00 1.000 BIT_MASK 0x20 FORMAT "%5.3" ECU_ADDRESS 0x600370C6 /end MEASUREMENT
/begin MEASUREMENT DFC_b.TSC_CEngDsTImps "Bit encoding / Ok-Tested Since Clear bit for check DFC_CEngDsTImps" UBYTE DFC_OneToOne 1 100 0.00 1.000 BIT_MASK 0x20 FORMAT "%5.3" ECU_ADDRESS 0x600370C7 /end MEASUREMENT
/begin MEASUREMENT DFC_b.TSC_CEngDsTPlausHSC "Bit encoding / Ok-Tested Since Clear bit for check DFC_CEngDsTPlausHSC" UBYTE DFC_OneToOne 1 100 0.00 1.000 BIT_MASK 0x20 FORMAT "%5.3" ECU_ADDRESS 0x600370C8 /end MEASUREMENT
/begin MEASUREMENT DFC_b.TSC_CEngDsTPlausLSC "Bit encoding / Ok-Tested Since Clear bit for check DFC_CEngDsTPlausLSC" UBYTE DFC_OneToOne 1 100 0.00 1.000 BIT_MASK 0x20 FORMAT "%5.3" ECU_ADDRESS 0x600370C9 /end MEASUREMENT
/begin MEASUREMENT DFC_b.TSC_CEngDsTPlausSTC "Bit encoding / Ok-Tested Since Clear bit for check DFC_CEngDsTPlausSTC" UBYTE DFC_OneToOne 1 100 0.00 1.000 BIT_MASK 0x20 FORMAT "%5.3" ECU_ADDRESS 0x600370CA /end MEASUREMENT
/begin MEASUREMENT DFC_b.TSC_CEngDsTSRCMax "Bit encoding / Ok-Tested Since Clear bit for check DFC_CEngDsTSRCMax" UBYTE DFC_OneToOne 1 100 0.00 1.000 BIT_MASK 0x20 FORMAT "%5.3" ECU_ADDRESS 0x600370CB /end MEASUREMENT
/begin MEASUREMENT DFC_b.TSC_CEngDsTSRCMin "Bit encoding / Ok-Tested Since Clear bit for check DFC_CEngDsTSRCMin" UBYTE DFC_OneToOne 1 100 0.00 1.000 BIT_MASK 0x20 FORMAT "%5.3" ECU_ADDRESS 0x600370CC /end MEASUREMENT
/begin MEASUREMENT DFC_b.TSC_CEngDsTSig "Bit encoding / Ok-Tested Since Clear bit for check DFC_CEngDsTSig" UBYTE DFC_OneToOne 1 100 0.00 1.000 BIT_MASK 0x20 FORMAT "%5.3" ECU_ADDRESS 0x600370CD /end MEASUREMENT
/begin MEASUREMENT DFC_b.TSC_CEngUsTColdStrtMax "Bit encoding / Ok-Tested Since Clear bit for check DFC_CEngUsTColdStrtMax" UBYTE DFC_OneToOne 1 100 0.00 1.000 BIT_MASK 0x20 FORMAT "%5.3" ECU_ADDRESS 0x600370CE /end MEASUREMENT
/begin MEASUREMENT DFC_b.TSC_CEngUsTColdStrtMin "Bit encoding / Ok-Tested Since Clear bit for check DFC_CEngUsTColdStrtMin" UBYTE DFC_OneToOne 1 100 0.00 1.000 BIT_MASK 0x20 FORMAT "%5.3" ECU_ADDRESS 0x600370CF /end MEASUREMENT
/begin MEASUREMENT DFC_b.TSC_CEngUsTLooseCnctn "Bit encoding / Ok-Tested Since Clear bit for check DFC_CEngUsTLooseCnctn" UBYTE DFC_OneToOne 1 100 0.00 1.000 BIT_MASK 0x20 FORMAT "%5.3" ECU_ADDRESS 0x600370D0 /end MEASUREMENT
/begin MEASUREMENT DFC_b.TSC_CEngUsTSRCMax "Bit encoding / Ok-Tested Since Clear bit for check DFC_CEngUsTSRCMax" UBYTE DFC_OneToOne 1 100 0.00 1.000 BIT_MASK 0x20 FORMAT "%5.3" ECU_ADDRESS 0x600370D1 /end MEASUREMENT
/begin MEASUREMENT DFC_b.TSC_CEngUsTSRCMin "Bit encoding / Ok-Tested Since Clear bit for check DFC_CEngUsTSRCMin" UBYTE DFC_OneToOne 1 100 0.00 1.000 BIT_MASK 0x20 FORMAT "%5.3" ECU_ADDRESS 0x600370D2 /end MEASUREMENT
/begin MEASUREMENT DFC_b.TSC_ComDCDCACCFailr "Bit encoding / Ok-Tested Since Clear bit for check DFC_ComDCDCACCFailr" UBYTE DFC_OneToOne 1 100 0.00 1.000 BIT_MASK 0x20 FORMAT "%5.3" ECU_ADDRESS 0x600370D3 /end MEASUREMENT
/begin MEASUREMENT DFC_b.TSC_DCDCFltDet "Bit encoding / Ok-Tested Since Clear bit for check DFC_DCDCFltDet" UBYTE DFC_OneToOne 1 100 0.00 1.000 BIT_MASK 0x20 FORMAT "%5.3" ECU_ADDRESS 0x600370D4 /end MEASUREMENT
/begin MEASUREMENT DFC_b.TSC_DKRSA "Bit encoding / Ok-Tested Since Clear bit for check DFC_DKRSA" UBYTE DFC_OneToOne 1 100 0.00 1.000 BIT_MASK 0x20 FORMAT "%5.3" ECU_ADDRESS 0x600370D5 /end MEASUREMENT
/begin MEASUREMENT DFC_b.TSC_DKVSmax "Bit encoding / Ok-Tested Since Clear bit for check DFC_DKVSmax" UBYTE DFC_OneToOne 1 100 0.00 1.000 BIT_MASK 0x20 FORMAT "%5.3" ECU_ADDRESS 0x600370D6 /end MEASUREMENT
/begin MEASUREMENT DFC_b.TSC_DKnpl "Bit encoding / Ok-Tested Since Clear bit for check DFC_DKnpl" UBYTE DFC_OneToOne 1 100 0.00 1.000 BIT_MASK 0x20 FORMAT "%5.3" ECU_ADDRESS 0x600370D7 /end MEASUREMENT
/begin MEASUREMENT DFC_b.TSC_DSKVRmax "Bit encoding / Ok-Tested Since Clear bit for check DFC_DSKVRmax" UBYTE DFC_OneToOne 1 100 0.00 1.000 BIT_MASK 0x20 FORMAT "%5.3" ECU_ADDRESS 0x600370D8 /end MEASUREMENT
/begin MEASUREMENT DFC_b.TSC_DSKVRmin "Bit encoding / Ok-Tested Since Clear bit for check DFC_DSKVRmin" UBYTE DFC_OneToOne 1 100 0.00 1.000 BIT_MASK 0x20 FORMAT "%5.3" ECU_ADDRESS 0x600370D9 /end MEASUREMENT
/begin MEASUREMENT DFC_b.TSC_DSKVRnpl "Bit encoding / Ok-Tested Since Clear bit for check DFC_DSKVRnpl" UBYTE DFC_OneToOne 1 100 0.00 1.000 BIT_MASK 0x20 FORMAT "%5.3" ECU_ADDRESS 0x600370DA /end MEASUREMENT
/begin MEASUREMENT DFC_b.TSC_DSKVRsig "Bit encoding / Ok-Tested Since Clear bit for check DFC_DSKVRsig" UBYTE DFC_OneToOne 1 100 0.00 1.000 BIT_MASK 0x20 FORMAT "%5.3" ECU_ADDRESS 0x600370DB /end MEASUREMENT
/begin MEASUREMENT DFC_b.TSC_DSKVSsig "Bit encoding / Ok-Tested Since Clear bit for check DFC_DSKVSsig" UBYTE DFC_OneToOne 1 100 0.00 1.000 BIT_MASK 0x20 FORMAT "%5.3" ECU_ADDRESS 0x600370DC /end MEASUREMENT
/begin MEASUREMENT DFC_b.TSC_DSSmax "Bit encoding / Ok-Tested Since Clear bit for check DFC_DSSmax" UBYTE DFC_OneToOne 1 100 0.00 1.000 BIT_MASK 0x20 FORMAT "%5.3" ECU_ADDRESS 0x600370DD /end MEASUREMENT
/begin MEASUREMENT DFC_b.TSC_DSTDmax "Bit encoding / Ok-Tested Since Clear bit for check DFC_DSTDmax" UBYTE DFC_OneToOne 1 100 0.00 1.000 BIT_MASK 0x20 FORMAT "%5.3" ECU_ADDRESS 0x600370DE /end MEASUREMENT
/begin MEASUREMENT DFC_b.TSC_DSTEmax "Bit encoding / Ok-Tested Since Clear bit for check DFC_DSTEmax" UBYTE DFC_OneToOne 1 100 0.00 1.000 BIT_MASK 0x20 FORMAT "%5.3" ECU_ADDRESS 0x600370DF /end MEASUREMENT
/begin MEASUREMENT DFC_b.TSC_DSTEmin "Bit encoding / Ok-Tested Since Clear bit for check DFC_DSTEmin" UBYTE DFC_OneToOne 1 100 0.00 1.000 BIT_MASK 0x20 FORMAT "%5.3" ECU_ADDRESS 0x600370E0 /end MEASUREMENT
/begin MEASUREMENT DFC_b.TSC_DSTOFmax "Bit encoding / Ok-Tested Since Clear bit for check DFC_DSTOFmax" UBYTE DFC_OneToOne 1 100 0.00 1.000 BIT_MASK 0x20 FORMAT "%5.3" ECU_ADDRESS 0x600370E1 /end MEASUREMENT
/begin MEASUREMENT DFC_b.TSC_DSTRmax "Bit encoding / Ok-Tested Since Clear bit for check DFC_DSTRmax" UBYTE DFC_OneToOne 1 100 0.00 1.000 BIT_MASK 0x20 FORMAT "%5.3" ECU_ADDRESS 0x600370E2 /end MEASUREMENT
/begin MEASUREMENT DFC_b.TSC_DSTRmin "Bit encoding / Ok-Tested Since Clear bit for check DFC_DSTRmin" UBYTE DFC_OneToOne 1 100 0.00 1.000 BIT_MASK 0x20 FORMAT "%5.3" ECU_ADDRESS 0x600370E3 /end MEASUREMENT
/begin MEASUREMENT DFC_b.TSC_DSTRnpl "Bit encoding / Ok-Tested Since Clear bit for check DFC_DSTRnpl" UBYTE DFC_OneToOne 1 100 0.00 1.000 BIT_MASK 0x20 FORMAT "%5.3" ECU_ADDRESS 0x600370E4 /end MEASUREMENT
/begin MEASUREMENT DFC_b.TSC_DSTRsig "Bit encoding / Ok-Tested Since Clear bit for check DFC_DSTRsig" UBYTE DFC_OneToOne 1 100 0.00 1.000 BIT_MASK 0x20 FORMAT "%5.3" ECU_ADDRESS 0x600370E5 /end MEASUREMENT
/begin MEASUREMENT DFC_b.TSC_DSTTI "Bit encoding / Ok-Tested Since Clear bit for check DFC_DSTTI" UBYTE DFC_OneToOne 1 100 0.00 1.000 BIT_MASK 0x20 FORMAT "%5.3" ECU_ADDRESS 0x600370E6 /end MEASUREMENT
/begin MEASUREMENT DFC_b.TSC_DSUmax "Bit encoding / Ok-Tested Since Clear bit for check DFC_DSUmax" UBYTE DFC_OneToOne 1 100 0.00 1.000 BIT_MASK 0x20 FORMAT "%5.3" ECU_ADDRESS 0x600370E7 /end MEASUREMENT
/begin MEASUREMENT DFC_b.TSC_DiagCpv1DteskLoLoadStuckClsd "Bit encoding / Ok-Tested Since Clear bit for check DFC_DiagCpv1DteskLoLoadStuckClsd" UBYTE DFC_OneToOne 1 100 0.00 1.000 BIT_MASK 0x20 FORMAT "%5.3" ECU_ADDRESS 0x600370E8 /end MEASUREMENT
/begin MEASUREMENT DFC_b.TSC_DiagCpv1DteskLoLoadStuckOpen "Bit encoding / Ok-Tested Since Clear bit for check DFC_DiagCpv1DteskLoLoadStuckOpen" UBYTE DFC_OneToOne 1 100 0.00 1.000 BIT_MASK 0x20 FORMAT "%5.3" ECU_ADDRESS 0x600370E9 /end MEASUREMENT
/begin MEASUREMENT DFC_b.TSC_EGRVlvDrftClsd "Bit encoding / Ok-Tested Since Clear bit for check DFC_EGRVlvDrftClsd" UBYTE DFC_OneToOne 1 100 0.00 1.000 BIT_MASK 0x20 FORMAT "%5.3" ECU_ADDRESS 0x600370EA /end MEASUREMENT
/begin MEASUREMENT DFC_b.TSC_EGRVlvDrftOpn "Bit encoding / Ok-Tested Since Clear bit for check DFC_EGRVlvDrftOpn" UBYTE DFC_OneToOne 1 100 0.00 1.000 BIT_MASK 0x20 FORMAT "%5.3" ECU_ADDRESS 0x600370EB /end MEASUREMENT
/begin MEASUREMENT DFC_b.TSC_EGRVlvJamVlvClsd "Bit encoding / Ok-Tested Since Clear bit for check DFC_EGRVlvJamVlvClsd" UBYTE DFC_OneToOne 1 100 0.00 1.000 BIT_MASK 0x20 FORMAT "%5.3" ECU_ADDRESS 0x600370EC /end MEASUREMENT
/begin MEASUREMENT DFC_b.TSC_EGRVlvJamVlvOpn "Bit encoding / Ok-Tested Since Clear bit for check DFC_EGRVlvJamVlvOpn" UBYTE DFC_OneToOne 1 100 0.00 1.000 BIT_MASK 0x20 FORMAT "%5.3" ECU_ADDRESS 0x600370ED /end MEASUREMENT
/begin MEASUREMENT DFC_b.TSC_EGRVlvSprgBrk "Bit encoding / Ok-Tested Since Clear bit for check DFC_EGRVlvSprgBrk" UBYTE DFC_OneToOne 1 100 0.00 1.000 BIT_MASK 0x20 FORMAT "%5.3" ECU_ADDRESS 0x600370EE /end MEASUREMENT
/begin MEASUREMENT DFC_b.TSC_EGRVlvTempMdlEEPErr "Bit encoding / Ok-Tested Since Clear bit for check DFC_EGRVlvTempMdlEEPErr" UBYTE DFC_OneToOne 1 100 0.00 1.000 BIT_MASK 0x20 FORMAT "%5.3" ECU_ADDRESS 0x600370EF /end MEASUREMENT
/begin MEASUREMENT DFC_b.TSC_EGRVlvTmpErr "Bit encoding / Ok-Tested Since Clear bit for check DFC_EGRVlvTmpErr" UBYTE DFC_OneToOne 1 100 0.00 1.000 BIT_MASK 0x20 FORMAT "%5.3" ECU_ADDRESS 0x600370F0 /end MEASUREMENT
/begin MEASUREMENT DFC_b.TSC_EGSDUS2B1LtrDly "Bit encoding / Ok-Tested Since Clear bit for check DFC_EGSDUS2B1LtrDly" UBYTE DFC_OneToOne 1 100 0.00 1.000 BIT_MASK 0x20 FORMAT "%5.3" ECU_ADDRESS 0x600370F1 /end MEASUREMENT
/begin MEASUREMENT DFC_b.TSC_EGSDUS2B1LtrPT1 "Bit encoding / Ok-Tested Since Clear bit for check DFC_EGSDUS2B1LtrPT1" UBYTE DFC_OneToOne 1 100 0.00 1.000 BIT_MASK 0x20 FORMAT "%5.3" ECU_ADDRESS 0x600370F2 /end MEASUREMENT
/begin MEASUREMENT DFC_b.TSC_EGSDUS2B1RtlDly "Bit encoding / Ok-Tested Since Clear bit for check DFC_EGSDUS2B1RtlDly" UBYTE DFC_OneToOne 1 100 0.00 1.000 BIT_MASK 0x20 FORMAT "%5.3" ECU_ADDRESS 0x600370F3 /end MEASUREMENT
/begin MEASUREMENT DFC_b.TSC_EGSDUS2B1RtlPT1 "Bit encoding / Ok-Tested Since Clear bit for check DFC_EGSDUS2B1RtlPT1" UBYTE DFC_OneToOne 1 100 0.00 1.000 BIT_MASK 0x20 FORMAT "%5.3" ECU_ADDRESS 0x600370F4 /end MEASUREMENT
/begin MEASUREMENT DFC_b.TSC_EGSDUS2B1TarLean "Bit encoding / Ok-Tested Since Clear bit for check DFC_EGSDUS2B1TarLean" UBYTE DFC_OneToOne 1 100 0.00 1.000 BIT_MASK 0x20 FORMAT "%5.3" ECU_ADDRESS 0x600370F5 /end MEASUREMENT
/begin MEASUREMENT DFC_b.TSC_EGSDUS2B1TarRich "Bit encoding / Ok-Tested Since Clear bit for check DFC_EGSDUS2B1TarRich" UBYTE DFC_OneToOne 1 100 0.00 1.000 BIT_MASK 0x20 FORMAT "%5.3" ECU_ADDRESS 0x600370F6 /end MEASUREMENT
/begin MEASUREMENT DFC_b.TSC_EONVmax "Bit encoding / Ok-Tested Since Clear bit for check DFC_EONVmax" UBYTE DFC_OneToOne 1 100 0.00 1.000 BIT_MASK 0x20 FORMAT "%5.3" ECU_ADDRESS 0x600370F7 /end MEASUREMENT
/begin MEASUREMENT DFC_b.TSC_ETAKHLmax "Bit encoding / Ok-Tested Since Clear bit for check DFC_ETAKHLmax" UBYTE DFC_OneToOne 1 100 0.00 1.000 BIT_MASK 0x20 FORMAT "%5.3" ECU_ADDRESS 0x600370F8 /end MEASUREMENT
/begin MEASUREMENT DFC_b.TSC_ETAKHTmax "Bit encoding / Ok-Tested Since Clear bit for check DFC_ETAKHTmax" UBYTE DFC_OneToOne 1 100 0.00 1.000 BIT_MASK 0x20 FORMAT "%5.3" ECU_ADDRESS 0x600370F9 /end MEASUREMENT
/begin MEASUREMENT DFC_b.TSC_ETHSEmax "Bit encoding / Ok-Tested Since Clear bit for check DFC_ETHSEmax" UBYTE DFC_OneToOne 1 100 0.00 1.000 BIT_MASK 0x20 FORMAT "%5.3" ECU_ADDRESS 0x600370FA /end MEASUREMENT
/begin MEASUREMENT DFC_b.TSC_ETHSEmin "Bit encoding / Ok-Tested Since Clear bit for check DFC_ETHSEmin" UBYTE DFC_OneToOne 1 100 0.00 1.000 BIT_MASK 0x20 FORMAT "%5.3" ECU_ADDRESS 0x600370FB /end MEASUREMENT
/begin MEASUREMENT DFC_b.TSC_ETHSFmax "Bit encoding / Ok-Tested Since Clear bit for check DFC_ETHSFmax" UBYTE DFC_OneToOne 1 100 0.00 1.000 BIT_MASK 0x20 FORMAT "%5.3" ECU_ADDRESS 0x600370FC /end MEASUREMENT
/begin MEASUREMENT DFC_b.TSC_ETHSFmin "Bit encoding / Ok-Tested Since Clear bit for check DFC_ETHSFmin" UBYTE DFC_OneToOne 1 100 0.00 1.000 BIT_MASK 0x20 FORMAT "%5.3" ECU_ADDRESS 0x600370FD /end MEASUREMENT
/begin MEASUREMENT DFC_b.TSC_ETHSFsig "Bit encoding / Ok-Tested Since Clear bit for check DFC_ETHSFsig" UBYTE DFC_OneToOne 1 100 0.00 1.000 BIT_MASK 0x20 FORMAT "%5.3" ECU_ADDRESS 0x600370FE /end MEASUREMENT
/begin MEASUREMENT DFC_b.TSC_ETHSNPWmax "Bit encoding / Ok-Tested Since Clear bit for check DFC_ETHSNPWmax" UBYTE DFC_OneToOne 1 100 0.00 1.000 BIT_MASK 0x20 FORMAT "%5.3" ECU_ADDRESS 0x600370FF /end MEASUREMENT
/begin MEASUREMENT DFC_b.TSC_ETHSNPWmin "Bit encoding / Ok-Tested Since Clear bit for check DFC_ETHSNPWmin" UBYTE DFC_OneToOne 1 100 0.00 1.000 BIT_MASK 0x20 FORMAT "%5.3" ECU_ADDRESS 0x60037100 /end MEASUREMENT
/begin MEASUREMENT DFC_b.TSC_ETHSNPWsig "Bit encoding / Ok-Tested Since Clear bit for check DFC_ETHSNPWsig" UBYTE DFC_OneToOne 1 100 0.00 1.000 BIT_MASK 0x20 FORMAT "%5.3" ECU_ADDRESS 0x60037101 /end MEASUREMENT
/begin MEASUREMENT DFC_b.TSC_ETHSPLnpl "Bit encoding / Ok-Tested Since Clear bit for check DFC_ETHSPLnpl" UBYTE DFC_OneToOne 1 100 0.00 1.000 BIT_MASK 0x20 FORMAT "%5.3" ECU_ADDRESS 0x60037102 /end MEASUREMENT
/begin MEASUREMENT DFC_b.TSC_ETHSTPLnpl "Bit encoding / Ok-Tested Since Clear bit for check DFC_ETHSTPLnpl" UBYTE DFC_OneToOne 1 100 0.00 1.000 BIT_MASK 0x20 FORMAT "%5.3" ECU_ADDRESS 0x60037103 /end MEASUREMENT
/begin MEASUREMENT DFC_b.TSC_EngICO "Bit encoding / Ok-Tested Since Clear bit for check DFC_EngICO" UBYTE DFC_OneToOne 1 100 0.00 1.000 BIT_MASK 0x20 FORMAT "%5.3" ECU_ADDRESS 0x60037104 /end MEASUREMENT
/begin MEASUREMENT DFC_b.TSC_EngPrtOvrSpdMon "Bit encoding / Ok-Tested Since Clear bit for check DFC_EngPrtOvrSpdMon" UBYTE DFC_OneToOne 1 100 0.00 1.000 BIT_MASK 0x20 FORMAT "%5.3" ECU_ADDRESS 0x60037105 /end MEASUREMENT
/begin MEASUREMENT DFC_b.TSC_EpmCaSI1ErrSig "Bit encoding / Ok-Tested Since Clear bit for check DFC_EpmCaSI1ErrSig" UBYTE DFC_OneToOne 1 100 0.00 1.000 BIT_MASK 0x20 FORMAT "%5.3" ECU_ADDRESS 0x60037106 /end MEASUREMENT
/begin MEASUREMENT DFC_b.TSC_EpmCaSI1MntErr "Bit encoding / Ok-Tested Since Clear bit for check DFC_EpmCaSI1MntErr" UBYTE DFC_OneToOne 1 100 0.00 1.000 BIT_MASK 0x20 FORMAT "%5.3" ECU_ADDRESS 0x60037107 /end MEASUREMENT
/begin MEASUREMENT DFC_b.TSC_EpmCaSI1NoSigMax "Bit encoding / Ok-Tested Since Clear bit for check DFC_EpmCaSI1NoSigMax" UBYTE DFC_OneToOne 1 100 0.00 1.000 BIT_MASK 0x20 FORMAT "%5.3" ECU_ADDRESS 0x60037108 /end MEASUREMENT
/begin MEASUREMENT DFC_b.TSC_EpmCaSI1NoSigMin "Bit encoding / Ok-Tested Since Clear bit for check DFC_EpmCaSI1NoSigMin" UBYTE DFC_OneToOne 1 100 0.00 1.000 BIT_MASK 0x20 FORMAT "%5.3" ECU_ADDRESS 0x60037109 /end MEASUREMENT
/begin MEASUREMENT DFC_b.TSC_EpmCaSI1OfsErr "Bit encoding / Ok-Tested Since Clear bit for check DFC_EpmCaSI1OfsErr" UBYTE DFC_OneToOne 1 100 0.00 1.000 BIT_MASK 0x20 FORMAT "%5.3" ECU_ADDRESS 0x6003710A /end MEASUREMENT
/begin MEASUREMENT DFC_b.TSC_EpmCrSDGI "Bit encoding / Ok-Tested Since Clear bit for check DFC_EpmCrSDGI" UBYTE DFC_OneToOne 1 100 0.00 1.000 BIT_MASK 0x20 FORMAT "%5.3" ECU_ADDRESS 0x6003710B /end MEASUREMENT
/begin MEASUREMENT DFC_b.TSC_EpmCrSErrSig "Bit encoding / Ok-Tested Since Clear bit for check DFC_EpmCrSErrSig" UBYTE DFC_OneToOne 1 100 0.00 1.000 BIT_MASK 0x20 FORMAT "%5.3" ECU_ADDRESS 0x6003710C /end MEASUREMENT
/begin MEASUREMENT DFC_b.TSC_EpmCrSNoSig "Bit encoding / Ok-Tested Since Clear bit for check DFC_EpmCrSNoSig" UBYTE DFC_OneToOne 1 100 0.00 1.000 BIT_MASK 0x20 FORMAT "%5.3" ECU_ADDRESS 0x6003710D /end MEASUREMENT
/begin MEASUREMENT DFC_b.TSC_EtaEngIdleNonCsers "Bit encoding / Ok-Tested Since Clear bit for check DFC_EtaEngIdleNonCsers" UBYTE DFC_OneToOne 1 100 0.00 1.000 BIT_MASK 0x20 FORMAT "%5.3" ECU_ADDRESS 0x6003710E /end MEASUREMENT
/begin MEASUREMENT DFC_b.TSC_EtaEngPtlNonCsers "Bit encoding / Ok-Tested Since Clear bit for check DFC_EtaEngPtlNonCsers" UBYTE DFC_OneToOne 1 100 0.00 1.000 BIT_MASK 0x20 FORMAT "%5.3" ECU_ADDRESS 0x6003710F /end MEASUREMENT
/begin MEASUREMENT DFC_b.TSC_FRAmax "Bit encoding / Ok-Tested Since Clear bit for check DFC_FRAmax" UBYTE DFC_OneToOne 1 100 0.00 1.000 BIT_MASK 0x20 FORMAT "%5.3" ECU_ADDRESS 0x60037110 /end MEASUREMENT
/begin MEASUREMENT DFC_b.TSC_FRAmin "Bit encoding / Ok-Tested Since Clear bit for check DFC_FRAmin" UBYTE DFC_OneToOne 1 100 0.00 1.000 BIT_MASK 0x20 FORMAT "%5.3" ECU_ADDRESS 0x60037111 /end MEASUREMENT
/begin MEASUREMENT DFC_b.TSC_FSTEmax "Bit encoding / Ok-Tested Since Clear bit for check DFC_FSTEmax" UBYTE DFC_OneToOne 1 100 0.00 1.000 BIT_MASK 0x20 FORMAT "%5.3" ECU_ADDRESS 0x60037112 /end MEASUREMENT
/begin MEASUREMENT DFC_b.TSC_FSTEmin "Bit encoding / Ok-Tested Since Clear bit for check DFC_FSTEmin" UBYTE DFC_OneToOne 1 100 0.00 1.000 BIT_MASK 0x20 FORMAT "%5.3" ECU_ADDRESS 0x60037113 /end MEASUREMENT
/begin MEASUREMENT DFC_b.TSC_FSTRmax "Bit encoding / Ok-Tested Since Clear bit for check DFC_FSTRmax" UBYTE DFC_OneToOne 1 100 0.00 1.000 BIT_MASK 0x20 FORMAT "%5.3" ECU_ADDRESS 0x60037114 /end MEASUREMENT
/begin MEASUREMENT DFC_b.TSC_FSTRmin "Bit encoding / Ok-Tested Since Clear bit for check DFC_FSTRmin" UBYTE DFC_OneToOne 1 100 0.00 1.000 BIT_MASK 0x20 FORMAT "%5.3" ECU_ADDRESS 0x60037115 /end MEASUREMENT
/begin MEASUREMENT DFC_b.TSC_FSTRnpl "Bit encoding / Ok-Tested Since Clear bit for check DFC_FSTRnpl" UBYTE DFC_OneToOne 1 100 0.00 1.000 BIT_MASK 0x20 FORMAT "%5.3" ECU_ADDRESS 0x60037116 /end MEASUREMENT
/begin MEASUREMENT DFC_b.TSC_FSTmax "Bit encoding / Ok-Tested Since Clear bit for check DFC_FSTmax" UBYTE DFC_OneToOne 1 100 0.00 1.000 BIT_MASK 0x20 FORMAT "%5.3" ECU_ADDRESS 0x60037117 /end MEASUREMENT
/begin MEASUREMENT DFC_b.TSC_FTDLAmax "Bit encoding / Ok-Tested Since Clear bit for check DFC_FTDLAmax" UBYTE DFC_OneToOne 1 100 0.00 1.000 BIT_MASK 0x20 FORMAT "%5.3" ECU_ADDRESS 0x60037118 /end MEASUREMENT
/begin MEASUREMENT DFC_b.TSC_FTDLAmin "Bit encoding / Ok-Tested Since Clear bit for check DFC_FTDLAmin" UBYTE DFC_OneToOne 1 100 0.00 1.000 BIT_MASK 0x20 FORMAT "%5.3" ECU_ADDRESS 0x60037119 /end MEASUREMENT
/begin MEASUREMENT DFC_b.TSC_FuPHiSnsrEleclmax "Bit encoding / Ok-Tested Since Clear bit for check DFC_FuPHiSnsrEleclmax" UBYTE DFC_OneToOne 1 100 0.00 1.000 BIT_MASK 0x20 FORMAT "%5.3" ECU_ADDRESS 0x6003711A /end MEASUREMENT
/begin MEASUREMENT DFC_b.TSC_FuPHiSnsrEleclmin "Bit encoding / Ok-Tested Since Clear bit for check DFC_FuPHiSnsrEleclmin" UBYTE DFC_OneToOne 1 100 0.00 1.000 BIT_MASK 0x20 FORMAT "%5.3" ECU_ADDRESS 0x6003711B /end MEASUREMENT
/begin MEASUREMENT DFC_b.TSC_FuPHiSnsrEleclnpl "Bit encoding / Ok-Tested Since Clear bit for check DFC_FuPHiSnsrEleclnpl" UBYTE DFC_OneToOne 1 100 0.00 1.000 BIT_MASK 0x20 FORMAT "%5.3" ECU_ADDRESS 0x6003711C /end MEASUREMENT
/begin MEASUREMENT DFC_b.TSC_FuPHiSnsrURngMax "Bit encoding / Ok-Tested Since Clear bit for check DFC_FuPHiSnsrURngMax" UBYTE DFC_OneToOne 1 100 0.00 1.000 BIT_MASK 0x20 FORMAT "%5.3" ECU_ADDRESS 0x6003711D /end MEASUREMENT
/begin MEASUREMENT DFC_b.TSC_FuPHiSnsrURngMin "Bit encoding / Ok-Tested Since Clear bit for check DFC_FuPHiSnsrURngMin" UBYTE DFC_OneToOne 1 100 0.00 1.000 BIT_MASK 0x20 FORMAT "%5.3" ECU_ADDRESS 0x6003711E /end MEASUREMENT
/begin MEASUREMENT DFC_b.TSC_FuSnsrPhyRngMaxErr "Bit encoding / Ok-Tested Since Clear bit for check DFC_FuSnsrPhyRngMaxErr" UBYTE DFC_OneToOne 1 100 0.00 1.000 BIT_MASK 0x20 FORMAT "%5.3" ECU_ADDRESS 0x6003711F /end MEASUREMENT
/begin MEASUREMENT DFC_b.TSC_FuSnsrPhyRngMinErr "Bit encoding / Ok-Tested Since Clear bit for check DFC_FuSnsrPhyRngMinErr" UBYTE DFC_OneToOne 1 100 0.00 1.000 BIT_MASK 0x20 FORMAT "%5.3" ECU_ADDRESS 0x60037120 /end MEASUREMENT
/begin MEASUREMENT DFC_b.TSC_GEVlvLockPinDiagIntkB1 "Bit encoding / Ok-Tested Since Clear bit for check DFC_GEVlvLockPinDiagIntkB1" UBYTE DFC_OneToOne 1 100 0.00 1.000 BIT_MASK 0x20 FORMAT "%5.3" ECU_ADDRESS 0x60037121 /end MEASUREMENT
/begin MEASUREMENT DFC_b.TSC_GEVlvPhaSlowIntkB1 "Bit encoding / Ok-Tested Since Clear bit for check DFC_GEVlvPhaSlowIntkB1" UBYTE DFC_OneToOne 1 100 0.00 1.000 BIT_MASK 0x20 FORMAT "%5.3" ECU_ADDRESS 0x60037122 /end MEASUREMENT
/begin MEASUREMENT DFC_b.TSC_GEVlvPhaTargIntkB1 "Bit encoding / Ok-Tested Since Clear bit for check DFC_GEVlvPhaTargIntkB1" UBYTE DFC_OneToOne 1 100 0.00 1.000 BIT_MASK 0x20 FORMAT "%5.3" ECU_ADDRESS 0x60037123 /end MEASUREMENT
/begin MEASUREMENT DFC_b.TSC_GbxRvsSwtStk "Bit encoding / Ok-Tested Since Clear bit for check DFC_GbxRvsSwtStk" UBYTE DFC_OneToOne 1 100 0.00 1.000 BIT_MASK 0x20 FORMAT "%5.3" ECU_ADDRESS 0x60037124 /end MEASUREMENT
/begin MEASUREMENT DFC_b.TSC_HDRKHmax "Bit encoding / Ok-Tested Since Clear bit for check DFC_HDRKHmax" UBYTE DFC_OneToOne 1 100 0.00 1.000 BIT_MASK 0x20 FORMAT "%5.3" ECU_ADDRESS 0x60037125 /end MEASUREMENT
/begin MEASUREMENT DFC_b.TSC_HDRKHmin "Bit encoding / Ok-Tested Since Clear bit for check DFC_HDRKHmin" UBYTE DFC_OneToOne 1 100 0.00 1.000 BIT_MASK 0x20 FORMAT "%5.3" ECU_ADDRESS 0x60037126 /end MEASUREMENT
/begin MEASUREMENT DFC_b.TSC_HDRPLmax "Bit encoding / Ok-Tested Since Clear bit for check DFC_HDRPLmax" UBYTE DFC_OneToOne 1 100 0.00 1.000 BIT_MASK 0x20 FORMAT "%5.3" ECU_ADDRESS 0x60037127 /end MEASUREMENT
/begin MEASUREMENT DFC_b.TSC_HDRPLmin "Bit encoding / Ok-Tested Since Clear bit for check DFC_HDRPLmin" UBYTE DFC_OneToOne 1 100 0.00 1.000 BIT_MASK 0x20 FORMAT "%5.3" ECU_ADDRESS 0x60037128 /end MEASUREMENT
/begin MEASUREMENT DFC_b.TSC_HDRmax "Bit encoding / Ok-Tested Since Clear bit for check DFC_HDRmax" UBYTE DFC_OneToOne 1 100 0.00 1.000 BIT_MASK 0x20 FORMAT "%5.3" ECU_ADDRESS 0x60037129 /end MEASUREMENT
/begin MEASUREMENT DFC_b.TSC_HDRmin "Bit encoding / Ok-Tested Since Clear bit for check DFC_HDRmin" UBYTE DFC_OneToOne 1 100 0.00 1.000 BIT_MASK 0x20 FORMAT "%5.3" ECU_ADDRESS 0x6003712A /end MEASUREMENT
/begin MEASUREMENT DFC_b.TSC_HEGOS2B1ElecMax "Bit encoding / Ok-Tested Since Clear bit for check DFC_HEGOS2B1ElecMax" UBYTE DFC_OneToOne 1 100 0.00 1.000 BIT_MASK 0x20 FORMAT "%5.3" ECU_ADDRESS 0x6003712B /end MEASUREMENT
/begin MEASUREMENT DFC_b.TSC_HEGOS2B1ElecMin "Bit encoding / Ok-Tested Since Clear bit for check DFC_HEGOS2B1ElecMin" UBYTE DFC_OneToOne 1 100 0.00 1.000 BIT_MASK 0x20 FORMAT "%5.3" ECU_ADDRESS 0x6003712C /end MEASUREMENT
/begin MEASUREMENT DFC_b.TSC_HEGOS2B1ElecSig "Bit encoding / Ok-Tested Since Clear bit for check DFC_HEGOS2B1ElecSig" UBYTE DFC_OneToOne 1 100 0.00 1.000 BIT_MASK 0x20 FORMAT "%5.3" ECU_ADDRESS 0x6003712D /end MEASUREMENT
/begin MEASUREMENT DFC_b.TSC_HEGOS2B1HtgNpl "Bit encoding / Ok-Tested Since Clear bit for check DFC_HEGOS2B1HtgNpl" UBYTE DFC_OneToOne 1 100 0.00 1.000 BIT_MASK 0x20 FORMAT "%5.3" ECU_ADDRESS 0x6003712E /end MEASUREMENT
/begin MEASUREMENT DFC_b.TSC_HEV00max "Bit encoding / Ok-Tested Since Clear bit for check DFC_HEV00max" UBYTE DFC_OneToOne 1 100 0.00 1.000 BIT_MASK 0x20 FORMAT "%5.3" ECU_ADDRESS 0x6003712F /end MEASUREMENT
/begin MEASUREMENT DFC_b.TSC_HEV01max "Bit encoding / Ok-Tested Since Clear bit for check DFC_HEV01max" UBYTE DFC_OneToOne 1 100 0.00 1.000 BIT_MASK 0x20 FORMAT "%5.3" ECU_ADDRESS 0x60037130 /end MEASUREMENT
/begin MEASUREMENT DFC_b.TSC_HEV02max "Bit encoding / Ok-Tested Since Clear bit for check DFC_HEV02max" UBYTE DFC_OneToOne 1 100 0.00 1.000 BIT_MASK 0x20 FORMAT "%5.3" ECU_ADDRESS 0x60037131 /end MEASUREMENT
/begin MEASUREMENT DFC_b.TSC_HEV03max "Bit encoding / Ok-Tested Since Clear bit for check DFC_HEV03max" UBYTE DFC_OneToOne 1 100 0.00 1.000 BIT_MASK 0x20 FORMAT "%5.3" ECU_ADDRESS 0x60037132 /end MEASUREMENT
/begin MEASUREMENT DFC_b.TSC_HEVE0max "Bit encoding / Ok-Tested Since Clear bit for check DFC_HEVE0max" UBYTE DFC_OneToOne 1 100 0.00 1.000 BIT_MASK 0x20 FORMAT "%5.3" ECU_ADDRESS 0x60037133 /end MEASUREMENT
/begin MEASUREMENT DFC_b.TSC_HEVE1max "Bit encoding / Ok-Tested Since Clear bit for check DFC_HEVE1max" UBYTE DFC_OneToOne 1 100 0.00 1.000 BIT_MASK 0x20 FORMAT "%5.3" ECU_ADDRESS 0x60037134 /end MEASUREMENT
/begin MEASUREMENT DFC_b.TSC_HFMmax "Bit encoding / Ok-Tested Since Clear bit for check DFC_HFMmax" UBYTE DFC_OneToOne 1 100 0.00 1.000 BIT_MASK 0x20 FORMAT "%5.3" ECU_ADDRESS 0x60037135 /end MEASUREMENT
/begin MEASUREMENT DFC_b.TSC_HiPSysHiPMaxLimExcdd "Bit encoding / Ok-Tested Since Clear bit for check DFC_HiPSysHiPMaxLimExcdd" UBYTE DFC_OneToOne 1 100 0.00 1.000 BIT_MASK 0x20 FORMAT "%5.3" ECU_ADDRESS 0x60037136 /end MEASUREMENT
/begin MEASUREMENT DFC_b.TSC_IVGdiCtlCvoErrMax_0 "Bit encoding / Ok-Tested Since Clear bit for check DFC_IVGdiCtlCvoErrMax_0" UBYTE DFC_OneToOne 1 100 0.00 1.000 BIT_MASK 0x20 FORMAT "%5.3" ECU_ADDRESS 0x60037137 /end MEASUREMENT
/begin MEASUREMENT DFC_b.TSC_IVGdiCtlCvoErrMax_1 "Bit encoding / Ok-Tested Since Clear bit for check DFC_IVGdiCtlCvoErrMax_1" UBYTE DFC_OneToOne 1 100 0.00 1.000 BIT_MASK 0x20 FORMAT "%5.3" ECU_ADDRESS 0x60037138 /end MEASUREMENT
/begin MEASUREMENT DFC_b.TSC_IVGdiCtlCvoErrMax_2 "Bit encoding / Ok-Tested Since Clear bit for check DFC_IVGdiCtlCvoErrMax_2" UBYTE DFC_OneToOne 1 100 0.00 1.000 BIT_MASK 0x20 FORMAT "%5.3" ECU_ADDRESS 0x60037139 /end MEASUREMENT
/begin MEASUREMENT DFC_b.TSC_IVGdiCtlCvoErrMax_3 "Bit encoding / Ok-Tested Since Clear bit for check DFC_IVGdiCtlCvoErrMax_3" UBYTE DFC_OneToOne 1 100 0.00 1.000 BIT_MASK 0x20 FORMAT "%5.3" ECU_ADDRESS 0x6003713A /end MEASUREMENT
/begin MEASUREMENT DFC_b.TSC_IVGdiCtlCvoErrMin_0 "Bit encoding / Ok-Tested Since Clear bit for check DFC_IVGdiCtlCvoErrMin_0" UBYTE DFC_OneToOne 1 100 0.00 1.000 BIT_MASK 0x20 FORMAT "%5.3" ECU_ADDRESS 0x6003713B /end MEASUREMENT
/begin MEASUREMENT DFC_b.TSC_IVGdiCtlCvoErrMin_1 "Bit encoding / Ok-Tested Since Clear bit for check DFC_IVGdiCtlCvoErrMin_1" UBYTE DFC_OneToOne 1 100 0.00 1.000 BIT_MASK 0x20 FORMAT "%5.3" ECU_ADDRESS 0x6003713C /end MEASUREMENT
/begin MEASUREMENT DFC_b.TSC_IVGdiCtlCvoErrMin_2 "Bit encoding / Ok-Tested Since Clear bit for check DFC_IVGdiCtlCvoErrMin_2" UBYTE DFC_OneToOne 1 100 0.00 1.000 BIT_MASK 0x20 FORMAT "%5.3" ECU_ADDRESS 0x6003713D /end MEASUREMENT
/begin MEASUREMENT DFC_b.TSC_IVGdiCtlCvoErrMin_3 "Bit encoding / Ok-Tested Since Clear bit for check DFC_IVGdiCtlCvoErrMin_3" UBYTE DFC_OneToOne 1 100 0.00 1.000 BIT_MASK 0x20 FORMAT "%5.3" ECU_ADDRESS 0x6003713E /end MEASUREMENT
/begin MEASUREMENT DFC_b.TSC_IVGdiCtlCvoErrMinMax "Bit encoding / Ok-Tested Since Clear bit for check DFC_IVGdiCtlCvoErrMinMax" UBYTE DFC_OneToOne 1 100 0.00 1.000 BIT_MASK 0x20 FORMAT "%5.3" ECU_ADDRESS 0x6003713F /end MEASUREMENT
/begin MEASUREMENT DFC_b.TSC_IVGdiCtlCvoSigPlausErrSmrCdn "Bit encoding / Ok-Tested Since Clear bit for check DFC_IVGdiCtlCvoSigPlausErrSmrCdn" UBYTE DFC_OneToOne 1 100 0.00 1.000 BIT_MASK 0x20 FORMAT "%5.3" ECU_ADDRESS 0x60037140 /end MEASUREMENT
/begin MEASUREMENT DFC_b.TSC_IVGdiCtl_CvoErr "Bit encoding / Ok-Tested Since Clear bit for check DFC_IVGdiCtl_CvoErr" UBYTE DFC_OneToOne 1 100 0.00 1.000 BIT_MASK 0x20 FORMAT "%5.3" ECU_ADDRESS 0x60037141 /end MEASUREMENT
/begin MEASUREMENT DFC_b.TSC_IVGdiCtl_CvoSigPlaus_0 "Bit encoding / Ok-Tested Since Clear bit for check DFC_IVGdiCtl_CvoSigPlaus_0" UBYTE DFC_OneToOne 1 100 0.00 1.000 BIT_MASK 0x20 FORMAT "%5.3" ECU_ADDRESS 0x60037142 /end MEASUREMENT
/begin MEASUREMENT DFC_b.TSC_IVGdiCtl_CvoSigPlaus_1 "Bit encoding / Ok-Tested Since Clear bit for check DFC_IVGdiCtl_CvoSigPlaus_1" UBYTE DFC_OneToOne 1 100 0.00 1.000 BIT_MASK 0x20 FORMAT "%5.3" ECU_ADDRESS 0x60037143 /end MEASUREMENT
/begin MEASUREMENT DFC_b.TSC_IVGdiCtl_CvoSigPlaus_2 "Bit encoding / Ok-Tested Since Clear bit for check DFC_IVGdiCtl_CvoSigPlaus_2" UBYTE DFC_OneToOne 1 100 0.00 1.000 BIT_MASK 0x20 FORMAT "%5.3" ECU_ADDRESS 0x60037144 /end MEASUREMENT
/begin MEASUREMENT DFC_b.TSC_IVGdiCtl_CvoSigPlaus_3 "Bit encoding / Ok-Tested Since Clear bit for check DFC_IVGdiCtl_CvoSigPlaus_3" UBYTE DFC_OneToOne 1 100 0.00 1.000 BIT_MASK 0x20 FORMAT "%5.3" ECU_ADDRESS 0x60037145 /end MEASUREMENT
/begin MEASUREMENT DFC_b.TSC_IntkAirTAirFltDsCrssMax "Bit encoding / Ok-Tested Since Clear bit for check DFC_IntkAirTAirFltDsCrssMax" UBYTE DFC_OneToOne 1 100 0.00 1.000 BIT_MASK 0x20 FORMAT "%5.3" ECU_ADDRESS 0x60037146 /end MEASUREMENT
/begin MEASUREMENT DFC_b.TSC_IntkAirTAirFltDsCrssMin "Bit encoding / Ok-Tested Since Clear bit for check DFC_IntkAirTAirFltDsCrssMin" UBYTE DFC_OneToOne 1 100 0.00 1.000 BIT_MASK 0x20 FORMAT "%5.3" ECU_ADDRESS 0x60037147 /end MEASUREMENT
/begin MEASUREMENT DFC_b.TSC_IntkAirTAirFltDsHSCMax "Bit encoding / Ok-Tested Since Clear bit for check DFC_IntkAirTAirFltDsHSCMax" UBYTE DFC_OneToOne 1 100 0.00 1.000 BIT_MASK 0x20 FORMAT "%5.3" ECU_ADDRESS 0x60037148 /end MEASUREMENT
/begin MEASUREMENT DFC_b.TSC_IntkAirTAirFltDsImps "Bit encoding / Ok-Tested Since Clear bit for check DFC_IntkAirTAirFltDsImps" UBYTE DFC_OneToOne 1 100 0.00 1.000 BIT_MASK 0x20 FORMAT "%5.3" ECU_ADDRESS 0x60037149 /end MEASUREMENT
/begin MEASUREMENT DFC_b.TSC_IntkAirTAirFltDsPRCMax "Bit encoding / Ok-Tested Since Clear bit for check DFC_IntkAirTAirFltDsPRCMax" UBYTE DFC_OneToOne 1 100 0.00 1.000 BIT_MASK 0x20 FORMAT "%5.3" ECU_ADDRESS 0x6003714A /end MEASUREMENT
/begin MEASUREMENT DFC_b.TSC_IntkAirTAirFltDsPRCMin "Bit encoding / Ok-Tested Since Clear bit for check DFC_IntkAirTAirFltDsPRCMin" UBYTE DFC_OneToOne 1 100 0.00 1.000 BIT_MASK 0x20 FORMAT "%5.3" ECU_ADDRESS 0x6003714B /end MEASUREMENT
/begin MEASUREMENT DFC_b.TSC_IntkAirTAirFltDsSRCMax "Bit encoding / Ok-Tested Since Clear bit for check DFC_IntkAirTAirFltDsSRCMax" UBYTE DFC_OneToOne 1 100 0.00 1.000 BIT_MASK 0x20 FORMAT "%5.3" ECU_ADDRESS 0x6003714C /end MEASUREMENT
/begin MEASUREMENT DFC_b.TSC_IntkAirTAirFltDsSRCMin "Bit encoding / Ok-Tested Since Clear bit for check DFC_IntkAirTAirFltDsSRCMin" UBYTE DFC_OneToOne 1 100 0.00 1.000 BIT_MASK 0x20 FORMAT "%5.3" ECU_ADDRESS 0x6003714D /end MEASUREMENT
/begin MEASUREMENT DFC_b.TSC_IntkAirTAirFltDsSTC "Bit encoding / Ok-Tested Since Clear bit for check DFC_IntkAirTAirFltDsSTC" UBYTE DFC_OneToOne 1 100 0.00 1.000 BIT_MASK 0x20 FORMAT "%5.3" ECU_ADDRESS 0x6003714E /end MEASUREMENT
/begin MEASUREMENT DFC_b.TSC_IntkAirTIntkMnfldCrssMax "Bit encoding / Ok-Tested Since Clear bit for check DFC_IntkAirTIntkMnfldCrssMax" UBYTE DFC_OneToOne 1 100 0.00 1.000 BIT_MASK 0x20 FORMAT "%5.3" ECU_ADDRESS 0x6003714F /end MEASUREMENT
/begin MEASUREMENT DFC_b.TSC_IntkAirTIntkMnfldCrssMin "Bit encoding / Ok-Tested Since Clear bit for check DFC_IntkAirTIntkMnfldCrssMin" UBYTE DFC_OneToOne 1 100 0.00 1.000 BIT_MASK 0x20 FORMAT "%5.3" ECU_ADDRESS 0x60037150 /end MEASUREMENT
/begin MEASUREMENT DFC_b.TSC_IntkAirTIntkMnfldHSCMax "Bit encoding / Ok-Tested Since Clear bit for check DFC_IntkAirTIntkMnfldHSCMax" UBYTE DFC_OneToOne 1 100 0.00 1.000 BIT_MASK 0x20 FORMAT "%5.3" ECU_ADDRESS 0x60037151 /end MEASUREMENT
/begin MEASUREMENT DFC_b.TSC_IntkAirTIntkMnfldImps "Bit encoding / Ok-Tested Since Clear bit for check DFC_IntkAirTIntkMnfldImps" UBYTE DFC_OneToOne 1 100 0.00 1.000 BIT_MASK 0x20 FORMAT "%5.3" ECU_ADDRESS 0x60037152 /end MEASUREMENT
/begin MEASUREMENT DFC_b.TSC_IntkAirTIntkMnfldPRCMax "Bit encoding / Ok-Tested Since Clear bit for check DFC_IntkAirTIntkMnfldPRCMax" UBYTE DFC_OneToOne 1 100 0.00 1.000 BIT_MASK 0x20 FORMAT "%5.3" ECU_ADDRESS 0x60037153 /end MEASUREMENT
/begin MEASUREMENT DFC_b.TSC_IntkAirTIntkMnfldPRCMin "Bit encoding / Ok-Tested Since Clear bit for check DFC_IntkAirTIntkMnfldPRCMin" UBYTE DFC_OneToOne 1 100 0.00 1.000 BIT_MASK 0x20 FORMAT "%5.3" ECU_ADDRESS 0x60037154 /end MEASUREMENT
/begin MEASUREMENT DFC_b.TSC_IntkAirTIntkMnfldSRCMax "Bit encoding / Ok-Tested Since Clear bit for check DFC_IntkAirTIntkMnfldSRCMax" UBYTE DFC_OneToOne 1 100 0.00 1.000 BIT_MASK 0x20 FORMAT "%5.3" ECU_ADDRESS 0x60037155 /end MEASUREMENT
/begin MEASUREMENT DFC_b.TSC_IntkAirTIntkMnfldSRCMin "Bit encoding / Ok-Tested Since Clear bit for check DFC_IntkAirTIntkMnfldSRCMin" UBYTE DFC_OneToOne 1 100 0.00 1.000 BIT_MASK 0x20 FORMAT "%5.3" ECU_ADDRESS 0x60037156 /end MEASUREMENT
/begin MEASUREMENT DFC_b.TSC_IntkAirTIntkMnfldSTC "Bit encoding / Ok-Tested Since Clear bit for check DFC_IntkAirTIntkMnfldSTC" UBYTE DFC_OneToOne 1 100 0.00 1.000 BIT_MASK 0x20 FORMAT "%5.3" ECU_ADDRESS 0x60037157 /end MEASUREMENT
/begin MEASUREMENT DFC_b.TSC_KRREGRLMX "Bit encoding / Ok-Tested Since Clear bit for check DFC_KRREGRLMX" UBYTE DFC_OneToOne 1 100 0.00 1.000 BIT_MASK 0x20 FORMAT "%5.3" ECU_ADDRESS 0x60037158 /end MEASUREMENT
/begin MEASUREMENT DFC_b.TSC_KRVEKOCVLCI "Bit encoding / Ok-Tested Since Clear bit for check DFC_KRVEKOCVLCI" UBYTE DFC_OneToOne 1 100 0.00 1.000 BIT_MASK 0x20 FORMAT "%5.3" ECU_ADDRESS 0x60037159 /end MEASUREMENT
/begin MEASUREMENT DFC_b.TSC_KRVEKOENCHMT "Bit encoding / Ok-Tested Since Clear bit for check DFC_KRVEKOENCHMT" UBYTE DFC_OneToOne 1 100 0.00 1.000 BIT_MASK 0x20 FORMAT "%5.3" ECU_ADDRESS 0x6003715A /end MEASUREMENT
/begin MEASUREMENT DFC_b.TSC_KRVEKOENCHMT0 "Bit encoding / Ok-Tested Since Clear bit for check DFC_KRVEKOENCHMT0" UBYTE DFC_OneToOne 1 100 0.00 1.000 BIT_MASK 0x20 FORMAT "%5.3" ECU_ADDRESS 0x6003715B /end MEASUREMENT
/begin MEASUREMENT DFC_b.TSC_KRVEKOENCHMT1 "Bit encoding / Ok-Tested Since Clear bit for check DFC_KRVEKOENCHMT1" UBYTE DFC_OneToOne 1 100 0.00 1.000 BIT_MASK 0x20 FORMAT "%5.3" ECU_ADDRESS 0x6003715C /end MEASUREMENT
/begin MEASUREMENT DFC_b.TSC_KRVEKOENCHMT2 "Bit encoding / Ok-Tested Since Clear bit for check DFC_KRVEKOENCHMT2" UBYTE DFC_OneToOne 1 100 0.00 1.000 BIT_MASK 0x20 FORMAT "%5.3" ECU_ADDRESS 0x6003715D /end MEASUREMENT
/begin MEASUREMENT DFC_b.TSC_KRVEKOENCHMT3 "Bit encoding / Ok-Tested Since Clear bit for check DFC_KRVEKOENCHMT3" UBYTE DFC_OneToOne 1 100 0.00 1.000 BIT_MASK 0x20 FORMAT "%5.3" ECU_ADDRESS 0x6003715E /end MEASUREMENT
/begin MEASUREMENT DFC_b.TSC_KRVEKOENCHMT4 "Bit encoding / Ok-Tested Since Clear bit for check DFC_KRVEKOENCHMT4" UBYTE DFC_OneToOne 1 100 0.00 1.000 BIT_MASK 0x20 FORMAT "%5.3" ECU_ADDRESS 0x6003715F /end MEASUREMENT
/begin MEASUREMENT DFC_b.TSC_KRVEKOENCHMT5 "Bit encoding / Ok-Tested Since Clear bit for check DFC_KRVEKOENCHMT5" UBYTE DFC_OneToOne 1 100 0.00 1.000 BIT_MASK 0x20 FORMAT "%5.3" ECU_ADDRESS 0x60037160 /end MEASUREMENT
/begin MEASUREMENT DFC_b.TSC_KRVEKOENCHMT6 "Bit encoding / Ok-Tested Since Clear bit for check DFC_KRVEKOENCHMT6" UBYTE DFC_OneToOne 1 100 0.00 1.000 BIT_MASK 0x20 FORMAT "%5.3" ECU_ADDRESS 0x60037161 /end MEASUREMENT
/begin MEASUREMENT DFC_b.TSC_KRVEKOENCHMT7 "Bit encoding / Ok-Tested Since Clear bit for check DFC_KRVEKOENCHMT7" UBYTE DFC_OneToOne 1 100 0.00 1.000 BIT_MASK 0x20 FORMAT "%5.3" ECU_ADDRESS 0x60037162 /end MEASUREMENT
/begin MEASUREMENT DFC_b.TSC_KRVEKORLMX "Bit encoding / Ok-Tested Since Clear bit for check DFC_KRVEKORLMX" UBYTE DFC_OneToOne 1 100 0.00 1.000 BIT_MASK 0x20 FORMAT "%5.3" ECU_ADDRESS 0x60037163 /end MEASUREMENT
/begin MEASUREMENT DFC_b.TSC_KRVEKORLMXL "Bit encoding / Ok-Tested Since Clear bit for check DFC_KRVEKORLMXL" UBYTE DFC_OneToOne 1 100 0.00 1.000 BIT_MASK 0x20 FORMAT "%5.3" ECU_ADDRESS 0x60037164 /end MEASUREMENT
/begin MEASUREMENT DFC_b.TSC_KS1max "Bit encoding / Ok-Tested Since Clear bit for check DFC_KS1max" UBYTE DFC_OneToOne 1 100 0.00 1.000 BIT_MASK 0x20 FORMAT "%5.3" ECU_ADDRESS 0x60037165 /end MEASUREMENT
/begin MEASUREMENT DFC_b.TSC_KS1min "Bit encoding / Ok-Tested Since Clear bit for check DFC_KS1min" UBYTE DFC_OneToOne 1 100 0.00 1.000 BIT_MASK 0x20 FORMAT "%5.3" ECU_ADDRESS 0x60037166 /end MEASUREMENT
/begin MEASUREMENT DFC_b.TSC_LMmax "Bit encoding / Ok-Tested Since Clear bit for check DFC_LMmax" UBYTE DFC_OneToOne 1 100 0.00 1.000 BIT_MASK 0x20 FORMAT "%5.3" ECU_ADDRESS 0x60037167 /end MEASUREMENT
/begin MEASUREMENT DFC_b.TSC_LZSRnpl "Bit encoding / Ok-Tested Since Clear bit for check DFC_LZSRnpl" UBYTE DFC_OneToOne 1 100 0.00 1.000 BIT_MASK 0x20 FORMAT "%5.3" ECU_ADDRESS 0x60037168 /end MEASUREMENT
/begin MEASUREMENT DFC_b.TSC_LamDynDiagS1B1 "Bit encoding / Ok-Tested Since Clear bit for check DFC_LamDynDiagS1B1" UBYTE DFC_OneToOne 1 100 0.00 1.000 BIT_MASK 0x20 FORMAT "%5.3" ECU_ADDRESS 0x60037169 /end MEASUREMENT
/begin MEASUREMENT DFC_b.TSC_LeakIntkMnfldEmiInfl "Bit encoding / Ok-Tested Since Clear bit for check DFC_LeakIntkMnfldEmiInfl" UBYTE DFC_OneToOne 1 100 0.00 1.000 BIT_MASK 0x20 FORMAT "%5.3" ECU_ADDRESS 0x6003716A /end MEASUREMENT
/begin MEASUREMENT DFC_b.TSC_LinFrameErrDCDC "Bit encoding / Ok-Tested Since Clear bit for check DFC_LinFrameErrDCDC" UBYTE DFC_OneToOne 1 100 0.00 1.000 BIT_MASK 0x20 FORMAT "%5.3" ECU_ADDRESS 0x6003716B /end MEASUREMENT
/begin MEASUREMENT DFC_b.TSC_LinOverrunErrDCDC "Bit encoding / Ok-Tested Since Clear bit for check DFC_LinOverrunErrDCDC" UBYTE DFC_OneToOne 1 100 0.00 1.000 BIT_MASK 0x20 FORMAT "%5.3" ECU_ADDRESS 0x6003716C /end MEASUREMENT
/begin MEASUREMENT DFC_b.TSC_MD00max "Bit encoding / Ok-Tested Since Clear bit for check DFC_MD00max" UBYTE DFC_OneToOne 1 100 0.00 1.000 BIT_MASK 0x20 FORMAT "%5.3" ECU_ADDRESS 0x6003716D /end MEASUREMENT
/begin MEASUREMENT DFC_b.TSC_MDBmax "Bit encoding / Ok-Tested Since Clear bit for check DFC_MDBmax" UBYTE DFC_OneToOne 1 100 0.00 1.000 BIT_MASK 0x20 FORMAT "%5.3" ECU_ADDRESS 0x6003716E /end MEASUREMENT
/begin MEASUREMENT DFC_b.TSC_MDCat "Bit encoding / Ok-Tested Since Clear bit for check DFC_MDCat" UBYTE DFC_OneToOne 1 100 0.00 1.000 BIT_MASK 0x20 FORMAT "%5.3" ECU_ADDRESS 0x6003716F /end MEASUREMENT
/begin MEASUREMENT DFC_b.TSC_MDCatCrit "Bit encoding / Ok-Tested Since Clear bit for check DFC_MDCatCrit" UBYTE DFC_OneToOne 1 100 0.00 1.000 BIT_MASK 0x20 FORMAT "%5.3" ECU_ADDRESS 0x60037170 /end MEASUREMENT
/begin MEASUREMENT DFC_b.TSC_MDCatCurr "Bit encoding / Ok-Tested Since Clear bit for check DFC_MDCatCurr" UBYTE DFC_OneToOne 1 100 0.00 1.000 BIT_MASK 0x20 FORMAT "%5.3" ECU_ADDRESS 0x60037171 /end MEASUREMENT
/begin MEASUREMENT DFC_b.TSC_MDCyl_0 "Bit encoding / Ok-Tested Since Clear bit for check DFC_MDCyl_0" UBYTE DFC_OneToOne 1 100 0.00 1.000 BIT_MASK 0x20 FORMAT "%5.3" ECU_ADDRESS 0x60037172 /end MEASUREMENT
/begin MEASUREMENT DFC_b.TSC_MDCyl_1 "Bit encoding / Ok-Tested Since Clear bit for check DFC_MDCyl_1" UBYTE DFC_OneToOne 1 100 0.00 1.000 BIT_MASK 0x20 FORMAT "%5.3" ECU_ADDRESS 0x60037173 /end MEASUREMENT
/begin MEASUREMENT DFC_b.TSC_MDCyl_2 "Bit encoding / Ok-Tested Since Clear bit for check DFC_MDCyl_2" UBYTE DFC_OneToOne 1 100 0.00 1.000 BIT_MASK 0x20 FORMAT "%5.3" ECU_ADDRESS 0x60037174 /end MEASUREMENT
/begin MEASUREMENT DFC_b.TSC_MDCyl_3 "Bit encoding / Ok-Tested Since Clear bit for check DFC_MDCyl_3" UBYTE DFC_OneToOne 1 100 0.00 1.000 BIT_MASK 0x20 FORMAT "%5.3" ECU_ADDRESS 0x60037175 /end MEASUREMENT
/begin MEASUREMENT DFC_b.TSC_MDEmi "Bit encoding / Ok-Tested Since Clear bit for check DFC_MDEmi" UBYTE DFC_OneToOne 1 100 0.00 1.000 BIT_MASK 0x20 FORMAT "%5.3" ECU_ADDRESS 0x60037176 /end MEASUREMENT
/begin MEASUREMENT DFC_b.TSC_MDEmiStrt "Bit encoding / Ok-Tested Since Clear bit for check DFC_MDEmiStrt" UBYTE DFC_OneToOne 1 100 0.00 1.000 BIT_MASK 0x20 FORMAT "%5.3" ECU_ADDRESS 0x60037177 /end MEASUREMENT
/begin MEASUREMENT DFC_b.TSC_MDFco "Bit encoding / Ok-Tested Since Clear bit for check DFC_MDFco" UBYTE DFC_OneToOne 1 100 0.00 1.000 BIT_MASK 0x20 FORMAT "%5.3" ECU_ADDRESS 0x60037178 /end MEASUREMENT
/begin MEASUREMENT DFC_b.TSC_MDMpl "Bit encoding / Ok-Tested Since Clear bit for check DFC_MDMpl" UBYTE DFC_OneToOne 1 100 0.00 1.000 BIT_MASK 0x20 FORMAT "%5.3" ECU_ADDRESS 0x60037179 /end MEASUREMENT
/begin MEASUREMENT DFC_b.TSC_MDSegTiAdpn "Bit encoding / Ok-Tested Since Clear bit for check DFC_MDSegTiAdpn" UBYTE DFC_OneToOne 1 100 0.00 1.000 BIT_MASK 0x20 FORMAT "%5.3" ECU_ADDRESS 0x6003717A /end MEASUREMENT
/begin MEASUREMENT DFC_b.TSC_MDmax "Bit encoding / Ok-Tested Since Clear bit for check DFC_MDmax" UBYTE DFC_OneToOne 1 100 0.00 1.000 BIT_MASK 0x20 FORMAT "%5.3" ECU_ADDRESS 0x6003717B /end MEASUREMENT
/begin MEASUREMENT DFC_b.TSC_MFuOilMax "Bit encoding / Ok-Tested Since Clear bit for check DFC_MFuOilMax" UBYTE DFC_OneToOne 1 100 0.00 1.000 BIT_MASK 0x20 FORMAT "%5.3" ECU_ADDRESS 0x6003717C /end MEASUREMENT
/begin MEASUREMENT DFC_b.TSC_MOXEMM_SMU_ALM0_0 "Bit encoding / Ok-Tested Since Clear bit for check DFC_MOXEMM_SMU_ALM0_0" UBYTE DFC_OneToOne 1 100 0.00 1.000 BIT_MASK 0x20 FORMAT "%5.3" ECU_ADDRESS 0x6003717D /end MEASUREMENT
/begin MEASUREMENT DFC_b.TSC_MOXEMM_SMU_ALM0_1 "Bit encoding / Ok-Tested Since Clear bit for check DFC_MOXEMM_SMU_ALM0_1" UBYTE DFC_OneToOne 1 100 0.00 1.000 BIT_MASK 0x20 FORMAT "%5.3" ECU_ADDRESS 0x6003717E /end MEASUREMENT
/begin MEASUREMENT DFC_b.TSC_MOXEMM_SMU_ALM0_10 "Bit encoding / Ok-Tested Since Clear bit for check DFC_MOXEMM_SMU_ALM0_10" UBYTE DFC_OneToOne 1 100 0.00 1.000 BIT_MASK 0x20 FORMAT "%5.3" ECU_ADDRESS 0x6003717F /end MEASUREMENT
/begin MEASUREMENT DFC_b.TSC_MOXEMM_SMU_ALM0_11 "Bit encoding / Ok-Tested Since Clear bit for check DFC_MOXEMM_SMU_ALM0_11" UBYTE DFC_OneToOne 1 100 0.00 1.000 BIT_MASK 0x20 FORMAT "%5.3" ECU_ADDRESS 0x60037180 /end MEASUREMENT
/begin MEASUREMENT DFC_b.TSC_MOXEMM_SMU_ALM0_13 "Bit encoding / Ok-Tested Since Clear bit for check DFC_MOXEMM_SMU_ALM0_13" UBYTE DFC_OneToOne 1 100 0.00 1.000 BIT_MASK 0x20 FORMAT "%5.3" ECU_ADDRESS 0x60037181 /end MEASUREMENT
/begin MEASUREMENT DFC_b.TSC_MOXEMM_SMU_ALM0_14 "Bit encoding / Ok-Tested Since Clear bit for check DFC_MOXEMM_SMU_ALM0_14" UBYTE DFC_OneToOne 1 100 0.00 1.000 BIT_MASK 0x20 FORMAT "%5.3" ECU_ADDRESS 0x60037182 /end MEASUREMENT
/begin MEASUREMENT DFC_b.TSC_MOXEMM_SMU_ALM0_2 "Bit encoding / Ok-Tested Since Clear bit for check DFC_MOXEMM_SMU_ALM0_2" UBYTE DFC_OneToOne 1 100 0.00 1.000 BIT_MASK 0x20 FORMAT "%5.3" ECU_ADDRESS 0x60037183 /end MEASUREMENT
/begin MEASUREMENT DFC_b.TSC_MOXEMM_SMU_ALM0_22 "Bit encoding / Ok-Tested Since Clear bit for check DFC_MOXEMM_SMU_ALM0_22" UBYTE DFC_OneToOne 1 100 0.00 1.000 BIT_MASK 0x20 FORMAT "%5.3" ECU_ADDRESS 0x60037184 /end MEASUREMENT
/begin MEASUREMENT DFC_b.TSC_MOXEMM_SMU_ALM0_23 "Bit encoding / Ok-Tested Since Clear bit for check DFC_MOXEMM_SMU_ALM0_23" UBYTE DFC_OneToOne 1 100 0.00 1.000 BIT_MASK 0x20 FORMAT "%5.3" ECU_ADDRESS 0x60037185 /end MEASUREMENT
/begin MEASUREMENT DFC_b.TSC_MOXEMM_SMU_ALM0_4 "Bit encoding / Ok-Tested Since Clear bit for check DFC_MOXEMM_SMU_ALM0_4" UBYTE DFC_OneToOne 1 100 0.00 1.000 BIT_MASK 0x20 FORMAT "%5.3" ECU_ADDRESS 0x60037186 /end MEASUREMENT
/begin MEASUREMENT DFC_b.TSC_MOXEMM_SMU_ALM0_5 "Bit encoding / Ok-Tested Since Clear bit for check DFC_MOXEMM_SMU_ALM0_5" UBYTE DFC_OneToOne 1 100 0.00 1.000 BIT_MASK 0x20 FORMAT "%5.3" ECU_ADDRESS 0x60037187 /end MEASUREMENT
/begin MEASUREMENT DFC_b.TSC_MOXEMM_SMU_ALM0_7 "Bit encoding / Ok-Tested Since Clear bit for check DFC_MOXEMM_SMU_ALM0_7" UBYTE DFC_OneToOne 1 100 0.00 1.000 BIT_MASK 0x20 FORMAT "%5.3" ECU_ADDRESS 0x60037188 /end MEASUREMENT
/begin MEASUREMENT DFC_b.TSC_MOXEMM_SMU_ALM0_8 "Bit encoding / Ok-Tested Since Clear bit for check DFC_MOXEMM_SMU_ALM0_8" UBYTE DFC_OneToOne 1 100 0.00 1.000 BIT_MASK 0x20 FORMAT "%5.3" ECU_ADDRESS 0x60037189 /end MEASUREMENT
/begin MEASUREMENT DFC_b.TSC_MOXEMM_SMU_ALM10_16 "Bit encoding / Ok-Tested Since Clear bit for check DFC_MOXEMM_SMU_ALM10_16" UBYTE DFC_OneToOne 1 100 0.00 1.000 BIT_MASK 0x20 FORMAT "%5.3" ECU_ADDRESS 0x6003718A /end MEASUREMENT
/begin MEASUREMENT DFC_b.TSC_MOXEMM_SMU_ALM10_17 "Bit encoding / Ok-Tested Since Clear bit for check DFC_MOXEMM_SMU_ALM10_17" UBYTE DFC_OneToOne 1 100 0.00 1.000 BIT_MASK 0x20 FORMAT "%5.3" ECU_ADDRESS 0x6003718B /end MEASUREMENT
/begin MEASUREMENT DFC_b.TSC_MOXEMM_SMU_ALM10_21 "Bit encoding / Ok-Tested Since Clear bit for check DFC_MOXEMM_SMU_ALM10_21" UBYTE DFC_OneToOne 1 100 0.00 1.000 BIT_MASK 0x20 FORMAT "%5.3" ECU_ADDRESS 0x6003718C /end MEASUREMENT
/begin MEASUREMENT DFC_b.TSC_MOXEMM_SMU_ALM11_0 "Bit encoding / Ok-Tested Since Clear bit for check DFC_MOXEMM_SMU_ALM11_0" UBYTE DFC_OneToOne 1 100 0.00 1.000 BIT_MASK 0x20 FORMAT "%5.3" ECU_ADDRESS 0x6003718D /end MEASUREMENT
/begin MEASUREMENT DFC_b.TSC_MOXEMM_SMU_ALM11_1 "Bit encoding / Ok-Tested Since Clear bit for check DFC_MOXEMM_SMU_ALM11_1" UBYTE DFC_OneToOne 1 100 0.00 1.000 BIT_MASK 0x20 FORMAT "%5.3" ECU_ADDRESS 0x6003718E /end MEASUREMENT
/begin MEASUREMENT DFC_b.TSC_MOXEMM_SMU_ALM11_2 "Bit encoding / Ok-Tested Since Clear bit for check DFC_MOXEMM_SMU_ALM11_2" UBYTE DFC_OneToOne 1 100 0.00 1.000 BIT_MASK 0x20 FORMAT "%5.3" ECU_ADDRESS 0x6003718F /end MEASUREMENT
/begin MEASUREMENT DFC_b.TSC_MOXEMM_SMU_ALM11_3 "Bit encoding / Ok-Tested Since Clear bit for check DFC_MOXEMM_SMU_ALM11_3" UBYTE DFC_OneToOne 1 100 0.00 1.000 BIT_MASK 0x20 FORMAT "%5.3" ECU_ADDRESS 0x60037190 /end MEASUREMENT
/begin MEASUREMENT DFC_b.TSC_MOXEMM_SMU_ALM11_4 "Bit encoding / Ok-Tested Since Clear bit for check DFC_MOXEMM_SMU_ALM11_4" UBYTE DFC_OneToOne 1 100 0.00 1.000 BIT_MASK 0x20 FORMAT "%5.3" ECU_ADDRESS 0x60037191 /end MEASUREMENT
/begin MEASUREMENT DFC_b.TSC_MOXEMM_SMU_ALM11_5 "Bit encoding / Ok-Tested Since Clear bit for check DFC_MOXEMM_SMU_ALM11_5" UBYTE DFC_OneToOne 1 100 0.00 1.000 BIT_MASK 0x20 FORMAT "%5.3" ECU_ADDRESS 0x60037192 /end MEASUREMENT
/begin MEASUREMENT DFC_b.TSC_MOXEMM_SMU_ALM11_8 "Bit encoding / Ok-Tested Since Clear bit for check DFC_MOXEMM_SMU_ALM11_8" UBYTE DFC_OneToOne 1 100 0.00 1.000 BIT_MASK 0x20 FORMAT "%5.3" ECU_ADDRESS 0x60037193 /end MEASUREMENT
/begin MEASUREMENT DFC_b.TSC_MOXEMM_SMU_ALM11_9 "Bit encoding / Ok-Tested Since Clear bit for check DFC_MOXEMM_SMU_ALM11_9" UBYTE DFC_OneToOne 1 100 0.00 1.000 BIT_MASK 0x20 FORMAT "%5.3" ECU_ADDRESS 0x60037194 /end MEASUREMENT
/begin MEASUREMENT DFC_b.TSC_MOXEMM_SMU_ALM1_0 "Bit encoding / Ok-Tested Since Clear bit for check DFC_MOXEMM_SMU_ALM1_0" UBYTE DFC_OneToOne 1 100 0.00 1.000 BIT_MASK 0x20 FORMAT "%5.3" ECU_ADDRESS 0x60037195 /end MEASUREMENT
/begin MEASUREMENT DFC_b.TSC_MOXEMM_SMU_ALM1_1 "Bit encoding / Ok-Tested Since Clear bit for check DFC_MOXEMM_SMU_ALM1_1" UBYTE DFC_OneToOne 1 100 0.00 1.000 BIT_MASK 0x20 FORMAT "%5.3" ECU_ADDRESS 0x60037196 /end MEASUREMENT
/begin MEASUREMENT DFC_b.TSC_MOXEMM_SMU_ALM1_10 "Bit encoding / Ok-Tested Since Clear bit for check DFC_MOXEMM_SMU_ALM1_10" UBYTE DFC_OneToOne 1 100 0.00 1.000 BIT_MASK 0x20 FORMAT "%5.3" ECU_ADDRESS 0x60037197 /end MEASUREMENT
/begin MEASUREMENT DFC_b.TSC_MOXEMM_SMU_ALM1_11 "Bit encoding / Ok-Tested Since Clear bit for check DFC_MOXEMM_SMU_ALM1_11" UBYTE DFC_OneToOne 1 100 0.00 1.000 BIT_MASK 0x20 FORMAT "%5.3" ECU_ADDRESS 0x60037198 /end MEASUREMENT
/begin MEASUREMENT DFC_b.TSC_MOXEMM_SMU_ALM1_13 "Bit encoding / Ok-Tested Since Clear bit for check DFC_MOXEMM_SMU_ALM1_13" UBYTE DFC_OneToOne 1 100 0.00 1.000 BIT_MASK 0x20 FORMAT "%5.3" ECU_ADDRESS 0x60037199 /end MEASUREMENT
/begin MEASUREMENT DFC_b.TSC_MOXEMM_SMU_ALM1_14 "Bit encoding / Ok-Tested Since Clear bit for check DFC_MOXEMM_SMU_ALM1_14" UBYTE DFC_OneToOne 1 100 0.00 1.000 BIT_MASK 0x20 FORMAT "%5.3" ECU_ADDRESS 0x6003719A /end MEASUREMENT
/begin MEASUREMENT DFC_b.TSC_MOXEMM_SMU_ALM1_2 "Bit encoding / Ok-Tested Since Clear bit for check DFC_MOXEMM_SMU_ALM1_2" UBYTE DFC_OneToOne 1 100 0.00 1.000 BIT_MASK 0x20 FORMAT "%5.3" ECU_ADDRESS 0x6003719B /end MEASUREMENT
/begin MEASUREMENT DFC_b.TSC_MOXEMM_SMU_ALM1_22 "Bit encoding / Ok-Tested Since Clear bit for check DFC_MOXEMM_SMU_ALM1_22" UBYTE DFC_OneToOne 1 100 0.00 1.000 BIT_MASK 0x20 FORMAT "%5.3" ECU_ADDRESS 0x6003719C /end MEASUREMENT
/begin MEASUREMENT DFC_b.TSC_MOXEMM_SMU_ALM1_23 "Bit encoding / Ok-Tested Since Clear bit for check DFC_MOXEMM_SMU_ALM1_23" UBYTE DFC_OneToOne 1 100 0.00 1.000 BIT_MASK 0x20 FORMAT "%5.3" ECU_ADDRESS 0x6003719D /end MEASUREMENT
/begin MEASUREMENT DFC_b.TSC_MOXEMM_SMU_ALM1_4 "Bit encoding / Ok-Tested Since Clear bit for check DFC_MOXEMM_SMU_ALM1_4" UBYTE DFC_OneToOne 1 100 0.00 1.000 BIT_MASK 0x20 FORMAT "%5.3" ECU_ADDRESS 0x6003719E /end MEASUREMENT
/begin MEASUREMENT DFC_b.TSC_MOXEMM_SMU_ALM1_5 "Bit encoding / Ok-Tested Since Clear bit for check DFC_MOXEMM_SMU_ALM1_5" UBYTE DFC_OneToOne 1 100 0.00 1.000 BIT_MASK 0x20 FORMAT "%5.3" ECU_ADDRESS 0x6003719F /end MEASUREMENT
/begin MEASUREMENT DFC_b.TSC_MOXEMM_SMU_ALM1_7 "Bit encoding / Ok-Tested Since Clear bit for check DFC_MOXEMM_SMU_ALM1_7" UBYTE DFC_OneToOne 1 100 0.00 1.000 BIT_MASK 0x20 FORMAT "%5.3" ECU_ADDRESS 0x600371A0 /end MEASUREMENT
/begin MEASUREMENT DFC_b.TSC_MOXEMM_SMU_ALM1_8 "Bit encoding / Ok-Tested Since Clear bit for check DFC_MOXEMM_SMU_ALM1_8" UBYTE DFC_OneToOne 1 100 0.00 1.000 BIT_MASK 0x20 FORMAT "%5.3" ECU_ADDRESS 0x600371A1 /end MEASUREMENT
/begin MEASUREMENT DFC_b.TSC_MOXEMM_SMU_ALM21_0 "Bit encoding / Ok-Tested Since Clear bit for check DFC_MOXEMM_SMU_ALM21_0" UBYTE DFC_OneToOne 1 100 0.00 1.000 BIT_MASK 0x20 FORMAT "%5.3" ECU_ADDRESS 0x600371A2 /end MEASUREMENT
/begin MEASUREMENT DFC_b.TSC_MOXEMM_SMU_ALM21_16 "Bit encoding / Ok-Tested Since Clear bit for check DFC_MOXEMM_SMU_ALM21_16" UBYTE DFC_OneToOne 1 100 0.00 1.000 BIT_MASK 0x20 FORMAT "%5.3" ECU_ADDRESS 0x600371A3 /end MEASUREMENT
/begin MEASUREMENT DFC_b.TSC_MOXEMM_SMU_ALM21_3 "Bit encoding / Ok-Tested Since Clear bit for check DFC_MOXEMM_SMU_ALM21_3" UBYTE DFC_OneToOne 1 100 0.00 1.000 BIT_MASK 0x20 FORMAT "%5.3" ECU_ADDRESS 0x600371A4 /end MEASUREMENT
/begin MEASUREMENT DFC_b.TSC_MOXEMM_SMU_ALM2_1 "Bit encoding / Ok-Tested Since Clear bit for check DFC_MOXEMM_SMU_ALM2_1" UBYTE DFC_OneToOne 1 100 0.00 1.000 BIT_MASK 0x20 FORMAT "%5.3" ECU_ADDRESS 0x600371A5 /end MEASUREMENT
/begin MEASUREMENT DFC_b.TSC_MOXEMM_SMU_ALM2_10 "Bit encoding / Ok-Tested Since Clear bit for check DFC_MOXEMM_SMU_ALM2_10" UBYTE DFC_OneToOne 1 100 0.00 1.000 BIT_MASK 0x20 FORMAT "%5.3" ECU_ADDRESS 0x600371A6 /end MEASUREMENT
/begin MEASUREMENT DFC_b.TSC_MOXEMM_SMU_ALM2_11 "Bit encoding / Ok-Tested Since Clear bit for check DFC_MOXEMM_SMU_ALM2_11" UBYTE DFC_OneToOne 1 100 0.00 1.000 BIT_MASK 0x20 FORMAT "%5.3" ECU_ADDRESS 0x600371A7 /end MEASUREMENT
/begin MEASUREMENT DFC_b.TSC_MOXEMM_SMU_ALM2_13 "Bit encoding / Ok-Tested Since Clear bit for check DFC_MOXEMM_SMU_ALM2_13" UBYTE DFC_OneToOne 1 100 0.00 1.000 BIT_MASK 0x20 FORMAT "%5.3" ECU_ADDRESS 0x600371A8 /end MEASUREMENT
/begin MEASUREMENT DFC_b.TSC_MOXEMM_SMU_ALM2_14 "Bit encoding / Ok-Tested Since Clear bit for check DFC_MOXEMM_SMU_ALM2_14" UBYTE DFC_OneToOne 1 100 0.00 1.000 BIT_MASK 0x20 FORMAT "%5.3" ECU_ADDRESS 0x600371A9 /end MEASUREMENT
/begin MEASUREMENT DFC_b.TSC_MOXEMM_SMU_ALM2_22 "Bit encoding / Ok-Tested Since Clear bit for check DFC_MOXEMM_SMU_ALM2_22" UBYTE DFC_OneToOne 1 100 0.00 1.000 BIT_MASK 0x20 FORMAT "%5.3" ECU_ADDRESS 0x600371AA /end MEASUREMENT
/begin MEASUREMENT DFC_b.TSC_MOXEMM_SMU_ALM2_23 "Bit encoding / Ok-Tested Since Clear bit for check DFC_MOXEMM_SMU_ALM2_23" UBYTE DFC_OneToOne 1 100 0.00 1.000 BIT_MASK 0x20 FORMAT "%5.3" ECU_ADDRESS 0x600371AB /end MEASUREMENT
/begin MEASUREMENT DFC_b.TSC_MOXEMM_SMU_ALM2_4 "Bit encoding / Ok-Tested Since Clear bit for check DFC_MOXEMM_SMU_ALM2_4" UBYTE DFC_OneToOne 1 100 0.00 1.000 BIT_MASK 0x20 FORMAT "%5.3" ECU_ADDRESS 0x600371AC /end MEASUREMENT
/begin MEASUREMENT DFC_b.TSC_MOXEMM_SMU_ALM2_5 "Bit encoding / Ok-Tested Since Clear bit for check DFC_MOXEMM_SMU_ALM2_5" UBYTE DFC_OneToOne 1 100 0.00 1.000 BIT_MASK 0x20 FORMAT "%5.3" ECU_ADDRESS 0x600371AD /end MEASUREMENT
/begin MEASUREMENT DFC_b.TSC_MOXEMM_SMU_ALM2_7 "Bit encoding / Ok-Tested Since Clear bit for check DFC_MOXEMM_SMU_ALM2_7" UBYTE DFC_OneToOne 1 100 0.00 1.000 BIT_MASK 0x20 FORMAT "%5.3" ECU_ADDRESS 0x600371AE /end MEASUREMENT
/begin MEASUREMENT DFC_b.TSC_MOXEMM_SMU_ALM2_8 "Bit encoding / Ok-Tested Since Clear bit for check DFC_MOXEMM_SMU_ALM2_8" UBYTE DFC_OneToOne 1 100 0.00 1.000 BIT_MASK 0x20 FORMAT "%5.3" ECU_ADDRESS 0x600371AF /end MEASUREMENT
/begin MEASUREMENT DFC_b.TSC_MOXEMM_SMU_ALM6_0 "Bit encoding / Ok-Tested Since Clear bit for check DFC_MOXEMM_SMU_ALM6_0" UBYTE DFC_OneToOne 1 100 0.00 1.000 BIT_MASK 0x20 FORMAT "%5.3" ECU_ADDRESS 0x600371B0 /end MEASUREMENT
/begin MEASUREMENT DFC_b.TSC_MOXEMM_SMU_ALM6_11 "Bit encoding / Ok-Tested Since Clear bit for check DFC_MOXEMM_SMU_ALM6_11" UBYTE DFC_OneToOne 1 100 0.00 1.000 BIT_MASK 0x20 FORMAT "%5.3" ECU_ADDRESS 0x600371B1 /end MEASUREMENT
/begin MEASUREMENT DFC_b.TSC_MOXEMM_SMU_ALM6_12 "Bit encoding / Ok-Tested Since Clear bit for check DFC_MOXEMM_SMU_ALM6_12" UBYTE DFC_OneToOne 1 100 0.00 1.000 BIT_MASK 0x20 FORMAT "%5.3" ECU_ADDRESS 0x600371B2 /end MEASUREMENT
/begin MEASUREMENT DFC_b.TSC_MOXEMM_SMU_ALM6_14 "Bit encoding / Ok-Tested Since Clear bit for check DFC_MOXEMM_SMU_ALM6_14" UBYTE DFC_OneToOne 1 100 0.00 1.000 BIT_MASK 0x20 FORMAT "%5.3" ECU_ADDRESS 0x600371B3 /end MEASUREMENT
/begin MEASUREMENT DFC_b.TSC_MOXEMM_SMU_ALM6_15 "Bit encoding / Ok-Tested Since Clear bit for check DFC_MOXEMM_SMU_ALM6_15" UBYTE DFC_OneToOne 1 100 0.00 1.000 BIT_MASK 0x20 FORMAT "%5.3" ECU_ADDRESS 0x600371B4 /end MEASUREMENT
/begin MEASUREMENT DFC_b.TSC_MOXEMM_SMU_ALM6_17 "Bit encoding / Ok-Tested Since Clear bit for check DFC_MOXEMM_SMU_ALM6_17" UBYTE DFC_OneToOne 1 100 0.00 1.000 BIT_MASK 0x20 FORMAT "%5.3" ECU_ADDRESS 0x600371B5 /end MEASUREMENT
/begin MEASUREMENT DFC_b.TSC_MOXEMM_SMU_ALM6_18 "Bit encoding / Ok-Tested Since Clear bit for check DFC_MOXEMM_SMU_ALM6_18" UBYTE DFC_OneToOne 1 100 0.00 1.000 BIT_MASK 0x20 FORMAT "%5.3" ECU_ADDRESS 0x600371B6 /end MEASUREMENT
/begin MEASUREMENT DFC_b.TSC_MOXEMM_SMU_ALM6_20 "Bit encoding / Ok-Tested Since Clear bit for check DFC_MOXEMM_SMU_ALM6_20" UBYTE DFC_OneToOne 1 100 0.00 1.000 BIT_MASK 0x20 FORMAT "%5.3" ECU_ADDRESS 0x600371B7 /end MEASUREMENT
/begin MEASUREMENT DFC_b.TSC_MOXEMM_SMU_ALM6_21 "Bit encoding / Ok-Tested Since Clear bit for check DFC_MOXEMM_SMU_ALM6_21" UBYTE DFC_OneToOne 1 100 0.00 1.000 BIT_MASK 0x20 FORMAT "%5.3" ECU_ADDRESS 0x600371B8 /end MEASUREMENT
/begin MEASUREMENT DFC_b.TSC_MOXEMM_SMU_ALM6_25 "Bit encoding / Ok-Tested Since Clear bit for check DFC_MOXEMM_SMU_ALM6_25" UBYTE DFC_OneToOne 1 100 0.00 1.000 BIT_MASK 0x20 FORMAT "%5.3" ECU_ADDRESS 0x600371B9 /end MEASUREMENT
/begin MEASUREMENT DFC_b.TSC_MOXEMM_SMU_ALM6_4 "Bit encoding / Ok-Tested Since Clear bit for check DFC_MOXEMM_SMU_ALM6_4" UBYTE DFC_OneToOne 1 100 0.00 1.000 BIT_MASK 0x20 FORMAT "%5.3" ECU_ADDRESS 0x600371BA /end MEASUREMENT
/begin MEASUREMENT DFC_b.TSC_MOXEMM_SMU_ALM6_5 "Bit encoding / Ok-Tested Since Clear bit for check DFC_MOXEMM_SMU_ALM6_5" UBYTE DFC_OneToOne 1 100 0.00 1.000 BIT_MASK 0x20 FORMAT "%5.3" ECU_ADDRESS 0x600371BB /end MEASUREMENT
/begin MEASUREMENT DFC_b.TSC_MOXEMM_SMU_ALM6_7 "Bit encoding / Ok-Tested Since Clear bit for check DFC_MOXEMM_SMU_ALM6_7" UBYTE DFC_OneToOne 1 100 0.00 1.000 BIT_MASK 0x20 FORMAT "%5.3" ECU_ADDRESS 0x600371BC /end MEASUREMENT
/begin MEASUREMENT DFC_b.TSC_MOXEMM_SMU_ALM6_8 "Bit encoding / Ok-Tested Since Clear bit for check DFC_MOXEMM_SMU_ALM6_8" UBYTE DFC_OneToOne 1 100 0.00 1.000 BIT_MASK 0x20 FORMAT "%5.3" ECU_ADDRESS 0x600371BD /end MEASUREMENT
/begin MEASUREMENT DFC_b.TSC_MOXEMM_SMU_ALM7_1 "Bit encoding / Ok-Tested Since Clear bit for check DFC_MOXEMM_SMU_ALM7_1" UBYTE DFC_OneToOne 1 100 0.00 1.000 BIT_MASK 0x20 FORMAT "%5.3" ECU_ADDRESS 0x600371BE /end MEASUREMENT
/begin MEASUREMENT DFC_b.TSC_MOXEMM_SMU_ALM7_12 "Bit encoding / Ok-Tested Since Clear bit for check DFC_MOXEMM_SMU_ALM7_12" UBYTE DFC_OneToOne 1 100 0.00 1.000 BIT_MASK 0x20 FORMAT "%5.3" ECU_ADDRESS 0x600371BF /end MEASUREMENT
/begin MEASUREMENT DFC_b.TSC_MOXEMM_SMU_ALM7_13 "Bit encoding / Ok-Tested Since Clear bit for check DFC_MOXEMM_SMU_ALM7_13" UBYTE DFC_OneToOne 1 100 0.00 1.000 BIT_MASK 0x20 FORMAT "%5.3" ECU_ADDRESS 0x600371C0 /end MEASUREMENT
/begin MEASUREMENT DFC_b.TSC_MOXEMM_SMU_ALM7_14 "Bit encoding / Ok-Tested Since Clear bit for check DFC_MOXEMM_SMU_ALM7_14" UBYTE DFC_OneToOne 1 100 0.00 1.000 BIT_MASK 0x20 FORMAT "%5.3" ECU_ADDRESS 0x600371C1 /end MEASUREMENT
/begin MEASUREMENT DFC_b.TSC_MOXEMM_SMU_ALM7_15 "Bit encoding / Ok-Tested Since Clear bit for check DFC_MOXEMM_SMU_ALM7_15" UBYTE DFC_OneToOne 1 100 0.00 1.000 BIT_MASK 0x20 FORMAT "%5.3" ECU_ADDRESS 0x600371C2 /end MEASUREMENT
/begin MEASUREMENT DFC_b.TSC_MOXEMM_SMU_ALM7_16 "Bit encoding / Ok-Tested Since Clear bit for check DFC_MOXEMM_SMU_ALM7_16" UBYTE DFC_OneToOne 1 100 0.00 1.000 BIT_MASK 0x20 FORMAT "%5.3" ECU_ADDRESS 0x600371C3 /end MEASUREMENT
/begin MEASUREMENT DFC_b.TSC_MOXEMM_SMU_ALM7_17 "Bit encoding / Ok-Tested Since Clear bit for check DFC_MOXEMM_SMU_ALM7_17" UBYTE DFC_OneToOne 1 100 0.00 1.000 BIT_MASK 0x20 FORMAT "%5.3" ECU_ADDRESS 0x600371C4 /end MEASUREMENT
/begin MEASUREMENT DFC_b.TSC_MOXEMM_SMU_ALM7_2 "Bit encoding / Ok-Tested Since Clear bit for check DFC_MOXEMM_SMU_ALM7_2" UBYTE DFC_OneToOne 1 100 0.00 1.000 BIT_MASK 0x20 FORMAT "%5.3" ECU_ADDRESS 0x600371C5 /end MEASUREMENT
/begin MEASUREMENT DFC_b.TSC_MOXEMM_SMU_ALM7_20 "Bit encoding / Ok-Tested Since Clear bit for check DFC_MOXEMM_SMU_ALM7_20" UBYTE DFC_OneToOne 1 100 0.00 1.000 BIT_MASK 0x20 FORMAT "%5.3" ECU_ADDRESS 0x600371C6 /end MEASUREMENT
/begin MEASUREMENT DFC_b.TSC_MOXEMM_SMU_ALM7_25 "Bit encoding / Ok-Tested Since Clear bit for check DFC_MOXEMM_SMU_ALM7_25" UBYTE DFC_OneToOne 1 100 0.00 1.000 BIT_MASK 0x20 FORMAT "%5.3" ECU_ADDRESS 0x600371C7 /end MEASUREMENT
/begin MEASUREMENT DFC_b.TSC_MOXEMM_SMU_ALM7_26 "Bit encoding / Ok-Tested Since Clear bit for check DFC_MOXEMM_SMU_ALM7_26" UBYTE DFC_OneToOne 1 100 0.00 1.000 BIT_MASK 0x20 FORMAT "%5.3" ECU_ADDRESS 0x600371C8 /end MEASUREMENT
/begin MEASUREMENT DFC_b.TSC_MOXEMM_SMU_ALM7_28 "Bit encoding / Ok-Tested Since Clear bit for check DFC_MOXEMM_SMU_ALM7_28" UBYTE DFC_OneToOne 1 100 0.00 1.000 BIT_MASK 0x20 FORMAT "%5.3" ECU_ADDRESS 0x600371C9 /end MEASUREMENT
/begin MEASUREMENT DFC_b.TSC_MOXEMM_SMU_ALM7_29 "Bit encoding / Ok-Tested Since Clear bit for check DFC_MOXEMM_SMU_ALM7_29" UBYTE DFC_OneToOne 1 100 0.00 1.000 BIT_MASK 0x20 FORMAT "%5.3" ECU_ADDRESS 0x600371CA /end MEASUREMENT
/begin MEASUREMENT DFC_b.TSC_MOXEMM_SMU_ALM7_30 "Bit encoding / Ok-Tested Since Clear bit for check DFC_MOXEMM_SMU_ALM7_30" UBYTE DFC_OneToOne 1 100 0.00 1.000 BIT_MASK 0x20 FORMAT "%5.3" ECU_ADDRESS 0x600371CB /end MEASUREMENT
/begin MEASUREMENT DFC_b.TSC_MOXEMM_SMU_ALM7_31 "Bit encoding / Ok-Tested Since Clear bit for check DFC_MOXEMM_SMU_ALM7_31" UBYTE DFC_OneToOne 1 100 0.00 1.000 BIT_MASK 0x20 FORMAT "%5.3" ECU_ADDRESS 0x600371CC /end MEASUREMENT
/begin MEASUREMENT DFC_b.TSC_MOXEMM_SMU_ALM8_0 "Bit encoding / Ok-Tested Since Clear bit for check DFC_MOXEMM_SMU_ALM8_0" UBYTE DFC_OneToOne 1 100 0.00 1.000 BIT_MASK 0x20 FORMAT "%5.3" ECU_ADDRESS 0x600371CD /end MEASUREMENT
/begin MEASUREMENT DFC_b.TSC_MOXEMM_SMU_ALM8_1 "Bit encoding / Ok-Tested Since Clear bit for check DFC_MOXEMM_SMU_ALM8_1" UBYTE DFC_OneToOne 1 100 0.00 1.000 BIT_MASK 0x20 FORMAT "%5.3" ECU_ADDRESS 0x600371CE /end MEASUREMENT
/begin MEASUREMENT DFC_b.TSC_MOXEMM_SMU_ALM8_10 "Bit encoding / Ok-Tested Since Clear bit for check DFC_MOXEMM_SMU_ALM8_10" UBYTE DFC_OneToOne 1 100 0.00 1.000 BIT_MASK 0x20 FORMAT "%5.3" ECU_ADDRESS 0x600371CF /end MEASUREMENT
/begin MEASUREMENT DFC_b.TSC_MOXEMM_SMU_ALM8_11 "Bit encoding / Ok-Tested Since Clear bit for check DFC_MOXEMM_SMU_ALM8_11" UBYTE DFC_OneToOne 1 100 0.00 1.000 BIT_MASK 0x20 FORMAT "%5.3" ECU_ADDRESS 0x600371D0 /end MEASUREMENT
/begin MEASUREMENT DFC_b.TSC_MOXEMM_SMU_ALM8_12 "Bit encoding / Ok-Tested Since Clear bit for check DFC_MOXEMM_SMU_ALM8_12" UBYTE DFC_OneToOne 1 100 0.00 1.000 BIT_MASK 0x20 FORMAT "%5.3" ECU_ADDRESS 0x600371D1 /end MEASUREMENT
/begin MEASUREMENT DFC_b.TSC_MOXEMM_SMU_ALM8_16 "Bit encoding / Ok-Tested Since Clear bit for check DFC_MOXEMM_SMU_ALM8_16" UBYTE DFC_OneToOne 1 100 0.00 1.000 BIT_MASK 0x20 FORMAT "%5.3" ECU_ADDRESS 0x600371D2 /end MEASUREMENT
/begin MEASUREMENT DFC_b.TSC_MOXEMM_SMU_ALM8_18 "Bit encoding / Ok-Tested Since Clear bit for check DFC_MOXEMM_SMU_ALM8_18" UBYTE DFC_OneToOne 1 100 0.00 1.000 BIT_MASK 0x20 FORMAT "%5.3" ECU_ADDRESS 0x600371D3 /end MEASUREMENT
/begin MEASUREMENT DFC_b.TSC_MOXEMM_SMU_ALM8_2 "Bit encoding / Ok-Tested Since Clear bit for check DFC_MOXEMM_SMU_ALM8_2" UBYTE DFC_OneToOne 1 100 0.00 1.000 BIT_MASK 0x20 FORMAT "%5.3" ECU_ADDRESS 0x600371D4 /end MEASUREMENT
/begin MEASUREMENT DFC_b.TSC_MOXEMM_SMU_ALM8_3 "Bit encoding / Ok-Tested Since Clear bit for check DFC_MOXEMM_SMU_ALM8_3" UBYTE DFC_OneToOne 1 100 0.00 1.000 BIT_MASK 0x20 FORMAT "%5.3" ECU_ADDRESS 0x600371D5 /end MEASUREMENT
/begin MEASUREMENT DFC_b.TSC_MOXEMM_SMU_ALM8_31 "Bit encoding / Ok-Tested Since Clear bit for check DFC_MOXEMM_SMU_ALM8_31" UBYTE DFC_OneToOne 1 100 0.00 1.000 BIT_MASK 0x20 FORMAT "%5.3" ECU_ADDRESS 0x600371D6 /end MEASUREMENT
/begin MEASUREMENT DFC_b.TSC_MOXEMM_SMU_ALM8_4 "Bit encoding / Ok-Tested Since Clear bit for check DFC_MOXEMM_SMU_ALM8_4" UBYTE DFC_OneToOne 1 100 0.00 1.000 BIT_MASK 0x20 FORMAT "%5.3" ECU_ADDRESS 0x600371D7 /end MEASUREMENT
/begin MEASUREMENT DFC_b.TSC_MOXEMM_SMU_ALM9_0 "Bit encoding / Ok-Tested Since Clear bit for check DFC_MOXEMM_SMU_ALM9_0" UBYTE DFC_OneToOne 1 100 0.00 1.000 BIT_MASK 0x20 FORMAT "%5.3" ECU_ADDRESS 0x600371D8 /end MEASUREMENT
/begin MEASUREMENT DFC_b.TSC_MOXEMM_SMU_ALM9_15 "Bit encoding / Ok-Tested Since Clear bit for check DFC_MOXEMM_SMU_ALM9_15" UBYTE DFC_OneToOne 1 100 0.00 1.000 BIT_MASK 0x20 FORMAT "%5.3" ECU_ADDRESS 0x600371D9 /end MEASUREMENT
/begin MEASUREMENT DFC_b.TSC_MOXEMM_SMU_ALM9_3 "Bit encoding / Ok-Tested Since Clear bit for check DFC_MOXEMM_SMU_ALM9_3" UBYTE DFC_OneToOne 1 100 0.00 1.000 BIT_MASK 0x20 FORMAT "%5.3" ECU_ADDRESS 0x600371DA /end MEASUREMENT
/begin MEASUREMENT DFC_b.TSC_MoCADCNTP "Bit encoding / Ok-Tested Since Clear bit for check DFC_MoCADCNTP" UBYTE DFC_OneToOne 1 100 0.00 1.000 BIT_MASK 0x20 FORMAT "%5.3" ECU_ADDRESS 0x600371DB /end MEASUREMENT
/begin MEASUREMENT DFC_b.TSC_MoCADCTst "Bit encoding / Ok-Tested Since Clear bit for check DFC_MoCADCTst" UBYTE DFC_OneToOne 1 100 0.00 1.000 BIT_MASK 0x20 FORMAT "%5.3" ECU_ADDRESS 0x600371DC /end MEASUREMENT
/begin MEASUREMENT DFC_b.TSC_MoCSOPICO "Bit encoding / Ok-Tested Since Clear bit for check DFC_MoCSOPICO" UBYTE DFC_OneToOne 1 100 0.00 1.000 BIT_MASK 0x20 FORMAT "%5.3" ECU_ADDRESS 0x600371DD /end MEASUREMENT
/begin MEASUREMENT DFC_b.TSC_MoFAPP "Bit encoding / Ok-Tested Since Clear bit for check DFC_MoFAPP" UBYTE DFC_OneToOne 1 100 0.00 1.000 BIT_MASK 0x20 FORMAT "%5.3" ECU_ADDRESS 0x600371DE /end MEASUREMENT
/begin MEASUREMENT DFC_b.TSC_MoFAirFilgPrdc "Bit encoding / Ok-Tested Since Clear bit for check DFC_MoFAirFilgPrdc" UBYTE DFC_OneToOne 1 100 0.00 1.000 BIT_MASK 0x20 FORMAT "%5.3" ECU_ADDRESS 0x600371DF /end MEASUREMENT
/begin MEASUREMENT DFC_b.TSC_MoFAirFlCtOffGdi "Bit encoding / Ok-Tested Since Clear bit for check DFC_MoFAirFlCtOffGdi" UBYTE DFC_OneToOne 1 100 0.00 1.000 BIT_MASK 0x20 FORMAT "%5.3" ECU_ADDRESS 0x600371E0 /end MEASUREMENT
/begin MEASUREMENT DFC_b.TSC_MoFAirFlCylGdi "Bit encoding / Ok-Tested Since Clear bit for check DFC_MoFAirFlCylGdi" UBYTE DFC_OneToOne 1 100 0.00 1.000 BIT_MASK 0x20 FORMAT "%5.3" ECU_ADDRESS 0x600371E1 /end MEASUREMENT
/begin MEASUREMENT DFC_b.TSC_MoFAirFlFF "Bit encoding / Ok-Tested Since Clear bit for check DFC_MoFAirFlFF" UBYTE DFC_OneToOne 1 100 0.00 1.000 BIT_MASK 0x20 FORMAT "%5.3" ECU_ADDRESS 0x600371E2 /end MEASUREMENT
/begin MEASUREMENT DFC_b.TSC_MoFAirFlIn "Bit encoding / Ok-Tested Since Clear bit for check DFC_MoFAirFlIn" UBYTE DFC_OneToOne 1 100 0.00 1.000 BIT_MASK 0x20 FORMAT "%5.3" ECU_ADDRESS 0x600371E3 /end MEASUREMENT
/begin MEASUREMENT DFC_b.TSC_MoFAirFlMixCtlGdiChkAirFl "Bit encoding / Ok-Tested Since Clear bit for check DFC_MoFAirFlMixCtlGdiChkAirFl" UBYTE DFC_OneToOne 1 100 0.00 1.000 BIT_MASK 0x20 FORMAT "%5.3" ECU_ADDRESS 0x600371E4 /end MEASUREMENT
/begin MEASUREMENT DFC_b.TSC_MoFAirFlMixCtlGdiChkCtrl "Bit encoding / Ok-Tested Since Clear bit for check DFC_MoFAirFlMixCtlGdiChkCtrl" UBYTE DFC_OneToOne 1 100 0.00 1.000 BIT_MASK 0x20 FORMAT "%5.3" ECU_ADDRESS 0x600371E5 /end MEASUREMENT
/begin MEASUREMENT DFC_b.TSC_MoFAirFlMode "Bit encoding / Ok-Tested Since Clear bit for check DFC_MoFAirFlMode" UBYTE DFC_OneToOne 1 100 0.00 1.000 BIT_MASK 0x20 FORMAT "%5.3" ECU_ADDRESS 0x600371E6 /end MEASUREMENT
/begin MEASUREMENT DFC_b.TSC_MoFESpd "Bit encoding / Ok-Tested Since Clear bit for check DFC_MoFESpd" UBYTE DFC_OneToOne 1 100 0.00 1.000 BIT_MASK 0x20 FORMAT "%5.3" ECU_ADDRESS 0x600371E7 /end MEASUREMENT
/begin MEASUREMENT DFC_b.TSC_MoFIACo "Bit encoding / Ok-Tested Since Clear bit for check DFC_MoFIACo" UBYTE DFC_OneToOne 1 100 0.00 1.000 BIT_MASK 0x20 FORMAT "%5.3" ECU_ADDRESS 0x600371E8 /end MEASUREMENT
/begin MEASUREMENT DFC_b.TSC_MoFICOL1 "Bit encoding / Ok-Tested Since Clear bit for check DFC_MoFICOL1" UBYTE DFC_OneToOne 1 100 0.00 1.000 BIT_MASK 0x20 FORMAT "%5.3" ECU_ADDRESS 0x600371E9 /end MEASUREMENT
/begin MEASUREMENT DFC_b.TSC_MoFICOL2 "Bit encoding / Ok-Tested Since Clear bit for check DFC_MoFICOL2" UBYTE DFC_OneToOne 1 100 0.00 1.000 BIT_MASK 0x20 FORMAT "%5.3" ECU_ADDRESS 0x600371EA /end MEASUREMENT
/begin MEASUREMENT DFC_b.TSC_MoFStrt "Bit encoding / Ok-Tested Since Clear bit for check DFC_MoFStrt" UBYTE DFC_OneToOne 1 100 0.00 1.000 BIT_MASK 0x20 FORMAT "%5.3" ECU_ADDRESS 0x600371EB /end MEASUREMENT
/begin MEASUREMENT DFC_b.TSC_MoFTrqCmp "Bit encoding / Ok-Tested Since Clear bit for check DFC_MoFTrqCmp" UBYTE DFC_OneToOne 1 100 0.00 1.000 BIT_MASK 0x20 FORMAT "%5.3" ECU_ADDRESS 0x600371EC /end MEASUREMENT
/begin MEASUREMENT DFC_b.TSC_MoFTrqCmpMax "Bit encoding / Ok-Tested Since Clear bit for check DFC_MoFTrqCmpMax" UBYTE DFC_OneToOne 1 100 0.00 1.000 BIT_MASK 0x20 FORMAT "%5.3" ECU_ADDRESS 0x600371ED /end MEASUREMENT
/begin MEASUREMENT DFC_b.TSC_MoFTrqCmpMin "Bit encoding / Ok-Tested Since Clear bit for check DFC_MoFTrqCmpMin" UBYTE DFC_OneToOne 1 100 0.00 1.000 BIT_MASK 0x20 FORMAT "%5.3" ECU_ADDRESS 0x600371EE /end MEASUREMENT
/begin MEASUREMENT DFC_b.TSC_MoFVarPostBldSel "Bit encoding / Ok-Tested Since Clear bit for check DFC_MoFVarPostBldSel" UBYTE DFC_OneToOne 1 100 0.00 1.000 BIT_MASK 0x20 FORMAT "%5.3" ECU_ADDRESS 0x600371EF /end MEASUREMENT
/begin MEASUREMENT DFC_b.TSC_MoXEMMHwLTMCUFW "Bit encoding / Ok-Tested Since Clear bit for check DFC_MoXEMMHwLTMCUFW" UBYTE DFC_OneToOne 1 100 0.00 1.000 BIT_MASK 0x20 FORMAT "%5.3" ECU_ADDRESS 0x600371F0 /end MEASUREMENT
/begin MEASUREMENT DFC_b.TSC_MoXEMMHwLTMonBIST "Bit encoding / Ok-Tested Since Clear bit for check DFC_MoXEMMHwLTMonBIST" UBYTE DFC_OneToOne 1 100 0.00 1.000 BIT_MASK 0x20 FORMAT "%5.3" ECU_ADDRESS 0x600371F1 /end MEASUREMENT
/begin MEASUREMENT DFC_b.TSC_MoXEMMHwLTRegMonTest "Bit encoding / Ok-Tested Since Clear bit for check DFC_MoXEMMHwLTRegMonTest" UBYTE DFC_OneToOne 1 100 0.00 1.000 BIT_MASK 0x20 FORMAT "%5.3" ECU_ADDRESS 0x600371F2 /end MEASUREMENT
/begin MEASUREMENT DFC_b.TSC_MoXEMMHwLTStbySMUAlvTest "Bit encoding / Ok-Tested Since Clear bit for check DFC_MoXEMMHwLTStbySMUAlvTest" UBYTE DFC_OneToOne 1 100 0.00 1.000 BIT_MASK 0x20 FORMAT "%5.3" ECU_ADDRESS 0x600371F3 /end MEASUREMENT
/begin MEASUREMENT DFC_b.TSC_MoXEMMHwLTTempSens "Bit encoding / Ok-Tested Since Clear bit for check DFC_MoXEMMHwLTTempSens" UBYTE DFC_OneToOne 1 100 0.00 1.000 BIT_MASK 0x20 FORMAT "%5.3" ECU_ADDRESS 0x600371F4 /end MEASUREMENT
/begin MEASUREMENT DFC_b.TSC_MoXEMMHwLTUCBCfg "Bit encoding / Ok-Tested Since Clear bit for check DFC_MoXEMMHwLTUCBCfg" UBYTE DFC_OneToOne 1 100 0.00 1.000 BIT_MASK 0x20 FORMAT "%5.3" ECU_ADDRESS 0x600371F5 /end MEASUREMENT
/begin MEASUREMENT DFC_b.TSC_NWSEmax "Bit encoding / Ok-Tested Since Clear bit for check DFC_NWSEmax" UBYTE DFC_OneToOne 1 100 0.00 1.000 BIT_MASK 0x20 FORMAT "%5.3" ECU_ADDRESS 0x600371F6 /end MEASUREMENT
/begin MEASUREMENT DFC_b.TSC_NWSmax "Bit encoding / Ok-Tested Since Clear bit for check DFC_NWSmax" UBYTE DFC_OneToOne 1 100 0.00 1.000 BIT_MASK 0x20 FORMAT "%5.3" ECU_ADDRESS 0x600371F7 /end MEASUREMENT
/begin MEASUREMENT DFC_b.TSC_OCWDAABEActv "Bit encoding / Ok-Tested Since Clear bit for check DFC_OCWDAABEActv" UBYTE DFC_OneToOne 1 100 0.00 1.000 BIT_MASK 0x20 FORMAT "%5.3" ECU_ADDRESS 0x600371F8 /end MEASUREMENT
/begin MEASUREMENT DFC_b.TSC_OCWDACom "Bit encoding / Ok-Tested Since Clear bit for check DFC_OCWDACom" UBYTE DFC_OneToOne 1 100 0.00 1.000 BIT_MASK 0x20 FORMAT "%5.3" ECU_ADDRESS 0x600371F9 /end MEASUREMENT
/begin MEASUREMENT DFC_b.TSC_OCWDAErrPin "Bit encoding / Ok-Tested Since Clear bit for check DFC_OCWDAErrPin" UBYTE DFC_OneToOne 1 100 0.00 1.000 BIT_MASK 0x20 FORMAT "%5.3" ECU_ADDRESS 0x600371FA /end MEASUREMENT
/begin MEASUREMENT DFC_b.TSC_OCWDAOvrVltg "Bit encoding / Ok-Tested Since Clear bit for check DFC_OCWDAOvrVltg" UBYTE DFC_OneToOne 1 100 0.00 1.000 BIT_MASK 0x20 FORMAT "%5.3" ECU_ADDRESS 0x600371FB /end MEASUREMENT
/begin MEASUREMENT DFC_b.TSC_ORAmax "Bit encoding / Ok-Tested Since Clear bit for check DFC_ORAmax" UBYTE DFC_OneToOne 1 100 0.00 1.000 BIT_MASK 0x20 FORMAT "%5.3" ECU_ADDRESS 0x600371FC /end MEASUREMENT
/begin MEASUREMENT DFC_b.TSC_ORAmin "Bit encoding / Ok-Tested Since Clear bit for check DFC_ORAmin" UBYTE DFC_OneToOne 1 100 0.00 1.000 BIT_MASK 0x20 FORMAT "%5.3" ECU_ADDRESS 0x600371FD /end MEASUREMENT
/begin MEASUREMENT DFC_b.TSC_OilPPlaus "Bit encoding / Ok-Tested Since Clear bit for check DFC_OilPPlaus" UBYTE DFC_OneToOne 1 100 0.00 1.000 BIT_MASK 0x20 FORMAT "%5.3" ECU_ADDRESS 0x600371FE /end MEASUREMENT
/begin MEASUREMENT DFC_b.TSC_PLLSUmax "Bit encoding / Ok-Tested Since Clear bit for check DFC_PLLSUmax" UBYTE DFC_OneToOne 1 100 0.00 1.000 BIT_MASK 0x20 FORMAT "%5.3" ECU_ADDRESS 0x600371FF /end MEASUREMENT
/begin MEASUREMENT DFC_b.TSC_PLLSUmin "Bit encoding / Ok-Tested Since Clear bit for check DFC_PLLSUmin" UBYTE DFC_OneToOne 1 100 0.00 1.000 BIT_MASK 0x20 FORMAT "%5.3" ECU_ADDRESS 0x60037200 /end MEASUREMENT
/begin MEASUREMENT DFC_b.TSC_PSR1max "Bit encoding / Ok-Tested Since Clear bit for check DFC_PSR1max" UBYTE DFC_OneToOne 1 100 0.00 1.000 BIT_MASK 0x20 FORMAT "%5.3" ECU_ADDRESS 0x60037201 /end MEASUREMENT
/begin MEASUREMENT DFC_b.TSC_PSRBmax "Bit encoding / Ok-Tested Since Clear bit for check DFC_PSRBmax" UBYTE DFC_OneToOne 1 100 0.00 1.000 BIT_MASK 0x20 FORMAT "%5.3" ECU_ADDRESS 0x60037202 /end MEASUREMENT
/begin MEASUREMENT DFC_b.TSC_PSRBmin "Bit encoding / Ok-Tested Since Clear bit for check DFC_PSRBmin" UBYTE DFC_OneToOne 1 100 0.00 1.000 BIT_MASK 0x20 FORMAT "%5.3" ECU_ADDRESS 0x60037203 /end MEASUREMENT
/begin MEASUREMENT DFC_b.TSC_PSRPmax "Bit encoding / Ok-Tested Since Clear bit for check DFC_PSRPmax" UBYTE DFC_OneToOne 1 100 0.00 1.000 BIT_MASK 0x20 FORMAT "%5.3" ECU_ADDRESS 0x60037204 /end MEASUREMENT
/begin MEASUREMENT DFC_b.TSC_PSRPmin "Bit encoding / Ok-Tested Since Clear bit for check DFC_PSRPmin" UBYTE DFC_OneToOne 1 100 0.00 1.000 BIT_MASK 0x20 FORMAT "%5.3" ECU_ADDRESS 0x60037205 /end MEASUREMENT
/begin MEASUREMENT DFC_b.TSC_PSRPsig "Bit encoding / Ok-Tested Since Clear bit for check DFC_PSRPsig" UBYTE DFC_OneToOne 1 100 0.00 1.000 BIT_MASK 0x20 FORMAT "%5.3" ECU_ADDRESS 0x60037206 /end MEASUREMENT
/begin MEASUREMENT DFC_b.TSC_PSRmax "Bit encoding / Ok-Tested Since Clear bit for check DFC_PSRmax" UBYTE DFC_OneToOne 1 100 0.00 1.000 BIT_MASK 0x20 FORMAT "%5.3" ECU_ADDRESS 0x60037207 /end MEASUREMENT
/begin MEASUREMENT DFC_b.TSC_PUmax "Bit encoding / Ok-Tested Since Clear bit for check DFC_PUmax" UBYTE DFC_OneToOne 1 100 0.00 1.000 BIT_MASK 0x20 FORMAT "%5.3" ECU_ADDRESS 0x60037208 /end MEASUREMENT
/begin MEASUREMENT DFC_b.TSC_P_VSE11_OL "Bit encoding / Ok-Tested Since Clear bit for check DFC_P_VSE11_OL" UBYTE DFC_OneToOne 1 100 0.00 1.000 BIT_MASK 0x20 FORMAT "%5.3" ECU_ADDRESS 0x60037209 /end MEASUREMENT
/begin MEASUREMENT DFC_b.TSC_P_VSE11_SCB "Bit encoding / Ok-Tested Since Clear bit for check DFC_P_VSE11_SCB" UBYTE DFC_OneToOne 1 100 0.00 1.000 BIT_MASK 0x20 FORMAT "%5.3" ECU_ADDRESS 0x6003720A /end MEASUREMENT
/begin MEASUREMENT DFC_b.TSC_P_VSE11_SCG "Bit encoding / Ok-Tested Since Clear bit for check DFC_P_VSE11_SCG" UBYTE DFC_OneToOne 1 100 0.00 1.000 BIT_MASK 0x20 FORMAT "%5.3" ECU_ADDRESS 0x6003720B /end MEASUREMENT
/begin MEASUREMENT DFC_b.TSC_PhyHighAPP1 "Bit encoding / Ok-Tested Since Clear bit for check DFC_PhyHighAPP1" UBYTE DFC_OneToOne 1 100 0.00 1.000 BIT_MASK 0x20 FORMAT "%5.3" ECU_ADDRESS 0x6003720C /end MEASUREMENT
/begin MEASUREMENT DFC_b.TSC_PhyHighAPP2 "Bit encoding / Ok-Tested Since Clear bit for check DFC_PhyHighAPP2" UBYTE DFC_OneToOne 1 100 0.00 1.000 BIT_MASK 0x20 FORMAT "%5.3" ECU_ADDRESS 0x6003720D /end MEASUREMENT
/begin MEASUREMENT DFC_b.TSC_PhyLowAPP1 "Bit encoding / Ok-Tested Since Clear bit for check DFC_PhyLowAPP1" UBYTE DFC_OneToOne 1 100 0.00 1.000 BIT_MASK 0x20 FORMAT "%5.3" ECU_ADDRESS 0x6003720E /end MEASUREMENT
/begin MEASUREMENT DFC_b.TSC_PhyLowAPP2 "Bit encoding / Ok-Tested Since Clear bit for check DFC_PhyLowAPP2" UBYTE DFC_OneToOne 1 100 0.00 1.000 BIT_MASK 0x20 FORMAT "%5.3" ECU_ADDRESS 0x6003720F /end MEASUREMENT
/begin MEASUREMENT DFC_b.TSC_SRCHighAPP1 "Bit encoding / Ok-Tested Since Clear bit for check DFC_SRCHighAPP1" UBYTE DFC_OneToOne 1 100 0.00 1.000 BIT_MASK 0x20 FORMAT "%5.3" ECU_ADDRESS 0x60037210 /end MEASUREMENT
/begin MEASUREMENT DFC_b.TSC_SRCHighAPP2 "Bit encoding / Ok-Tested Since Clear bit for check DFC_SRCHighAPP2" UBYTE DFC_OneToOne 1 100 0.00 1.000 BIT_MASK 0x20 FORMAT "%5.3" ECU_ADDRESS 0x60037211 /end MEASUREMENT
/begin MEASUREMENT DFC_b.TSC_SRCLowAPP1 "Bit encoding / Ok-Tested Since Clear bit for check DFC_SRCLowAPP1" UBYTE DFC_OneToOne 1 100 0.00 1.000 BIT_MASK 0x20 FORMAT "%5.3" ECU_ADDRESS 0x60037212 /end MEASUREMENT
/begin MEASUREMENT DFC_b.TSC_SRCLowAPP2 "Bit encoding / Ok-Tested Since Clear bit for check DFC_SRCLowAPP2" UBYTE DFC_OneToOne 1 100 0.00 1.000 BIT_MASK 0x20 FORMAT "%5.3" ECU_ADDRESS 0x60037213 /end MEASUREMENT
/begin MEASUREMENT DFC_b.TSC_SSpMon2 "Bit encoding / Ok-Tested Since Clear bit for check DFC_SSpMon2" UBYTE DFC_OneToOne 1 100 0.00 1.000 BIT_MASK 0x20 FORMAT "%5.3" ECU_ADDRESS 0x60037214 /end MEASUREMENT
/begin MEASUREMENT DFC_b.TSC_STHDRmax "Bit encoding / Ok-Tested Since Clear bit for check DFC_STHDRmax" UBYTE DFC_OneToOne 1 100 0.00 1.000 BIT_MASK 0x20 FORMAT "%5.3" ECU_ADDRESS 0x60037215 /end MEASUREMENT
/begin MEASUREMENT DFC_b.TSC_SWReset_0 "Bit encoding / Ok-Tested Since Clear bit for check DFC_SWReset_0" UBYTE DFC_OneToOne 1 100 0.00 1.000 BIT_MASK 0x20 FORMAT "%5.3" ECU_ADDRESS 0x60037216 /end MEASUREMENT
/begin MEASUREMENT DFC_b.TSC_SWReset_1 "Bit encoding / Ok-Tested Since Clear bit for check DFC_SWReset_1" UBYTE DFC_OneToOne 1 100 0.00 1.000 BIT_MASK 0x20 FORMAT "%5.3" ECU_ADDRESS 0x60037217 /end MEASUREMENT
/begin MEASUREMENT DFC_b.TSC_SWReset_2 "Bit encoding / Ok-Tested Since Clear bit for check DFC_SWReset_2" UBYTE DFC_OneToOne 1 100 0.00 1.000 BIT_MASK 0x20 FORMAT "%5.3" ECU_ADDRESS 0x60037218 /end MEASUREMENT
/begin MEASUREMENT DFC_b.TSC_SyncAPP "Bit encoding / Ok-Tested Since Clear bit for check DFC_SyncAPP" UBYTE DFC_OneToOne 1 100 0.00 1.000 BIT_MASK 0x20 FORMAT "%5.3" ECU_ADDRESS 0x60037219 /end MEASUREMENT
/begin MEASUREMENT DFC_b.TSC_TANKLnpl "Bit encoding / Ok-Tested Since Clear bit for check DFC_TANKLnpl" UBYTE DFC_OneToOne 1 100 0.00 1.000 BIT_MASK 0x20 FORMAT "%5.3" ECU_ADDRESS 0x6003721A /end MEASUREMENT
/begin MEASUREMENT DFC_b.TSC_TAmax_Dummy "Bit encoding / Ok-Tested Since Clear bit for check DFC_TAmax_Dummy" UBYTE DFC_OneToOne 1 100 0.00 1.000 BIT_MASK 0x20 FORMAT "%5.3" ECU_ADDRESS 0x6003721B /end MEASUREMENT
/begin MEASUREMENT DFC_b.TSC_TESFmax "Bit encoding / Ok-Tested Since Clear bit for check DFC_TESFmax" UBYTE DFC_OneToOne 1 100 0.00 1.000 BIT_MASK 0x20 FORMAT "%5.3" ECU_ADDRESS 0x6003721C /end MEASUREMENT
/begin MEASUREMENT DFC_b.TSC_TESGmax "Bit encoding / Ok-Tested Since Clear bit for check DFC_TESGmax" UBYTE DFC_OneToOne 1 100 0.00 1.000 BIT_MASK 0x20 FORMAT "%5.3" ECU_ADDRESS 0x6003721D /end MEASUREMENT
/begin MEASUREMENT DFC_b.TSC_TKAEmax "Bit encoding / Ok-Tested Since Clear bit for check DFC_TKAEmax" UBYTE DFC_OneToOne 1 100 0.00 1.000 BIT_MASK 0x20 FORMAT "%5.3" ECU_ADDRESS 0x6003721E /end MEASUREMENT
/begin MEASUREMENT DFC_b.TSC_TKAEmin "Bit encoding / Ok-Tested Since Clear bit for check DFC_TKAEmin" UBYTE DFC_OneToOne 1 100 0.00 1.000 BIT_MASK 0x20 FORMAT "%5.3" ECU_ADDRESS 0x6003721F /end MEASUREMENT
/begin MEASUREMENT DFC_b.TSC_TKARmax "Bit encoding / Ok-Tested Since Clear bit for check DFC_TKARmax" UBYTE DFC_OneToOne 1 100 0.00 1.000 BIT_MASK 0x20 FORMAT "%5.3" ECU_ADDRESS 0x60037220 /end MEASUREMENT
/begin MEASUREMENT DFC_b.TSC_TKARnpl "Bit encoding / Ok-Tested Since Clear bit for check DFC_TKARnpl" UBYTE DFC_OneToOne 1 100 0.00 1.000 BIT_MASK 0x20 FORMAT "%5.3" ECU_ADDRESS 0x60037221 /end MEASUREMENT
/begin MEASUREMENT DFC_b.TSC_TMmax_Dummy "Bit encoding / Ok-Tested Since Clear bit for check DFC_TMmax_Dummy" UBYTE DFC_OneToOne 1 100 0.00 1.000 BIT_MASK 0x20 FORMAT "%5.3" ECU_ADDRESS 0x60037222 /end MEASUREMENT
/begin MEASUREMENT DFC_b.TSC_TUMmax_Dummy "Bit encoding / Ok-Tested Since Clear bit for check DFC_TUMmax_Dummy" UBYTE DFC_OneToOne 1 100 0.00 1.000 BIT_MASK 0x20 FORMAT "%5.3" ECU_ADDRESS 0x60037223 /end MEASUREMENT
/begin MEASUREMENT DFC_b.TSC_TWCDPriCatB1 "Bit encoding / Ok-Tested Since Clear bit for check DFC_TWCDPriCatB1" UBYTE DFC_OneToOne 1 100 0.00 1.000 BIT_MASK 0x20 FORMAT "%5.3" ECU_ADDRESS 0x60037224 /end MEASUREMENT
/begin MEASUREMENT DFC_b.TSC_ThrVlvClsdPosnFirstOffsLrnImpoB1 "Bit encoding / Ok-Tested Since Clear bit for check DFC_ThrVlvClsdPosnFirstOffsLrnImpoB1" UBYTE DFC_OneToOne 1 100 0.00 1.000 BIT_MASK 0x20 FORMAT "%5.3" ECU_ADDRESS 0x60037225 /end MEASUREMENT
/begin MEASUREMENT DFC_b.TSC_ThrVlvClsdPosnOffsLrnImpoB1 "Bit encoding / Ok-Tested Since Clear bit for check DFC_ThrVlvClsdPosnOffsLrnImpoB1" UBYTE DFC_OneToOne 1 100 0.00 1.000 BIT_MASK 0x20 FORMAT "%5.3" ECU_ADDRESS 0x60037226 /end MEASUREMENT
/begin MEASUREMENT DFC_b.TSC_ThrVlvClsdPosnOffsLrnMaxB1 "Bit encoding / Ok-Tested Since Clear bit for check DFC_ThrVlvClsdPosnOffsLrnMaxB1" UBYTE DFC_OneToOne 1 100 0.00 1.000 BIT_MASK 0x20 FORMAT "%5.3" ECU_ADDRESS 0x60037227 /end MEASUREMENT
/begin MEASUREMENT DFC_b.TSC_ThrVlvClsdPosnOffsLrnMinB1 "Bit encoding / Ok-Tested Since Clear bit for check DFC_ThrVlvClsdPosnOffsLrnMinB1" UBYTE DFC_OneToOne 1 100 0.00 1.000 BIT_MASK 0x20 FORMAT "%5.3" ECU_ADDRESS 0x60037228 /end MEASUREMENT
/begin MEASUREMENT DFC_b.TSC_ThrVlvCtrlDeB1 "Bit encoding / Ok-Tested Since Clear bit for check DFC_ThrVlvCtrlDeB1" UBYTE DFC_OneToOne 1 100 0.00 1.000 BIT_MASK 0x20 FORMAT "%5.3" ECU_ADDRESS 0x60037229 /end MEASUREMENT
/begin MEASUREMENT DFC_b.TSC_ThrVlvDycB1 "Bit encoding / Ok-Tested Since Clear bit for check DFC_ThrVlvDycB1" UBYTE DFC_OneToOne 1 100 0.00 1.000 BIT_MASK 0x20 FORMAT "%5.3" ECU_ADDRESS 0x6003722A /end MEASUREMENT
/begin MEASUREMENT DFC_b.TSC_ThrVlvLimpAirPosnMaxAbsltDriftB1 "Bit encoding / Ok-Tested Since Clear bit for check DFC_ThrVlvLimpAirPosnMaxAbsltDriftB1" UBYTE DFC_OneToOne 1 100 0.00 1.000 BIT_MASK 0x20 FORMAT "%5.3" ECU_ADDRESS 0x6003722B /end MEASUREMENT
/begin MEASUREMENT DFC_b.TSC_ThrVlvLimpAirPosnMaxB1 "Bit encoding / Ok-Tested Since Clear bit for check DFC_ThrVlvLimpAirPosnMaxB1" UBYTE DFC_OneToOne 1 100 0.00 1.000 BIT_MASK 0x20 FORMAT "%5.3" ECU_ADDRESS 0x6003722C /end MEASUREMENT
/begin MEASUREMENT DFC_b.TSC_ThrVlvLimpAirPosnMaxRelDriftB1 "Bit encoding / Ok-Tested Since Clear bit for check DFC_ThrVlvLimpAirPosnMaxRelDriftB1" UBYTE DFC_OneToOne 1 100 0.00 1.000 BIT_MASK 0x20 FORMAT "%5.3" ECU_ADDRESS 0x6003722D /end MEASUREMENT
/begin MEASUREMENT DFC_b.TSC_ThrVlvLimpAirPosnMinB1 "Bit encoding / Ok-Tested Since Clear bit for check DFC_ThrVlvLimpAirPosnMinB1" UBYTE DFC_OneToOne 1 100 0.00 1.000 BIT_MASK 0x20 FORMAT "%5.3" ECU_ADDRESS 0x6003722E /end MEASUREMENT
/begin MEASUREMENT DFC_b.TSC_ThrVlvOpenLoadB1 "Bit encoding / Ok-Tested Since Clear bit for check DFC_ThrVlvOpenLoadB1" UBYTE DFC_OneToOne 1 100 0.00 1.000 BIT_MASK 0x20 FORMAT "%5.3" ECU_ADDRESS 0x6003722F /end MEASUREMENT
/begin MEASUREMENT DFC_b.TSC_ThrVlvOpenSprgB1 "Bit encoding / Ok-Tested Since Clear bit for check DFC_ThrVlvOpenSprgB1" UBYTE DFC_OneToOne 1 100 0.00 1.000 BIT_MASK 0x20 FORMAT "%5.3" ECU_ADDRESS 0x60037230 /end MEASUREMENT
/begin MEASUREMENT DFC_b.TSC_ThrVlvOpenSprgSprdB1 "Bit encoding / Ok-Tested Since Clear bit for check DFC_ThrVlvOpenSprgSprdB1" UBYTE DFC_OneToOne 1 100 0.00 1.000 BIT_MASK 0x20 FORMAT "%5.3" ECU_ADDRESS 0x60037231 /end MEASUREMENT
/begin MEASUREMENT DFC_b.TSC_ThrVlvOpenSprgTwnB1 "Bit encoding / Ok-Tested Since Clear bit for check DFC_ThrVlvOpenSprgTwnB1" UBYTE DFC_OneToOne 1 100 0.00 1.000 BIT_MASK 0x20 FORMAT "%5.3" ECU_ADDRESS 0x60037232 /end MEASUREMENT
/begin MEASUREMENT DFC_b.TSC_ThrVlvOverTB1 "Bit encoding / Ok-Tested Since Clear bit for check DFC_ThrVlvOverTB1" UBYTE DFC_OneToOne 1 100 0.00 1.000 BIT_MASK 0x20 FORMAT "%5.3" ECU_ADDRESS 0x60037233 /end MEASUREMENT
/begin MEASUREMENT DFC_b.TSC_ThrVlvRetSprgB1 "Bit encoding / Ok-Tested Since Clear bit for check DFC_ThrVlvRetSprgB1" UBYTE DFC_OneToOne 1 100 0.00 1.000 BIT_MASK 0x20 FORMAT "%5.3" ECU_ADDRESS 0x60037234 /end MEASUREMENT
/begin FUNCTION DFC "30000.33.0_1.1.0Diagnostic Fault Check"
 /begin OUT_MEASUREMENT DFC_b.TSC_ComEATATOut DFC_b.TSC_ComEATBChkSum DFC_b.TSC_ComEATBRingCnt DFC_b.TSC_ComEATBTOut DFC_b.TSC_ComEATCChksum DFC_b.TSC_ComEATCRingCnt DFC_b.TSC_ComEATCTOut DFC_b.TSC_ComEPBBChkSum DFC_b.TSC_ComEPBBRingCnt DFC_b.TSC_ComEPBBTOut DFC_b.TSC_ComEPBChksum DFC_b.TSC_ComEPBTOut DFC_b.TSC_ComEPBctRing DFC_b.TSC_ComEPS1Chksum DFC_b.TSC_ComEPS1RingCnt DFC_b.TSC_ComEPS1TOut DFC_b.TSC_ComEngCanRxErr DFC_b.TSC_ComGrvySnsrErr DFC_b.TSC_ComGwIMG1ChkSum DFC_b.TSC_ComGwIMG1RingCnt DFC_b.TSC_ComGwIMG1TOut DFC_b.TSC_ComGwIMG3ChkSum DFC_b.TSC_ComGwIMG3RingCnt DFC_b.TSC_ComGwIMG3TOut DFC_b.TSC_ComGwIMG4ChkSum DFC_b.TSC_ComGwIMG4RingCnt DFC_b.TSC_ComGwIMG4TOut DFC_b.TSC_ComGwIMG5ChkSum DFC_b.TSC_ComGwIMG5RingCnt DFC_b.TSC_ComGwIMG5TOut DFC_b.TSC_ComGwIMG6ChkSum DFC_b.TSC_ComGwIMG6RingCnt DFC_b.TSC_ComGwIMG6TOut DFC_b.TSC_ComIDASBChksum DFC_b.TSC_ComIDASBRingCnt DFC_b.TSC_ComIDASBTOut DFC_b.TSC_ComIMGMILReq DFC_b.TSC_ComISSPrms DFC_b.TSC_ComMETAChksum DFC_b.TSC_ComMETAChksumPstDrv DFC_b.TSC_ComMETARingCnt DFC_b.TSC_ComMETARingCntPstDrv DFC_b.TSC_ComMETATOut DFC_b.TSC_ComMETATOutPstDrv DFC_b.TSC_ComMETCChksum DFC_b.TSC_ComMETCRingCnt DFC_b.TSC_ComMETCTOut DFC_b.TSC_ComMETDChksum DFC_b.TSC_ComMETDRingCnt DFC_b.TSC_ComMETDTOut DFC_b.TSC_ComMETE2Chksum DFC_b.TSC_ComMETE2RingCnt DFC_b.TSC_ComMETE2TOut DFC_b.TSC_ComMETFChksum DFC_b.TSC_ComMETFRingCnt DFC_b.TSC_ComMETFTOut DFC_b.TSC_ComMETGChksum DFC_b.TSC_ComMETGRingCnt DFC_b.TSC_ComMETGTOut DFC_b.TSC_ComMETH2Chksum DFC_b.TSC_ComMETH2RingCnt DFC_b.TSC_ComMETH2TOut DFC_b.TSC_ComMETHChksum DFC_b.TSC_ComMETHRingCnt DFC_b.TSC_ComMETHTOut DFC_b.TSC_ComMETIChksum DFC_b.TSC_ComMETIRingCnt DFC_b.TSC_ComMETITOut DFC_b.TSC_ComMETKChksum DFC_b.TSC_ComMETKRingCnt DFC_b.TSC_ComMETKTOut DFC_b.TSC_ComMETLChksum DFC_b.TSC_ComMETLRingCnt DFC_b.TSC_ComMETLTOut DFC_b.TSC_ComMETMChksum DFC_b.TSC_ComMETMRingCnt DFC_b.TSC_ComMETMTOut DFC_b.TSC_ComMETNChksum DFC_b.TSC_ComMETNRingCnt DFC_b.TSC_ComMETNTOut DFC_b.TSC_ComMtrCom DFC_b.TSC_ComPCUChkSum DFC_b.TSC_ComPCURingCnt DFC_b.TSC_ComPCUTOut DFC_b.TSC_ComSRSAChksum DFC_b.TSC_ComSRSARingCnt DFC_b.TSC_ComSRSATOut DFC_b.TSC_ComSRSBChksum DFC_b.TSC_ComSRSBRingCnt DFC_b.TSC_ComSRSBTOut DFC_b.TSC_ComSRSChksum DFC_b.TSC_ComSRSErr DFC_b.TSC_ComSRSRingCnt DFC_b.TSC_ComSRSTOut DFC_b.TSC_ComVehSpdPndFltTCU DFC_b.TSC_EbsChartcCurrErr DFC_b.TSC_EbsSelfDiagErr DFC_b.TSC_GEVlvPhaCsersIntkB1 DFC_b.TSC_GEVlvPhaPsOpenLoadIntkB1 DFC_b.TSC_GEVlvPhaPsShoToBattIntkB1 DFC_b.TSC_GEVlvPhaPsShoToGndIntkB1 DFC_b.TSC_GbxCANDigPlausErr DFC_b.TSC_GbxNPos1SRCMax DFC_b.TSC_GbxNPos1SRCMin DFC_b.TSC_GbxNPos2SRCMax DFC_b.TSC_GbxNPos2SRCMin DFC_b.TSC_GbxNPosAlvChk DFC_b.TSC_GbxNPosSyncErr DFC_b.TSC_HEGOS2B1HtrPsMax DFC_b.TSC_HEGOS2B1HtrPsMin DFC_b.TSC_HEGOS2B1HtrPsSig DFC_b.TSC_LinCSErrACG DFC_b.TSC_LinCSErrAEV DFC_b.TSC_LinCSErrDCDC DFC_b.TSC_LinCSErrEBS DFC_b.TSC_LinHdrTimeoutErrACG DFC_b.TSC_LinHdrTimeoutErrAEV DFC_b.TSC_LinHdrTimeoutErrDCDC DFC_b.TSC_LinHdrTimeoutErrEBS DFC_b.TSC_LinMsgTimeoutErrACG DFC_b.TSC_LinMsgTimeoutErrAEV DFC_b.TSC_LinMsgTimeoutErrDCDC DFC_b.TSC_LinMsgTimeoutErrEBS DFC_b.TSC_LinNoStrtComErr DFC_b.TSC_LowPresOilP DFC_b.TSC_MisfDetVWhlFrntLeOORHi DFC_b.TSC_MisfDetVWhlFrntLeRatyHi DFC_b.TSC_MisfDetVWhlFrntLeRatyLo DFC_b.TSC_MisfDetVWhlFrntLeStuck DFC_b.TSC_MisfDetVWhlFrntRiOORHi DFC_b.TSC_MisfDetVWhlFrntRiRatyHi DFC_b.TSC_MisfDetVWhlFrntRiRatyLo DFC_b.TSC_MisfDetVWhlFrntRiStuck DFC_b.TSC_MisfDetVWhlReLeOORHi DFC_b.TSC_MisfDetVWhlReLeRatyHi DFC_b.TSC_MisfDetVWhlReLeRatyLo DFC_b.TSC_MisfDetVWhlReLeStuck DFC_b.TSC_MisfDetVWhlReRiOORHi DFC_b.TSC_MisfDetVWhlReRiRatyHi DFC_b.TSC_MisfDetVWhlReRiRatyLo DFC_b.TSC_MisfDetVWhlReRiStuck DFC_b.TSC_MisfDetdVWhlFrntLePlaus DFC_b.TSC_MisfDetdVWhlFrntRiPlaus DFC_b.TSC_MisfDetdVWhlReLePlaus DFC_b.TSC_MisfDetdVWhlReRiPlaus DFC_b.TSC_PEnvSigRngMax DFC_b.TSC_PEnvSigRngMin DFC_b.TSC_StmFault DFC_b.TSC_StrtCtOffPth DFC_b.TSC_StrtCtlErr DFC_b.TSC_StrtFault DFC_b.TSC_StrtLckJudg1 DFC_b.TSC_StrtLckJudg2 DFC_b.TSC_StrtOL DFC_b.TSC_StrtOL2 DFC_b.TSC_StrtSCB DFC_b.TSC_StrtSCB2 DFC_b.TSC_StrtSCG DFC_b.TSC_StrtSCG2 DFC_b.TSC_StrtStkRly1 DFC_b.TSC_StrtStkRly2 DFC_b.TSC_TEVEmax DFC_b.TSC_TEVEmin DFC_b.TSC_TEVEsig DFC_b.TSC_UegoHeatrPrfmncLoS1B1 DFC_b.TSC_VehVAllPlaus DFC_b.TSC_VehVNCSnsrElecFailr DFC_b.TSC_VehVPlausCan DFC_b.TSC_VehVPlausFco DFC_b.TSC_VehVPlausPwr DFC_b.TSC_VehVPlausV2N DFC_b.TSC_VehVSpdSnsrAElecFailr DFC_b.TSC_VehVSpdSnsrBElecFailr DFC_b.TSC_ClthMax DFC_b.TSC_IgnClPs_DevComErr DFC_b.TSC_IgnClPs_LineOl_0 DFC_b.TSC_IgnClPs_LineOl_1 DFC_b.TSC_IgnClPs_LineOl_2 DFC_b.TSC_IgnClPs_LineOl_3 DFC_b.TSC_IgnClPs_LineScb_0 DFC_b.TSC_IgnClPs_LineScb_1 DFC_b.TSC_IgnClPs_LineScb_2 DFC_b.TSC_IgnClPs_LineScb_3 DFC_b.TSC_IgnClPs_LineScg_0 DFC_b.TSC_IgnClPs_LineScg_1 DFC_b.TSC_IgnClPs_LineScg_2 DFC_b.TSC_IgnClPs_LineScg_3 DFC_b.TSC_KRVEKOEVAB DFC_b.TSC_KRVEKOEVAB0 DFC_b.TSC_KRVEKOEVAB1 DFC_b.TSC_KRVEKOEVAB2 DFC_b.TSC_KRVEKOEVAB3 DFC_b.TSC_UegoSigEcuAsicS1B1 DFC_b.TSC_UegoSigEcuComS1B1 DFC_b.TSC_UegoSigSnsrS1B1 DFC_b.TSC_UegoSigWireOlApesS1B1 DFC_b.TSC_UegoSigWireOlIpeS1B1 DFC_b.TSC_UegoSigWireOlReS1B1 DFC_b.TSC_UegoSigWireRCmpS1B1 DFC_b.TSC_UegoSigWireScbS1B1 DFC_b.TSC_UegoSigWireScgS1B1 DFC_b.TSC_AfsPhyRngHiB1 DFC_b.TSC_AfsPhyRngLoB1 DFC_b.TSC_AirCCmprOL DFC_b.TSC_AirCCmprOvrTemp DFC_b.TSC_AirCCmprSCB DFC_b.TSC_AirCCmprSCG DFC_b.TSC_AltErr DFC_b.TSC_BattUSRCMax DFC_b.TSC_BattUSRCMin DFC_b.TSC_ComChksTCU1 DFC_b.TSC_ComChksTCU11 DFC_b.TSC_ComChksTCU12 DFC_b.TSC_ComChksTCU13 DFC_b.TSC_ComChksTCU2 DFC_b.TSC_ComChksTCU3 DFC_b.TSC_ComChksTCU4 DFC_b.TSC_ComCntTCU1 DFC_b.TSC_ComCntTCU11 DFC_b.TSC_ComCntTCU12 DFC_b.TSC_ComCntTCU13 DFC_b.TSC_ComCntTCU2 DFC_b.TSC_ComCntTCU3 DFC_b.TSC_ComCntTCU4 DFC_b.TSC_ComTOutTCU01 DFC_b.TSC_ComTOutTCU02 DFC_b.TSC_ComTOutTCU1 DFC_b.TSC_ComTOutTCU11 DFC_b.TSC_ComTOutTCU12 DFC_b.TSC_ComTOutTCU13 DFC_b.TSC_ComTOutTCU14 DFC_b.TSC_ComTOutTCU2 DFC_b.TSC_ComTOutTCU3 DFC_b.TSC_ComTOutTCU4 DFC_b.TSC_DevLibBattUHi DFC_b.TSC_DevLibBattULo DFC_b.TSC_EGRVlvFailSafeActv DFC_b.TSC_EGRVlvGovDvtCld DFC_b.TSC_EGRVlvPhysSRCMax DFC_b.TSC_EGRVlvPhysSRCMin DFC_b.TSC_FanDIOOL_0 DFC_b.TSC_FanDIOOL_1 DFC_b.TSC_FanDIOOvrTemp_0 DFC_b.TSC_FanDIOOvrTemp_1 DFC_b.TSC_FanDIOSCB_0 DFC_b.TSC_FanDIOSCB_1 DFC_b.TSC_FanDIOSCG_0 DFC_b.TSC_FanDIOSCG_1 DFC_b.TSC_MRlyDcOL DFC_b.TSC_MRlyDcSCB DFC_b.TSC_MRlyDcSCG DFC_b.TSC_PSPOL DFC_b.TSC_PSPOvrTemp DFC_b.TSC_PSPSCB DFC_b.TSC_PSPSCG DFC_b.TSC_T50Err DFC_b.TSC_ThrVlvLoBattB1 DFC_b.TSC_UegoSigOperPlausS1B1 DFC_b.TSC_VehVPhysRngHi DFC_b.TSC_VehVSclOutOL DFC_b.TSC_VehVSclOutOT DFC_b.TSC_VehVSclOutSCB DFC_b.TSC_VehVSclOutSCG DFC_b.TSC_VehVSigFL DFC_b.TSC_VehVSigFR DFC_b.TSC_VehVSigRL DFC_b.TSC_VehVSigRR DFC_b.TSC_VehVSnsrARngHi DFC_b.TSC_VehVSnsrBRngHi DFC_b.TSC_VehVSpdRtyDiag DFC_b.TSC_DHFHD DFC_b.TSC_InjVlv_DI_DcDc DFC_b.TSC_InjVlv_DI_NoLd_0 DFC_b.TSC_InjVlv_DI_NoLd_1 DFC_b.TSC_InjVlv_DI_NoLd_2 DFC_b.TSC_InjVlv_DI_NoLd_3 DFC_b.TSC_InjVlv_DI_ScBnk_0 DFC_b.TSC_InjVlv_DI_ScBnk_1 DFC_b.TSC_InjVlv_DI_ScBnk_2 DFC_b.TSC_InjVlv_DI_ScBnk_3 DFC_b.TSC_InjVlv_DI_ScCyl_0 DFC_b.TSC_InjVlv_DI_ScCyl_1 DFC_b.TSC_InjVlv_DI_ScCyl_2 DFC_b.TSC_InjVlv_DI_ScCyl_3 DFC_b.TSC_InjVlv_DI_ScHsLs_0 DFC_b.TSC_InjVlv_DI_ScHsLs_1 DFC_b.TSC_InjVlv_DI_ScHsLs_2 DFC_b.TSC_InjVlv_DI_ScHsLs_3 DFC_b.TSC_MfPsDiaOpenLoad1 DFC_b.TSC_MfPsDiaScHiS1 DFC_b.TSC_MfPsDiaScHiSLowS1 DFC_b.TSC_MfPsDiaScLowS1 DFC_b.TSC_ACEvpTPhysRngHi DFC_b.TSC_ACEvpTPhysRngLo DFC_b.TSC_ACEvpTSRCMax DFC_b.TSC_ACEvpTSRCMin DFC_b.TSC_AfsRawSigRngHiB1 DFC_b.TSC_AfsRawSigRngLoB1 DFC_b.TSC_AfsSnsrErrB1 DFC_b.TSC_AirCClntPAnaSRCMax DFC_b.TSC_AirCClntPAnaSRCMin DFC_b.TSC_AirCSwtNpl DFC_b.TSC_AirCSwtSig DFC_b.TSC_Brk DFC_b.TSC_BrkBstSensSCB DFC_b.TSC_BrkBstSensSCG DFC_b.TSC_BrkSig DFC_b.TSC_ClthSig DFC_b.TSC_EGRVlvCurrLim DFC_b.TSC_EGRVlvOL DFC_b.TSC_EGRVlvOvrTemp DFC_b.TSC_EGRVlvSCB DFC_b.TSC_EGRVlvSCG DFC_b.TSC_EGRVlvSRCMax DFC_b.TSC_EGRVlvSRCMin DFC_b.TSC_HLSDemOvhtEngLim DFC_b.TSC_OilPSwmpSRCMax DFC_b.TSC_OilPSwmpSRCMin DFC_b.TSC_PIntkVUsLineHiB1 DFC_b.TSC_PIntkVUsLineLoB1 DFC_b.TSC_VehVPhysRngLo DFC_b.TSC_VehVSigCan DFC_b.TSC_VehVSigCanSafe DFC_b.TSC_VlvLftFbOilPSnsrIntk11SRCMax DFC_b.TSC_VlvLftFbOilPSnsrIntk11SRCMin DFC_b.TSC_ClthNpl DFC_b.TSC_GbxPNPosnDrvCdn DFC_b.TSC_GbxPNPosnPlausy DFC_b.TSC_AfsSigErrLineHiB1 DFC_b.TSC_AfsSigErrLineLoB1 DFC_b.TSC_PEnvCcMax DFC_b.TSC_PEnvCcMin DFC_b.TSC_PEnvRngChkMax DFC_b.TSC_PEnvRngChkMin DFC_b.TSC_PEnvSnsrPlaus DFC_b.TSC_UEGOHeatrRlyPsOLS1B1 DFC_b.TSC_UEGOHeatrRlyPsSCBS1B1 DFC_b.TSC_UEGOHeatrRlyPsSCGS1B1 DFC_b.TSC_UegoHeatrWireOlS1B1 DFC_b.TSC_UegoHeatrWireScbS1B1 DFC_b.TSC_UegoHeatrWireScgS1B1 DFC_b.TSC_KnDetSens1PortAMax DFC_b.TSC_KnDetSens1PortAMin DFC_b.TSC_KnDetSens1PortBMax DFC_b.TSC_KnDetSens1PortBMin DFC_b.TSC_Clth2ONStuck DFC_b.TSC_Clth2ONStuckLdc DFC_b.TSC_Clth3ONStuckLdc DFC_b.TSC_Clth3ONStuckPostDrv DFC_b.TSC_Clth4ONStuck DFC_b.TSC_Clth4ONStuckLdc DFC_b.TSC_ComBCMUnit DFC_b.TSC_ComDLCTCU01 DFC_b.TSC_ComDLCTCU02 DFC_b.TSC_ComDLCTCU1 DFC_b.TSC_ComDLCTCU11 DFC_b.TSC_ComDLCTCU12 DFC_b.TSC_ComDLCTCU13 DFC_b.TSC_ComDLCTCU14 DFC_b.TSC_ComDLCTCU2 DFC_b.TSC_ComDLCTCU3 DFC_b.TSC_ComDLCTCU4 DFC_b.TSC_ComEPSUnit DFC_b.TSC_ComIDASBUnit DFC_b.TSC_ComIMGUnit DFC_b.TSC_ComMETUnit DFC_b.TSC_ComSRSUnit DFC_b.TSC_ComVSAUnit DFC_b.TSC_EbsSocFlt DFC_b.TSC_I14229VINErr DFC_b.TSC_InjCatHeatgErr DFC_b.TSC_InjSysMulInjDiagErr DFC_b.TSC_LLRHmax DFC_b.TSC_LLRHmin DFC_b.TSC_LLRHnpl DFC_b.TSC_LLRKHmax DFC_b.TSC_LLRKHmin DFC_b.TSC_LLRKHnpl DFC_b.TSC_LinACGUnit DFC_b.TSC_LinAEVUnit DFC_b.TSC_LinEBSUnit DFC_b.TSC_RoughRoad DFC_b.TSC_SiaEEPRdErr DFC_b.TSC_SiaEEPWrngCod DFC_b.TSC_UegoHeatrStrtS1B1 DFC_b.TSC_BusDiagCANAPPLBusOff DFC_b.TSC_BusDiagCANCANCBusOff DFC_b.TSC_BusDiagCANVEHICLEBusOff DFC_b.TSC_RBA_IODIAGPWR_rba_IoExtCy329_SignalVltSply_0 DFC_b.TSC_RBA_IODIAGPWR_rba_IoExtCy329_SignalVltSply_0OT DFC_b.TSC_RBA_IODIAGPWR_rba_IoExtCy329_SignalVltSply_0OV DFC_b.TSC_RBA_IODIAGPWR_rba_IoExtCy329_SignalVltSply_0SCG DFC_b.TSC_RBA_IODIAGPWR_rba_IoExtCy329_SignalVltSply_0UV DFC_b.TSC_RBA_IODIAGPWR_rba_IoExtCy329_SignalVltSply_1 DFC_b.TSC_RBA_IODIAGPWR_rba_IoExtCy329_SignalVltSply_1OT DFC_b.TSC_RBA_IODIAGPWR_rba_IoExtCy329_SignalVltSply_1OV DFC_b.TSC_RBA_IODIAGPWR_rba_IoExtCy329_SignalVltSply_1SCG DFC_b.TSC_RBA_IODIAGPWR_rba_IoExtCy329_SignalVltSply_1UV DFC_b.TSC_RBA_IODIAGPWR_rba_IoExtCy329_SignalVltSply_2 DFC_b.TSC_RBA_IODIAGPWR_rba_IoExtCy329_SignalVltSply_2OT DFC_b.TSC_RBA_IODIAGPWR_rba_IoExtCy329_SignalVltSply_2OV DFC_b.TSC_RBA_IODIAGPWR_rba_IoExtCy329_SignalVltSply_2SCG DFC_b.TSC_RBA_IODIAGPWR_rba_IoExtCy329_SignalVltSply_2UV DFC_b.TSC_CAN_E_TIMEOUT DFC_b.TSC_LIN_E_TIMEOUT DFC_b.TSC_MRlyOL DFC_b.TSC_MRlySCB DFC_b.TSC_MRlySCG DFC_b.TSC_rba_MultiStackTrace_Threshold DFC_b.TSC_BSWM_E_ACTION_FAILED DFC_b.TSC_BSWM_E_INTRPTQUEUE_FULL DFC_b.TSC_RBA_IOEXTLIB_KEEPALIVE_DRV DFC_b.TSC_RBA_IOEXTLIB_KEEPALIVE_INI DFC_b.TSC_rba_IoSigRtc_StopCounter DFC_b.TSC_rba_MRly_Diag_Stk_Event DFC_b.TSC_rba_MemDiag_MemReadErr DFC_b.TSC_rba_MemDiag_MemWrErr DFC_b.TSC_rba_SyC_IrrSwOffTrigEngRun_Event DFC_b.TSC_rba_T15_Diag_ComInVld_Event DFC_b.TSC_rba_T15_Diag_ComOff_HwOn_Event DFC_b.TSC_rba_T15_Diag_ComOn_HwOff_Event DFC_b.TSC_AAVmin DFC_b.TSC_AGRSUS DFC_b.TSC_AfsPlausDiagHi DFC_b.TSC_AfsPlausDiagLo DFC_b.TSC_AfsVrntDiagErrB1 DFC_b.TSC_AppAllSnsrDfct DFC_b.TSC_BBKRnldg DFC_b.TSC_BBKRsyne DFC_b.TSC_BattUStdbyDiaOL DFC_b.TSC_BigLeakIntkMnfldEmiInfl DFC_b.TSC_BlkdLineTank DFC_b.TSC_BrkMnSwtContOnWarnLmp DFC_b.TSC_BrkMnSwtNotStpWarnLmp DFC_b.TSC_BrkRdntSwtContOnWarnLmp DFC_b.TSC_BrkRdntSwtNotStpWarnLmp DFC_b.TSC_CEngDsTColdStrtMax DFC_b.TSC_CEngDsTColdStrtMin DFC_b.TSC_CEngDsTImps DFC_b.TSC_CEngDsTPlausHSC DFC_b.TSC_CEngDsTPlausLSC DFC_b.TSC_CEngDsTPlausSTC DFC_b.TSC_CEngDsTSRCMax DFC_b.TSC_CEngDsTSRCMin DFC_b.TSC_CEngDsTSig DFC_b.TSC_CEngUsTColdStrtMax DFC_b.TSC_CEngUsTColdStrtMin DFC_b.TSC_CEngUsTLooseCnctn DFC_b.TSC_CEngUsTSRCMax DFC_b.TSC_CEngUsTSRCMin DFC_b.TSC_ComDCDCACCFailr DFC_b.TSC_DCDCFltDet DFC_b.TSC_DKRSA DFC_b.TSC_DKVSmax DFC_b.TSC_DKnpl DFC_b.TSC_DSKVRmax DFC_b.TSC_DSKVRmin DFC_b.TSC_DSKVRnpl DFC_b.TSC_DSKVRsig DFC_b.TSC_DSKVSsig DFC_b.TSC_DSSmax DFC_b.TSC_DSTDmax DFC_b.TSC_DSTEmax DFC_b.TSC_DSTEmin DFC_b.TSC_DSTOFmax DFC_b.TSC_DSTRmax DFC_b.TSC_DSTRmin DFC_b.TSC_DSTRnpl DFC_b.TSC_DSTRsig DFC_b.TSC_DSTTI DFC_b.TSC_DSUmax DFC_b.TSC_DiagCpv1DteskLoLoadStuckClsd DFC_b.TSC_DiagCpv1DteskLoLoadStuckOpen DFC_b.TSC_EGRVlvDrftClsd DFC_b.TSC_EGRVlvDrftOpn DFC_b.TSC_EGRVlvJamVlvClsd DFC_b.TSC_EGRVlvJamVlvOpn DFC_b.TSC_EGRVlvSprgBrk DFC_b.TSC_EGRVlvTempMdlEEPErr DFC_b.TSC_EGRVlvTmpErr DFC_b.TSC_EGSDUS2B1LtrDly DFC_b.TSC_EGSDUS2B1LtrPT1 DFC_b.TSC_EGSDUS2B1RtlDly DFC_b.TSC_EGSDUS2B1RtlPT1 DFC_b.TSC_EGSDUS2B1TarLean DFC_b.TSC_EGSDUS2B1TarRich DFC_b.TSC_EONVmax DFC_b.TSC_ETAKHLmax DFC_b.TSC_ETAKHTmax DFC_b.TSC_ETHSEmax DFC_b.TSC_ETHSEmin DFC_b.TSC_ETHSFmax DFC_b.TSC_ETHSFmin DFC_b.TSC_ETHSFsig DFC_b.TSC_ETHSNPWmax DFC_b.TSC_ETHSNPWmin DFC_b.TSC_ETHSNPWsig DFC_b.TSC_ETHSPLnpl DFC_b.TSC_ETHSTPLnpl DFC_b.TSC_EngICO DFC_b.TSC_EngPrtOvrSpdMon DFC_b.TSC_EpmCaSI1ErrSig DFC_b.TSC_EpmCaSI1MntErr DFC_b.TSC_EpmCaSI1NoSigMax DFC_b.TSC_EpmCaSI1NoSigMin DFC_b.TSC_EpmCaSI1OfsErr DFC_b.TSC_EpmCrSDGI DFC_b.TSC_EpmCrSErrSig DFC_b.TSC_EpmCrSNoSig DFC_b.TSC_EtaEngIdleNonCsers DFC_b.TSC_EtaEngPtlNonCsers DFC_b.TSC_FRAmax DFC_b.TSC_FRAmin DFC_b.TSC_FSTEmax DFC_b.TSC_FSTEmin DFC_b.TSC_FSTRmax DFC_b.TSC_FSTRmin DFC_b.TSC_FSTRnpl DFC_b.TSC_FSTmax DFC_b.TSC_FTDLAmax DFC_b.TSC_FTDLAmin DFC_b.TSC_FuPHiSnsrEleclmax DFC_b.TSC_FuPHiSnsrEleclmin DFC_b.TSC_FuPHiSnsrEleclnpl DFC_b.TSC_FuPHiSnsrURngMax DFC_b.TSC_FuPHiSnsrURngMin DFC_b.TSC_FuSnsrPhyRngMaxErr DFC_b.TSC_FuSnsrPhyRngMinErr DFC_b.TSC_GEVlvLockPinDiagIntkB1 DFC_b.TSC_GEVlvPhaSlowIntkB1 DFC_b.TSC_GEVlvPhaTargIntkB1 DFC_b.TSC_GbxRvsSwtStk DFC_b.TSC_HDRKHmax DFC_b.TSC_HDRKHmin DFC_b.TSC_HDRPLmax DFC_b.TSC_HDRPLmin DFC_b.TSC_HDRmax DFC_b.TSC_HDRmin DFC_b.TSC_HEGOS2B1ElecMax DFC_b.TSC_HEGOS2B1ElecMin DFC_b.TSC_HEGOS2B1ElecSig DFC_b.TSC_HEGOS2B1HtgNpl DFC_b.TSC_HEV00max DFC_b.TSC_HEV01max DFC_b.TSC_HEV02max DFC_b.TSC_HEV03max DFC_b.TSC_HEVE0max DFC_b.TSC_HEVE1max DFC_b.TSC_HFMmax DFC_b.TSC_HiPSysHiPMaxLimExcdd DFC_b.TSC_IVGdiCtlCvoErrMax_0 DFC_b.TSC_IVGdiCtlCvoErrMax_1 DFC_b.TSC_IVGdiCtlCvoErrMax_2 DFC_b.TSC_IVGdiCtlCvoErrMax_3 DFC_b.TSC_IVGdiCtlCvoErrMin_0 DFC_b.TSC_IVGdiCtlCvoErrMin_1 DFC_b.TSC_IVGdiCtlCvoErrMin_2 DFC_b.TSC_IVGdiCtlCvoErrMin_3 DFC_b.TSC_IVGdiCtlCvoErrMinMax DFC_b.TSC_IVGdiCtlCvoSigPlausErrSmrCdn DFC_b.TSC_IVGdiCtl_CvoErr DFC_b.TSC_IVGdiCtl_CvoSigPlaus_0 DFC_b.TSC_IVGdiCtl_CvoSigPlaus_1 DFC_b.TSC_IVGdiCtl_CvoSigPlaus_2 DFC_b.TSC_IVGdiCtl_CvoSigPlaus_3 DFC_b.TSC_IntkAirTAirFltDsCrssMax DFC_b.TSC_IntkAirTAirFltDsCrssMin DFC_b.TSC_IntkAirTAirFltDsHSCMax DFC_b.TSC_IntkAirTAirFltDsImps DFC_b.TSC_IntkAirTAirFltDsPRCMax DFC_b.TSC_IntkAirTAirFltDsPRCMin DFC_b.TSC_IntkAirTAirFltDsSRCMax DFC_b.TSC_IntkAirTAirFltDsSRCMin DFC_b.TSC_IntkAirTAirFltDsSTC DFC_b.TSC_IntkAirTIntkMnfldCrssMax DFC_b.TSC_IntkAirTIntkMnfldCrssMin DFC_b.TSC_IntkAirTIntkMnfldHSCMax DFC_b.TSC_IntkAirTIntkMnfldImps DFC_b.TSC_IntkAirTIntkMnfldPRCMax DFC_b.TSC_IntkAirTIntkMnfldPRCMin DFC_b.TSC_IntkAirTIntkMnfldSRCMax DFC_b.TSC_IntkAirTIntkMnfldSRCMin DFC_b.TSC_IntkAirTIntkMnfldSTC DFC_b.TSC_KRREGRLMX DFC_b.TSC_KRVEKOCVLCI DFC_b.TSC_KRVEKOENCHMT DFC_b.TSC_KRVEKOENCHMT0 DFC_b.TSC_KRVEKOENCHMT1 DFC_b.TSC_KRVEKOENCHMT2 DFC_b.TSC_KRVEKOENCHMT3 DFC_b.TSC_KRVEKOENCHMT4 DFC_b.TSC_KRVEKOENCHMT5 DFC_b.TSC_KRVEKOENCHMT6 DFC_b.TSC_KRVEKOENCHMT7 DFC_b.TSC_KRVEKORLMX DFC_b.TSC_KRVEKORLMXL DFC_b.TSC_KS1max DFC_b.TSC_KS1min DFC_b.TSC_LMmax DFC_b.TSC_LZSRnpl DFC_b.TSC_LamDynDiagS1B1 DFC_b.TSC_LeakIntkMnfldEmiInfl DFC_b.TSC_LinFrameErrDCDC DFC_b.TSC_LinOverrunErrDCDC DFC_b.TSC_MD00max DFC_b.TSC_MDBmax DFC_b.TSC_MDCat DFC_b.TSC_MDCatCrit DFC_b.TSC_MDCatCurr DFC_b.TSC_MDCyl_0 DFC_b.TSC_MDCyl_1 DFC_b.TSC_MDCyl_2 DFC_b.TSC_MDCyl_3 DFC_b.TSC_MDEmi DFC_b.TSC_MDEmiStrt DFC_b.TSC_MDFco DFC_b.TSC_MDMpl DFC_b.TSC_MDSegTiAdpn DFC_b.TSC_MDmax DFC_b.TSC_MFuOilMax DFC_b.TSC_MOXEMM_SMU_ALM0_0 DFC_b.TSC_MOXEMM_SMU_ALM0_1 DFC_b.TSC_MOXEMM_SMU_ALM0_10 DFC_b.TSC_MOXEMM_SMU_ALM0_11 DFC_b.TSC_MOXEMM_SMU_ALM0_13 DFC_b.TSC_MOXEMM_SMU_ALM0_14 DFC_b.TSC_MOXEMM_SMU_ALM0_2 DFC_b.TSC_MOXEMM_SMU_ALM0_22 DFC_b.TSC_MOXEMM_SMU_ALM0_23 DFC_b.TSC_MOXEMM_SMU_ALM0_4 DFC_b.TSC_MOXEMM_SMU_ALM0_5 DFC_b.TSC_MOXEMM_SMU_ALM0_7 DFC_b.TSC_MOXEMM_SMU_ALM0_8 DFC_b.TSC_MOXEMM_SMU_ALM10_16 DFC_b.TSC_MOXEMM_SMU_ALM10_17 DFC_b.TSC_MOXEMM_SMU_ALM10_21 DFC_b.TSC_MOXEMM_SMU_ALM11_0 DFC_b.TSC_MOXEMM_SMU_ALM11_1 DFC_b.TSC_MOXEMM_SMU_ALM11_2 DFC_b.TSC_MOXEMM_SMU_ALM11_3 DFC_b.TSC_MOXEMM_SMU_ALM11_4 DFC_b.TSC_MOXEMM_SMU_ALM11_5 DFC_b.TSC_MOXEMM_SMU_ALM11_8 DFC_b.TSC_MOXEMM_SMU_ALM11_9 DFC_b.TSC_MOXEMM_SMU_ALM1_0 DFC_b.TSC_MOXEMM_SMU_ALM1_1 DFC_b.TSC_MOXEMM_SMU_ALM1_10 DFC_b.TSC_MOXEMM_SMU_ALM1_11 DFC_b.TSC_MOXEMM_SMU_ALM1_13 DFC_b.TSC_MOXEMM_SMU_ALM1_14 DFC_b.TSC_MOXEMM_SMU_ALM1_2 DFC_b.TSC_MOXEMM_SMU_ALM1_22 DFC_b.TSC_MOXEMM_SMU_ALM1_23 DFC_b.TSC_MOXEMM_SMU_ALM1_4 DFC_b.TSC_MOXEMM_SMU_ALM1_5 DFC_b.TSC_MOXEMM_SMU_ALM1_7 DFC_b.TSC_MOXEMM_SMU_ALM1_8 DFC_b.TSC_MOXEMM_SMU_ALM21_0 DFC_b.TSC_MOXEMM_SMU_ALM21_16 DFC_b.TSC_MOXEMM_SMU_ALM21_3 DFC_b.TSC_MOXEMM_SMU_ALM2_1 DFC_b.TSC_MOXEMM_SMU_ALM2_10 DFC_b.TSC_MOXEMM_SMU_ALM2_11 DFC_b.TSC_MOXEMM_SMU_ALM2_13 DFC_b.TSC_MOXEMM_SMU_ALM2_14 DFC_b.TSC_MOXEMM_SMU_ALM2_22 DFC_b.TSC_MOXEMM_SMU_ALM2_23 DFC_b.TSC_MOXEMM_SMU_ALM2_4 DFC_b.TSC_MOXEMM_SMU_ALM2_5 DFC_b.TSC_MOXEMM_SMU_ALM2_7 DFC_b.TSC_MOXEMM_SMU_ALM2_8 DFC_b.TSC_MOXEMM_SMU_ALM6_0 DFC_b.TSC_MOXEMM_SMU_ALM6_11 DFC_b.TSC_MOXEMM_SMU_ALM6_12 DFC_b.TSC_MOXEMM_SMU_ALM6_14 DFC_b.TSC_MOXEMM_SMU_ALM6_15 DFC_b.TSC_MOXEMM_SMU_ALM6_17 DFC_b.TSC_MOXEMM_SMU_ALM6_18 DFC_b.TSC_MOXEMM_SMU_ALM6_20 DFC_b.TSC_MOXEMM_SMU_ALM6_21 DFC_b.TSC_MOXEMM_SMU_ALM6_25 DFC_b.TSC_MOXEMM_SMU_ALM6_4 DFC_b.TSC_MOXEMM_SMU_ALM6_5 DFC_b.TSC_MOXEMM_SMU_ALM6_7 DFC_b.TSC_MOXEMM_SMU_ALM6_8 DFC_b.TSC_MOXEMM_SMU_ALM7_1 DFC_b.TSC_MOXEMM_SMU_ALM7_12 DFC_b.TSC_MOXEMM_SMU_ALM7_13 DFC_b.TSC_MOXEMM_SMU_ALM7_14 DFC_b.TSC_MOXEMM_SMU_ALM7_15 DFC_b.TSC_MOXEMM_SMU_ALM7_16 DFC_b.TSC_MOXEMM_SMU_ALM7_17 DFC_b.TSC_MOXEMM_SMU_ALM7_2 DFC_b.TSC_MOXEMM_SMU_ALM7_20 DFC_b.TSC_MOXEMM_SMU_ALM7_25 DFC_b.TSC_MOXEMM_SMU_ALM7_26 DFC_b.TSC_MOXEMM_SMU_ALM7_28 DFC_b.TSC_MOXEMM_SMU_ALM7_29 DFC_b.TSC_MOXEMM_SMU_ALM7_30 DFC_b.TSC_MOXEMM_SMU_ALM7_31 DFC_b.TSC_MOXEMM_SMU_ALM8_0 DFC_b.TSC_MOXEMM_SMU_ALM8_1 DFC_b.TSC_MOXEMM_SMU_ALM8_10 DFC_b.TSC_MOXEMM_SMU_ALM8_11 DFC_b.TSC_MOXEMM_SMU_ALM8_12 DFC_b.TSC_MOXEMM_SMU_ALM8_16 DFC_b.TSC_MOXEMM_SMU_ALM8_18 DFC_b.TSC_MOXEMM_SMU_ALM8_2 DFC_b.TSC_MOXEMM_SMU_ALM8_3 DFC_b.TSC_MOXEMM_SMU_ALM8_31 DFC_b.TSC_MOXEMM_SMU_ALM8_4 DFC_b.TSC_MOXEMM_SMU_ALM9_0 DFC_b.TSC_MOXEMM_SMU_ALM9_15 DFC_b.TSC_MOXEMM_SMU_ALM9_3 DFC_b.TSC_MoCADCNTP DFC_b.TSC_MoCADCTst DFC_b.TSC_MoCSOPICO DFC_b.TSC_MoFAPP DFC_b.TSC_MoFAirFilgPrdc DFC_b.TSC_MoFAirFlCtOffGdi DFC_b.TSC_MoFAirFlCylGdi DFC_b.TSC_MoFAirFlFF DFC_b.TSC_MoFAirFlIn DFC_b.TSC_MoFAirFlMixCtlGdiChkAirFl DFC_b.TSC_MoFAirFlMixCtlGdiChkCtrl DFC_b.TSC_MoFAirFlMode DFC_b.TSC_MoFESpd DFC_b.TSC_MoFIACo DFC_b.TSC_MoFICOL1 DFC_b.TSC_MoFICOL2 DFC_b.TSC_MoFStrt DFC_b.TSC_MoFTrqCmp DFC_b.TSC_MoFTrqCmpMax DFC_b.TSC_MoFTrqCmpMin DFC_b.TSC_MoFVarPostBldSel DFC_b.TSC_MoXEMMHwLTMCUFW DFC_b.TSC_MoXEMMHwLTMonBIST DFC_b.TSC_MoXEMMHwLTRegMonTest DFC_b.TSC_MoXEMMHwLTStbySMUAlvTest DFC_b.TSC_MoXEMMHwLTTempSens DFC_b.TSC_MoXEMMHwLTUCBCfg DFC_b.TSC_NWSEmax DFC_b.TSC_NWSmax DFC_b.TSC_OCWDAABEActv DFC_b.TSC_OCWDACom DFC_b.TSC_OCWDAErrPin DFC_b.TSC_OCWDAOvrVltg DFC_b.TSC_ORAmax DFC_b.TSC_ORAmin DFC_b.TSC_OilPPlaus DFC_b.TSC_PLLSUmax DFC_b.TSC_PLLSUmin DFC_b.TSC_PSR1max DFC_b.TSC_PSRBmax DFC_b.TSC_PSRBmin DFC_b.TSC_PSRPmax DFC_b.TSC_PSRPmin DFC_b.TSC_PSRPsig DFC_b.TSC_PSRmax DFC_b.TSC_PUmax DFC_b.TSC_P_VSE11_OL DFC_b.TSC_P_VSE11_SCB DFC_b.TSC_P_VSE11_SCG DFC_b.TSC_PhyHighAPP1 DFC_b.TSC_PhyHighAPP2 DFC_b.TSC_PhyLowAPP1 DFC_b.TSC_PhyLowAPP2 DFC_b.TSC_SRCHighAPP1 DFC_b.TSC_SRCHighAPP2 DFC_b.TSC_SRCLowAPP1 DFC_b.TSC_SRCLowAPP2 DFC_b.TSC_SSpMon2 DFC_b.TSC_STHDRmax DFC_b.TSC_SWReset_0 DFC_b.TSC_SWReset_1 DFC_b.TSC_SWReset_2 DFC_b.TSC_SyncAPP DFC_b.TSC_TANKLnpl DFC_b.TSC_TAmax_Dummy DFC_b.TSC_TESFmax DFC_b.TSC_TESGmax DFC_b.TSC_TKAEmax DFC_b.TSC_TKAEmin DFC_b.TSC_TKARmax DFC_b.TSC_TKARnpl DFC_b.TSC_TMmax_Dummy DFC_b.TSC_TUMmax_Dummy DFC_b.TSC_TWCDPriCatB1 DFC_b.TSC_ThrVlvClsdPosnFirstOffsLrnImpoB1 DFC_b.TSC_ThrVlvClsdPosnOffsLrnImpoB1 DFC_b.TSC_ThrVlvClsdPosnOffsLrnMaxB1 DFC_b.TSC_ThrVlvClsdPosnOffsLrnMinB1 DFC_b.TSC_ThrVlvCtrlDeB1 DFC_b.TSC_ThrVlvDycB1 DFC_b.TSC_ThrVlvLimpAirPosnMaxAbsltDriftB1 DFC_b.TSC_ThrVlvLimpAirPosnMaxB1 DFC_b.TSC_ThrVlvLimpAirPosnMaxRelDriftB1 DFC_b.TSC_ThrVlvLimpAirPosnMinB1 DFC_b.TSC_ThrVlvOpenLoadB1 DFC_b.TSC_ThrVlvOpenSprgB1 DFC_b.TSC_ThrVlvOpenSprgSprdB1 DFC_b.TSC_ThrVlvOpenSprgTwnB1 DFC_b.TSC_ThrVlvOverTB1 DFC_b.TSC_ThrVlvRetSprgB1 /end OUT_MEASUREMENT
 FUNCTION_VERSION "30000.33.0_1.1.0" /end FUNCTION
/begin COMPU_METHOD DFC_OneToOne "" RAT_FUNC "%6.2" "-" COEFFS 0 1 0 0 0 1 /end COMPU_METHOD
/end MODULE
/end PROJECT
