ASAP2_VERSION 1 60
/begin PROJECT MG1CS022 "MG1CS022"
/begin HEADER "" VERSION "MG1CS022_62XSC_V037_TPROT" PROJECT_NO MG1CS022 /end HEADER
/begin MODULE DIM ""
/begin MOD_COMMON "" BYTE_ORDER MSB_LAST ALIGNMENT_BYTE 1 ALIGNMENT_WORD 2 ALIGNMENT_LONG 4 ALIGNMENT_INT64 4 ALIGNMENT_FLOAT32_IEEE 4 ALIGNMENT_FLOAT64_IEEE 4 DATA_SIZE 32 /end MOD_COMMON
/begin CHARACTERISTIC DINH_Lim.DFC_ComMETATOutPstDrv_CA "inhibit conditions / inhibit limit conditions for inhibit source DFC_ComMETATOutPstDrv" VAL_BLK 0x804F7DEB ValA_Wu8 17.0000000000 DINH_LimDFCVerb 0.00 17.0000000000 FORMAT "%13.10" NUMBER 50 /end CHARACTERISTIC
/begin CHARACTERISTIC DINH_Lim.DFC_ComMETCChksum_CA "inhibit conditions / inhibit limit conditions for inhibit source DFC_ComMETCChksum" VAL_BLK 0x804F7E1D ValA_Wu8 17.0000000000 DINH_LimDFCVerb 0.00 17.0000000000 FORMAT "%13.10" NUMBER 64 /end CHARACTERISTIC
/begin CHARACTERISTIC DINH_Lim.DFC_ComMETCRingCnt_CA "inhibit conditions / inhibit limit conditions for inhibit source DFC_ComMETCRingCnt" VAL_BLK 0x804F7E5D ValA_Wu8 17.0000000000 DINH_LimDFCVerb 0.00 17.0000000000 FORMAT "%13.10" NUMBER 64 /end CHARACTERISTIC
/begin CHARACTERISTIC DINH_Lim.DFC_ComMETCTOut_CA "inhibit conditions / inhibit limit conditions for inhibit source DFC_ComMETCTOut" VAL_BLK 0x804F7E9D ValA_Wu8 17.0000000000 DINH_LimDFCVerb 0.00 17.0000000000 FORMAT "%13.10" NUMBER 64 /end CHARACTERISTIC
/begin CHARACTERISTIC DINH_Lim.DFC_ComMETDChksum_CA "inhibit conditions / inhibit limit conditions for inhibit source DFC_ComMETDChksum" VAL_BLK 0x804F7EDD ValA_Wu8 17.0000000000 DINH_LimDFCVerb 0.00 17.0000000000 FORMAT "%13.10" NUMBER 63 /end CHARACTERISTIC
/begin CHARACTERISTIC DINH_Lim.DFC_ComMETDRingCnt_CA "inhibit conditions / inhibit limit conditions for inhibit source DFC_ComMETDRingCnt" VAL_BLK 0x804F7F1C ValA_Wu8 17.0000000000 DINH_LimDFCVerb 0.00 17.0000000000 FORMAT "%13.10" NUMBER 63 /end CHARACTERISTIC
/begin CHARACTERISTIC DINH_Lim.DFC_ComMETDTOut_CA "inhibit conditions / inhibit limit conditions for inhibit source DFC_ComMETDTOut" VAL_BLK 0x804F7F5B ValA_Wu8 17.0000000000 DINH_LimDFCVerb 0.00 17.0000000000 FORMAT "%13.10" NUMBER 63 /end CHARACTERISTIC
/begin CHARACTERISTIC DINH_Lim.DFC_ComMETE2Chksum_CA "inhibit conditions / inhibit limit conditions for inhibit source DFC_ComMETE2Chksum" VAL_BLK 0x804F7F9A ValA_Wu8 17.0000000000 DINH_LimDFCVerb 0.00 17.0000000000 FORMAT "%13.10" NUMBER 62 /end CHARACTERISTIC
/begin CHARACTERISTIC DINH_Lim.DFC_ComMETE2RingCnt_CA "inhibit conditions / inhibit limit conditions for inhibit source DFC_ComMETE2RingCnt" VAL_BLK 0x804F7FD8 ValA_Wu8 17.0000000000 DINH_LimDFCVerb 0.00 17.0000000000 FORMAT "%13.10" NUMBER 62 /end CHARACTERISTIC
/begin CHARACTERISTIC DINH_Lim.DFC_ComMETE2TOut_CA "inhibit conditions / inhibit limit conditions for inhibit source DFC_ComMETE2TOut" VAL_BLK 0x804F8016 ValA_Wu8 17.0000000000 DINH_LimDFCVerb 0.00 17.0000000000 FORMAT "%13.10" NUMBER 62 /end CHARACTERISTIC
/begin CHARACTERISTIC DINH_Lim.DFC_ComMETFChksum_CA "inhibit conditions / inhibit limit conditions for inhibit source DFC_ComMETFChksum" VAL_BLK 0x804F8054 ValA_Wu8 17.0000000000 DINH_LimDFCVerb 0.00 17.0000000000 FORMAT "%13.10" NUMBER 62 /end CHARACTERISTIC
/begin CHARACTERISTIC DINH_Lim.DFC_ComMETFRingCnt_CA "inhibit conditions / inhibit limit conditions for inhibit source DFC_ComMETFRingCnt" VAL_BLK 0x804F8092 ValA_Wu8 17.0000000000 DINH_LimDFCVerb 0.00 17.0000000000 FORMAT "%13.10" NUMBER 62 /end CHARACTERISTIC
/begin CHARACTERISTIC DINH_Lim.DFC_ComMETFTOut_CA "inhibit conditions / inhibit limit conditions for inhibit source DFC_ComMETFTOut" VAL_BLK 0x804F80D0 ValA_Wu8 17.0000000000 DINH_LimDFCVerb 0.00 17.0000000000 FORMAT "%13.10" NUMBER 62 /end CHARACTERISTIC
/begin CHARACTERISTIC DINH_Lim.DFC_ComMETGChksum_CA "inhibit conditions / inhibit limit conditions for inhibit source DFC_ComMETGChksum" VAL_BLK 0x804F810E ValA_Wu8 17.0000000000 DINH_LimDFCVerb 0.00 17.0000000000 FORMAT "%13.10" NUMBER 62 /end CHARACTERISTIC
/begin CHARACTERISTIC DINH_Lim.DFC_ComMETGRingCnt_CA "inhibit conditions / inhibit limit conditions for inhibit source DFC_ComMETGRingCnt" VAL_BLK 0x804F814C ValA_Wu8 17.0000000000 DINH_LimDFCVerb 0.00 17.0000000000 FORMAT "%13.10" NUMBER 62 /end CHARACTERISTIC
/begin CHARACTERISTIC DINH_Lim.DFC_ComMETGTOut_CA "inhibit conditions / inhibit limit conditions for inhibit source DFC_ComMETGTOut" VAL_BLK 0x804F818A ValA_Wu8 17.0000000000 DINH_LimDFCVerb 0.00 17.0000000000 FORMAT "%13.10" NUMBER 62 /end CHARACTERISTIC
/begin CHARACTERISTIC DINH_Lim.DFC_ComMETH2Chksum_CA "inhibit conditions / inhibit limit conditions for inhibit source DFC_ComMETH2Chksum" VAL_BLK 0x804F81C8 ValA_Wu8 17.0000000000 DINH_LimDFCVerb 0.00 17.0000000000 FORMAT "%13.10" NUMBER 62 /end CHARACTERISTIC
/begin CHARACTERISTIC DINH_Lim.DFC_ComMETH2RingCnt_CA "inhibit conditions / inhibit limit conditions for inhibit source DFC_ComMETH2RingCnt" VAL_BLK 0x804F8206 ValA_Wu8 17.0000000000 DINH_LimDFCVerb 0.00 17.0000000000 FORMAT "%13.10" NUMBER 62 /end CHARACTERISTIC
/begin CHARACTERISTIC DINH_Lim.DFC_ComMETH2TOut_CA "inhibit conditions / inhibit limit conditions for inhibit source DFC_ComMETH2TOut" VAL_BLK 0x804F8244 ValA_Wu8 17.0000000000 DINH_LimDFCVerb 0.00 17.0000000000 FORMAT "%13.10" NUMBER 62 /end CHARACTERISTIC
/begin CHARACTERISTIC DINH_Lim.DFC_ComMETHChksum_CA "inhibit conditions / inhibit limit conditions for inhibit source DFC_ComMETHChksum" VAL_BLK 0x804F8282 ValA_Wu8 17.0000000000 DINH_LimDFCVerb 0.00 17.0000000000 FORMAT "%13.10" NUMBER 62 /end CHARACTERISTIC
/begin CHARACTERISTIC DINH_Lim.DFC_ComMETHRingCnt_CA "inhibit conditions / inhibit limit conditions for inhibit source DFC_ComMETHRingCnt" VAL_BLK 0x804F82C0 ValA_Wu8 17.0000000000 DINH_LimDFCVerb 0.00 17.0000000000 FORMAT "%13.10" NUMBER 62 /end CHARACTERISTIC
/begin CHARACTERISTIC DINH_Lim.DFC_ComMETHTOut_CA "inhibit conditions / inhibit limit conditions for inhibit source DFC_ComMETHTOut" VAL_BLK 0x804F82FE ValA_Wu8 17.0000000000 DINH_LimDFCVerb 0.00 17.0000000000 FORMAT "%13.10" NUMBER 62 /end CHARACTERISTIC
/begin CHARACTERISTIC DINH_Lim.DFC_ComMETIChksum_CA "inhibit conditions / inhibit limit conditions for inhibit source DFC_ComMETIChksum" VAL_BLK 0x804F833C ValA_Wu8 17.0000000000 DINH_LimDFCVerb 0.00 17.0000000000 FORMAT "%13.10" NUMBER 69 /end CHARACTERISTIC
/begin CHARACTERISTIC DINH_Lim.DFC_ComMETIRingCnt_CA "inhibit conditions / inhibit limit conditions for inhibit source DFC_ComMETIRingCnt" VAL_BLK 0x804F8381 ValA_Wu8 17.0000000000 DINH_LimDFCVerb 0.00 17.0000000000 FORMAT "%13.10" NUMBER 69 /end CHARACTERISTIC
/begin CHARACTERISTIC DINH_Lim.DFC_ComMETITOut_CA "inhibit conditions / inhibit limit conditions for inhibit source DFC_ComMETITOut" VAL_BLK 0x804F83C6 ValA_Wu8 17.0000000000 DINH_LimDFCVerb 0.00 17.0000000000 FORMAT "%13.10" NUMBER 69 /end CHARACTERISTIC
/begin CHARACTERISTIC DINH_Lim.DFC_ComMETKChksum_CA "inhibit conditions / inhibit limit conditions for inhibit source DFC_ComMETKChksum" VAL_BLK 0x804F840B ValA_Wu8 17.0000000000 DINH_LimDFCVerb 0.00 17.0000000000 FORMAT "%13.10" NUMBER 62 /end CHARACTERISTIC
/begin CHARACTERISTIC DINH_Lim.DFC_ComMETKRingCnt_CA "inhibit conditions / inhibit limit conditions for inhibit source DFC_ComMETKRingCnt" VAL_BLK 0x804F8449 ValA_Wu8 17.0000000000 DINH_LimDFCVerb 0.00 17.0000000000 FORMAT "%13.10" NUMBER 62 /end CHARACTERISTIC
/begin CHARACTERISTIC DINH_Lim.DFC_ComMETKTOut_CA "inhibit conditions / inhibit limit conditions for inhibit source DFC_ComMETKTOut" VAL_BLK 0x804F8487 ValA_Wu8 17.0000000000 DINH_LimDFCVerb 0.00 17.0000000000 FORMAT "%13.10" NUMBER 62 /end CHARACTERISTIC
/begin CHARACTERISTIC DINH_Lim.DFC_ComMETLChksum_CA "inhibit conditions / inhibit limit conditions for inhibit source DFC_ComMETLChksum" VAL_BLK 0x804F84C5 ValA_Wu8 17.0000000000 DINH_LimDFCVerb 0.00 17.0000000000 FORMAT "%13.10" NUMBER 62 /end CHARACTERISTIC
/begin CHARACTERISTIC DINH_Lim.DFC_ComMETLRingCnt_CA "inhibit conditions / inhibit limit conditions for inhibit source DFC_ComMETLRingCnt" VAL_BLK 0x804F8503 ValA_Wu8 17.0000000000 DINH_LimDFCVerb 0.00 17.0000000000 FORMAT "%13.10" NUMBER 62 /end CHARACTERISTIC
/begin CHARACTERISTIC DINH_Lim.DFC_ComMETLTOut_CA "inhibit conditions / inhibit limit conditions for inhibit source DFC_ComMETLTOut" VAL_BLK 0x804F8541 ValA_Wu8 17.0000000000 DINH_LimDFCVerb 0.00 17.0000000000 FORMAT "%13.10" NUMBER 62 /end CHARACTERISTIC
/begin CHARACTERISTIC DINH_Lim.DFC_ComMETMChksum_CA "inhibit conditions / inhibit limit conditions for inhibit source DFC_ComMETMChksum" VAL_BLK 0x804F857F ValA_Wu8 17.0000000000 DINH_LimDFCVerb 0.00 17.0000000000 FORMAT "%13.10" NUMBER 61 /end CHARACTERISTIC
/begin CHARACTERISTIC DINH_Lim.DFC_ComMETMRingCnt_CA "inhibit conditions / inhibit limit conditions for inhibit source DFC_ComMETMRingCnt" VAL_BLK 0x804F85BC ValA_Wu8 17.0000000000 DINH_LimDFCVerb 0.00 17.0000000000 FORMAT "%13.10" NUMBER 61 /end CHARACTERISTIC
/begin CHARACTERISTIC DINH_Lim.DFC_ComMETMTOut_CA "inhibit conditions / inhibit limit conditions for inhibit source DFC_ComMETMTOut" VAL_BLK 0x804F85F9 ValA_Wu8 17.0000000000 DINH_LimDFCVerb 0.00 17.0000000000 FORMAT "%13.10" NUMBER 61 /end CHARACTERISTIC
/begin CHARACTERISTIC DINH_Lim.DFC_ComMETNChksum_CA "inhibit conditions / inhibit limit conditions for inhibit source DFC_ComMETNChksum" VAL_BLK 0x804F8636 ValA_Wu8 17.0000000000 DINH_LimDFCVerb 0.00 17.0000000000 FORMAT "%13.10" NUMBER 62 /end CHARACTERISTIC
/begin CHARACTERISTIC DINH_Lim.DFC_ComMETNRingCnt_CA "inhibit conditions / inhibit limit conditions for inhibit source DFC_ComMETNRingCnt" VAL_BLK 0x804F8674 ValA_Wu8 17.0000000000 DINH_LimDFCVerb 0.00 17.0000000000 FORMAT "%13.10" NUMBER 62 /end CHARACTERISTIC
/begin CHARACTERISTIC DINH_Lim.DFC_ComMETNTOut_CA "inhibit conditions / inhibit limit conditions for inhibit source DFC_ComMETNTOut" VAL_BLK 0x804F86B2 ValA_Wu8 17.0000000000 DINH_LimDFCVerb 0.00 17.0000000000 FORMAT "%13.10" NUMBER 62 /end CHARACTERISTIC
/begin CHARACTERISTIC DINH_Lim.DFC_ComMtrCom_CA "inhibit conditions / inhibit limit conditions for inhibit source DFC_ComMtrCom" VAL_BLK 0x804F86F0 ValA_Wu8 17.0000000000 DINH_LimDFCVerb 0.00 17.0000000000 FORMAT "%13.10" NUMBER 51 /end CHARACTERISTIC
/begin CHARACTERISTIC DINH_Lim.DFC_ComPCUChkSum_CA "inhibit conditions / inhibit limit conditions for inhibit source DFC_ComPCUChkSum" VAL_BLK 0x804F8723 ValA_Wu8 17.0000000000 DINH_LimDFCVerb 0.00 17.0000000000 FORMAT "%13.10" NUMBER 58 /end CHARACTERISTIC
/begin CHARACTERISTIC DINH_Lim.DFC_ComPCURingCnt_CA "inhibit conditions / inhibit limit conditions for inhibit source DFC_ComPCURingCnt" VAL_BLK 0x804F875D ValA_Wu8 17.0000000000 DINH_LimDFCVerb 0.00 17.0000000000 FORMAT "%13.10" NUMBER 58 /end CHARACTERISTIC
/begin CHARACTERISTIC DINH_Lim.DFC_ComPCUTOut_CA "inhibit conditions / inhibit limit conditions for inhibit source DFC_ComPCUTOut" VAL_BLK 0x804F8797 ValA_Wu8 17.0000000000 DINH_LimDFCVerb 0.00 17.0000000000 FORMAT "%13.10" NUMBER 58 /end CHARACTERISTIC
/begin CHARACTERISTIC DINH_Lim.DFC_ComSRSAChksum_CA "inhibit conditions / inhibit limit conditions for inhibit source DFC_ComSRSAChksum" VAL_BLK 0x804F87D1 ValA_Wu8 17.0000000000 DINH_LimDFCVerb 0.00 17.0000000000 FORMAT "%13.10" NUMBER 58 /end CHARACTERISTIC
/begin CHARACTERISTIC DINH_Lim.DFC_ComSRSARingCnt_CA "inhibit conditions / inhibit limit conditions for inhibit source DFC_ComSRSARingCnt" VAL_BLK 0x804F880B ValA_Wu8 17.0000000000 DINH_LimDFCVerb 0.00 17.0000000000 FORMAT "%13.10" NUMBER 58 /end CHARACTERISTIC
/begin CHARACTERISTIC DINH_Lim.DFC_ComSRSATOut_CA "inhibit conditions / inhibit limit conditions for inhibit source DFC_ComSRSATOut" VAL_BLK 0x804F8845 ValA_Wu8 17.0000000000 DINH_LimDFCVerb 0.00 17.0000000000 FORMAT "%13.10" NUMBER 58 /end CHARACTERISTIC
/begin CHARACTERISTIC DINH_Lim.DFC_ComSRSBChksum_CA "inhibit conditions / inhibit limit conditions for inhibit source DFC_ComSRSBChksum" VAL_BLK 0x804F887F ValA_Wu8 17.0000000000 DINH_LimDFCVerb 0.00 17.0000000000 FORMAT "%13.10" NUMBER 57 /end CHARACTERISTIC
/begin CHARACTERISTIC DINH_Lim.DFC_ComSRSBRingCnt_CA "inhibit conditions / inhibit limit conditions for inhibit source DFC_ComSRSBRingCnt" VAL_BLK 0x804F88B8 ValA_Wu8 17.0000000000 DINH_LimDFCVerb 0.00 17.0000000000 FORMAT "%13.10" NUMBER 57 /end CHARACTERISTIC
/begin CHARACTERISTIC DINH_Lim.DFC_ComSRSBTOut_CA "inhibit conditions / inhibit limit conditions for inhibit source DFC_ComSRSBTOut" VAL_BLK 0x804F88F1 ValA_Wu8 17.0000000000 DINH_LimDFCVerb 0.00 17.0000000000 FORMAT "%13.10" NUMBER 57 /end CHARACTERISTIC
/begin CHARACTERISTIC DINH_Lim.DFC_ComSRSChksum_CA "inhibit conditions / inhibit limit conditions for inhibit source DFC_ComSRSChksum" VAL_BLK 0x804F892A ValA_Wu8 17.0000000000 DINH_LimDFCVerb 0.00 17.0000000000 FORMAT "%13.10" NUMBER 57 /end CHARACTERISTIC
/begin CHARACTERISTIC DINH_Lim.DFC_ComSRSErr_CA "inhibit conditions / inhibit limit conditions for inhibit source DFC_ComSRSErr" VAL_BLK 0x804F8963 ValA_Wu8 17.0000000000 DINH_LimDFCVerb 0.00 17.0000000000 FORMAT "%13.10" NUMBER 50 /end CHARACTERISTIC
/begin CHARACTERISTIC DINH_Lim.DFC_ComSRSRingCnt_CA "inhibit conditions / inhibit limit conditions for inhibit source DFC_ComSRSRingCnt" VAL_BLK 0x804F8995 ValA_Wu8 17.0000000000 DINH_LimDFCVerb 0.00 17.0000000000 FORMAT "%13.10" NUMBER 57 /end CHARACTERISTIC
/begin CHARACTERISTIC DINH_Lim.DFC_ComSRSTOut_CA "inhibit conditions / inhibit limit conditions for inhibit source DFC_ComSRSTOut" VAL_BLK 0x804F89CE ValA_Wu8 17.0000000000 DINH_LimDFCVerb 0.00 17.0000000000 FORMAT "%13.10" NUMBER 57 /end CHARACTERISTIC
/begin CHARACTERISTIC DINH_Lim.DFC_ComVehSpdPndFltTCU_CA "inhibit conditions / inhibit limit conditions for inhibit source DFC_ComVehSpdPndFltTCU" VAL_BLK 0x804F8A07 ValA_Wu8 17.0000000000 DINH_LimDFCVerb 0.00 17.0000000000 FORMAT "%13.10" NUMBER 50 /end CHARACTERISTIC
/begin CHARACTERISTIC DINH_Lim.DFC_EbsChartcCurrErr_CA "inhibit conditions / inhibit limit conditions for inhibit source DFC_EbsChartcCurrErr" VAL_BLK 0x804F8A39 ValA_Wu8 17.0000000000 DINH_LimDFCVerb 0.00 17.0000000000 FORMAT "%13.10" NUMBER 63 /end CHARACTERISTIC
/begin CHARACTERISTIC DINH_Lim.DFC_EbsSelfDiagErr_CA "inhibit conditions / inhibit limit conditions for inhibit source DFC_EbsSelfDiagErr" VAL_BLK 0x804F8A78 ValA_Wu8 17.0000000000 DINH_LimDFCVerb 0.00 17.0000000000 FORMAT "%13.10" NUMBER 63 /end CHARACTERISTIC
/begin CHARACTERISTIC DINH_Lim.DFC_GEVlvPhaCsersIntkB1_CA "inhibit conditions / inhibit limit conditions for inhibit source DFC_GEVlvPhaCsersIntkB1" VAL_BLK 0x804F8AB7 ValA_Wu8 17.0000000000 DINH_LimDFCVerb 0.00 17.0000000000 FORMAT "%13.10" NUMBER 58 /end CHARACTERISTIC
/begin CHARACTERISTIC DINH_Lim.DFC_GEVlvPhaPsOpenLoadIntkB1_CA "inhibit conditions / inhibit limit conditions for inhibit source DFC_GEVlvPhaPsOpenLoadIntkB1" VAL_BLK 0x804F8AF1 ValA_Wu8 17.0000000000 DINH_LimDFCVerb 0.00 17.0000000000 FORMAT "%13.10" NUMBER 94 /end CHARACTERISTIC
/begin CHARACTERISTIC DINH_Lim.DFC_GEVlvPhaPsShoToBattIntkB1_CA "inhibit conditions / inhibit limit conditions for inhibit source DFC_GEVlvPhaPsShoToBattIntkB1" VAL_BLK 0x804F8B4F ValA_Wu8 17.0000000000 DINH_LimDFCVerb 0.00 17.0000000000 FORMAT "%13.10" NUMBER 94 /end CHARACTERISTIC
/begin CHARACTERISTIC DINH_Lim.DFC_GEVlvPhaPsShoToGndIntkB1_CA "inhibit conditions / inhibit limit conditions for inhibit source DFC_GEVlvPhaPsShoToGndIntkB1" VAL_BLK 0x804F8BAD ValA_Wu8 17.0000000000 DINH_LimDFCVerb 0.00 17.0000000000 FORMAT "%13.10" NUMBER 94 /end CHARACTERISTIC
/begin CHARACTERISTIC DINH_Lim.DFC_GbxCANDigPlausErr_CA "inhibit conditions / inhibit limit conditions for inhibit source DFC_GbxCANDigPlausErr" VAL_BLK 0x804F8C0B ValA_Wu8 17.0000000000 DINH_LimDFCVerb 0.00 17.0000000000 FORMAT "%13.10" NUMBER 52 /end CHARACTERISTIC
/begin CHARACTERISTIC DINH_Lim.DFC_GbxNPos1SRCMax_CA "inhibit conditions / inhibit limit conditions for inhibit source DFC_GbxNPos1SRCMax" VAL_BLK 0x804F8C3F ValA_Wu8 17.0000000000 DINH_LimDFCVerb 0.00 17.0000000000 FORMAT "%13.10" NUMBER 60 /end CHARACTERISTIC
/begin CHARACTERISTIC DINH_Lim.DFC_GbxNPos1SRCMin_CA "inhibit conditions / inhibit limit conditions for inhibit source DFC_GbxNPos1SRCMin" VAL_BLK 0x804F8C7B ValA_Wu8 17.0000000000 DINH_LimDFCVerb 0.00 17.0000000000 FORMAT "%13.10" NUMBER 60 /end CHARACTERISTIC
/begin CHARACTERISTIC DINH_Lim.DFC_GbxNPos2SRCMax_CA "inhibit conditions / inhibit limit conditions for inhibit source DFC_GbxNPos2SRCMax" VAL_BLK 0x804F8CB7 ValA_Wu8 17.0000000000 DINH_LimDFCVerb 0.00 17.0000000000 FORMAT "%13.10" NUMBER 60 /end CHARACTERISTIC
/begin CHARACTERISTIC DINH_Lim.DFC_GbxNPos2SRCMin_CA "inhibit conditions / inhibit limit conditions for inhibit source DFC_GbxNPos2SRCMin" VAL_BLK 0x804F8CF3 ValA_Wu8 17.0000000000 DINH_LimDFCVerb 0.00 17.0000000000 FORMAT "%13.10" NUMBER 60 /end CHARACTERISTIC
/begin CHARACTERISTIC DINH_Lim.DFC_GbxNPosAlvChk_CA "inhibit conditions / inhibit limit conditions for inhibit source DFC_GbxNPosAlvChk" VAL_BLK 0x804F8D2F ValA_Wu8 17.0000000000 DINH_LimDFCVerb 0.00 17.0000000000 FORMAT "%13.10" NUMBER 50 /end CHARACTERISTIC
/begin CHARACTERISTIC DINH_Lim.DFC_GbxNPosSyncErr_CA "inhibit conditions / inhibit limit conditions for inhibit source DFC_GbxNPosSyncErr" VAL_BLK 0x804F8D61 ValA_Wu8 17.0000000000 DINH_LimDFCVerb 0.00 17.0000000000 FORMAT "%13.10" NUMBER 58 /end CHARACTERISTIC
/begin CHARACTERISTIC DINH_Lim.DFC_HEGOS2B1HtrPsMax_CA "inhibit conditions / inhibit limit conditions for inhibit source DFC_HEGOS2B1HtrPsMax" VAL_BLK 0x804F8D9B ValA_Wu8 17.0000000000 DINH_LimDFCVerb 0.00 17.0000000000 FORMAT "%13.10" NUMBER 70 /end CHARACTERISTIC
/begin CHARACTERISTIC DINH_Lim.DFC_HEGOS2B1HtrPsMin_CA "inhibit conditions / inhibit limit conditions for inhibit source DFC_HEGOS2B1HtrPsMin" VAL_BLK 0x804F8DE1 ValA_Wu8 17.0000000000 DINH_LimDFCVerb 0.00 17.0000000000 FORMAT "%13.10" NUMBER 70 /end CHARACTERISTIC
/begin CHARACTERISTIC DINH_Lim.DFC_HEGOS2B1HtrPsSig_CA "inhibit conditions / inhibit limit conditions for inhibit source DFC_HEGOS2B1HtrPsSig" VAL_BLK 0x804F8E27 ValA_Wu8 17.0000000000 DINH_LimDFCVerb 0.00 17.0000000000 FORMAT "%13.10" NUMBER 70 /end CHARACTERISTIC
/begin CHARACTERISTIC DINH_Lim.DFC_LinCSErrACG_CA "inhibit conditions / inhibit limit conditions for inhibit source DFC_LinCSErrACG" VAL_BLK 0x804F8E6D ValA_Wu8 17.0000000000 DINH_LimDFCVerb 0.00 17.0000000000 FORMAT "%13.10" NUMBER 68 /end CHARACTERISTIC
/begin CHARACTERISTIC DINH_Lim.DFC_LinCSErrAEV_CA "inhibit conditions / inhibit limit conditions for inhibit source DFC_LinCSErrAEV" VAL_BLK 0x804F8EB1 ValA_Wu8 17.0000000000 DINH_LimDFCVerb 0.00 17.0000000000 FORMAT "%13.10" NUMBER 52 /end CHARACTERISTIC
/begin CHARACTERISTIC DINH_Lim.DFC_LinCSErrDCDC_CA "inhibit conditions / inhibit limit conditions for inhibit source DFC_LinCSErrDCDC" VAL_BLK 0x804F8EE5 ValA_Wu8 17.0000000000 DINH_LimDFCVerb 0.00 17.0000000000 FORMAT "%13.10" NUMBER 57 /end CHARACTERISTIC
/begin CHARACTERISTIC DINH_Lim.DFC_LinCSErrEBS_CA "inhibit conditions / inhibit limit conditions for inhibit source DFC_LinCSErrEBS" VAL_BLK 0x804F8F1E ValA_Wu8 17.0000000000 DINH_LimDFCVerb 0.00 17.0000000000 FORMAT "%13.10" NUMBER 67 /end CHARACTERISTIC
/begin CHARACTERISTIC DINH_Lim.DFC_LinHdrTimeoutErrACG_CA "inhibit conditions / inhibit limit conditions for inhibit source DFC_LinHdrTimeoutErrACG" VAL_BLK 0x804F8F61 ValA_Wu8 17.0000000000 DINH_LimDFCVerb 0.00 17.0000000000 FORMAT "%13.10" NUMBER 68 /end CHARACTERISTIC
/begin CHARACTERISTIC DINH_Lim.DFC_LinHdrTimeoutErrAEV_CA "inhibit conditions / inhibit limit conditions for inhibit source DFC_LinHdrTimeoutErrAEV" VAL_BLK 0x804F8FA5 ValA_Wu8 17.0000000000 DINH_LimDFCVerb 0.00 17.0000000000 FORMAT "%13.10" NUMBER 52 /end CHARACTERISTIC
/begin CHARACTERISTIC DINH_Lim.DFC_LinHdrTimeoutErrDCDC_CA "inhibit conditions / inhibit limit conditions for inhibit source DFC_LinHdrTimeoutErrDCDC" VAL_BLK 0x804F8FD9 ValA_Wu8 17.0000000000 DINH_LimDFCVerb 0.00 17.0000000000 FORMAT "%13.10" NUMBER 57 /end CHARACTERISTIC
/begin CHARACTERISTIC DINH_Lim.DFC_LinHdrTimeoutErrEBS_CA "inhibit conditions / inhibit limit conditions for inhibit source DFC_LinHdrTimeoutErrEBS" VAL_BLK 0x804F9012 ValA_Wu8 17.0000000000 DINH_LimDFCVerb 0.00 17.0000000000 FORMAT "%13.10" NUMBER 67 /end CHARACTERISTIC
/begin CHARACTERISTIC DINH_Lim.DFC_LinMsgTimeoutErrACG_CA "inhibit conditions / inhibit limit conditions for inhibit source DFC_LinMsgTimeoutErrACG" VAL_BLK 0x804F9055 ValA_Wu8 17.0000000000 DINH_LimDFCVerb 0.00 17.0000000000 FORMAT "%13.10" NUMBER 68 /end CHARACTERISTIC
/begin CHARACTERISTIC DINH_Lim.DFC_LinMsgTimeoutErrAEV_CA "inhibit conditions / inhibit limit conditions for inhibit source DFC_LinMsgTimeoutErrAEV" VAL_BLK 0x804F9099 ValA_Wu8 17.0000000000 DINH_LimDFCVerb 0.00 17.0000000000 FORMAT "%13.10" NUMBER 52 /end CHARACTERISTIC
/begin CHARACTERISTIC DINH_Lim.DFC_LinMsgTimeoutErrDCDC_CA "inhibit conditions / inhibit limit conditions for inhibit source DFC_LinMsgTimeoutErrDCDC" VAL_BLK 0x804F90CD ValA_Wu8 17.0000000000 DINH_LimDFCVerb 0.00 17.0000000000 FORMAT "%13.10" NUMBER 57 /end CHARACTERISTIC
/begin CHARACTERISTIC DINH_Lim.DFC_LinMsgTimeoutErrEBS_CA "inhibit conditions / inhibit limit conditions for inhibit source DFC_LinMsgTimeoutErrEBS" VAL_BLK 0x804F9106 ValA_Wu8 17.0000000000 DINH_LimDFCVerb 0.00 17.0000000000 FORMAT "%13.10" NUMBER 67 /end CHARACTERISTIC
/begin CHARACTERISTIC DINH_Lim.DFC_LinNoStrtComErr_CA "inhibit conditions / inhibit limit conditions for inhibit source DFC_LinNoStrtComErr" VAL_BLK 0x804F9149 ValA_Wu8 17.0000000000 DINH_LimDFCVerb 0.00 17.0000000000 FORMAT "%13.10" NUMBER 65 /end CHARACTERISTIC
/begin CHARACTERISTIC DINH_Lim.DFC_LowPresOilP_CA "inhibit conditions / inhibit limit conditions for inhibit source DFC_LowPresOilP" VAL_BLK 0x804F918A ValA_Wu8 17.0000000000 DINH_LimDFCVerb 0.00 17.0000000000 FORMAT "%13.10" NUMBER 50 /end CHARACTERISTIC
/begin CHARACTERISTIC DINH_Lim.DFC_MisfDetVWhlFrntLeOORHi_CA "inhibit conditions / inhibit limit conditions for inhibit source DFC_MisfDetVWhlFrntLeOORHi" VAL_BLK 0x804F91BC ValA_Wu8 17.0000000000 DINH_LimDFCVerb 0.00 17.0000000000 FORMAT "%13.10" NUMBER 50 /end CHARACTERISTIC
/begin CHARACTERISTIC DINH_Lim.DFC_MisfDetVWhlFrntLeRatyHi_CA "inhibit conditions / inhibit limit conditions for inhibit source DFC_MisfDetVWhlFrntLeRatyHi" VAL_BLK 0x804F91EE ValA_Wu8 17.0000000000 DINH_LimDFCVerb 0.00 17.0000000000 FORMAT "%13.10" NUMBER 50 /end CHARACTERISTIC
/begin CHARACTERISTIC DINH_Lim.DFC_MisfDetVWhlFrntLeRatyLo_CA "inhibit conditions / inhibit limit conditions for inhibit source DFC_MisfDetVWhlFrntLeRatyLo" VAL_BLK 0x804F9220 ValA_Wu8 17.0000000000 DINH_LimDFCVerb 0.00 17.0000000000 FORMAT "%13.10" NUMBER 50 /end CHARACTERISTIC
/begin CHARACTERISTIC DINH_Lim.DFC_MisfDetVWhlFrntLeStuck_CA "inhibit conditions / inhibit limit conditions for inhibit source DFC_MisfDetVWhlFrntLeStuck" VAL_BLK 0x804F9252 ValA_Wu8 17.0000000000 DINH_LimDFCVerb 0.00 17.0000000000 FORMAT "%13.10" NUMBER 50 /end CHARACTERISTIC
/begin CHARACTERISTIC DINH_Lim.DFC_MisfDetVWhlFrntRiOORHi_CA "inhibit conditions / inhibit limit conditions for inhibit source DFC_MisfDetVWhlFrntRiOORHi" VAL_BLK 0x804F9284 ValA_Wu8 17.0000000000 DINH_LimDFCVerb 0.00 17.0000000000 FORMAT "%13.10" NUMBER 50 /end CHARACTERISTIC
/begin CHARACTERISTIC DINH_Lim.DFC_MisfDetVWhlFrntRiRatyHi_CA "inhibit conditions / inhibit limit conditions for inhibit source DFC_MisfDetVWhlFrntRiRatyHi" VAL_BLK 0x804F92B6 ValA_Wu8 17.0000000000 DINH_LimDFCVerb 0.00 17.0000000000 FORMAT "%13.10" NUMBER 50 /end CHARACTERISTIC
/begin CHARACTERISTIC DINH_Lim.DFC_MisfDetVWhlFrntRiRatyLo_CA "inhibit conditions / inhibit limit conditions for inhibit source DFC_MisfDetVWhlFrntRiRatyLo" VAL_BLK 0x804F92E8 ValA_Wu8 17.0000000000 DINH_LimDFCVerb 0.00 17.0000000000 FORMAT "%13.10" NUMBER 50 /end CHARACTERISTIC
/begin CHARACTERISTIC DINH_Lim.DFC_MisfDetVWhlFrntRiStuck_CA "inhibit conditions / inhibit limit conditions for inhibit source DFC_MisfDetVWhlFrntRiStuck" VAL_BLK 0x804F931A ValA_Wu8 17.0000000000 DINH_LimDFCVerb 0.00 17.0000000000 FORMAT "%13.10" NUMBER 50 /end CHARACTERISTIC
/begin CHARACTERISTIC DINH_Lim.DFC_MisfDetVWhlReLeOORHi_CA "inhibit conditions / inhibit limit conditions for inhibit source DFC_MisfDetVWhlReLeOORHi" VAL_BLK 0x804F934C ValA_Wu8 17.0000000000 DINH_LimDFCVerb 0.00 17.0000000000 FORMAT "%13.10" NUMBER 50 /end CHARACTERISTIC
/begin CHARACTERISTIC DINH_Lim.DFC_MisfDetVWhlReLeRatyHi_CA "inhibit conditions / inhibit limit conditions for inhibit source DFC_MisfDetVWhlReLeRatyHi" VAL_BLK 0x804F937E ValA_Wu8 17.0000000000 DINH_LimDFCVerb 0.00 17.0000000000 FORMAT "%13.10" NUMBER 50 /end CHARACTERISTIC
/begin CHARACTERISTIC DINH_Lim.DFC_MisfDetVWhlReLeRatyLo_CA "inhibit conditions / inhibit limit conditions for inhibit source DFC_MisfDetVWhlReLeRatyLo" VAL_BLK 0x804F93B0 ValA_Wu8 17.0000000000 DINH_LimDFCVerb 0.00 17.0000000000 FORMAT "%13.10" NUMBER 50 /end CHARACTERISTIC
/begin CHARACTERISTIC DINH_Lim.DFC_MisfDetVWhlReLeStuck_CA "inhibit conditions / inhibit limit conditions for inhibit source DFC_MisfDetVWhlReLeStuck" VAL_BLK 0x804F93E2 ValA_Wu8 17.0000000000 DINH_LimDFCVerb 0.00 17.0000000000 FORMAT "%13.10" NUMBER 50 /end CHARACTERISTIC
/begin CHARACTERISTIC DINH_Lim.DFC_MisfDetVWhlReRiOORHi_CA "inhibit conditions / inhibit limit conditions for inhibit source DFC_MisfDetVWhlReRiOORHi" VAL_BLK 0x804F9414 ValA_Wu8 17.0000000000 DINH_LimDFCVerb 0.00 17.0000000000 FORMAT "%13.10" NUMBER 50 /end CHARACTERISTIC
/begin CHARACTERISTIC DINH_Lim.DFC_MisfDetVWhlReRiRatyHi_CA "inhibit conditions / inhibit limit conditions for inhibit source DFC_MisfDetVWhlReRiRatyHi" VAL_BLK 0x804F9446 ValA_Wu8 17.0000000000 DINH_LimDFCVerb 0.00 17.0000000000 FORMAT "%13.10" NUMBER 50 /end CHARACTERISTIC
/begin CHARACTERISTIC DINH_Lim.DFC_MisfDetVWhlReRiRatyLo_CA "inhibit conditions / inhibit limit conditions for inhibit source DFC_MisfDetVWhlReRiRatyLo" VAL_BLK 0x804F9478 ValA_Wu8 17.0000000000 DINH_LimDFCVerb 0.00 17.0000000000 FORMAT "%13.10" NUMBER 50 /end CHARACTERISTIC
/begin CHARACTERISTIC DINH_Lim.DFC_MisfDetVWhlReRiStuck_CA "inhibit conditions / inhibit limit conditions for inhibit source DFC_MisfDetVWhlReRiStuck" VAL_BLK 0x804F94AA ValA_Wu8 17.0000000000 DINH_LimDFCVerb 0.00 17.0000000000 FORMAT "%13.10" NUMBER 50 /end CHARACTERISTIC
/begin CHARACTERISTIC DINH_Lim.DFC_MisfDetdVWhlFrntLePlaus_CA "inhibit conditions / inhibit limit conditions for inhibit source DFC_MisfDetdVWhlFrntLePlaus" VAL_BLK 0x804F94DC ValA_Wu8 17.0000000000 DINH_LimDFCVerb 0.00 17.0000000000 FORMAT "%13.10" NUMBER 50 /end CHARACTERISTIC
/begin CHARACTERISTIC DINH_Lim.DFC_MisfDetdVWhlFrntRiPlaus_CA "inhibit conditions / inhibit limit conditions for inhibit source DFC_MisfDetdVWhlFrntRiPlaus" VAL_BLK 0x804F950E ValA_Wu8 17.0000000000 DINH_LimDFCVerb 0.00 17.0000000000 FORMAT "%13.10" NUMBER 50 /end CHARACTERISTIC
/begin CHARACTERISTIC DINH_Lim.DFC_MisfDetdVWhlReLePlaus_CA "inhibit conditions / inhibit limit conditions for inhibit source DFC_MisfDetdVWhlReLePlaus" VAL_BLK 0x804F9540 ValA_Wu8 17.0000000000 DINH_LimDFCVerb 0.00 17.0000000000 FORMAT "%13.10" NUMBER 50 /end CHARACTERISTIC
/begin CHARACTERISTIC DINH_Lim.DFC_MisfDetdVWhlReRiPlaus_CA "inhibit conditions / inhibit limit conditions for inhibit source DFC_MisfDetdVWhlReRiPlaus" VAL_BLK 0x804F9572 ValA_Wu8 17.0000000000 DINH_LimDFCVerb 0.00 17.0000000000 FORMAT "%13.10" NUMBER 50 /end CHARACTERISTIC
/begin CHARACTERISTIC DINH_Lim.DFC_PEnvSigRngMax_CA "inhibit conditions / inhibit limit conditions for inhibit source DFC_PEnvSigRngMax" VAL_BLK 0x804F95A4 ValA_Wu8 17.0000000000 DINH_LimDFCVerb 0.00 17.0000000000 FORMAT "%13.10" NUMBER 91 /end CHARACTERISTIC
/begin CHARACTERISTIC DINH_Lim.DFC_PEnvSigRngMin_CA "inhibit conditions / inhibit limit conditions for inhibit source DFC_PEnvSigRngMin" VAL_BLK 0x804F95FF ValA_Wu8 17.0000000000 DINH_LimDFCVerb 0.00 17.0000000000 FORMAT "%13.10" NUMBER 91 /end CHARACTERISTIC
/begin CHARACTERISTIC DINH_Lim.DFC_StmFault_CA "inhibit conditions / inhibit limit conditions for inhibit source DFC_StmFault" VAL_BLK 0x804F965A ValA_Wu8 17.0000000000 DINH_LimDFCVerb 0.00 17.0000000000 FORMAT "%13.10" NUMBER 53 /end CHARACTERISTIC
/begin CHARACTERISTIC DINH_Lim.DFC_StrtCtOffPth_CA "inhibit conditions / inhibit limit conditions for inhibit source DFC_StrtCtOffPth" VAL_BLK 0x804F968F ValA_Wu8 17.0000000000 DINH_LimDFCVerb 0.00 17.0000000000 FORMAT "%13.10" NUMBER 58 /end CHARACTERISTIC
/begin CHARACTERISTIC DINH_Lim.DFC_StrtCtlErr_CA "inhibit conditions / inhibit limit conditions for inhibit source DFC_StrtCtlErr" VAL_BLK 0x804F96C9 ValA_Wu8 17.0000000000 DINH_LimDFCVerb 0.00 17.0000000000 FORMAT "%13.10" NUMBER 51 /end CHARACTERISTIC
/begin CHARACTERISTIC DINH_Lim.DFC_StrtFault_CA "inhibit conditions / inhibit limit conditions for inhibit source DFC_StrtFault" VAL_BLK 0x804F96FC ValA_Wu8 17.0000000000 DINH_LimDFCVerb 0.00 17.0000000000 FORMAT "%13.10" NUMBER 52 /end CHARACTERISTIC
/begin CHARACTERISTIC DINH_Lim.DFC_StrtLckJudg1_CA "inhibit conditions / inhibit limit conditions for inhibit source DFC_StrtLckJudg1" VAL_BLK 0x804F9730 ValA_Wu8 17.0000000000 DINH_LimDFCVerb 0.00 17.0000000000 FORMAT "%13.10" NUMBER 57 /end CHARACTERISTIC
/begin CHARACTERISTIC DINH_Lim.DFC_StrtLckJudg2_CA "inhibit conditions / inhibit limit conditions for inhibit source DFC_StrtLckJudg2" VAL_BLK 0x804F9769 ValA_Wu8 17.0000000000 DINH_LimDFCVerb 0.00 17.0000000000 FORMAT "%13.10" NUMBER 57 /end CHARACTERISTIC
/begin CHARACTERISTIC DINH_Lim.DFC_StrtOL_CA "inhibit conditions / inhibit limit conditions for inhibit source DFC_StrtOL" VAL_BLK 0x804F97A2 ValA_Wu8 17.0000000000 DINH_LimDFCVerb 0.00 17.0000000000 FORMAT "%13.10" NUMBER 57 /end CHARACTERISTIC
/begin CHARACTERISTIC DINH_Lim.DFC_StrtOL2_CA "inhibit conditions / inhibit limit conditions for inhibit source DFC_StrtOL2" VAL_BLK 0x804F97DB ValA_Wu8 17.0000000000 DINH_LimDFCVerb 0.00 17.0000000000 FORMAT "%13.10" NUMBER 57 /end CHARACTERISTIC
/begin CHARACTERISTIC DINH_Lim.DFC_StrtSCB_CA "inhibit conditions / inhibit limit conditions for inhibit source DFC_StrtSCB" VAL_BLK 0x804F9814 ValA_Wu8 17.0000000000 DINH_LimDFCVerb 0.00 17.0000000000 FORMAT "%13.10" NUMBER 58 /end CHARACTERISTIC
/begin CHARACTERISTIC DINH_Lim.DFC_StrtSCB2_CA "inhibit conditions / inhibit limit conditions for inhibit source DFC_StrtSCB2" VAL_BLK 0x804F984E ValA_Wu8 17.0000000000 DINH_LimDFCVerb 0.00 17.0000000000 FORMAT "%13.10" NUMBER 58 /end CHARACTERISTIC
/begin CHARACTERISTIC DINH_Lim.DFC_StrtSCG_CA "inhibit conditions / inhibit limit conditions for inhibit source DFC_StrtSCG" VAL_BLK 0x804F9888 ValA_Wu8 17.0000000000 DINH_LimDFCVerb 0.00 17.0000000000 FORMAT "%13.10" NUMBER 58 /end CHARACTERISTIC
/begin CHARACTERISTIC DINH_Lim.DFC_StrtSCG2_CA "inhibit conditions / inhibit limit conditions for inhibit source DFC_StrtSCG2" VAL_BLK 0x804F98C2 ValA_Wu8 17.0000000000 DINH_LimDFCVerb 0.00 17.0000000000 FORMAT "%13.10" NUMBER 58 /end CHARACTERISTIC
/begin CHARACTERISTIC DINH_Lim.DFC_StrtStkRly1_CA "inhibit conditions / inhibit limit conditions for inhibit source DFC_StrtStkRly1" VAL_BLK 0x804F98FC ValA_Wu8 17.0000000000 DINH_LimDFCVerb 0.00 17.0000000000 FORMAT "%13.10" NUMBER 56 /end CHARACTERISTIC
/begin CHARACTERISTIC DINH_Lim.DFC_StrtStkRly2_CA "inhibit conditions / inhibit limit conditions for inhibit source DFC_StrtStkRly2" VAL_BLK 0x804F9934 ValA_Wu8 17.0000000000 DINH_LimDFCVerb 0.00 17.0000000000 FORMAT "%13.10" NUMBER 56 /end CHARACTERISTIC
/begin CHARACTERISTIC DINH_Lim.DFC_TEVEmax_CA "inhibit conditions / inhibit limit conditions for inhibit source DFC_TEVEmax" VAL_BLK 0x804F996C ValA_Wu8 17.0000000000 DINH_LimDFCVerb 0.00 17.0000000000 FORMAT "%13.10" NUMBER 82 /end CHARACTERISTIC
/begin CHARACTERISTIC DINH_Lim.DFC_TEVEmin_CA "inhibit conditions / inhibit limit conditions for inhibit source DFC_TEVEmin" VAL_BLK 0x804F99BE ValA_Wu8 17.0000000000 DINH_LimDFCVerb 0.00 17.0000000000 FORMAT "%13.10" NUMBER 83 /end CHARACTERISTIC
/begin CHARACTERISTIC DINH_Lim.DFC_TEVEsig_CA "inhibit conditions / inhibit limit conditions for inhibit source DFC_TEVEsig" VAL_BLK 0x804F9A11 ValA_Wu8 17.0000000000 DINH_LimDFCVerb 0.00 17.0000000000 FORMAT "%13.10" NUMBER 82 /end CHARACTERISTIC
/begin CHARACTERISTIC DINH_Lim.DFC_UegoHeatrPrfmncLoS1B1_CA "inhibit conditions / inhibit limit conditions for inhibit source DFC_UegoHeatrPrfmncLoS1B1" VAL_BLK 0x804F9A63 ValA_Wu8 17.0000000000 DINH_LimDFCVerb 0.00 17.0000000000 FORMAT "%13.10" NUMBER 53 /end CHARACTERISTIC
/begin CHARACTERISTIC DINH_Lim.DFC_VehVAllPlaus_CA "inhibit conditions / inhibit limit conditions for inhibit source DFC_VehVAllPlaus" VAL_BLK 0x804F9A98 ValA_Wu8 17.0000000000 DINH_LimDFCVerb 0.00 17.0000000000 FORMAT "%13.10" NUMBER 67 /end CHARACTERISTIC
/begin CHARACTERISTIC DINH_Lim.DFC_VehVNCSnsrElecFailr_CA "inhibit conditions / inhibit limit conditions for inhibit source DFC_VehVNCSnsrElecFailr" VAL_BLK 0x804F9ADB ValA_Wu8 17.0000000000 DINH_LimDFCVerb 0.00 17.0000000000 FORMAT "%13.10" NUMBER 55 /end CHARACTERISTIC
/begin CHARACTERISTIC DINH_Lim.DFC_VehVPlausCan_CA "inhibit conditions / inhibit limit conditions for inhibit source DFC_VehVPlausCan" VAL_BLK 0x804F9B12 ValA_Wu8 17.0000000000 DINH_LimDFCVerb 0.00 17.0000000000 FORMAT "%13.10" NUMBER 81 /end CHARACTERISTIC
/begin CHARACTERISTIC DINH_Lim.DFC_VehVPlausFco_CA "inhibit conditions / inhibit limit conditions for inhibit source DFC_VehVPlausFco" VAL_BLK 0x804F9B63 ValA_Wu8 17.0000000000 DINH_LimDFCVerb 0.00 17.0000000000 FORMAT "%13.10" NUMBER 90 /end CHARACTERISTIC
/begin CHARACTERISTIC DINH_Lim.DFC_VehVPlausPwr_CA "inhibit conditions / inhibit limit conditions for inhibit source DFC_VehVPlausPwr" VAL_BLK 0x804F9BBD ValA_Wu8 17.0000000000 DINH_LimDFCVerb 0.00 17.0000000000 FORMAT "%13.10" NUMBER 76 /end CHARACTERISTIC
/begin CHARACTERISTIC DINH_Lim.DFC_VehVPlausV2N_CA "inhibit conditions / inhibit limit conditions for inhibit source DFC_VehVPlausV2N" VAL_BLK 0x804F9C09 ValA_Wu8 17.0000000000 DINH_LimDFCVerb 0.00 17.0000000000 FORMAT "%13.10" NUMBER 76 /end CHARACTERISTIC
/begin CHARACTERISTIC DINH_Lim.DFC_VehVSpdSnsrAElecFailr_CA "inhibit conditions / inhibit limit conditions for inhibit source DFC_VehVSpdSnsrAElecFailr" VAL_BLK 0x804F9C55 ValA_Wu8 17.0000000000 DINH_LimDFCVerb 0.00 17.0000000000 FORMAT "%13.10" NUMBER 54 /end CHARACTERISTIC
/begin CHARACTERISTIC DINH_Lim.DFC_VehVSpdSnsrBElecFailr_CA "inhibit conditions / inhibit limit conditions for inhibit source DFC_VehVSpdSnsrBElecFailr" VAL_BLK 0x804F9C8B ValA_Wu8 17.0000000000 DINH_LimDFCVerb 0.00 17.0000000000 FORMAT "%13.10" NUMBER 54 /end CHARACTERISTIC
/begin CHARACTERISTIC DINH_Lim.DFC_ClthMax_CA "inhibit conditions / inhibit limit conditions for inhibit source DFC_ClthMax" VAL_BLK 0x804F9CC1 ValA_Wu8 17.0000000000 DINH_LimDFCVerb 0.00 17.0000000000 FORMAT "%13.10" NUMBER 65 /end CHARACTERISTIC
/begin CHARACTERISTIC DINH_Lim.DFC_IgnClPs_DevComErr_CA "inhibit conditions / inhibit limit conditions for inhibit source DFC_IgnClPs_DevComErr" VAL_BLK 0x804F9D02 ValA_Wu8 17.0000000000 DINH_LimDFCVerb 0.00 17.0000000000 FORMAT "%13.10" NUMBER 51 /end CHARACTERISTIC
/begin CHARACTERISTIC DINH_Lim.DFC_IgnClPs_LineOl_0_CA "inhibit conditions / inhibit limit conditions for inhibit source DFC_IgnClPs_LineOl_0" VAL_BLK 0x804F9D35 ValA_Wu8 17.0000000000 DINH_LimDFCVerb 0.00 17.0000000000 FORMAT "%13.10" NUMBER 55 /end CHARACTERISTIC
/begin CHARACTERISTIC DINH_Lim.DFC_IgnClPs_LineOl_1_CA "inhibit conditions / inhibit limit conditions for inhibit source DFC_IgnClPs_LineOl_1" VAL_BLK 0x804F9D6C ValA_Wu8 17.0000000000 DINH_LimDFCVerb 0.00 17.0000000000 FORMAT "%13.10" NUMBER 55 /end CHARACTERISTIC
/begin CHARACTERISTIC DINH_Lim.DFC_IgnClPs_LineOl_2_CA "inhibit conditions / inhibit limit conditions for inhibit source DFC_IgnClPs_LineOl_2" VAL_BLK 0x804F9DA3 ValA_Wu8 17.0000000000 DINH_LimDFCVerb 0.00 17.0000000000 FORMAT "%13.10" NUMBER 55 /end CHARACTERISTIC
/begin CHARACTERISTIC DINH_Lim.DFC_IgnClPs_LineOl_3_CA "inhibit conditions / inhibit limit conditions for inhibit source DFC_IgnClPs_LineOl_3" VAL_BLK 0x804F9DDA ValA_Wu8 17.0000000000 DINH_LimDFCVerb 0.00 17.0000000000 FORMAT "%13.10" NUMBER 55 /end CHARACTERISTIC
/begin CHARACTERISTIC DINH_Lim.DFC_IgnClPs_LineScb_0_CA "inhibit conditions / inhibit limit conditions for inhibit source DFC_IgnClPs_LineScb_0" VAL_BLK 0x804F9E11 ValA_Wu8 17.0000000000 DINH_LimDFCVerb 0.00 17.0000000000 FORMAT "%13.10" NUMBER 55 /end CHARACTERISTIC
/begin CHARACTERISTIC DINH_Lim.DFC_IgnClPs_LineScb_1_CA "inhibit conditions / inhibit limit conditions for inhibit source DFC_IgnClPs_LineScb_1" VAL_BLK 0x804F9E48 ValA_Wu8 17.0000000000 DINH_LimDFCVerb 0.00 17.0000000000 FORMAT "%13.10" NUMBER 55 /end CHARACTERISTIC
/begin CHARACTERISTIC DINH_Lim.DFC_IgnClPs_LineScb_2_CA "inhibit conditions / inhibit limit conditions for inhibit source DFC_IgnClPs_LineScb_2" VAL_BLK 0x804F9E7F ValA_Wu8 17.0000000000 DINH_LimDFCVerb 0.00 17.0000000000 FORMAT "%13.10" NUMBER 55 /end CHARACTERISTIC
/begin CHARACTERISTIC DINH_Lim.DFC_IgnClPs_LineScb_3_CA "inhibit conditions / inhibit limit conditions for inhibit source DFC_IgnClPs_LineScb_3" VAL_BLK 0x804F9EB6 ValA_Wu8 17.0000000000 DINH_LimDFCVerb 0.00 17.0000000000 FORMAT "%13.10" NUMBER 55 /end CHARACTERISTIC
/begin CHARACTERISTIC DINH_Lim.DFC_IgnClPs_LineScg_0_CA "inhibit conditions / inhibit limit conditions for inhibit source DFC_IgnClPs_LineScg_0" VAL_BLK 0x804F9EED ValA_Wu8 17.0000000000 DINH_LimDFCVerb 0.00 17.0000000000 FORMAT "%13.10" NUMBER 55 /end CHARACTERISTIC
/begin CHARACTERISTIC DINH_Lim.DFC_IgnClPs_LineScg_1_CA "inhibit conditions / inhibit limit conditions for inhibit source DFC_IgnClPs_LineScg_1" VAL_BLK 0x804F9F24 ValA_Wu8 17.0000000000 DINH_LimDFCVerb 0.00 17.0000000000 FORMAT "%13.10" NUMBER 55 /end CHARACTERISTIC
/begin CHARACTERISTIC DINH_Lim.DFC_IgnClPs_LineScg_2_CA "inhibit conditions / inhibit limit conditions for inhibit source DFC_IgnClPs_LineScg_2" VAL_BLK 0x804F9F5B ValA_Wu8 17.0000000000 DINH_LimDFCVerb 0.00 17.0000000000 FORMAT "%13.10" NUMBER 55 /end CHARACTERISTIC
/begin CHARACTERISTIC DINH_Lim.DFC_IgnClPs_LineScg_3_CA "inhibit conditions / inhibit limit conditions for inhibit source DFC_IgnClPs_LineScg_3" VAL_BLK 0x804F9F92 ValA_Wu8 17.0000000000 DINH_LimDFCVerb 0.00 17.0000000000 FORMAT "%13.10" NUMBER 55 /end CHARACTERISTIC
/begin CHARACTERISTIC DINH_Lim.DFC_KRVEKOEVAB_CA "inhibit conditions / inhibit limit conditions for inhibit source DFC_KRVEKOEVAB" VAL_BLK 0x804F9FC9 ValA_Wu8 17.0000000000 DINH_LimDFCVerb 0.00 17.0000000000 FORMAT "%13.10" NUMBER 50 /end CHARACTERISTIC
/begin CHARACTERISTIC DINH_Lim.DFC_KRVEKOEVAB0_CA "inhibit conditions / inhibit limit conditions for inhibit source DFC_KRVEKOEVAB0" VAL_BLK 0x804F9FFB ValA_Wu8 17.0000000000 DINH_LimDFCVerb 0.00 17.0000000000 FORMAT "%13.10" NUMBER 50 /end CHARACTERISTIC
/begin CHARACTERISTIC DINH_Lim.DFC_KRVEKOEVAB1_CA "inhibit conditions / inhibit limit conditions for inhibit source DFC_KRVEKOEVAB1" VAL_BLK 0x804FA02D ValA_Wu8 17.0000000000 DINH_LimDFCVerb 0.00 17.0000000000 FORMAT "%13.10" NUMBER 50 /end CHARACTERISTIC
/begin CHARACTERISTIC DINH_Lim.DFC_KRVEKOEVAB2_CA "inhibit conditions / inhibit limit conditions for inhibit source DFC_KRVEKOEVAB2" VAL_BLK 0x804FA05F ValA_Wu8 17.0000000000 DINH_LimDFCVerb 0.00 17.0000000000 FORMAT "%13.10" NUMBER 50 /end CHARACTERISTIC
/begin CHARACTERISTIC DINH_Lim.DFC_KRVEKOEVAB3_CA "inhibit conditions / inhibit limit conditions for inhibit source DFC_KRVEKOEVAB3" VAL_BLK 0x804FA091 ValA_Wu8 17.0000000000 DINH_LimDFCVerb 0.00 17.0000000000 FORMAT "%13.10" NUMBER 50 /end CHARACTERISTIC
/begin CHARACTERISTIC DINH_Lim.DFC_UegoSigEcuAsicS1B1_CA "inhibit conditions / inhibit limit conditions for inhibit source DFC_UegoSigEcuAsicS1B1" VAL_BLK 0x804FA0C3 ValA_Wu8 17.0000000000 DINH_LimDFCVerb 0.00 17.0000000000 FORMAT "%13.10" NUMBER 85 /end CHARACTERISTIC
/begin CHARACTERISTIC DINH_Lim.DFC_UegoSigEcuComS1B1_CA "inhibit conditions / inhibit limit conditions for inhibit source DFC_UegoSigEcuComS1B1" VAL_BLK 0x804FA118 ValA_Wu8 17.0000000000 DINH_LimDFCVerb 0.00 17.0000000000 FORMAT "%13.10" NUMBER 85 /end CHARACTERISTIC
/begin CHARACTERISTIC DINH_Lim.DFC_UegoSigSnsrS1B1_CA "inhibit conditions / inhibit limit conditions for inhibit source DFC_UegoSigSnsrS1B1" VAL_BLK 0x804FA16D ValA_Wu8 17.0000000000 DINH_LimDFCVerb 0.00 17.0000000000 FORMAT "%13.10" NUMBER 53 /end CHARACTERISTIC
/begin CHARACTERISTIC DINH_Lim.DFC_UegoSigWireOlApesS1B1_CA "inhibit conditions / inhibit limit conditions for inhibit source DFC_UegoSigWireOlApesS1B1" VAL_BLK 0x804FA1A2 ValA_Wu8 17.0000000000 DINH_LimDFCVerb 0.00 17.0000000000 FORMAT "%13.10" NUMBER 82 /end CHARACTERISTIC
/begin CHARACTERISTIC DINH_Lim.DFC_UegoSigWireOlIpeS1B1_CA "inhibit conditions / inhibit limit conditions for inhibit source DFC_UegoSigWireOlIpeS1B1" VAL_BLK 0x804FA1F4 ValA_Wu8 17.0000000000 DINH_LimDFCVerb 0.00 17.0000000000 FORMAT "%13.10" NUMBER 85 /end CHARACTERISTIC
/begin CHARACTERISTIC DINH_Lim.DFC_UegoSigWireOlReS1B1_CA "inhibit conditions / inhibit limit conditions for inhibit source DFC_UegoSigWireOlReS1B1" VAL_BLK 0x804FA249 ValA_Wu8 17.0000000000 DINH_LimDFCVerb 0.00 17.0000000000 FORMAT "%13.10" NUMBER 85 /end CHARACTERISTIC
/begin CHARACTERISTIC DINH_Lim.DFC_UegoSigWireRCmpS1B1_CA "inhibit conditions / inhibit limit conditions for inhibit source DFC_UegoSigWireRCmpS1B1" VAL_BLK 0x804FA29E ValA_Wu8 17.0000000000 DINH_LimDFCVerb 0.00 17.0000000000 FORMAT "%13.10" NUMBER 83 /end CHARACTERISTIC
/begin CHARACTERISTIC DINH_Lim.DFC_UegoSigWireScbS1B1_CA "inhibit conditions / inhibit limit conditions for inhibit source DFC_UegoSigWireScbS1B1" VAL_BLK 0x804FA2F1 ValA_Wu8 17.0000000000 DINH_LimDFCVerb 0.00 17.0000000000 FORMAT "%13.10" NUMBER 86 /end CHARACTERISTIC
/begin CHARACTERISTIC DINH_Lim.DFC_UegoSigWireScgS1B1_CA "inhibit conditions / inhibit limit conditions for inhibit source DFC_UegoSigWireScgS1B1" VAL_BLK 0x804FA347 ValA_Wu8 17.0000000000 DINH_LimDFCVerb 0.00 17.0000000000 FORMAT "%13.10" NUMBER 86 /end CHARACTERISTIC
/begin CHARACTERISTIC DINH_Lim.DFC_AfsPhyRngHiB1_CA "inhibit conditions / inhibit limit conditions for inhibit source DFC_AfsPhyRngHiB1" VAL_BLK 0x804FA39D ValA_Wu8 17.0000000000 DINH_LimDFCVerb 0.00 17.0000000000 FORMAT "%13.10" NUMBER 56 /end CHARACTERISTIC
/begin CHARACTERISTIC DINH_Lim.DFC_AfsPhyRngLoB1_CA "inhibit conditions / inhibit limit conditions for inhibit source DFC_AfsPhyRngLoB1" VAL_BLK 0x804FA3D5 ValA_Wu8 17.0000000000 DINH_LimDFCVerb 0.00 17.0000000000 FORMAT "%13.10" NUMBER 56 /end CHARACTERISTIC
/begin CHARACTERISTIC DINH_Lim.DFC_AirCCmprOL_CA "inhibit conditions / inhibit limit conditions for inhibit source DFC_AirCCmprOL" VAL_BLK 0x804FA40D ValA_Wu8 17.0000000000 DINH_LimDFCVerb 0.00 17.0000000000 FORMAT "%13.10" NUMBER 50 /end CHARACTERISTIC
/begin CHARACTERISTIC DINH_Lim.DFC_AirCCmprOvrTemp_CA "inhibit conditions / inhibit limit conditions for inhibit source DFC_AirCCmprOvrTemp" VAL_BLK 0x804FA43F ValA_Wu8 17.0000000000 DINH_LimDFCVerb 0.00 17.0000000000 FORMAT "%13.10" NUMBER 50 /end CHARACTERISTIC
/begin CHARACTERISTIC DINH_Lim.DFC_AirCCmprSCB_CA "inhibit conditions / inhibit limit conditions for inhibit source DFC_AirCCmprSCB" VAL_BLK 0x804FA471 ValA_Wu8 17.0000000000 DINH_LimDFCVerb 0.00 17.0000000000 FORMAT "%13.10" NUMBER 50 /end CHARACTERISTIC
/begin CHARACTERISTIC DINH_Lim.DFC_AirCCmprSCG_CA "inhibit conditions / inhibit limit conditions for inhibit source DFC_AirCCmprSCG" VAL_BLK 0x804FA4A3 ValA_Wu8 17.0000000000 DINH_LimDFCVerb 0.00 17.0000000000 FORMAT "%13.10" NUMBER 50 /end CHARACTERISTIC
/begin CHARACTERISTIC DINH_Lim.DFC_AltErr_CA "inhibit conditions / inhibit limit conditions for inhibit source DFC_AltErr" VAL_BLK 0x804FA4D5 ValA_Wu8 17.0000000000 DINH_LimDFCVerb 0.00 17.0000000000 FORMAT "%13.10" NUMBER 51 /end CHARACTERISTIC
/begin CHARACTERISTIC DINH_Lim.DFC_BattUSRCMax_CA "inhibit conditions / inhibit limit conditions for inhibit source DFC_BattUSRCMax" VAL_BLK 0x804FA508 ValA_Wu8 17.0000000000 DINH_LimDFCVerb 0.00 17.0000000000 FORMAT "%13.10" NUMBER 58 /end CHARACTERISTIC
/begin CHARACTERISTIC DINH_Lim.DFC_BattUSRCMin_CA "inhibit conditions / inhibit limit conditions for inhibit source DFC_BattUSRCMin" VAL_BLK 0x804FA542 ValA_Wu8 17.0000000000 DINH_LimDFCVerb 0.00 17.0000000000 FORMAT "%13.10" NUMBER 58 /end CHARACTERISTIC
/begin CHARACTERISTIC DINH_Lim.DFC_ComChksTCU1_CA "inhibit conditions / inhibit limit conditions for inhibit source DFC_ComChksTCU1" VAL_BLK 0x804FA57C ValA_Wu8 17.0000000000 DINH_LimDFCVerb 0.00 17.0000000000 FORMAT "%13.10" NUMBER 50 /end CHARACTERISTIC
/begin CHARACTERISTIC DINH_Lim.DFC_ComChksTCU11_CA "inhibit conditions / inhibit limit conditions for inhibit source DFC_ComChksTCU11" VAL_BLK 0x804FA5AE ValA_Wu8 17.0000000000 DINH_LimDFCVerb 0.00 17.0000000000 FORMAT "%13.10" NUMBER 51 /end CHARACTERISTIC
/begin CHARACTERISTIC DINH_Lim.DFC_ComChksTCU12_CA "inhibit conditions / inhibit limit conditions for inhibit source DFC_ComChksTCU12" VAL_BLK 0x804FA5E1 ValA_Wu8 17.0000000000 DINH_LimDFCVerb 0.00 17.0000000000 FORMAT "%13.10" NUMBER 52 /end CHARACTERISTIC
/begin CHARACTERISTIC DINH_Lim.DFC_ComChksTCU13_CA "inhibit conditions / inhibit limit conditions for inhibit source DFC_ComChksTCU13" VAL_BLK 0x804FA615 ValA_Wu8 17.0000000000 DINH_LimDFCVerb 0.00 17.0000000000 FORMAT "%13.10" NUMBER 52 /end CHARACTERISTIC
/begin CHARACTERISTIC DINH_Lim.DFC_ComChksTCU2_CA "inhibit conditions / inhibit limit conditions for inhibit source DFC_ComChksTCU2" VAL_BLK 0x804FA649 ValA_Wu8 17.0000000000 DINH_LimDFCVerb 0.00 17.0000000000 FORMAT "%13.10" NUMBER 50 /end CHARACTERISTIC
/begin CHARACTERISTIC DINH_Lim.DFC_ComChksTCU3_CA "inhibit conditions / inhibit limit conditions for inhibit source DFC_ComChksTCU3" VAL_BLK 0x804FA67B ValA_Wu8 17.0000000000 DINH_LimDFCVerb 0.00 17.0000000000 FORMAT "%13.10" NUMBER 50 /end CHARACTERISTIC
/begin CHARACTERISTIC DINH_Lim.DFC_ComChksTCU4_CA "inhibit conditions / inhibit limit conditions for inhibit source DFC_ComChksTCU4" VAL_BLK 0x804FA6AD ValA_Wu8 17.0000000000 DINH_LimDFCVerb 0.00 17.0000000000 FORMAT "%13.10" NUMBER 50 /end CHARACTERISTIC
/begin CHARACTERISTIC DINH_Lim.DFC_ComCntTCU1_CA "inhibit conditions / inhibit limit conditions for inhibit source DFC_ComCntTCU1" VAL_BLK 0x804FA6DF ValA_Wu8 17.0000000000 DINH_LimDFCVerb 0.00 17.0000000000 FORMAT "%13.10" NUMBER 50 /end CHARACTERISTIC
/begin CHARACTERISTIC DINH_Lim.DFC_ComCntTCU11_CA "inhibit conditions / inhibit limit conditions for inhibit source DFC_ComCntTCU11" VAL_BLK 0x804FA711 ValA_Wu8 17.0000000000 DINH_LimDFCVerb 0.00 17.0000000000 FORMAT "%13.10" NUMBER 51 /end CHARACTERISTIC
/begin CHARACTERISTIC DINH_Lim.DFC_ComCntTCU12_CA "inhibit conditions / inhibit limit conditions for inhibit source DFC_ComCntTCU12" VAL_BLK 0x804FA744 ValA_Wu8 17.0000000000 DINH_LimDFCVerb 0.00 17.0000000000 FORMAT "%13.10" NUMBER 52 /end CHARACTERISTIC
/begin CHARACTERISTIC DINH_Lim.DFC_ComCntTCU13_CA "inhibit conditions / inhibit limit conditions for inhibit source DFC_ComCntTCU13" VAL_BLK 0x804FA778 ValA_Wu8 17.0000000000 DINH_LimDFCVerb 0.00 17.0000000000 FORMAT "%13.10" NUMBER 52 /end CHARACTERISTIC
/begin CHARACTERISTIC DINH_Lim.DFC_ComCntTCU2_CA "inhibit conditions / inhibit limit conditions for inhibit source DFC_ComCntTCU2" VAL_BLK 0x804FA7AC ValA_Wu8 17.0000000000 DINH_LimDFCVerb 0.00 17.0000000000 FORMAT "%13.10" NUMBER 50 /end CHARACTERISTIC
/begin CHARACTERISTIC DINH_Lim.DFC_ComCntTCU3_CA "inhibit conditions / inhibit limit conditions for inhibit source DFC_ComCntTCU3" VAL_BLK 0x804FA7DE ValA_Wu8 17.0000000000 DINH_LimDFCVerb 0.00 17.0000000000 FORMAT "%13.10" NUMBER 50 /end CHARACTERISTIC
/begin CHARACTERISTIC DINH_Lim.DFC_ComCntTCU4_CA "inhibit conditions / inhibit limit conditions for inhibit source DFC_ComCntTCU4" VAL_BLK 0x804FA810 ValA_Wu8 17.0000000000 DINH_LimDFCVerb 0.00 17.0000000000 FORMAT "%13.10" NUMBER 50 /end CHARACTERISTIC
/begin CHARACTERISTIC DINH_Lim.DFC_ComTOutTCU01_CA "inhibit conditions / inhibit limit conditions for inhibit source DFC_ComTOutTCU01" VAL_BLK 0x804FA842 ValA_Wu8 17.0000000000 DINH_LimDFCVerb 0.00 17.0000000000 FORMAT "%13.10" NUMBER 51 /end CHARACTERISTIC
/begin CHARACTERISTIC DINH_Lim.DFC_ComTOutTCU02_CA "inhibit conditions / inhibit limit conditions for inhibit source DFC_ComTOutTCU02" VAL_BLK 0x804FA875 ValA_Wu8 17.0000000000 DINH_LimDFCVerb 0.00 17.0000000000 FORMAT "%13.10" NUMBER 51 /end CHARACTERISTIC
/begin CHARACTERISTIC DINH_Lim.DFC_ComTOutTCU1_CA "inhibit conditions / inhibit limit conditions for inhibit source DFC_ComTOutTCU1" VAL_BLK 0x804FA8A8 ValA_Wu8 17.0000000000 DINH_LimDFCVerb 0.00 17.0000000000 FORMAT "%13.10" NUMBER 55 /end CHARACTERISTIC
/begin CHARACTERISTIC DINH_Lim.DFC_ComTOutTCU11_CA "inhibit conditions / inhibit limit conditions for inhibit source DFC_ComTOutTCU11" VAL_BLK 0x804FA8DF ValA_Wu8 17.0000000000 DINH_LimDFCVerb 0.00 17.0000000000 FORMAT "%13.10" NUMBER 54 /end CHARACTERISTIC
/begin CHARACTERISTIC DINH_Lim.DFC_ComTOutTCU12_CA "inhibit conditions / inhibit limit conditions for inhibit source DFC_ComTOutTCU12" VAL_BLK 0x804FA915 ValA_Wu8 17.0000000000 DINH_LimDFCVerb 0.00 17.0000000000 FORMAT "%13.10" NUMBER 52 /end CHARACTERISTIC
/begin CHARACTERISTIC DINH_Lim.DFC_ComTOutTCU13_CA "inhibit conditions / inhibit limit conditions for inhibit source DFC_ComTOutTCU13" VAL_BLK 0x804FA949 ValA_Wu8 17.0000000000 DINH_LimDFCVerb 0.00 17.0000000000 FORMAT "%13.10" NUMBER 52 /end CHARACTERISTIC
/begin CHARACTERISTIC DINH_Lim.DFC_ComTOutTCU14_CA "inhibit conditions / inhibit limit conditions for inhibit source DFC_ComTOutTCU14" VAL_BLK 0x804FA97D ValA_Wu8 17.0000000000 DINH_LimDFCVerb 0.00 17.0000000000 FORMAT "%13.10" NUMBER 51 /end CHARACTERISTIC
/begin CHARACTERISTIC DINH_Lim.DFC_ComTOutTCU2_CA "inhibit conditions / inhibit limit conditions for inhibit source DFC_ComTOutTCU2" VAL_BLK 0x804FA9B0 ValA_Wu8 17.0000000000 DINH_LimDFCVerb 0.00 17.0000000000 FORMAT "%13.10" NUMBER 52 /end CHARACTERISTIC
/begin CHARACTERISTIC DINH_Lim.DFC_ComTOutTCU3_CA "inhibit conditions / inhibit limit conditions for inhibit source DFC_ComTOutTCU3" VAL_BLK 0x804FA9E4 ValA_Wu8 17.0000000000 DINH_LimDFCVerb 0.00 17.0000000000 FORMAT "%13.10" NUMBER 52 /end CHARACTERISTIC
/begin CHARACTERISTIC DINH_Lim.DFC_ComTOutTCU4_CA "inhibit conditions / inhibit limit conditions for inhibit source DFC_ComTOutTCU4" VAL_BLK 0x804FAA18 ValA_Wu8 17.0000000000 DINH_LimDFCVerb 0.00 17.0000000000 FORMAT "%13.10" NUMBER 51 /end CHARACTERISTIC
/begin CHARACTERISTIC DINH_Lim.DFC_DevLibBattUHi_CA "inhibit conditions / inhibit limit conditions for inhibit source DFC_DevLibBattUHi" VAL_BLK 0x804FAA4B ValA_Wu8 17.0000000000 DINH_LimDFCVerb 0.00 17.0000000000 FORMAT "%13.10" NUMBER 50 /end CHARACTERISTIC
/begin CHARACTERISTIC DINH_Lim.DFC_DevLibBattULo_CA "inhibit conditions / inhibit limit conditions for inhibit source DFC_DevLibBattULo" VAL_BLK 0x804FAA7D ValA_Wu8 17.0000000000 DINH_LimDFCVerb 0.00 17.0000000000 FORMAT "%13.10" NUMBER 50 /end CHARACTERISTIC
/begin CHARACTERISTIC DINH_Lim.DFC_EGRVlvFailSafeActv_CA "inhibit conditions / inhibit limit conditions for inhibit source DFC_EGRVlvFailSafeActv" VAL_BLK 0x804FAAAF ValA_Wu8 17.0000000000 DINH_LimDFCVerb 0.00 17.0000000000 FORMAT "%13.10" NUMBER 51 /end CHARACTERISTIC
/begin CHARACTERISTIC DINH_Lim.DFC_EGRVlvGovDvtCld_CA "inhibit conditions / inhibit limit conditions for inhibit source DFC_EGRVlvGovDvtCld" VAL_BLK 0x804FAAE2 ValA_Wu8 17.0000000000 DINH_LimDFCVerb 0.00 17.0000000000 FORMAT "%13.10" NUMBER 51 /end CHARACTERISTIC
/begin CHARACTERISTIC DINH_Lim.DFC_EGRVlvPhysSRCMax_CA "inhibit conditions / inhibit limit conditions for inhibit source DFC_EGRVlvPhysSRCMax" VAL_BLK 0x804FAB15 ValA_Wu8 17.0000000000 DINH_LimDFCVerb 0.00 17.0000000000 FORMAT "%13.10" NUMBER 54 /end CHARACTERISTIC
/begin CHARACTERISTIC DINH_Lim.DFC_EGRVlvPhysSRCMin_CA "inhibit conditions / inhibit limit conditions for inhibit source DFC_EGRVlvPhysSRCMin" VAL_BLK 0x804FAB4B ValA_Wu8 17.0000000000 DINH_LimDFCVerb 0.00 17.0000000000 FORMAT "%13.10" NUMBER 54 /end CHARACTERISTIC
/begin CHARACTERISTIC DINH_Lim.DFC_FanDIOOL_0_CA "inhibit conditions / inhibit limit conditions for inhibit source DFC_FanDIOOL_0" VAL_BLK 0x804FAB81 ValA_Wu8 17.0000000000 DINH_LimDFCVerb 0.00 17.0000000000 FORMAT "%13.10" NUMBER 51 /end CHARACTERISTIC
/begin CHARACTERISTIC DINH_Lim.DFC_FanDIOOL_1_CA "inhibit conditions / inhibit limit conditions for inhibit source DFC_FanDIOOL_1" VAL_BLK 0x804FABB4 ValA_Wu8 17.0000000000 DINH_LimDFCVerb 0.00 17.0000000000 FORMAT "%13.10" NUMBER 51 /end CHARACTERISTIC
/begin CHARACTERISTIC DINH_Lim.DFC_FanDIOOvrTemp_0_CA "inhibit conditions / inhibit limit conditions for inhibit source DFC_FanDIOOvrTemp_0" VAL_BLK 0x804FABE7 ValA_Wu8 17.0000000000 DINH_LimDFCVerb 0.00 17.0000000000 FORMAT "%13.10" NUMBER 50 /end CHARACTERISTIC
/begin CHARACTERISTIC DINH_Lim.DFC_FanDIOOvrTemp_1_CA "inhibit conditions / inhibit limit conditions for inhibit source DFC_FanDIOOvrTemp_1" VAL_BLK 0x804FAC19 ValA_Wu8 17.0000000000 DINH_LimDFCVerb 0.00 17.0000000000 FORMAT "%13.10" NUMBER 50 /end CHARACTERISTIC
/begin CHARACTERISTIC DINH_Lim.DFC_FanDIOSCB_0_CA "inhibit conditions / inhibit limit conditions for inhibit source DFC_FanDIOSCB_0" VAL_BLK 0x804FAC4B ValA_Wu8 17.0000000000 DINH_LimDFCVerb 0.00 17.0000000000 FORMAT "%13.10" NUMBER 51 /end CHARACTERISTIC
/begin CHARACTERISTIC DINH_Lim.DFC_FanDIOSCB_1_CA "inhibit conditions / inhibit limit conditions for inhibit source DFC_FanDIOSCB_1" VAL_BLK 0x804FAC7E ValA_Wu8 17.0000000000 DINH_LimDFCVerb 0.00 17.0000000000 FORMAT "%13.10" NUMBER 51 /end CHARACTERISTIC
/begin CHARACTERISTIC DINH_Lim.DFC_FanDIOSCG_0_CA "inhibit conditions / inhibit limit conditions for inhibit source DFC_FanDIOSCG_0" VAL_BLK 0x804FACB1 ValA_Wu8 17.0000000000 DINH_LimDFCVerb 0.00 17.0000000000 FORMAT "%13.10" NUMBER 51 /end CHARACTERISTIC
/begin CHARACTERISTIC DINH_Lim.DFC_FanDIOSCG_1_CA "inhibit conditions / inhibit limit conditions for inhibit source DFC_FanDIOSCG_1" VAL_BLK 0x804FACE4 ValA_Wu8 17.0000000000 DINH_LimDFCVerb 0.00 17.0000000000 FORMAT "%13.10" NUMBER 51 /end CHARACTERISTIC
/begin CHARACTERISTIC DINH_Lim.DFC_MRlyDcOL_CA "inhibit conditions / inhibit limit conditions for inhibit source DFC_MRlyDcOL" VAL_BLK 0x804FAD17 ValA_Wu8 17.0000000000 DINH_LimDFCVerb 0.00 17.0000000000 FORMAT "%13.10" NUMBER 50 /end CHARACTERISTIC
/begin CHARACTERISTIC DINH_Lim.DFC_MRlyDcSCB_CA "inhibit conditions / inhibit limit conditions for inhibit source DFC_MRlyDcSCB" VAL_BLK 0x804FAD49 ValA_Wu8 17.0000000000 DINH_LimDFCVerb 0.00 17.0000000000 FORMAT "%13.10" NUMBER 50 /end CHARACTERISTIC
/begin CHARACTERISTIC DINH_Lim.DFC_MRlyDcSCG_CA "inhibit conditions / inhibit limit conditions for inhibit source DFC_MRlyDcSCG" VAL_BLK 0x804FAD7B ValA_Wu8 17.0000000000 DINH_LimDFCVerb 0.00 17.0000000000 FORMAT "%13.10" NUMBER 50 /end CHARACTERISTIC
/begin CHARACTERISTIC DINH_Lim.DFC_PSPOL_CA "inhibit conditions / inhibit limit conditions for inhibit source DFC_PSPOL" VAL_BLK 0x804FADAD ValA_Wu8 17.0000000000 DINH_LimDFCVerb 0.00 17.0000000000 FORMAT "%13.10" NUMBER 50 /end CHARACTERISTIC
/begin CHARACTERISTIC DINH_Lim.DFC_PSPOvrTemp_CA "inhibit conditions / inhibit limit conditions for inhibit source DFC_PSPOvrTemp" VAL_BLK 0x804FADDF ValA_Wu8 17.0000000000 DINH_LimDFCVerb 0.00 17.0000000000 FORMAT "%13.10" NUMBER 50 /end CHARACTERISTIC
/begin CHARACTERISTIC DINH_Lim.DFC_PSPSCB_CA "inhibit conditions / inhibit limit conditions for inhibit source DFC_PSPSCB" VAL_BLK 0x804FAE11 ValA_Wu8 17.0000000000 DINH_LimDFCVerb 0.00 17.0000000000 FORMAT "%13.10" NUMBER 50 /end CHARACTERISTIC
/begin CHARACTERISTIC DINH_Lim.DFC_PSPSCG_CA "inhibit conditions / inhibit limit conditions for inhibit source DFC_PSPSCG" VAL_BLK 0x804FAE43 ValA_Wu8 17.0000000000 DINH_LimDFCVerb 0.00 17.0000000000 FORMAT "%13.10" NUMBER 50 /end CHARACTERISTIC
/begin CHARACTERISTIC DINH_Lim.DFC_T50Err_CA "inhibit conditions / inhibit limit conditions for inhibit source DFC_T50Err" VAL_BLK 0x804FAE75 ValA_Wu8 17.0000000000 DINH_LimDFCVerb 0.00 17.0000000000 FORMAT "%13.10" NUMBER 51 /end CHARACTERISTIC
/begin CHARACTERISTIC DINH_Lim.DFC_ThrVlvLoBattB1_CA "inhibit conditions / inhibit limit conditions for inhibit source DFC_ThrVlvLoBattB1" VAL_BLK 0x804FAEA8 ValA_Wu8 17.0000000000 DINH_LimDFCVerb 0.00 17.0000000000 FORMAT "%13.10" NUMBER 50 /end CHARACTERISTIC
/begin CHARACTERISTIC DINH_Lim.DFC_UegoSigOperPlausS1B1_CA "inhibit conditions / inhibit limit conditions for inhibit source DFC_UegoSigOperPlausS1B1" VAL_BLK 0x804FAEDA ValA_Wu8 17.0000000000 DINH_LimDFCVerb 0.00 17.0000000000 FORMAT "%13.10" NUMBER 73 /end CHARACTERISTIC
/begin CHARACTERISTIC DINH_Lim.DFC_VehVPhysRngHi_CA "inhibit conditions / inhibit limit conditions for inhibit source DFC_VehVPhysRngHi" VAL_BLK 0x804FAF23 ValA_Wu8 17.0000000000 DINH_LimDFCVerb 0.00 17.0000000000 FORMAT "%13.10" NUMBER 99 /end CHARACTERISTIC
/begin CHARACTERISTIC DINH_Lim.DFC_VehVSclOutOL_CA "inhibit conditions / inhibit limit conditions for inhibit source DFC_VehVSclOutOL" VAL_BLK 0x804FAF86 ValA_Wu8 17.0000000000 DINH_LimDFCVerb 0.00 17.0000000000 FORMAT "%13.10" NUMBER 50 /end CHARACTERISTIC
/begin CHARACTERISTIC DINH_Lim.DFC_VehVSclOutOT_CA "inhibit conditions / inhibit limit conditions for inhibit source DFC_VehVSclOutOT" VAL_BLK 0x804FAFB8 ValA_Wu8 17.0000000000 DINH_LimDFCVerb 0.00 17.0000000000 FORMAT "%13.10" NUMBER 50 /end CHARACTERISTIC
/begin CHARACTERISTIC DINH_Lim.DFC_VehVSclOutSCB_CA "inhibit conditions / inhibit limit conditions for inhibit source DFC_VehVSclOutSCB" VAL_BLK 0x804FAFEA ValA_Wu8 17.0000000000 DINH_LimDFCVerb 0.00 17.0000000000 FORMAT "%13.10" NUMBER 50 /end CHARACTERISTIC
/begin CHARACTERISTIC DINH_Lim.DFC_VehVSclOutSCG_CA "inhibit conditions / inhibit limit conditions for inhibit source DFC_VehVSclOutSCG" VAL_BLK 0x804FB01C ValA_Wu8 17.0000000000 DINH_LimDFCVerb 0.00 17.0000000000 FORMAT "%13.10" NUMBER 50 /end CHARACTERISTIC
/begin CHARACTERISTIC DINH_Lim.DFC_VehVSigFL_CA "inhibit conditions / inhibit limit conditions for inhibit source DFC_VehVSigFL" VAL_BLK 0x804FB04E ValA_Wu8 17.0000000000 DINH_LimDFCVerb 0.00 17.0000000000 FORMAT "%13.10" NUMBER 51 /end CHARACTERISTIC
/begin CHARACTERISTIC DINH_Lim.DFC_VehVSigFR_CA "inhibit conditions / inhibit limit conditions for inhibit source DFC_VehVSigFR" VAL_BLK 0x804FB081 ValA_Wu8 17.0000000000 DINH_LimDFCVerb 0.00 17.0000000000 FORMAT "%13.10" NUMBER 51 /end CHARACTERISTIC
/begin CHARACTERISTIC DINH_Lim.DFC_VehVSigRL_CA "inhibit conditions / inhibit limit conditions for inhibit source DFC_VehVSigRL" VAL_BLK 0x804FB0B4 ValA_Wu8 17.0000000000 DINH_LimDFCVerb 0.00 17.0000000000 FORMAT "%13.10" NUMBER 51 /end CHARACTERISTIC
/begin CHARACTERISTIC DINH_Lim.DFC_VehVSigRR_CA "inhibit conditions / inhibit limit conditions for inhibit source DFC_VehVSigRR" VAL_BLK 0x804FB0E7 ValA_Wu8 17.0000000000 DINH_LimDFCVerb 0.00 17.0000000000 FORMAT "%13.10" NUMBER 51 /end CHARACTERISTIC
/begin CHARACTERISTIC DINH_Lim.DFC_VehVSnsrARngHi_CA "inhibit conditions / inhibit limit conditions for inhibit source DFC_VehVSnsrARngHi" VAL_BLK 0x804FB11A ValA_Wu8 17.0000000000 DINH_LimDFCVerb 0.00 17.0000000000 FORMAT "%13.10" NUMBER 50 /end CHARACTERISTIC
/begin CHARACTERISTIC DINH_Lim.DFC_VehVSnsrBRngHi_CA "inhibit conditions / inhibit limit conditions for inhibit source DFC_VehVSnsrBRngHi" VAL_BLK 0x804FB14C ValA_Wu8 17.0000000000 DINH_LimDFCVerb 0.00 17.0000000000 FORMAT "%13.10" NUMBER 50 /end CHARACTERISTIC
/begin CHARACTERISTIC DINH_Lim.DFC_VehVSpdRtyDiag_CA "inhibit conditions / inhibit limit conditions for inhibit source DFC_VehVSpdRtyDiag" VAL_BLK 0x804FB17E ValA_Wu8 17.0000000000 DINH_LimDFCVerb 0.00 17.0000000000 FORMAT "%13.10" NUMBER 51 /end CHARACTERISTIC
/begin CHARACTERISTIC DINH_Lim.DFC_DHFHD_CA "inhibit conditions / inhibit limit conditions for inhibit source DFC_DHFHD" VAL_BLK 0x804FB1B1 ValA_Wu8 17.0000000000 DINH_LimDFCVerb 0.00 17.0000000000 FORMAT "%13.10" NUMBER 51 /end CHARACTERISTIC
/begin CHARACTERISTIC DINH_Lim.DFC_InjVlv_DI_DcDc_CA "inhibit conditions / inhibit limit conditions for inhibit source DFC_InjVlv_DI_DcDc" VAL_BLK 0x804FB1E4 ValA_Wu8 17.0000000000 DINH_LimDFCVerb 0.00 17.0000000000 FORMAT "%13.10" NUMBER 50 /end CHARACTERISTIC
/begin CHARACTERISTIC DINH_Lim.DFC_InjVlv_DI_NoLd_0_CA "inhibit conditions / inhibit limit conditions for inhibit source DFC_InjVlv_DI_NoLd_0" VAL_BLK 0x804FB216 ValA_Wu8 17.0000000000 DINH_LimDFCVerb 0.00 17.0000000000 FORMAT "%13.10" NUMBER 60 /end CHARACTERISTIC
/begin CHARACTERISTIC DINH_Lim.DFC_InjVlv_DI_NoLd_1_CA "inhibit conditions / inhibit limit conditions for inhibit source DFC_InjVlv_DI_NoLd_1" VAL_BLK 0x804FB252 ValA_Wu8 17.0000000000 DINH_LimDFCVerb 0.00 17.0000000000 FORMAT "%13.10" NUMBER 60 /end CHARACTERISTIC
/begin CHARACTERISTIC DINH_Lim.DFC_InjVlv_DI_NoLd_2_CA "inhibit conditions / inhibit limit conditions for inhibit source DFC_InjVlv_DI_NoLd_2" VAL_BLK 0x804FB28E ValA_Wu8 17.0000000000 DINH_LimDFCVerb 0.00 17.0000000000 FORMAT "%13.10" NUMBER 60 /end CHARACTERISTIC
/begin CHARACTERISTIC DINH_Lim.DFC_InjVlv_DI_NoLd_3_CA "inhibit conditions / inhibit limit conditions for inhibit source DFC_InjVlv_DI_NoLd_3" VAL_BLK 0x804FB2CA ValA_Wu8 17.0000000000 DINH_LimDFCVerb 0.00 17.0000000000 FORMAT "%13.10" NUMBER 60 /end CHARACTERISTIC
/begin CHARACTERISTIC DINH_Lim.DFC_InjVlv_DI_ScBnk_0_CA "inhibit conditions / inhibit limit conditions for inhibit source DFC_InjVlv_DI_ScBnk_0" VAL_BLK 0x804FB306 ValA_Wu8 17.0000000000 DINH_LimDFCVerb 0.00 17.0000000000 FORMAT "%13.10" NUMBER 60 /end CHARACTERISTIC
/begin CHARACTERISTIC DINH_Lim.DFC_InjVlv_DI_ScBnk_1_CA "inhibit conditions / inhibit limit conditions for inhibit source DFC_InjVlv_DI_ScBnk_1" VAL_BLK 0x804FB342 ValA_Wu8 17.0000000000 DINH_LimDFCVerb 0.00 17.0000000000 FORMAT "%13.10" NUMBER 60 /end CHARACTERISTIC
/begin CHARACTERISTIC DINH_Lim.DFC_InjVlv_DI_ScBnk_2_CA "inhibit conditions / inhibit limit conditions for inhibit source DFC_InjVlv_DI_ScBnk_2" VAL_BLK 0x804FB37E ValA_Wu8 17.0000000000 DINH_LimDFCVerb 0.00 17.0000000000 FORMAT "%13.10" NUMBER 60 /end CHARACTERISTIC
/begin CHARACTERISTIC DINH_Lim.DFC_InjVlv_DI_ScBnk_3_CA "inhibit conditions / inhibit limit conditions for inhibit source DFC_InjVlv_DI_ScBnk_3" VAL_BLK 0x804FB3BA ValA_Wu8 17.0000000000 DINH_LimDFCVerb 0.00 17.0000000000 FORMAT "%13.10" NUMBER 60 /end CHARACTERISTIC
/begin CHARACTERISTIC DINH_Lim.DFC_InjVlv_DI_ScCyl_0_CA "inhibit conditions / inhibit limit conditions for inhibit source DFC_InjVlv_DI_ScCyl_0" VAL_BLK 0x804FB3F6 ValA_Wu8 17.0000000000 DINH_LimDFCVerb 0.00 17.0000000000 FORMAT "%13.10" NUMBER 60 /end CHARACTERISTIC
/begin CHARACTERISTIC DINH_Lim.DFC_InjVlv_DI_ScCyl_1_CA "inhibit conditions / inhibit limit conditions for inhibit source DFC_InjVlv_DI_ScCyl_1" VAL_BLK 0x804FB432 ValA_Wu8 17.0000000000 DINH_LimDFCVerb 0.00 17.0000000000 FORMAT "%13.10" NUMBER 60 /end CHARACTERISTIC
/begin CHARACTERISTIC DINH_Lim.DFC_InjVlv_DI_ScCyl_2_CA "inhibit conditions / inhibit limit conditions for inhibit source DFC_InjVlv_DI_ScCyl_2" VAL_BLK 0x804FB46E ValA_Wu8 17.0000000000 DINH_LimDFCVerb 0.00 17.0000000000 FORMAT "%13.10" NUMBER 60 /end CHARACTERISTIC
/begin CHARACTERISTIC DINH_Lim.DFC_InjVlv_DI_ScCyl_3_CA "inhibit conditions / inhibit limit conditions for inhibit source DFC_InjVlv_DI_ScCyl_3" VAL_BLK 0x804FB4AA ValA_Wu8 17.0000000000 DINH_LimDFCVerb 0.00 17.0000000000 FORMAT "%13.10" NUMBER 60 /end CHARACTERISTIC
/begin CHARACTERISTIC DINH_Lim.DFC_InjVlv_DI_ScHsLs_0_CA "inhibit conditions / inhibit limit conditions for inhibit source DFC_InjVlv_DI_ScHsLs_0" VAL_BLK 0x804FB4E6 ValA_Wu8 17.0000000000 DINH_LimDFCVerb 0.00 17.0000000000 FORMAT "%13.10" NUMBER 60 /end CHARACTERISTIC
/begin CHARACTERISTIC DINH_Lim.DFC_InjVlv_DI_ScHsLs_1_CA "inhibit conditions / inhibit limit conditions for inhibit source DFC_InjVlv_DI_ScHsLs_1" VAL_BLK 0x804FB522 ValA_Wu8 17.0000000000 DINH_LimDFCVerb 0.00 17.0000000000 FORMAT "%13.10" NUMBER 60 /end CHARACTERISTIC
/begin CHARACTERISTIC DINH_Lim.DFC_InjVlv_DI_ScHsLs_2_CA "inhibit conditions / inhibit limit conditions for inhibit source DFC_InjVlv_DI_ScHsLs_2" VAL_BLK 0x804FB55E ValA_Wu8 17.0000000000 DINH_LimDFCVerb 0.00 17.0000000000 FORMAT "%13.10" NUMBER 60 /end CHARACTERISTIC
/begin CHARACTERISTIC DINH_Lim.DFC_InjVlv_DI_ScHsLs_3_CA "inhibit conditions / inhibit limit conditions for inhibit source DFC_InjVlv_DI_ScHsLs_3" VAL_BLK 0x804FB59A ValA_Wu8 17.0000000000 DINH_LimDFCVerb 0.00 17.0000000000 FORMAT "%13.10" NUMBER 60 /end CHARACTERISTIC
/begin CHARACTERISTIC DINH_Lim.DFC_MfPsDiaOpenLoad1_CA "inhibit conditions / inhibit limit conditions for inhibit source DFC_MfPsDiaOpenLoad1" VAL_BLK 0x804FB5D6 ValA_Wu8 17.0000000000 DINH_LimDFCVerb 0.00 17.0000000000 FORMAT "%13.10" NUMBER 65 /end CHARACTERISTIC
/begin CHARACTERISTIC DINH_Lim.DFC_MfPsDiaScHiS1_CA "inhibit conditions / inhibit limit conditions for inhibit source DFC_MfPsDiaScHiS1" VAL_BLK 0x804FB617 ValA_Wu8 17.0000000000 DINH_LimDFCVerb 0.00 17.0000000000 FORMAT "%13.10" NUMBER 65 /end CHARACTERISTIC
/begin CHARACTERISTIC DINH_Lim.DFC_MfPsDiaScHiSLowS1_CA "inhibit conditions / inhibit limit conditions for inhibit source DFC_MfPsDiaScHiSLowS1" VAL_BLK 0x804FB658 ValA_Wu8 17.0000000000 DINH_LimDFCVerb 0.00 17.0000000000 FORMAT "%13.10" NUMBER 65 /end CHARACTERISTIC
/begin CHARACTERISTIC DINH_Lim.DFC_MfPsDiaScLowS1_CA "inhibit conditions / inhibit limit conditions for inhibit source DFC_MfPsDiaScLowS1" VAL_BLK 0x804FB699 ValA_Wu8 17.0000000000 DINH_LimDFCVerb 0.00 17.0000000000 FORMAT "%13.10" NUMBER 65 /end CHARACTERISTIC
/begin CHARACTERISTIC DINH_Lim.DFC_ACEvpTPhysRngHi_CA "inhibit conditions / inhibit limit conditions for inhibit source DFC_ACEvpTPhysRngHi" VAL_BLK 0x804FB6DA ValA_Wu8 17.0000000000 DINH_LimDFCVerb 0.00 17.0000000000 FORMAT "%13.10" NUMBER 52 /end CHARACTERISTIC
/begin CHARACTERISTIC DINH_Lim.DFC_ACEvpTPhysRngLo_CA "inhibit conditions / inhibit limit conditions for inhibit source DFC_ACEvpTPhysRngLo" VAL_BLK 0x804FB70E ValA_Wu8 17.0000000000 DINH_LimDFCVerb 0.00 17.0000000000 FORMAT "%13.10" NUMBER 52 /end CHARACTERISTIC
/begin CHARACTERISTIC DINH_Lim.DFC_ACEvpTSRCMax_CA "inhibit conditions / inhibit limit conditions for inhibit source DFC_ACEvpTSRCMax" VAL_BLK 0x804FB742 ValA_Wu8 17.0000000000 DINH_LimDFCVerb 0.00 17.0000000000 FORMAT "%13.10" NUMBER 53 /end CHARACTERISTIC
/begin CHARACTERISTIC DINH_Lim.DFC_ACEvpTSRCMin_CA "inhibit conditions / inhibit limit conditions for inhibit source DFC_ACEvpTSRCMin" VAL_BLK 0x804FB777 ValA_Wu8 17.0000000000 DINH_LimDFCVerb 0.00 17.0000000000 FORMAT "%13.10" NUMBER 53 /end CHARACTERISTIC
/begin CHARACTERISTIC DINH_Lim.DFC_AfsRawSigRngHiB1_CA "inhibit conditions / inhibit limit conditions for inhibit source DFC_AfsRawSigRngHiB1" VAL_BLK 0x804FB7AC ValA_Wu8 17.0000000000 DINH_LimDFCVerb 0.00 17.0000000000 FORMAT "%13.10" NUMBER 57 /end CHARACTERISTIC
/begin CHARACTERISTIC DINH_Lim.DFC_AfsRawSigRngLoB1_CA "inhibit conditions / inhibit limit conditions for inhibit source DFC_AfsRawSigRngLoB1" VAL_BLK 0x804FB7E5 ValA_Wu8 17.0000000000 DINH_LimDFCVerb 0.00 17.0000000000 FORMAT "%13.10" NUMBER 57 /end CHARACTERISTIC
/begin CHARACTERISTIC DINH_Lim.DFC_AfsSnsrErrB1_CA "inhibit conditions / inhibit limit conditions for inhibit source DFC_AfsSnsrErrB1" VAL_BLK 0x804FB81E ValA_Wu8 17.0000000000 DINH_LimDFCVerb 0.00 17.0000000000 FORMAT "%13.10" NUMBER 57 /end CHARACTERISTIC
/begin CHARACTERISTIC DINH_Lim.DFC_AirCClntPAnaSRCMax_CA "inhibit conditions / inhibit limit conditions for inhibit source DFC_AirCClntPAnaSRCMax" VAL_BLK 0x804FB857 ValA_Wu8 17.0000000000 DINH_LimDFCVerb 0.00 17.0000000000 FORMAT "%13.10" NUMBER 56 /end CHARACTERISTIC
/begin CHARACTERISTIC DINH_Lim.DFC_AirCClntPAnaSRCMin_CA "inhibit conditions / inhibit limit conditions for inhibit source DFC_AirCClntPAnaSRCMin" VAL_BLK 0x804FB88F ValA_Wu8 17.0000000000 DINH_LimDFCVerb 0.00 17.0000000000 FORMAT "%13.10" NUMBER 56 /end CHARACTERISTIC
/begin CHARACTERISTIC DINH_Lim.DFC_AirCSwtNpl_CA "inhibit conditions / inhibit limit conditions for inhibit source DFC_AirCSwtNpl" VAL_BLK 0x804FB8C7 ValA_Wu8 17.0000000000 DINH_LimDFCVerb 0.00 17.0000000000 FORMAT "%13.10" NUMBER 51 /end CHARACTERISTIC
/begin CHARACTERISTIC DINH_Lim.DFC_AirCSwtSig_CA "inhibit conditions / inhibit limit conditions for inhibit source DFC_AirCSwtSig" VAL_BLK 0x804FB8FA ValA_Wu8 17.0000000000 DINH_LimDFCVerb 0.00 17.0000000000 FORMAT "%13.10" NUMBER 51 /end CHARACTERISTIC
/begin CHARACTERISTIC DINH_Lim.DFC_Brk_CA "inhibit conditions / inhibit limit conditions for inhibit source DFC_Brk" VAL_BLK 0x804FB92D ValA_Wu8 17.0000000000 DINH_LimDFCVerb 0.00 17.0000000000 FORMAT "%13.10" NUMBER 50 /end CHARACTERISTIC
/begin CHARACTERISTIC DINH_Lim.DFC_BrkBstSensSCB_CA "inhibit conditions / inhibit limit conditions for inhibit source DFC_BrkBstSensSCB" VAL_BLK 0x804FB95F ValA_Wu8 17.0000000000 DINH_LimDFCVerb 0.00 17.0000000000 FORMAT "%13.10" NUMBER 53 /end CHARACTERISTIC
/begin CHARACTERISTIC DINH_Lim.DFC_BrkBstSensSCG_CA "inhibit conditions / inhibit limit conditions for inhibit source DFC_BrkBstSensSCG" VAL_BLK 0x804FB994 ValA_Wu8 17.0000000000 DINH_LimDFCVerb 0.00 17.0000000000 FORMAT "%13.10" NUMBER 53 /end CHARACTERISTIC
/begin CHARACTERISTIC DINH_Lim.DFC_BrkSig_CA "inhibit conditions / inhibit limit conditions for inhibit source DFC_BrkSig" VAL_BLK 0x804FB9C9 ValA_Wu8 17.0000000000 DINH_LimDFCVerb 0.00 17.0000000000 FORMAT "%13.10" NUMBER 54 /end CHARACTERISTIC
/begin CHARACTERISTIC DINH_Lim.DFC_ClthSig_CA "inhibit conditions / inhibit limit conditions for inhibit source DFC_ClthSig" VAL_BLK 0x804FB9FF ValA_Wu8 17.0000000000 DINH_LimDFCVerb 0.00 17.0000000000 FORMAT "%13.10" NUMBER 63 /end CHARACTERISTIC
/begin CHARACTERISTIC DINH_Lim.DFC_EGRVlvCurrLim_CA "inhibit conditions / inhibit limit conditions for inhibit source DFC_EGRVlvCurrLim" VAL_BLK 0x804FBA3E ValA_Wu8 17.0000000000 DINH_LimDFCVerb 0.00 17.0000000000 FORMAT "%13.10" NUMBER 54 /end CHARACTERISTIC
/begin CHARACTERISTIC DINH_Lim.DFC_EGRVlvOL_CA "inhibit conditions / inhibit limit conditions for inhibit source DFC_EGRVlvOL" VAL_BLK 0x804FBA74 ValA_Wu8 17.0000000000 DINH_LimDFCVerb 0.00 17.0000000000 FORMAT "%13.10" NUMBER 68 /end CHARACTERISTIC
/begin CHARACTERISTIC DINH_Lim.DFC_EGRVlvOvrTemp_CA "inhibit conditions / inhibit limit conditions for inhibit source DFC_EGRVlvOvrTemp" VAL_BLK 0x804FBAB8 ValA_Wu8 17.0000000000 DINH_LimDFCVerb 0.00 17.0000000000 FORMAT "%13.10" NUMBER 50 /end CHARACTERISTIC
/begin CHARACTERISTIC DINH_Lim.DFC_EGRVlvSCB_CA "inhibit conditions / inhibit limit conditions for inhibit source DFC_EGRVlvSCB" VAL_BLK 0x804FBAEA ValA_Wu8 17.0000000000 DINH_LimDFCVerb 0.00 17.0000000000 FORMAT "%13.10" NUMBER 69 /end CHARACTERISTIC
/begin CHARACTERISTIC DINH_Lim.DFC_EGRVlvSCG_CA "inhibit conditions / inhibit limit conditions for inhibit source DFC_EGRVlvSCG" VAL_BLK 0x804FBB2F ValA_Wu8 17.0000000000 DINH_LimDFCVerb 0.00 17.0000000000 FORMAT "%13.10" NUMBER 68 /end CHARACTERISTIC
/begin CHARACTERISTIC DINH_Lim.DFC_EGRVlvSRCMax_CA "inhibit conditions / inhibit limit conditions for inhibit source DFC_EGRVlvSRCMax" VAL_BLK 0x804FBB73 ValA_Wu8 17.0000000000 DINH_LimDFCVerb 0.00 17.0000000000 FORMAT "%13.10" NUMBER 61 /end CHARACTERISTIC
/begin CHARACTERISTIC DINH_Lim.DFC_EGRVlvSRCMin_CA "inhibit conditions / inhibit limit conditions for inhibit source DFC_EGRVlvSRCMin" VAL_BLK 0x804FBBB0 ValA_Wu8 17.0000000000 DINH_LimDFCVerb 0.00 17.0000000000 FORMAT "%13.10" NUMBER 60 /end CHARACTERISTIC
/begin CHARACTERISTIC DINH_Lim.DFC_HLSDemOvhtEngLim_CA "inhibit conditions / inhibit limit conditions for inhibit source DFC_HLSDemOvhtEngLim" VAL_BLK 0x804FBBEC ValA_Wu8 17.0000000000 DINH_LimDFCVerb 0.00 17.0000000000 FORMAT "%13.10" NUMBER 50 /end CHARACTERISTIC
/begin CHARACTERISTIC DINH_Lim.DFC_OilPSwmpSRCMax_CA "inhibit conditions / inhibit limit conditions for inhibit source DFC_OilPSwmpSRCMax" VAL_BLK 0x804FBC1E ValA_Wu8 17.0000000000 DINH_LimDFCVerb 0.00 17.0000000000 FORMAT "%13.10" NUMBER 59 /end CHARACTERISTIC
/begin CHARACTERISTIC DINH_Lim.DFC_OilPSwmpSRCMin_CA "inhibit conditions / inhibit limit conditions for inhibit source DFC_OilPSwmpSRCMin" VAL_BLK 0x804FBC59 ValA_Wu8 17.0000000000 DINH_LimDFCVerb 0.00 17.0000000000 FORMAT "%13.10" NUMBER 60 /end CHARACTERISTIC
/begin CHARACTERISTIC DINH_Lim.DFC_PIntkVUsLineHiB1_CA "inhibit conditions / inhibit limit conditions for inhibit source DFC_PIntkVUsLineHiB1" VAL_BLK 0x804FBC95 ValA_Wu8 17.0000000000 DINH_LimDFCVerb 0.00 17.0000000000 FORMAT "%13.10" NUMBER 97 /end CHARACTERISTIC
/begin CHARACTERISTIC DINH_Lim.DFC_PIntkVUsLineLoB1_CA "inhibit conditions / inhibit limit conditions for inhibit source DFC_PIntkVUsLineLoB1" VAL_BLK 0x804FBCF6 ValA_Wu8 17.0000000000 DINH_LimDFCVerb 0.00 17.0000000000 FORMAT "%13.10" NUMBER 97 /end CHARACTERISTIC
/begin CHARACTERISTIC DINH_Lim.DFC_VehVPhysRngLo_CA "inhibit conditions / inhibit limit conditions for inhibit source DFC_VehVPhysRngLo" VAL_BLK 0x804FBD57 ValA_Wu8 17.0000000000 DINH_LimDFCVerb 0.00 17.0000000000 FORMAT "%13.10" NUMBER 82 /end CHARACTERISTIC
/begin CHARACTERISTIC DINH_Lim.DFC_VehVSigCan_CA "inhibit conditions / inhibit limit conditions for inhibit source DFC_VehVSigCan" VAL_BLK 0x804FBDA9 ValA_Wu8 17.0000000000 DINH_LimDFCVerb 0.00 17.0000000000 FORMAT "%13.10" NUMBER 54 /end CHARACTERISTIC
/begin CHARACTERISTIC DINH_Lim.DFC_VehVSigCanSafe_CA "inhibit conditions / inhibit limit conditions for inhibit source DFC_VehVSigCanSafe" VAL_BLK 0x804FBDDF ValA_Wu8 17.0000000000 DINH_LimDFCVerb 0.00 17.0000000000 FORMAT "%13.10" NUMBER 57 /end CHARACTERISTIC
/begin CHARACTERISTIC DINH_Lim.DFC_VlvLftFbOilPSnsrIntk11SRCMax_CA "inhibit conditions / inhibit limit conditions for inhibit source DFC_VlvLftFbOilPSnsrIntk11SRCMax" VAL_BLK 0x804FBE18 ValA_Wu8 17.0000000000 DINH_LimDFCVerb 0.00 17.0000000000 FORMAT "%13.10" NUMBER 79 /end CHARACTERISTIC
/begin CHARACTERISTIC DINH_Lim.DFC_VlvLftFbOilPSnsrIntk11SRCMin_CA "inhibit conditions / inhibit limit conditions for inhibit source DFC_VlvLftFbOilPSnsrIntk11SRCMin" VAL_BLK 0x804FBE67 ValA_Wu8 17.0000000000 DINH_LimDFCVerb 0.00 17.0000000000 FORMAT "%13.10" NUMBER 79 /end CHARACTERISTIC
/begin CHARACTERISTIC DINH_Lim.DFC_ClthNpl_CA "inhibit conditions / inhibit limit conditions for inhibit source DFC_ClthNpl" VAL_BLK 0x804FBEB6 ValA_Wu8 17.0000000000 DINH_LimDFCVerb 0.00 17.0000000000 FORMAT "%13.10" NUMBER 64 /end CHARACTERISTIC
/begin CHARACTERISTIC DINH_Lim.DFC_GbxPNPosnDrvCdn_CA "inhibit conditions / inhibit limit conditions for inhibit source DFC_GbxPNPosnDrvCdn" VAL_BLK 0x804FBEF6 ValA_Wu8 17.0000000000 DINH_LimDFCVerb 0.00 17.0000000000 FORMAT "%13.10" NUMBER 61 /end CHARACTERISTIC
/begin CHARACTERISTIC DINH_Lim.DFC_GbxPNPosnPlausy_CA "inhibit conditions / inhibit limit conditions for inhibit source DFC_GbxPNPosnPlausy" VAL_BLK 0x804FBF33 ValA_Wu8 17.0000000000 DINH_LimDFCVerb 0.00 17.0000000000 FORMAT "%13.10" NUMBER 55 /end CHARACTERISTIC
/begin CHARACTERISTIC DINH_Lim.DFC_AfsSigErrLineHiB1_CA "inhibit conditions / inhibit limit conditions for inhibit source DFC_AfsSigErrLineHiB1" VAL_BLK 0x804FBF6A ValA_Wu8 17.0000000000 DINH_LimDFCVerb 0.00 17.0000000000 FORMAT "%13.10" NUMBER 58 /end CHARACTERISTIC
/begin CHARACTERISTIC DINH_Lim.DFC_AfsSigErrLineLoB1_CA "inhibit conditions / inhibit limit conditions for inhibit source DFC_AfsSigErrLineLoB1" VAL_BLK 0x804FBFA4 ValA_Wu8 17.0000000000 DINH_LimDFCVerb 0.00 17.0000000000 FORMAT "%13.10" NUMBER 58 /end CHARACTERISTIC
/begin CHARACTERISTIC DINH_Lim.DFC_PEnvCcMax_CA "inhibit conditions / inhibit limit conditions for inhibit source DFC_PEnvCcMax" VAL_BLK 0x804FBFDE ValA_Wu8 17.0000000000 DINH_LimDFCVerb 0.00 17.0000000000 FORMAT "%13.10" NUMBER 85 /end CHARACTERISTIC
/begin CHARACTERISTIC DINH_Lim.DFC_PEnvCcMin_CA "inhibit conditions / inhibit limit conditions for inhibit source DFC_PEnvCcMin" VAL_BLK 0x804FC033 ValA_Wu8 17.0000000000 DINH_LimDFCVerb 0.00 17.0000000000 FORMAT "%13.10" NUMBER 85 /end CHARACTERISTIC
/begin CHARACTERISTIC DINH_Lim.DFC_PEnvRngChkMax_CA "inhibit conditions / inhibit limit conditions for inhibit source DFC_PEnvRngChkMax" VAL_BLK 0x804FC088 ValA_Wu8 17.0000000000 DINH_LimDFCVerb 0.00 17.0000000000 FORMAT "%13.10" NUMBER 86 /end CHARACTERISTIC
/begin CHARACTERISTIC DINH_Lim.DFC_PEnvRngChkMin_CA "inhibit conditions / inhibit limit conditions for inhibit source DFC_PEnvRngChkMin" VAL_BLK 0x804FC0DE ValA_Wu8 17.0000000000 DINH_LimDFCVerb 0.00 17.0000000000 FORMAT "%13.10" NUMBER 86 /end CHARACTERISTIC
/begin CHARACTERISTIC DINH_Lim.DFC_PEnvSnsrPlaus_CA "inhibit conditions / inhibit limit conditions for inhibit source DFC_PEnvSnsrPlaus" VAL_BLK 0x804FC134 ValA_Wu8 17.0000000000 DINH_LimDFCVerb 0.00 17.0000000000 FORMAT "%13.10" NUMBER 82 /end CHARACTERISTIC
/begin CHARACTERISTIC DINH_Lim.DFC_UEGOHeatrRlyPsOLS1B1_CA "inhibit conditions / inhibit limit conditions for inhibit source DFC_UEGOHeatrRlyPsOLS1B1" VAL_BLK 0x804FC186 ValA_Wu8 17.0000000000 DINH_LimDFCVerb 0.00 17.0000000000 FORMAT "%13.10" NUMBER 84 /end CHARACTERISTIC
/begin CHARACTERISTIC DINH_Lim.DFC_UEGOHeatrRlyPsSCBS1B1_CA "inhibit conditions / inhibit limit conditions for inhibit source DFC_UEGOHeatrRlyPsSCBS1B1" VAL_BLK 0x804FC1DA ValA_Wu8 17.0000000000 DINH_LimDFCVerb 0.00 17.0000000000 FORMAT "%13.10" NUMBER 84 /end CHARACTERISTIC
/begin CHARACTERISTIC DINH_Lim.DFC_UEGOHeatrRlyPsSCGS1B1_CA "inhibit conditions / inhibit limit conditions for inhibit source DFC_UEGOHeatrRlyPsSCGS1B1" VAL_BLK 0x804FC22E ValA_Wu8 17.0000000000 DINH_LimDFCVerb 0.00 17.0000000000 FORMAT "%13.10" NUMBER 82 /end CHARACTERISTIC
/begin CHARACTERISTIC DINH_Lim.DFC_UegoHeatrWireOlS1B1_CA "inhibit conditions / inhibit limit conditions for inhibit source DFC_UegoHeatrWireOlS1B1" VAL_BLK 0x804FC280 ValA_Wu8 17.0000000000 DINH_LimDFCVerb 0.00 17.0000000000 FORMAT "%13.10" NUMBER 84 /end CHARACTERISTIC
/begin CHARACTERISTIC DINH_Lim.DFC_UegoHeatrWireScbS1B1_CA "inhibit conditions / inhibit limit conditions for inhibit source DFC_UegoHeatrWireScbS1B1" VAL_BLK 0x804FC2D4 ValA_Wu8 17.0000000000 DINH_LimDFCVerb 0.00 17.0000000000 FORMAT "%13.10" NUMBER 84 /end CHARACTERISTIC
/begin CHARACTERISTIC DINH_Lim.DFC_UegoHeatrWireScgS1B1_CA "inhibit conditions / inhibit limit conditions for inhibit source DFC_UegoHeatrWireScgS1B1" VAL_BLK 0x804FC328 ValA_Wu8 17.0000000000 DINH_LimDFCVerb 0.00 17.0000000000 FORMAT "%13.10" NUMBER 85 /end CHARACTERISTIC
/begin CHARACTERISTIC DINH_Lim.DFC_KnDetSens1PortAMax_CA "inhibit conditions / inhibit limit conditions for inhibit source DFC_KnDetSens1PortAMax" VAL_BLK 0x804FC37D ValA_Wu8 17.0000000000 DINH_LimDFCVerb 0.00 17.0000000000 FORMAT "%13.10" NUMBER 58 /end CHARACTERISTIC
/begin CHARACTERISTIC DINH_Lim.DFC_KnDetSens1PortAMin_CA "inhibit conditions / inhibit limit conditions for inhibit source DFC_KnDetSens1PortAMin" VAL_BLK 0x804FC3B7 ValA_Wu8 17.0000000000 DINH_LimDFCVerb 0.00 17.0000000000 FORMAT "%13.10" NUMBER 58 /end CHARACTERISTIC
/begin CHARACTERISTIC DINH_Lim.DFC_KnDetSens1PortBMax_CA "inhibit conditions / inhibit limit conditions for inhibit source DFC_KnDetSens1PortBMax" VAL_BLK 0x804FC3F1 ValA_Wu8 17.0000000000 DINH_LimDFCVerb 0.00 17.0000000000 FORMAT "%13.10" NUMBER 58 /end CHARACTERISTIC
/begin CHARACTERISTIC DINH_Lim.DFC_KnDetSens1PortBMin_CA "inhibit conditions / inhibit limit conditions for inhibit source DFC_KnDetSens1PortBMin" VAL_BLK 0x804FC42B ValA_Wu8 17.0000000000 DINH_LimDFCVerb 0.00 17.0000000000 FORMAT "%13.10" NUMBER 58 /end CHARACTERISTIC
/begin CHARACTERISTIC DINH_Lim.DFC_Clth2ONStuck_CA "inhibit conditions / inhibit limit conditions for inhibit source DFC_Clth2ONStuck" VAL_BLK 0x804FC465 ValA_Wu8 17.0000000000 DINH_LimDFCVerb 0.00 17.0000000000 FORMAT "%13.10" NUMBER 52 /end CHARACTERISTIC
/begin CHARACTERISTIC DINH_Lim.DFC_Clth2ONStuckLdc_CA "inhibit conditions / inhibit limit conditions for inhibit source DFC_Clth2ONStuckLdc" VAL_BLK 0x804FC499 ValA_Wu8 17.0000000000 DINH_LimDFCVerb 0.00 17.0000000000 FORMAT "%13.10" NUMBER 52 /end CHARACTERISTIC
/begin CHARACTERISTIC DINH_Lim.DFC_Clth3ONStuckLdc_CA "inhibit conditions / inhibit limit conditions for inhibit source DFC_Clth3ONStuckLdc" VAL_BLK 0x804FC4CD ValA_Wu8 17.0000000000 DINH_LimDFCVerb 0.00 17.0000000000 FORMAT "%13.10" NUMBER 55 /end CHARACTERISTIC
/begin CHARACTERISTIC DINH_Lim.DFC_Clth3ONStuckPostDrv_CA "inhibit conditions / inhibit limit conditions for inhibit source DFC_Clth3ONStuckPostDrv" VAL_BLK 0x804FC504 ValA_Wu8 17.0000000000 DINH_LimDFCVerb 0.00 17.0000000000 FORMAT "%13.10" NUMBER 54 /end CHARACTERISTIC
/begin CHARACTERISTIC DINH_Lim.DFC_Clth4ONStuck_CA "inhibit conditions / inhibit limit conditions for inhibit source DFC_Clth4ONStuck" VAL_BLK 0x804FC53A ValA_Wu8 17.0000000000 DINH_LimDFCVerb 0.00 17.0000000000 FORMAT "%13.10" NUMBER 51 /end CHARACTERISTIC
/begin CHARACTERISTIC DINH_Lim.DFC_Clth4ONStuckLdc_CA "inhibit conditions / inhibit limit conditions for inhibit source DFC_Clth4ONStuckLdc" VAL_BLK 0x804FC56D ValA_Wu8 17.0000000000 DINH_LimDFCVerb 0.00 17.0000000000 FORMAT "%13.10" NUMBER 59 /end CHARACTERISTIC
/begin CHARACTERISTIC DINH_Lim.DFC_ComBCMUnit_CA "inhibit conditions / inhibit limit conditions for inhibit source DFC_ComBCMUnit" VAL_BLK 0x804FC5A8 ValA_Wu8 17.0000000000 DINH_LimDFCVerb 0.00 17.0000000000 FORMAT "%13.10" NUMBER 50 /end CHARACTERISTIC
/begin CHARACTERISTIC DINH_Lim.DFC_ComDLCTCU01_CA "inhibit conditions / inhibit limit conditions for inhibit source DFC_ComDLCTCU01" VAL_BLK 0x804FC5DA ValA_Wu8 17.0000000000 DINH_LimDFCVerb 0.00 17.0000000000 FORMAT "%13.10" NUMBER 51 /end CHARACTERISTIC
/begin CHARACTERISTIC DINH_Lim.DFC_ComDLCTCU02_CA "inhibit conditions / inhibit limit conditions for inhibit source DFC_ComDLCTCU02" VAL_BLK 0x804FC60D ValA_Wu8 17.0000000000 DINH_LimDFCVerb 0.00 17.0000000000 FORMAT "%13.10" NUMBER 51 /end CHARACTERISTIC
/begin CHARACTERISTIC DINH_Lim.DFC_ComDLCTCU1_CA "inhibit conditions / inhibit limit conditions for inhibit source DFC_ComDLCTCU1" VAL_BLK 0x804FC640 ValA_Wu8 17.0000000000 DINH_LimDFCVerb 0.00 17.0000000000 FORMAT "%13.10" NUMBER 55 /end CHARACTERISTIC
/begin CHARACTERISTIC DINH_Lim.DFC_ComDLCTCU11_CA "inhibit conditions / inhibit limit conditions for inhibit source DFC_ComDLCTCU11" VAL_BLK 0x804FC677 ValA_Wu8 17.0000000000 DINH_LimDFCVerb 0.00 17.0000000000 FORMAT "%13.10" NUMBER 54 /end CHARACTERISTIC
/begin CHARACTERISTIC DINH_Lim.DFC_ComDLCTCU12_CA "inhibit conditions / inhibit limit conditions for inhibit source DFC_ComDLCTCU12" VAL_BLK 0x804FC6AD ValA_Wu8 17.0000000000 DINH_LimDFCVerb 0.00 17.0000000000 FORMAT "%13.10" NUMBER 52 /end CHARACTERISTIC
/begin CHARACTERISTIC DINH_Lim.DFC_ComDLCTCU13_CA "inhibit conditions / inhibit limit conditions for inhibit source DFC_ComDLCTCU13" VAL_BLK 0x804FC6E1 ValA_Wu8 17.0000000000 DINH_LimDFCVerb 0.00 17.0000000000 FORMAT "%13.10" NUMBER 52 /end CHARACTERISTIC
/begin CHARACTERISTIC DINH_Lim.DFC_ComDLCTCU14_CA "inhibit conditions / inhibit limit conditions for inhibit source DFC_ComDLCTCU14" VAL_BLK 0x804FC715 ValA_Wu8 17.0000000000 DINH_LimDFCVerb 0.00 17.0000000000 FORMAT "%13.10" NUMBER 51 /end CHARACTERISTIC
/begin CHARACTERISTIC DINH_Lim.DFC_ComDLCTCU2_CA "inhibit conditions / inhibit limit conditions for inhibit source DFC_ComDLCTCU2" VAL_BLK 0x804FC748 ValA_Wu8 17.0000000000 DINH_LimDFCVerb 0.00 17.0000000000 FORMAT "%13.10" NUMBER 52 /end CHARACTERISTIC
/begin CHARACTERISTIC DINH_Lim.DFC_ComDLCTCU3_CA "inhibit conditions / inhibit limit conditions for inhibit source DFC_ComDLCTCU3" VAL_BLK 0x804FC77C ValA_Wu8 17.0000000000 DINH_LimDFCVerb 0.00 17.0000000000 FORMAT "%13.10" NUMBER 52 /end CHARACTERISTIC
/begin CHARACTERISTIC DINH_Lim.DFC_ComDLCTCU4_CA "inhibit conditions / inhibit limit conditions for inhibit source DFC_ComDLCTCU4" VAL_BLK 0x804FC7B0 ValA_Wu8 17.0000000000 DINH_LimDFCVerb 0.00 17.0000000000 FORMAT "%13.10" NUMBER 51 /end CHARACTERISTIC
/begin CHARACTERISTIC DINH_Lim.DFC_ComEPSUnit_CA "inhibit conditions / inhibit limit conditions for inhibit source DFC_ComEPSUnit" VAL_BLK 0x804FC7E3 ValA_Wu8 17.0000000000 DINH_LimDFCVerb 0.00 17.0000000000 FORMAT "%13.10" NUMBER 50 /end CHARACTERISTIC
/begin CHARACTERISTIC DINH_Lim.DFC_ComIDASBUnit_CA "inhibit conditions / inhibit limit conditions for inhibit source DFC_ComIDASBUnit" VAL_BLK 0x804FC815 ValA_Wu8 17.0000000000 DINH_LimDFCVerb 0.00 17.0000000000 FORMAT "%13.10" NUMBER 50 /end CHARACTERISTIC
/begin CHARACTERISTIC DINH_Lim.DFC_ComIMGUnit_CA "inhibit conditions / inhibit limit conditions for inhibit source DFC_ComIMGUnit" VAL_BLK 0x804FC847 ValA_Wu8 17.0000000000 DINH_LimDFCVerb 0.00 17.0000000000 FORMAT "%13.10" NUMBER 50 /end CHARACTERISTIC
/begin CHARACTERISTIC DINH_Lim.DFC_ComMETUnit_CA "inhibit conditions / inhibit limit conditions for inhibit source DFC_ComMETUnit" VAL_BLK 0x804FC879 ValA_Wu8 17.0000000000 DINH_LimDFCVerb 0.00 17.0000000000 FORMAT "%13.10" NUMBER 50 /end CHARACTERISTIC
/begin CHARACTERISTIC DINH_Lim.DFC_ComSRSUnit_CA "inhibit conditions / inhibit limit conditions for inhibit source DFC_ComSRSUnit" VAL_BLK 0x804FC8AB ValA_Wu8 17.0000000000 DINH_LimDFCVerb 0.00 17.0000000000 FORMAT "%13.10" NUMBER 50 /end CHARACTERISTIC
/begin CHARACTERISTIC DINH_Lim.DFC_ComVSAUnit_CA "inhibit conditions / inhibit limit conditions for inhibit source DFC_ComVSAUnit" VAL_BLK 0x804FC8DD ValA_Wu8 17.0000000000 DINH_LimDFCVerb 0.00 17.0000000000 FORMAT "%13.10" NUMBER 50 /end CHARACTERISTIC
/begin CHARACTERISTIC DINH_Lim.DFC_EbsSocFlt_CA "inhibit conditions / inhibit limit conditions for inhibit source DFC_EbsSocFlt" VAL_BLK 0x804FC90F ValA_Wu8 17.0000000000 DINH_LimDFCVerb 0.00 17.0000000000 FORMAT "%13.10" NUMBER 50 /end CHARACTERISTIC
/begin CHARACTERISTIC DINH_Lim.DFC_I14229VINErr_CA "inhibit conditions / inhibit limit conditions for inhibit source DFC_I14229VINErr" VAL_BLK 0x804FC941 ValA_Wu8 17.0000000000 DINH_LimDFCVerb 0.00 17.0000000000 FORMAT "%13.10" NUMBER 50 /end CHARACTERISTIC
/begin CHARACTERISTIC DINH_Lim.DFC_InjCatHeatgErr_CA "inhibit conditions / inhibit limit conditions for inhibit source DFC_InjCatHeatgErr" VAL_BLK 0x804FC973 ValA_Wu8 17.0000000000 DINH_LimDFCVerb 0.00 17.0000000000 FORMAT "%13.10" NUMBER 50 /end CHARACTERISTIC
/begin CHARACTERISTIC DINH_Lim.DFC_InjSysMulInjDiagErr_CA "inhibit conditions / inhibit limit conditions for inhibit source DFC_InjSysMulInjDiagErr" VAL_BLK 0x804FC9A5 ValA_Wu8 17.0000000000 DINH_LimDFCVerb 0.00 17.0000000000 FORMAT "%13.10" NUMBER 50 /end CHARACTERISTIC
/begin CHARACTERISTIC DINH_Lim.DFC_LLRHmax_CA "inhibit conditions / inhibit limit conditions for inhibit source DFC_LLRHmax" VAL_BLK 0x804FC9D7 ValA_Wu8 17.0000000000 DINH_LimDFCVerb 0.00 17.0000000000 FORMAT "%13.10" NUMBER 58 /end CHARACTERISTIC
/begin CHARACTERISTIC DINH_Lim.DFC_LLRHmin_CA "inhibit conditions / inhibit limit conditions for inhibit source DFC_LLRHmin" VAL_BLK 0x804FCA11 ValA_Wu8 17.0000000000 DINH_LimDFCVerb 0.00 17.0000000000 FORMAT "%13.10" NUMBER 58 /end CHARACTERISTIC
/begin CHARACTERISTIC DINH_Lim.DFC_LLRHnpl_CA "inhibit conditions / inhibit limit conditions for inhibit source DFC_LLRHnpl" VAL_BLK 0x804FCA4B ValA_Wu8 17.0000000000 DINH_LimDFCVerb 0.00 17.0000000000 FORMAT "%13.10" NUMBER 58 /end CHARACTERISTIC
/begin CHARACTERISTIC DINH_Lim.DFC_LLRKHmax_CA "inhibit conditions / inhibit limit conditions for inhibit source DFC_LLRKHmax" VAL_BLK 0x804FCA85 ValA_Wu8 17.0000000000 DINH_LimDFCVerb 0.00 17.0000000000 FORMAT "%13.10" NUMBER 50 /end CHARACTERISTIC
/begin CHARACTERISTIC DINH_Lim.DFC_LLRKHmin_CA "inhibit conditions / inhibit limit conditions for inhibit source DFC_LLRKHmin" VAL_BLK 0x804FCAB7 ValA_Wu8 17.0000000000 DINH_LimDFCVerb 0.00 17.0000000000 FORMAT "%13.10" NUMBER 50 /end CHARACTERISTIC
/begin CHARACTERISTIC DINH_Lim.DFC_LLRKHnpl_CA "inhibit conditions / inhibit limit conditions for inhibit source DFC_LLRKHnpl" VAL_BLK 0x804FCAE9 ValA_Wu8 17.0000000000 DINH_LimDFCVerb 0.00 17.0000000000 FORMAT "%13.10" NUMBER 50 /end CHARACTERISTIC
/begin CHARACTERISTIC DINH_Lim.DFC_LinACGUnit_CA "inhibit conditions / inhibit limit conditions for inhibit source DFC_LinACGUnit" VAL_BLK 0x804FCB1B ValA_Wu8 17.0000000000 DINH_LimDFCVerb 0.00 17.0000000000 FORMAT "%13.10" NUMBER 50 /end CHARACTERISTIC
/begin CHARACTERISTIC DINH_Lim.DFC_LinAEVUnit_CA "inhibit conditions / inhibit limit conditions for inhibit source DFC_LinAEVUnit" VAL_BLK 0x804FCB4D ValA_Wu8 17.0000000000 DINH_LimDFCVerb 0.00 17.0000000000 FORMAT "%13.10" NUMBER 50 /end CHARACTERISTIC
/begin CHARACTERISTIC DINH_Lim.DFC_LinEBSUnit_CA "inhibit conditions / inhibit limit conditions for inhibit source DFC_LinEBSUnit" VAL_BLK 0x804FCB7F ValA_Wu8 17.0000000000 DINH_LimDFCVerb 0.00 17.0000000000 FORMAT "%13.10" NUMBER 50 /end CHARACTERISTIC
/begin CHARACTERISTIC DINH_Lim.DFC_RoughRoad_CA "inhibit conditions / inhibit limit conditions for inhibit source DFC_RoughRoad" VAL_BLK 0x804FCBB1 ValA_Wu8 17.0000000000 DINH_LimDFCVerb 0.00 17.0000000000 FORMAT "%13.10" NUMBER 54 /end CHARACTERISTIC
/begin CHARACTERISTIC DINH_Lim.DFC_SiaEEPRdErr_CA "inhibit conditions / inhibit limit conditions for inhibit source DFC_SiaEEPRdErr" VAL_BLK 0x804FCBE7 ValA_Wu8 17.0000000000 DINH_LimDFCVerb 0.00 17.0000000000 FORMAT "%13.10" NUMBER 51 /end CHARACTERISTIC
/begin CHARACTERISTIC DINH_Lim.DFC_SiaEEPWrngCod_CA "inhibit conditions / inhibit limit conditions for inhibit source DFC_SiaEEPWrngCod" VAL_BLK 0x804FCC1A ValA_Wu8 17.0000000000 DINH_LimDFCVerb 0.00 17.0000000000 FORMAT "%13.10" NUMBER 51 /end CHARACTERISTIC
/begin CHARACTERISTIC DINH_Lim.DFC_UegoHeatrStrtS1B1_CA "inhibit conditions / inhibit limit conditions for inhibit source DFC_UegoHeatrStrtS1B1" VAL_BLK 0x804FCC4D ValA_Wu8 17.0000000000 DINH_LimDFCVerb 0.00 17.0000000000 FORMAT "%13.10" NUMBER 53 /end CHARACTERISTIC
/begin CHARACTERISTIC DINH_Lim.DFC_BusDiagCANAPPLBusOff_CA "inhibit conditions / inhibit limit conditions for inhibit source DFC_BusDiagCANAPPLBusOff" VAL_BLK 0x804FCC82 ValA_Wu8 17.0000000000 DINH_LimDFCVerb 0.00 17.0000000000 FORMAT "%13.10" NUMBER 50 /end CHARACTERISTIC
/begin CHARACTERISTIC DINH_Lim.DFC_BusDiagCANCANCBusOff_CA "inhibit conditions / inhibit limit conditions for inhibit source DFC_BusDiagCANCANCBusOff" VAL_BLK 0x804FCCB4 ValA_Wu8 17.0000000000 DINH_LimDFCVerb 0.00 17.0000000000 FORMAT "%13.10" NUMBER 50 /end CHARACTERISTIC
/begin CHARACTERISTIC DINH_Lim.DFC_BusDiagCANVEHICLEBusOff_CA "inhibit conditions / inhibit limit conditions for inhibit source DFC_BusDiagCANVEHICLEBusOff" VAL_BLK 0x804FCCE6 ValA_Wu8 17.0000000000 DINH_LimDFCVerb 0.00 17.0000000000 FORMAT "%13.10" NUMBER 61 /end CHARACTERISTIC
/begin CHARACTERISTIC DINH_Lim.DFC_RBA_IODIAGPWR_rba_IoExtCy329_SignalVltSply_0_CA "inhibit conditions / inhibit limit conditions for inhibit source DFC_RBA_IODIAGPWR_rba_IoExtCy329_SignalVltSply_0" VAL_BLK 0x804FCD23 ValA_Wu8 17.0000000000 DINH_LimDFCVerb 0.00 17.0000000000 FORMAT "%13.10" NUMBER 200 /end CHARACTERISTIC
/begin CHARACTERISTIC DINH_Lim.DFC_RBA_IODIAGPWR_rba_IoExtCy329_SignalVltSply_0OT_CA "inhibit conditions / inhibit limit conditions for inhibit source DFC_RBA_IODIAGPWR_rba_IoExtCy329_SignalVltSply_0OT" VAL_BLK 0x804FCDEB ValA_Wu8 17.0000000000 DINH_LimDFCVerb 0.00 17.0000000000 FORMAT "%13.10" NUMBER 50 /end CHARACTERISTIC
/begin CHARACTERISTIC DINH_Lim.DFC_RBA_IODIAGPWR_rba_IoExtCy329_SignalVltSply_0OV_CA "inhibit conditions / inhibit limit conditions for inhibit source DFC_RBA_IODIAGPWR_rba_IoExtCy329_SignalVltSply_0OV" VAL_BLK 0x804FCE1D ValA_Wu8 17.0000000000 DINH_LimDFCVerb 0.00 17.0000000000 FORMAT "%13.10" NUMBER 50 /end CHARACTERISTIC
/begin CHARACTERISTIC DINH_Lim.DFC_RBA_IODIAGPWR_rba_IoExtCy329_SignalVltSply_0SCG_CA "inhibit conditions / inhibit limit conditions for inhibit source DFC_RBA_IODIAGPWR_rba_IoExtCy329_SignalVltSply_0SCG" VAL_BLK 0x804FCE4F ValA_Wu8 17.0000000000 DINH_LimDFCVerb 0.00 17.0000000000 FORMAT "%13.10" NUMBER 50 /end CHARACTERISTIC
/begin CHARACTERISTIC DINH_Lim.DFC_RBA_IODIAGPWR_rba_IoExtCy329_SignalVltSply_0UV_CA "inhibit conditions / inhibit limit conditions for inhibit source DFC_RBA_IODIAGPWR_rba_IoExtCy329_SignalVltSply_0UV" VAL_BLK 0x804FCE81 ValA_Wu8 17.0000000000 DINH_LimDFCVerb 0.00 17.0000000000 FORMAT "%13.10" NUMBER 50 /end CHARACTERISTIC
/begin CHARACTERISTIC DINH_Lim.DFC_RBA_IODIAGPWR_rba_IoExtCy329_SignalVltSply_1_CA "inhibit conditions / inhibit limit conditions for inhibit source DFC_RBA_IODIAGPWR_rba_IoExtCy329_SignalVltSply_1" VAL_BLK 0x804FCEB3 ValA_Wu8 17.0000000000 DINH_LimDFCVerb 0.00 17.0000000000 FORMAT "%13.10" NUMBER 200 /end CHARACTERISTIC
/begin CHARACTERISTIC DINH_Lim.DFC_RBA_IODIAGPWR_rba_IoExtCy329_SignalVltSply_1OT_CA "inhibit conditions / inhibit limit conditions for inhibit source DFC_RBA_IODIAGPWR_rba_IoExtCy329_SignalVltSply_1OT" VAL_BLK 0x804FCF7B ValA_Wu8 17.0000000000 DINH_LimDFCVerb 0.00 17.0000000000 FORMAT "%13.10" NUMBER 50 /end CHARACTERISTIC
/begin CHARACTERISTIC DINH_Lim.DFC_RBA_IODIAGPWR_rba_IoExtCy329_SignalVltSply_1OV_CA "inhibit conditions / inhibit limit conditions for inhibit source DFC_RBA_IODIAGPWR_rba_IoExtCy329_SignalVltSply_1OV" VAL_BLK 0x804FCFAD ValA_Wu8 17.0000000000 DINH_LimDFCVerb 0.00 17.0000000000 FORMAT "%13.10" NUMBER 50 /end CHARACTERISTIC
/begin CHARACTERISTIC DINH_Lim.DFC_RBA_IODIAGPWR_rba_IoExtCy329_SignalVltSply_1SCG_CA "inhibit conditions / inhibit limit conditions for inhibit source DFC_RBA_IODIAGPWR_rba_IoExtCy329_SignalVltSply_1SCG" VAL_BLK 0x804FCFDF ValA_Wu8 17.0000000000 DINH_LimDFCVerb 0.00 17.0000000000 FORMAT "%13.10" NUMBER 50 /end CHARACTERISTIC
/begin CHARACTERISTIC DINH_Lim.DFC_RBA_IODIAGPWR_rba_IoExtCy329_SignalVltSply_1UV_CA "inhibit conditions / inhibit limit conditions for inhibit source DFC_RBA_IODIAGPWR_rba_IoExtCy329_SignalVltSply_1UV" VAL_BLK 0x804FD011 ValA_Wu8 17.0000000000 DINH_LimDFCVerb 0.00 17.0000000000 FORMAT "%13.10" NUMBER 50 /end CHARACTERISTIC
/begin CHARACTERISTIC DINH_Lim.DFC_RBA_IODIAGPWR_rba_IoExtCy329_SignalVltSply_2_CA "inhibit conditions / inhibit limit conditions for inhibit source DFC_RBA_IODIAGPWR_rba_IoExtCy329_SignalVltSply_2" VAL_BLK 0x804FD043 ValA_Wu8 17.0000000000 DINH_LimDFCVerb 0.00 17.0000000000 FORMAT "%13.10" NUMBER 200 /end CHARACTERISTIC
/begin CHARACTERISTIC DINH_Lim.DFC_RBA_IODIAGPWR_rba_IoExtCy329_SignalVltSply_2OT_CA "inhibit conditions / inhibit limit conditions for inhibit source DFC_RBA_IODIAGPWR_rba_IoExtCy329_SignalVltSply_2OT" VAL_BLK 0x804FD10B ValA_Wu8 17.0000000000 DINH_LimDFCVerb 0.00 17.0000000000 FORMAT "%13.10" NUMBER 50 /end CHARACTERISTIC
/begin CHARACTERISTIC DINH_Lim.DFC_RBA_IODIAGPWR_rba_IoExtCy329_SignalVltSply_2OV_CA "inhibit conditions / inhibit limit conditions for inhibit source DFC_RBA_IODIAGPWR_rba_IoExtCy329_SignalVltSply_2OV" VAL_BLK 0x804FD13D ValA_Wu8 17.0000000000 DINH_LimDFCVerb 0.00 17.0000000000 FORMAT "%13.10" NUMBER 50 /end CHARACTERISTIC
/begin CHARACTERISTIC DINH_Lim.DFC_RBA_IODIAGPWR_rba_IoExtCy329_SignalVltSply_2SCG_CA "inhibit conditions / inhibit limit conditions for inhibit source DFC_RBA_IODIAGPWR_rba_IoExtCy329_SignalVltSply_2SCG" VAL_BLK 0x804FD16F ValA_Wu8 17.0000000000 DINH_LimDFCVerb 0.00 17.0000000000 FORMAT "%13.10" NUMBER 50 /end CHARACTERISTIC
/begin CHARACTERISTIC DINH_Lim.DFC_RBA_IODIAGPWR_rba_IoExtCy329_SignalVltSply_2UV_CA "inhibit conditions / inhibit limit conditions for inhibit source DFC_RBA_IODIAGPWR_rba_IoExtCy329_SignalVltSply_2UV" VAL_BLK 0x804FD1A1 ValA_Wu8 17.0000000000 DINH_LimDFCVerb 0.00 17.0000000000 FORMAT "%13.10" NUMBER 50 /end CHARACTERISTIC
/begin CHARACTERISTIC DINH_Lim.DFC_CAN_E_TIMEOUT_CA "inhibit conditions / inhibit limit conditions for inhibit source DFC_CAN_E_TIMEOUT" VAL_BLK 0x804FD1D3 ValA_Wu8 17.0000000000 DINH_LimDFCVerb 0.00 17.0000000000 FORMAT "%13.10" NUMBER 50 /end CHARACTERISTIC
/begin CHARACTERISTIC DINH_Lim.DFC_LIN_E_TIMEOUT_CA "inhibit conditions / inhibit limit conditions for inhibit source DFC_LIN_E_TIMEOUT" VAL_BLK 0x804FD205 ValA_Wu8 17.0000000000 DINH_LimDFCVerb 0.00 17.0000000000 FORMAT "%13.10" NUMBER 50 /end CHARACTERISTIC
/begin CHARACTERISTIC DINH_Lim.DFC_MRlyOL_CA "inhibit conditions / inhibit limit conditions for inhibit source DFC_MRlyOL" VAL_BLK 0x804FD237 ValA_Wu8 17.0000000000 DINH_LimDFCVerb 0.00 17.0000000000 FORMAT "%13.10" NUMBER 50 /end CHARACTERISTIC
/begin CHARACTERISTIC DINH_Lim.DFC_MRlySCB_CA "inhibit conditions / inhibit limit conditions for inhibit source DFC_MRlySCB" VAL_BLK 0x804FD269 ValA_Wu8 17.0000000000 DINH_LimDFCVerb 0.00 17.0000000000 FORMAT "%13.10" NUMBER 50 /end CHARACTERISTIC
/begin CHARACTERISTIC DINH_Lim.DFC_MRlySCG_CA "inhibit conditions / inhibit limit conditions for inhibit source DFC_MRlySCG" VAL_BLK 0x804FD29B ValA_Wu8 17.0000000000 DINH_LimDFCVerb 0.00 17.0000000000 FORMAT "%13.10" NUMBER 51 /end CHARACTERISTIC
/begin CHARACTERISTIC DINH_Lim.DFC_rba_MultiStackTrace_Threshold_CA "inhibit conditions / inhibit limit conditions for inhibit source DFC_rba_MultiStackTrace_Threshold" VAL_BLK 0x804FD2CE ValA_Wu8 17.0000000000 DINH_LimDFCVerb 0.00 17.0000000000 FORMAT "%13.10" NUMBER 50 /end CHARACTERISTIC
/begin CHARACTERISTIC DINH_Lim.DFC_BSWM_E_ACTION_FAILED_CA "inhibit conditions / inhibit limit conditions for inhibit source DFC_BSWM_E_ACTION_FAILED" VAL_BLK 0x804FD300 ValA_Wu8 17.0000000000 DINH_LimDFCVerb 0.00 17.0000000000 FORMAT "%13.10" NUMBER 50 /end CHARACTERISTIC
/begin CHARACTERISTIC DINH_Lim.DFC_BSWM_E_INTRPTQUEUE_FULL_CA "inhibit conditions / inhibit limit conditions for inhibit source DFC_BSWM_E_INTRPTQUEUE_FULL" VAL_BLK 0x804FD332 ValA_Wu8 17.0000000000 DINH_LimDFCVerb 0.00 17.0000000000 FORMAT "%13.10" NUMBER 50 /end CHARACTERISTIC
/begin CHARACTERISTIC DINH_Lim.DFC_RBA_IOEXTLIB_KEEPALIVE_DRV_CA "inhibit conditions / inhibit limit conditions for inhibit source DFC_RBA_IOEXTLIB_KEEPALIVE_DRV" VAL_BLK 0x804FD364 ValA_Wu8 17.0000000000 DINH_LimDFCVerb 0.00 17.0000000000 FORMAT "%13.10" NUMBER 51 /end CHARACTERISTIC
/begin CHARACTERISTIC DINH_Lim.DFC_RBA_IOEXTLIB_KEEPALIVE_INI_CA "inhibit conditions / inhibit limit conditions for inhibit source DFC_RBA_IOEXTLIB_KEEPALIVE_INI" VAL_BLK 0x804FD397 ValA_Wu8 17.0000000000 DINH_LimDFCVerb 0.00 17.0000000000 FORMAT "%13.10" NUMBER 51 /end CHARACTERISTIC
/begin CHARACTERISTIC DINH_Lim.DFC_rba_IoSigRtc_StopCounter_CA "inhibit conditions / inhibit limit conditions for inhibit source DFC_rba_IoSigRtc_StopCounter" VAL_BLK 0x804FD3CA ValA_Wu8 17.0000000000 DINH_LimDFCVerb 0.00 17.0000000000 FORMAT "%13.10" NUMBER 57 /end CHARACTERISTIC
/begin CHARACTERISTIC DINH_Lim.DFC_rba_MRly_Diag_Stk_Event_CA "inhibit conditions / inhibit limit conditions for inhibit source DFC_rba_MRly_Diag_Stk_Event" VAL_BLK 0x804FD403 ValA_Wu8 17.0000000000 DINH_LimDFCVerb 0.00 17.0000000000 FORMAT "%13.10" NUMBER 50 /end CHARACTERISTIC
/begin CHARACTERISTIC DINH_Lim.DFC_rba_MemDiag_MemReadErr_CA "inhibit conditions / inhibit limit conditions for inhibit source DFC_rba_MemDiag_MemReadErr" VAL_BLK 0x804FD435 ValA_Wu8 17.0000000000 DINH_LimDFCVerb 0.00 17.0000000000 FORMAT "%13.10" NUMBER 61 /end CHARACTERISTIC
/begin CHARACTERISTIC DINH_Lim.DFC_rba_MemDiag_MemWrErr_CA "inhibit conditions / inhibit limit conditions for inhibit source DFC_rba_MemDiag_MemWrErr" VAL_BLK 0x804FD472 ValA_Wu8 17.0000000000 DINH_LimDFCVerb 0.00 17.0000000000 FORMAT "%13.10" NUMBER 60 /end CHARACTERISTIC
/begin CHARACTERISTIC DINH_Lim.DFC_rba_SyC_IrrSwOffTrigEngRun_Event_CA "inhibit conditions / inhibit limit conditions for inhibit source DFC_rba_SyC_IrrSwOffTrigEngRun_Event" VAL_BLK 0x804FD4AE ValA_Wu8 17.0000000000 DINH_LimDFCVerb 0.00 17.0000000000 FORMAT "%13.10" NUMBER 50 /end CHARACTERISTIC
/begin CHARACTERISTIC DINH_Lim.DFC_rba_T15_Diag_ComInVld_Event_CA "inhibit conditions / inhibit limit conditions for inhibit source DFC_rba_T15_Diag_ComInVld_Event" VAL_BLK 0x804FD4E0 ValA_Wu8 17.0000000000 DINH_LimDFCVerb 0.00 17.0000000000 FORMAT "%13.10" NUMBER 50 /end CHARACTERISTIC
/begin CHARACTERISTIC DINH_Lim.DFC_rba_T15_Diag_ComOff_HwOn_Event_CA "inhibit conditions / inhibit limit conditions for inhibit source DFC_rba_T15_Diag_ComOff_HwOn_Event" VAL_BLK 0x804FD512 ValA_Wu8 17.0000000000 DINH_LimDFCVerb 0.00 17.0000000000 FORMAT "%13.10" NUMBER 50 /end CHARACTERISTIC
/begin CHARACTERISTIC DINH_Lim.DFC_rba_T15_Diag_ComOn_HwOff_Event_CA "inhibit conditions / inhibit limit conditions for inhibit source DFC_rba_T15_Diag_ComOn_HwOff_Event" VAL_BLK 0x804FD544 ValA_Wu8 17.0000000000 DINH_LimDFCVerb 0.00 17.0000000000 FORMAT "%13.10" NUMBER 50 /end CHARACTERISTIC
/begin CHARACTERISTIC DINH_Lim.DFC_AAVmin_CA "inhibit conditions / inhibit limit conditions for inhibit source DFC_AAVmin" VAL_BLK 0x804FD576 ValA_Wu8 17.0000000000 DINH_LimDFCVerb 0.00 17.0000000000 FORMAT "%13.10" NUMBER 55 /end CHARACTERISTIC
/begin CHARACTERISTIC DINH_Lim.DFC_AGRSUS_CA "inhibit conditions / inhibit limit conditions for inhibit source DFC_AGRSUS" VAL_BLK 0x804FD5AD ValA_Wu8 17.0000000000 DINH_LimDFCVerb 0.00 17.0000000000 FORMAT "%13.10" NUMBER 72 /end CHARACTERISTIC
/begin CHARACTERISTIC DINH_Lim.DFC_AfsPlausDiagHi_CA "inhibit conditions / inhibit limit conditions for inhibit source DFC_AfsPlausDiagHi" VAL_BLK 0x804FD5F5 ValA_Wu8 17.0000000000 DINH_LimDFCVerb 0.00 17.0000000000 FORMAT "%13.10" NUMBER 54 /end CHARACTERISTIC
/begin CHARACTERISTIC DINH_Lim.DFC_AfsPlausDiagLo_CA "inhibit conditions / inhibit limit conditions for inhibit source DFC_AfsPlausDiagLo" VAL_BLK 0x804FD62B ValA_Wu8 17.0000000000 DINH_LimDFCVerb 0.00 17.0000000000 FORMAT "%13.10" NUMBER 54 /end CHARACTERISTIC
/begin CHARACTERISTIC DINH_Lim.DFC_AfsVrntDiagErrB1_CA "inhibit conditions / inhibit limit conditions for inhibit source DFC_AfsVrntDiagErrB1" VAL_BLK 0x804FD661 ValA_Wu8 17.0000000000 DINH_LimDFCVerb 0.00 17.0000000000 FORMAT "%13.10" NUMBER 54 /end CHARACTERISTIC
/begin CHARACTERISTIC DINH_Lim.DFC_AppAllSnsrDfct_CA "inhibit conditions / inhibit limit conditions for inhibit source DFC_AppAllSnsrDfct" VAL_BLK 0x804FD697 ValA_Wu8 17.0000000000 DINH_LimDFCVerb 0.00 17.0000000000 FORMAT "%13.10" NUMBER 51 /end CHARACTERISTIC
/begin CHARACTERISTIC DINH_Lim.DFC_BBKRnldg_CA "inhibit conditions / inhibit limit conditions for inhibit source DFC_BBKRnldg" VAL_BLK 0x804FD6CA ValA_Wu8 17.0000000000 DINH_LimDFCVerb 0.00 17.0000000000 FORMAT "%13.10" NUMBER 52 /end CHARACTERISTIC
/begin CHARACTERISTIC DINH_Lim.DFC_BBKRsyne_CA "inhibit conditions / inhibit limit conditions for inhibit source DFC_BBKRsyne" VAL_BLK 0x804FD6FE ValA_Wu8 17.0000000000 DINH_LimDFCVerb 0.00 17.0000000000 FORMAT "%13.10" NUMBER 52 /end CHARACTERISTIC
/begin CHARACTERISTIC DINH_Lim.DFC_BattUStdbyDiaOL_CA "inhibit conditions / inhibit limit conditions for inhibit source DFC_BattUStdbyDiaOL" VAL_BLK 0x804FD732 ValA_Wu8 17.0000000000 DINH_LimDFCVerb 0.00 17.0000000000 FORMAT "%13.10" NUMBER 50 /end CHARACTERISTIC
/begin CHARACTERISTIC DINH_Lim.DFC_BigLeakIntkMnfldEmiInfl_CA "inhibit conditions / inhibit limit conditions for inhibit source DFC_BigLeakIntkMnfldEmiInfl" VAL_BLK 0x804FD764 ValA_Wu8 17.0000000000 DINH_LimDFCVerb 0.00 17.0000000000 FORMAT "%13.10" NUMBER 54 /end CHARACTERISTIC
/begin CHARACTERISTIC DINH_Lim.DFC_BlkdLineTank_CA "inhibit conditions / inhibit limit conditions for inhibit source DFC_BlkdLineTank" VAL_BLK 0x804FD79A ValA_Wu8 17.0000000000 DINH_LimDFCVerb 0.00 17.0000000000 FORMAT "%13.10" NUMBER 52 /end CHARACTERISTIC
/begin CHARACTERISTIC DINH_Lim.DFC_BrkMnSwtContOnWarnLmp_CA "inhibit conditions / inhibit limit conditions for inhibit source DFC_BrkMnSwtContOnWarnLmp" VAL_BLK 0x804FD7CE ValA_Wu8 17.0000000000 DINH_LimDFCVerb 0.00 17.0000000000 FORMAT "%13.10" NUMBER 50 /end CHARACTERISTIC
/begin CHARACTERISTIC DINH_Lim.DFC_BrkMnSwtNotStpWarnLmp_CA "inhibit conditions / inhibit limit conditions for inhibit source DFC_BrkMnSwtNotStpWarnLmp" VAL_BLK 0x804FD800 ValA_Wu8 17.0000000000 DINH_LimDFCVerb 0.00 17.0000000000 FORMAT "%13.10" NUMBER 50 /end CHARACTERISTIC
/begin CHARACTERISTIC DINH_Lim.DFC_BrkRdntSwtContOnWarnLmp_CA "inhibit conditions / inhibit limit conditions for inhibit source DFC_BrkRdntSwtContOnWarnLmp" VAL_BLK 0x804FD832 ValA_Wu8 17.0000000000 DINH_LimDFCVerb 0.00 17.0000000000 FORMAT "%13.10" NUMBER 50 /end CHARACTERISTIC
/begin CHARACTERISTIC DINH_Lim.DFC_BrkRdntSwtNotStpWarnLmp_CA "inhibit conditions / inhibit limit conditions for inhibit source DFC_BrkRdntSwtNotStpWarnLmp" VAL_BLK 0x804FD864 ValA_Wu8 17.0000000000 DINH_LimDFCVerb 0.00 17.0000000000 FORMAT "%13.10" NUMBER 50 /end CHARACTERISTIC
/begin CHARACTERISTIC DINH_Lim.DFC_CEngDsTColdStrtMax_CA "inhibit conditions / inhibit limit conditions for inhibit source DFC_CEngDsTColdStrtMax" VAL_BLK 0x804FD896 ValA_Wu8 17.0000000000 DINH_LimDFCVerb 0.00 17.0000000000 FORMAT "%13.10" NUMBER 122 /end CHARACTERISTIC
/begin CHARACTERISTIC DINH_Lim.DFC_CEngDsTColdStrtMin_CA "inhibit conditions / inhibit limit conditions for inhibit source DFC_CEngDsTColdStrtMin" VAL_BLK 0x804FD910 ValA_Wu8 17.0000000000 DINH_LimDFCVerb 0.00 17.0000000000 FORMAT "%13.10" NUMBER 122 /end CHARACTERISTIC
/begin CHARACTERISTIC DINH_Lim.DFC_CEngDsTImps_CA "inhibit conditions / inhibit limit conditions for inhibit source DFC_CEngDsTImps" VAL_BLK 0x804FD98A ValA_Wu8 17.0000000000 DINH_LimDFCVerb 0.00 17.0000000000 FORMAT "%13.10" NUMBER 125 /end CHARACTERISTIC
/begin CHARACTERISTIC DINH_Lim.DFC_CEngDsTPlausHSC_CA "inhibit conditions / inhibit limit conditions for inhibit source DFC_CEngDsTPlausHSC" VAL_BLK 0x804FDA07 ValA_Wu8 17.0000000000 DINH_LimDFCVerb 0.00 17.0000000000 FORMAT "%13.10" NUMBER 121 /end CHARACTERISTIC
/begin CHARACTERISTIC DINH_Lim.DFC_CEngDsTPlausLSC_CA "inhibit conditions / inhibit limit conditions for inhibit source DFC_CEngDsTPlausLSC" VAL_BLK 0x804FDA80 ValA_Wu8 17.0000000000 DINH_LimDFCVerb 0.00 17.0000000000 FORMAT "%13.10" NUMBER 122 /end CHARACTERISTIC
/begin CHARACTERISTIC DINH_Lim.DFC_CEngDsTPlausSTC_CA "inhibit conditions / inhibit limit conditions for inhibit source DFC_CEngDsTPlausSTC" VAL_BLK 0x804FDAFA ValA_Wu8 17.0000000000 DINH_LimDFCVerb 0.00 17.0000000000 FORMAT "%13.10" NUMBER 121 /end CHARACTERISTIC
/begin CHARACTERISTIC DINH_Lim.DFC_CEngDsTSRCMax_CA "inhibit conditions / inhibit limit conditions for inhibit source DFC_CEngDsTSRCMax" VAL_BLK 0x804FDB73 ValA_Wu8 17.0000000000 DINH_LimDFCVerb 0.00 17.0000000000 FORMAT "%13.10" NUMBER 135 /end CHARACTERISTIC
/begin CHARACTERISTIC DINH_Lim.DFC_CEngDsTSRCMin_CA "inhibit conditions / inhibit limit conditions for inhibit source DFC_CEngDsTSRCMin" VAL_BLK 0x804FDBFA ValA_Wu8 17.0000000000 DINH_LimDFCVerb 0.00 17.0000000000 FORMAT "%13.10" NUMBER 135 /end CHARACTERISTIC
/begin CHARACTERISTIC DINH_Lim.DFC_CEngDsTSig_CA "inhibit conditions / inhibit limit conditions for inhibit source DFC_CEngDsTSig" VAL_BLK 0x804FDC81 ValA_Wu8 17.0000000000 DINH_LimDFCVerb 0.00 17.0000000000 FORMAT "%13.10" NUMBER 123 /end CHARACTERISTIC
/begin CHARACTERISTIC DINH_Lim.DFC_CEngUsTColdStrtMax_CA "inhibit conditions / inhibit limit conditions for inhibit source DFC_CEngUsTColdStrtMax" VAL_BLK 0x804FDCFC ValA_Wu8 17.0000000000 DINH_LimDFCVerb 0.00 17.0000000000 FORMAT "%13.10" NUMBER 53 /end CHARACTERISTIC
/begin CHARACTERISTIC DINH_Lim.DFC_CEngUsTColdStrtMin_CA "inhibit conditions / inhibit limit conditions for inhibit source DFC_CEngUsTColdStrtMin" VAL_BLK 0x804FDD31 ValA_Wu8 17.0000000000 DINH_LimDFCVerb 0.00 17.0000000000 FORMAT "%13.10" NUMBER 53 /end CHARACTERISTIC
/begin CHARACTERISTIC DINH_Lim.DFC_CEngUsTLooseCnctn_CA "inhibit conditions / inhibit limit conditions for inhibit source DFC_CEngUsTLooseCnctn" VAL_BLK 0x804FDD66 ValA_Wu8 17.0000000000 DINH_LimDFCVerb 0.00 17.0000000000 FORMAT "%13.10" NUMBER 55 /end CHARACTERISTIC
/begin CHARACTERISTIC DINH_Lim.DFC_CEngUsTSRCMax_CA "inhibit conditions / inhibit limit conditions for inhibit source DFC_CEngUsTSRCMax" VAL_BLK 0x804FDD9D ValA_Wu8 17.0000000000 DINH_LimDFCVerb 0.00 17.0000000000 FORMAT "%13.10" NUMBER 58 /end CHARACTERISTIC
/begin CHARACTERISTIC DINH_Lim.DFC_CEngUsTSRCMin_CA "inhibit conditions / inhibit limit conditions for inhibit source DFC_CEngUsTSRCMin" VAL_BLK 0x804FDDD7 ValA_Wu8 17.0000000000 DINH_LimDFCVerb 0.00 17.0000000000 FORMAT "%13.10" NUMBER 58 /end CHARACTERISTIC
/begin CHARACTERISTIC DINH_Lim.DFC_ComDCDCACCFailr_CA "inhibit conditions / inhibit limit conditions for inhibit source DFC_ComDCDCACCFailr" VAL_BLK 0x804FDE11 ValA_Wu8 17.0000000000 DINH_LimDFCVerb 0.00 17.0000000000 FORMAT "%13.10" NUMBER 57 /end CHARACTERISTIC
/begin CHARACTERISTIC DINH_Lim.DFC_DCDCFltDet_CA "inhibit conditions / inhibit limit conditions for inhibit source DFC_DCDCFltDet" VAL_BLK 0x804FDE4A ValA_Wu8 17.0000000000 DINH_LimDFCVerb 0.00 17.0000000000 FORMAT "%13.10" NUMBER 57 /end CHARACTERISTIC
/begin CHARACTERISTIC DINH_Lim.DFC_DKRSA_CA "inhibit conditions / inhibit limit conditions for inhibit source DFC_DKRSA" VAL_BLK 0x804FDE83 ValA_Wu8 17.0000000000 DINH_LimDFCVerb 0.00 17.0000000000 FORMAT "%13.10" NUMBER 58 /end CHARACTERISTIC
/begin CHARACTERISTIC DINH_Lim.DFC_DKVSmax_CA "inhibit conditions / inhibit limit conditions for inhibit source DFC_DKVSmax" VAL_BLK 0x804FDEBD ValA_Wu8 17.0000000000 DINH_LimDFCVerb 0.00 17.0000000000 FORMAT "%13.10" NUMBER 50 /end CHARACTERISTIC
/begin CHARACTERISTIC DINH_Lim.DFC_DKnpl_CA "inhibit conditions / inhibit limit conditions for inhibit source DFC_DKnpl" VAL_BLK 0x804FDEEF ValA_Wu8 17.0000000000 DINH_LimDFCVerb 0.00 17.0000000000 FORMAT "%13.10" NUMBER 50 /end CHARACTERISTIC
/begin CHARACTERISTIC DINH_Lim.DFC_DSKVRmax_CA "inhibit conditions / inhibit limit conditions for inhibit source DFC_DSKVRmax" VAL_BLK 0x804FDF21 ValA_Wu8 17.0000000000 DINH_LimDFCVerb 0.00 17.0000000000 FORMAT "%13.10" NUMBER 66 /end CHARACTERISTIC
/begin CHARACTERISTIC DINH_Lim.DFC_DSKVRmin_CA "inhibit conditions / inhibit limit conditions for inhibit source DFC_DSKVRmin" VAL_BLK 0x804FDF63 ValA_Wu8 17.0000000000 DINH_LimDFCVerb 0.00 17.0000000000 FORMAT "%13.10" NUMBER 66 /end CHARACTERISTIC
/begin CHARACTERISTIC DINH_Lim.DFC_DSKVRnpl_CA "inhibit conditions / inhibit limit conditions for inhibit source DFC_DSKVRnpl" VAL_BLK 0x804FDFA5 ValA_Wu8 17.0000000000 DINH_LimDFCVerb 0.00 17.0000000000 FORMAT "%13.10" NUMBER 62 /end CHARACTERISTIC
/begin CHARACTERISTIC DINH_Lim.DFC_DSKVRsig_CA "inhibit conditions / inhibit limit conditions for inhibit source DFC_DSKVRsig" VAL_BLK 0x804FDFE3 ValA_Wu8 17.0000000000 DINH_LimDFCVerb 0.00 17.0000000000 FORMAT "%13.10" NUMBER 62 /end CHARACTERISTIC
/begin CHARACTERISTIC DINH_Lim.DFC_DSKVSsig_CA "inhibit conditions / inhibit limit conditions for inhibit source DFC_DSKVSsig" VAL_BLK 0x804FE021 ValA_Wu8 17.0000000000 DINH_LimDFCVerb 0.00 17.0000000000 FORMAT "%13.10" NUMBER 64 /end CHARACTERISTIC
/begin CHARACTERISTIC DINH_Lim.DFC_DSSmax_CA "inhibit conditions / inhibit limit conditions for inhibit source DFC_DSSmax" VAL_BLK 0x804FE061 ValA_Wu8 17.0000000000 DINH_LimDFCVerb 0.00 17.0000000000 FORMAT "%13.10" NUMBER 50 /end CHARACTERISTIC
/begin CHARACTERISTIC DINH_Lim.DFC_DSTDmax_CA "inhibit conditions / inhibit limit conditions for inhibit source DFC_DSTDmax" VAL_BLK 0x804FE093 ValA_Wu8 17.0000000000 DINH_LimDFCVerb 0.00 17.0000000000 FORMAT "%13.10" NUMBER 50 /end CHARACTERISTIC
/begin CHARACTERISTIC DINH_Lim.DFC_DSTEmax_CA "inhibit conditions / inhibit limit conditions for inhibit source DFC_DSTEmax" VAL_BLK 0x804FE0C5 ValA_Wu8 17.0000000000 DINH_LimDFCVerb 0.00 17.0000000000 FORMAT "%13.10" NUMBER 59 /end CHARACTERISTIC
/begin CHARACTERISTIC DINH_Lim.DFC_DSTEmin_CA "inhibit conditions / inhibit limit conditions for inhibit source DFC_DSTEmin" VAL_BLK 0x804FE100 ValA_Wu8 17.0000000000 DINH_LimDFCVerb 0.00 17.0000000000 FORMAT "%13.10" NUMBER 59 /end CHARACTERISTIC
/begin CHARACTERISTIC DINH_Lim.DFC_DSTOFmax_CA "inhibit conditions / inhibit limit conditions for inhibit source DFC_DSTOFmax" VAL_BLK 0x804FE13B ValA_Wu8 17.0000000000 DINH_LimDFCVerb 0.00 17.0000000000 FORMAT "%13.10" NUMBER 56 /end CHARACTERISTIC
/begin CHARACTERISTIC DINH_Lim.DFC_DSTRmax_CA "inhibit conditions / inhibit limit conditions for inhibit source DFC_DSTRmax" VAL_BLK 0x804FE173 ValA_Wu8 17.0000000000 DINH_LimDFCVerb 0.00 17.0000000000 FORMAT "%13.10" NUMBER 57 /end CHARACTERISTIC
/begin CHARACTERISTIC DINH_Lim.DFC_DSTRmin_CA "inhibit conditions / inhibit limit conditions for inhibit source DFC_DSTRmin" VAL_BLK 0x804FE1AC ValA_Wu8 17.0000000000 DINH_LimDFCVerb 0.00 17.0000000000 FORMAT "%13.10" NUMBER 57 /end CHARACTERISTIC
/begin CHARACTERISTIC DINH_Lim.DFC_DSTRnpl_CA "inhibit conditions / inhibit limit conditions for inhibit source DFC_DSTRnpl" VAL_BLK 0x804FE1E5 ValA_Wu8 17.0000000000 DINH_LimDFCVerb 0.00 17.0000000000 FORMAT "%13.10" NUMBER 56 /end CHARACTERISTIC
/begin CHARACTERISTIC DINH_Lim.DFC_DSTRsig_CA "inhibit conditions / inhibit limit conditions for inhibit source DFC_DSTRsig" VAL_BLK 0x804FE21D ValA_Wu8 17.0000000000 DINH_LimDFCVerb 0.00 17.0000000000 FORMAT "%13.10" NUMBER 56 /end CHARACTERISTIC
/begin CHARACTERISTIC DINH_Lim.DFC_DSTTI_CA "inhibit conditions / inhibit limit conditions for inhibit source DFC_DSTTI" VAL_BLK 0x804FE255 ValA_Wu8 17.0000000000 DINH_LimDFCVerb 0.00 17.0000000000 FORMAT "%13.10" NUMBER 51 /end CHARACTERISTIC
/begin CHARACTERISTIC DINH_Lim.DFC_DSUmax_CA "inhibit conditions / inhibit limit conditions for inhibit source DFC_DSUmax" VAL_BLK 0x804FE288 ValA_Wu8 17.0000000000 DINH_LimDFCVerb 0.00 17.0000000000 FORMAT "%13.10" NUMBER 50 /end CHARACTERISTIC
/begin CHARACTERISTIC DINH_Lim.DFC_DiagCpv1DteskLoLoadStuckClsd_CA "inhibit conditions / inhibit limit conditions for inhibit source DFC_DiagCpv1DteskLoLoadStuckClsd" VAL_BLK 0x804FE2BA ValA_Wu8 17.0000000000 DINH_LimDFCVerb 0.00 17.0000000000 FORMAT "%13.10" NUMBER 71 /end CHARACTERISTIC
/begin CHARACTERISTIC DINH_Lim.DFC_DiagCpv1DteskLoLoadStuckOpen_CA "inhibit conditions / inhibit limit conditions for inhibit source DFC_DiagCpv1DteskLoLoadStuckOpen" VAL_BLK 0x804FE301 ValA_Wu8 17.0000000000 DINH_LimDFCVerb 0.00 17.0000000000 FORMAT "%13.10" NUMBER 80 /end CHARACTERISTIC
/begin CHARACTERISTIC DINH_Lim.DFC_EGRVlvDrftClsd_CA "inhibit conditions / inhibit limit conditions for inhibit source DFC_EGRVlvDrftClsd" VAL_BLK 0x804FE351 ValA_Wu8 17.0000000000 DINH_LimDFCVerb 0.00 17.0000000000 FORMAT "%13.10" NUMBER 51 /end CHARACTERISTIC
/begin CHARACTERISTIC DINH_Lim.DFC_EGRVlvDrftOpn_CA "inhibit conditions / inhibit limit conditions for inhibit source DFC_EGRVlvDrftOpn" VAL_BLK 0x804FE384 ValA_Wu8 17.0000000000 DINH_LimDFCVerb 0.00 17.0000000000 FORMAT "%13.10" NUMBER 50 /end CHARACTERISTIC
/begin CHARACTERISTIC DINH_Lim.DFC_EGRVlvJamVlvClsd_CA "inhibit conditions / inhibit limit conditions for inhibit source DFC_EGRVlvJamVlvClsd" VAL_BLK 0x804FE3B6 ValA_Wu8 17.0000000000 DINH_LimDFCVerb 0.00 17.0000000000 FORMAT "%13.10" NUMBER 53 /end CHARACTERISTIC
/begin CHARACTERISTIC DINH_Lim.DFC_EGRVlvJamVlvOpn_CA "inhibit conditions / inhibit limit conditions for inhibit source DFC_EGRVlvJamVlvOpn" VAL_BLK 0x804FE3EB ValA_Wu8 17.0000000000 DINH_LimDFCVerb 0.00 17.0000000000 FORMAT "%13.10" NUMBER 53 /end CHARACTERISTIC
/begin CHARACTERISTIC DINH_Lim.DFC_EGRVlvSprgBrk_CA "inhibit conditions / inhibit limit conditions for inhibit source DFC_EGRVlvSprgBrk" VAL_BLK 0x804FE420 ValA_Wu8 17.0000000000 DINH_LimDFCVerb 0.00 17.0000000000 FORMAT "%13.10" NUMBER 50 /end CHARACTERISTIC
/begin CHARACTERISTIC DINH_Lim.DFC_EGRVlvTempMdlEEPErr_CA "inhibit conditions / inhibit limit conditions for inhibit source DFC_EGRVlvTempMdlEEPErr" VAL_BLK 0x804FE452 ValA_Wu8 17.0000000000 DINH_LimDFCVerb 0.00 17.0000000000 FORMAT "%13.10" NUMBER 51 /end CHARACTERISTIC
/begin CHARACTERISTIC DINH_Lim.DFC_EGRVlvTmpErr_CA "inhibit conditions / inhibit limit conditions for inhibit source DFC_EGRVlvTmpErr" VAL_BLK 0x804FE485 ValA_Wu8 17.0000000000 DINH_LimDFCVerb 0.00 17.0000000000 FORMAT "%13.10" NUMBER 50 /end CHARACTERISTIC
/begin CHARACTERISTIC DINH_Lim.DFC_EGSDUS2B1LtrDly_CA "inhibit conditions / inhibit limit conditions for inhibit source DFC_EGSDUS2B1LtrDly" VAL_BLK 0x804FE4B7 ValA_Wu8 17.0000000000 DINH_LimDFCVerb 0.00 17.0000000000 FORMAT "%13.10" NUMBER 58 /end CHARACTERISTIC
/begin CHARACTERISTIC DINH_Lim.DFC_EGSDUS2B1LtrPT1_CA "inhibit conditions / inhibit limit conditions for inhibit source DFC_EGSDUS2B1LtrPT1" VAL_BLK 0x804FE4F1 ValA_Wu8 17.0000000000 DINH_LimDFCVerb 0.00 17.0000000000 FORMAT "%13.10" NUMBER 58 /end CHARACTERISTIC
/begin CHARACTERISTIC DINH_Lim.DFC_EGSDUS2B1RtlDly_CA "inhibit conditions / inhibit limit conditions for inhibit source DFC_EGSDUS2B1RtlDly" VAL_BLK 0x804FE52B ValA_Wu8 17.0000000000 DINH_LimDFCVerb 0.00 17.0000000000 FORMAT "%13.10" NUMBER 58 /end CHARACTERISTIC
/begin CHARACTERISTIC DINH_Lim.DFC_EGSDUS2B1RtlPT1_CA "inhibit conditions / inhibit limit conditions for inhibit source DFC_EGSDUS2B1RtlPT1" VAL_BLK 0x804FE565 ValA_Wu8 17.0000000000 DINH_LimDFCVerb 0.00 17.0000000000 FORMAT "%13.10" NUMBER 58 /end CHARACTERISTIC
/begin CHARACTERISTIC DINH_Lim.DFC_EGSDUS2B1TarLean_CA "inhibit conditions / inhibit limit conditions for inhibit source DFC_EGSDUS2B1TarLean" VAL_BLK 0x804FE59F ValA_Wu8 17.0000000000 DINH_LimDFCVerb 0.00 17.0000000000 FORMAT "%13.10" NUMBER 69 /end CHARACTERISTIC
/begin CHARACTERISTIC DINH_Lim.DFC_EGSDUS2B1TarRich_CA "inhibit conditions / inhibit limit conditions for inhibit source DFC_EGSDUS2B1TarRich" VAL_BLK 0x804FE5E4 ValA_Wu8 17.0000000000 DINH_LimDFCVerb 0.00 17.0000000000 FORMAT "%13.10" NUMBER 69 /end CHARACTERISTIC
/begin CHARACTERISTIC DINH_Lim.DFC_EONVmax_CA "inhibit conditions / inhibit limit conditions for inhibit source DFC_EONVmax" VAL_BLK 0x804FE629 ValA_Wu8 17.0000000000 DINH_LimDFCVerb 0.00 17.0000000000 FORMAT "%13.10" NUMBER 50 /end CHARACTERISTIC
/begin CHARACTERISTIC DINH_Lim.DFC_ETAKHLmax_CA "inhibit conditions / inhibit limit conditions for inhibit source DFC_ETAKHLmax" VAL_BLK 0x804FE65B ValA_Wu8 17.0000000000 DINH_LimDFCVerb 0.00 17.0000000000 FORMAT "%13.10" NUMBER 50 /end CHARACTERISTIC
/begin CHARACTERISTIC DINH_Lim.DFC_ETAKHTmax_CA "inhibit conditions / inhibit limit conditions for inhibit source DFC_ETAKHTmax" VAL_BLK 0x804FE68D ValA_Wu8 17.0000000000 DINH_LimDFCVerb 0.00 17.0000000000 FORMAT "%13.10" NUMBER 50 /end CHARACTERISTIC
/begin CHARACTERISTIC DINH_Lim.DFC_ETHSEmax_CA "inhibit conditions / inhibit limit conditions for inhibit source DFC_ETHSEmax" VAL_BLK 0x804FE6BF ValA_Wu8 17.0000000000 DINH_LimDFCVerb 0.00 17.0000000000 FORMAT "%13.10" NUMBER 70 /end CHARACTERISTIC
/begin CHARACTERISTIC DINH_Lim.DFC_ETHSEmin_CA "inhibit conditions / inhibit limit conditions for inhibit source DFC_ETHSEmin" VAL_BLK 0x804FE705 ValA_Wu8 17.0000000000 DINH_LimDFCVerb 0.00 17.0000000000 FORMAT "%13.10" NUMBER 70 /end CHARACTERISTIC
/begin CHARACTERISTIC DINH_Lim.DFC_ETHSFmax_CA "inhibit conditions / inhibit limit conditions for inhibit source DFC_ETHSFmax" VAL_BLK 0x804FE74B ValA_Wu8 17.0000000000 DINH_LimDFCVerb 0.00 17.0000000000 FORMAT "%13.10" NUMBER 70 /end CHARACTERISTIC
/begin CHARACTERISTIC DINH_Lim.DFC_ETHSFmin_CA "inhibit conditions / inhibit limit conditions for inhibit source DFC_ETHSFmin" VAL_BLK 0x804FE791 ValA_Wu8 17.0000000000 DINH_LimDFCVerb 0.00 17.0000000000 FORMAT "%13.10" NUMBER 70 /end CHARACTERISTIC
/begin CHARACTERISTIC DINH_Lim.DFC_ETHSFsig_CA "inhibit conditions / inhibit limit conditions for inhibit source DFC_ETHSFsig" VAL_BLK 0x804FE7D7 ValA_Wu8 17.0000000000 DINH_LimDFCVerb 0.00 17.0000000000 FORMAT "%13.10" NUMBER 70 /end CHARACTERISTIC
/begin CHARACTERISTIC DINH_Lim.DFC_ETHSNPWmax_CA "inhibit conditions / inhibit limit conditions for inhibit source DFC_ETHSNPWmax" VAL_BLK 0x804FE81D ValA_Wu8 17.0000000000 DINH_LimDFCVerb 0.00 17.0000000000 FORMAT "%13.10" NUMBER 68 /end CHARACTERISTIC
/begin CHARACTERISTIC DINH_Lim.DFC_ETHSNPWmin_CA "inhibit conditions / inhibit limit conditions for inhibit source DFC_ETHSNPWmin" VAL_BLK 0x804FE861 ValA_Wu8 17.0000000000 DINH_LimDFCVerb 0.00 17.0000000000 FORMAT "%13.10" NUMBER 68 /end CHARACTERISTIC
/begin CHARACTERISTIC DINH_Lim.DFC_ETHSNPWsig_CA "inhibit conditions / inhibit limit conditions for inhibit source DFC_ETHSNPWsig" VAL_BLK 0x804FE8A5 ValA_Wu8 17.0000000000 DINH_LimDFCVerb 0.00 17.0000000000 FORMAT "%13.10" NUMBER 68 /end CHARACTERISTIC
/begin CHARACTERISTIC DINH_Lim.DFC_ETHSPLnpl_CA "inhibit conditions / inhibit limit conditions for inhibit source DFC_ETHSPLnpl" VAL_BLK 0x804FE8E9 ValA_Wu8 17.0000000000 DINH_LimDFCVerb 0.00 17.0000000000 FORMAT "%13.10" NUMBER 66 /end CHARACTERISTIC
/begin CHARACTERISTIC DINH_Lim.DFC_ETHSTPLnpl_CA "inhibit conditions / inhibit limit conditions for inhibit source DFC_ETHSTPLnpl" VAL_BLK 0x804FE92B ValA_Wu8 17.0000000000 DINH_LimDFCVerb 0.00 17.0000000000 FORMAT "%13.10" NUMBER 68 /end CHARACTERISTIC
/begin CHARACTERISTIC DINH_Lim.DFC_EngICO_CA "inhibit conditions / inhibit limit conditions for inhibit source DFC_EngICO" VAL_BLK 0x804FE96F ValA_Wu8 17.0000000000 DINH_LimDFCVerb 0.00 17.0000000000 FORMAT "%13.10" NUMBER 50 /end CHARACTERISTIC
/begin CHARACTERISTIC DINH_Lim.DFC_EngPrtOvrSpdMon_CA "inhibit conditions / inhibit limit conditions for inhibit source DFC_EngPrtOvrSpdMon" VAL_BLK 0x804FE9A1 ValA_Wu8 17.0000000000 DINH_LimDFCVerb 0.00 17.0000000000 FORMAT "%13.10" NUMBER 50 /end CHARACTERISTIC
/begin CHARACTERISTIC DINH_Lim.DFC_EpmCaSI1ErrSig_CA "inhibit conditions / inhibit limit conditions for inhibit source DFC_EpmCaSI1ErrSig" VAL_BLK 0x804FE9D3 ValA_Wu8 17.0000000000 DINH_LimDFCVerb 0.00 17.0000000000 FORMAT "%13.10" NUMBER 72 /end CHARACTERISTIC
/begin CHARACTERISTIC DINH_Lim.DFC_EpmCaSI1MntErr_CA "inhibit conditions / inhibit limit conditions for inhibit source DFC_EpmCaSI1MntErr" VAL_BLK 0x804FEA1B ValA_Wu8 17.0000000000 DINH_LimDFCVerb 0.00 17.0000000000 FORMAT "%13.10" NUMBER 74 /end CHARACTERISTIC
/begin CHARACTERISTIC DINH_Lim.DFC_EpmCaSI1NoSigMax_CA "inhibit conditions / inhibit limit conditions for inhibit source DFC_EpmCaSI1NoSigMax" VAL_BLK 0x804FEA65 ValA_Wu8 17.0000000000 DINH_LimDFCVerb 0.00 17.0000000000 FORMAT "%13.10" NUMBER 72 /end CHARACTERISTIC
/begin CHARACTERISTIC DINH_Lim.DFC_EpmCaSI1NoSigMin_CA "inhibit conditions / inhibit limit conditions for inhibit source DFC_EpmCaSI1NoSigMin" VAL_BLK 0x804FEAAD ValA_Wu8 17.0000000000 DINH_LimDFCVerb 0.00 17.0000000000 FORMAT "%13.10" NUMBER 72 /end CHARACTERISTIC
/begin CHARACTERISTIC DINH_Lim.DFC_EpmCaSI1OfsErr_CA "inhibit conditions / inhibit limit conditions for inhibit source DFC_EpmCaSI1OfsErr" VAL_BLK 0x804FEAF5 ValA_Wu8 17.0000000000 DINH_LimDFCVerb 0.00 17.0000000000 FORMAT "%13.10" NUMBER 80 /end CHARACTERISTIC
/begin CHARACTERISTIC DINH_Lim.DFC_EpmCrSDGI_CA "inhibit conditions / inhibit limit conditions for inhibit source DFC_EpmCrSDGI" VAL_BLK 0x804FEB45 ValA_Wu8 17.0000000000 DINH_LimDFCVerb 0.00 17.0000000000 FORMAT "%13.10" NUMBER 61 /end CHARACTERISTIC
/begin CHARACTERISTIC DINH_Lim.DFC_EpmCrSErrSig_CA "inhibit conditions / inhibit limit conditions for inhibit source DFC_EpmCrSErrSig" VAL_BLK 0x804FEB82 ValA_Wu8 17.0000000000 DINH_LimDFCVerb 0.00 17.0000000000 FORMAT "%13.10" NUMBER 101 /end CHARACTERISTIC
/begin CHARACTERISTIC DINH_Lim.DFC_EpmCrSNoSig_CA "inhibit conditions / inhibit limit conditions for inhibit source DFC_EpmCrSNoSig" VAL_BLK 0x804FEBE7 ValA_Wu8 17.0000000000 DINH_LimDFCVerb 0.00 17.0000000000 FORMAT "%13.10" NUMBER 114 /end CHARACTERISTIC
/begin CHARACTERISTIC DINH_Lim.DFC_EtaEngIdleNonCsers_CA "inhibit conditions / inhibit limit conditions for inhibit source DFC_EtaEngIdleNonCsers" VAL_BLK 0x804FEC59 ValA_Wu8 17.0000000000 DINH_LimDFCVerb 0.00 17.0000000000 FORMAT "%13.10" NUMBER 50 /end CHARACTERISTIC
/begin CHARACTERISTIC DINH_Lim.DFC_EtaEngPtlNonCsers_CA "inhibit conditions / inhibit limit conditions for inhibit source DFC_EtaEngPtlNonCsers" VAL_BLK 0x804FEC8B ValA_Wu8 17.0000000000 DINH_LimDFCVerb 0.00 17.0000000000 FORMAT "%13.10" NUMBER 50 /end CHARACTERISTIC
/begin CHARACTERISTIC DINH_Lim.DFC_FRAmax_CA "inhibit conditions / inhibit limit conditions for inhibit source DFC_FRAmax" VAL_BLK 0x804FECBD ValA_Wu8 17.0000000000 DINH_LimDFCVerb 0.00 17.0000000000 FORMAT "%13.10" NUMBER 73 /end CHARACTERISTIC
/begin CHARACTERISTIC DINH_Lim.DFC_FRAmin_CA "inhibit conditions / inhibit limit conditions for inhibit source DFC_FRAmin" VAL_BLK 0x804FED06 ValA_Wu8 17.0000000000 DINH_LimDFCVerb 0.00 17.0000000000 FORMAT "%13.10" NUMBER 73 /end CHARACTERISTIC
/begin CHARACTERISTIC DINH_Lim.DFC_FSTEmax_CA "inhibit conditions / inhibit limit conditions for inhibit source DFC_FSTEmax" VAL_BLK 0x804FED4F ValA_Wu8 17.0000000000 DINH_LimDFCVerb 0.00 17.0000000000 FORMAT "%13.10" NUMBER 54 /end CHARACTERISTIC
/begin CHARACTERISTIC DINH_Lim.DFC_FSTEmin_CA "inhibit conditions / inhibit limit conditions for inhibit source DFC_FSTEmin" VAL_BLK 0x804FED85 ValA_Wu8 17.0000000000 DINH_LimDFCVerb 0.00 17.0000000000 FORMAT "%13.10" NUMBER 54 /end CHARACTERISTIC
/begin CHARACTERISTIC DINH_Lim.DFC_FSTRmax_CA "inhibit conditions / inhibit limit conditions for inhibit source DFC_FSTRmax" VAL_BLK 0x804FEDBB ValA_Wu8 17.0000000000 DINH_LimDFCVerb 0.00 17.0000000000 FORMAT "%13.10" NUMBER 53 /end CHARACTERISTIC
/begin CHARACTERISTIC DINH_Lim.DFC_FSTRmin_CA "inhibit conditions / inhibit limit conditions for inhibit source DFC_FSTRmin" VAL_BLK 0x804FEDF0 ValA_Wu8 17.0000000000 DINH_LimDFCVerb 0.00 17.0000000000 FORMAT "%13.10" NUMBER 53 /end CHARACTERISTIC
/begin CHARACTERISTIC DINH_Lim.DFC_FSTRnpl_CA "inhibit conditions / inhibit limit conditions for inhibit source DFC_FSTRnpl" VAL_BLK 0x804FEE25 ValA_Wu8 17.0000000000 DINH_LimDFCVerb 0.00 17.0000000000 FORMAT "%13.10" NUMBER 53 /end CHARACTERISTIC
/begin CHARACTERISTIC DINH_Lim.DFC_FSTmax_CA "inhibit conditions / inhibit limit conditions for inhibit source DFC_FSTmax" VAL_BLK 0x804FEE5A ValA_Wu8 17.0000000000 DINH_LimDFCVerb 0.00 17.0000000000 FORMAT "%13.10" NUMBER 50 /end CHARACTERISTIC
/begin CHARACTERISTIC DINH_Lim.DFC_FTDLAmax_CA "inhibit conditions / inhibit limit conditions for inhibit source DFC_FTDLAmax" VAL_BLK 0x804FEE8C ValA_Wu8 17.0000000000 DINH_LimDFCVerb 0.00 17.0000000000 FORMAT "%13.10" NUMBER 67 /end CHARACTERISTIC
/begin CHARACTERISTIC DINH_Lim.DFC_FTDLAmin_CA "inhibit conditions / inhibit limit conditions for inhibit source DFC_FTDLAmin" VAL_BLK 0x804FEECF ValA_Wu8 17.0000000000 DINH_LimDFCVerb 0.00 17.0000000000 FORMAT "%13.10" NUMBER 67 /end CHARACTERISTIC
/begin CHARACTERISTIC DINH_Lim.DFC_FuPHiSnsrEleclmax_CA "inhibit conditions / inhibit limit conditions for inhibit source DFC_FuPHiSnsrEleclmax" VAL_BLK 0x804FEF12 ValA_Wu8 17.0000000000 DINH_LimDFCVerb 0.00 17.0000000000 FORMAT "%13.10" NUMBER 51 /end CHARACTERISTIC
/begin CHARACTERISTIC DINH_Lim.DFC_FuPHiSnsrEleclmin_CA "inhibit conditions / inhibit limit conditions for inhibit source DFC_FuPHiSnsrEleclmin" VAL_BLK 0x804FEF45 ValA_Wu8 17.0000000000 DINH_LimDFCVerb 0.00 17.0000000000 FORMAT "%13.10" NUMBER 51 /end CHARACTERISTIC
/begin CHARACTERISTIC DINH_Lim.DFC_FuPHiSnsrEleclnpl_CA "inhibit conditions / inhibit limit conditions for inhibit source DFC_FuPHiSnsrEleclnpl" VAL_BLK 0x804FEF78 ValA_Wu8 17.0000000000 DINH_LimDFCVerb 0.00 17.0000000000 FORMAT "%13.10" NUMBER 51 /end CHARACTERISTIC
/begin CHARACTERISTIC DINH_Lim.DFC_FuPHiSnsrURngMax_CA "inhibit conditions / inhibit limit conditions for inhibit source DFC_FuPHiSnsrURngMax" VAL_BLK 0x804FEFAB ValA_Wu8 17.0000000000 DINH_LimDFCVerb 0.00 17.0000000000 FORMAT "%13.10" NUMBER 55 /end CHARACTERISTIC
/begin CHARACTERISTIC DINH_Lim.DFC_FuPHiSnsrURngMin_CA "inhibit conditions / inhibit limit conditions for inhibit source DFC_FuPHiSnsrURngMin" VAL_BLK 0x804FEFE2 ValA_Wu8 17.0000000000 DINH_LimDFCVerb 0.00 17.0000000000 FORMAT "%13.10" NUMBER 55 /end CHARACTERISTIC
/begin CHARACTERISTIC DINH_Lim.DFC_FuSnsrPhyRngMaxErr_CA "inhibit conditions / inhibit limit conditions for inhibit source DFC_FuSnsrPhyRngMaxErr" VAL_BLK 0x804FF019 ValA_Wu8 17.0000000000 DINH_LimDFCVerb 0.00 17.0000000000 FORMAT "%13.10" NUMBER 53 /end CHARACTERISTIC
/begin CHARACTERISTIC DINH_Lim.DFC_FuSnsrPhyRngMinErr_CA "inhibit conditions / inhibit limit conditions for inhibit source DFC_FuSnsrPhyRngMinErr" VAL_BLK 0x804FF04E ValA_Wu8 17.0000000000 DINH_LimDFCVerb 0.00 17.0000000000 FORMAT "%13.10" NUMBER 53 /end CHARACTERISTIC
/begin CHARACTERISTIC DINH_Lim.DFC_GEVlvLockPinDiagIntkB1_CA "inhibit conditions / inhibit limit conditions for inhibit source DFC_GEVlvLockPinDiagIntkB1" VAL_BLK 0x804FF083 ValA_Wu8 17.0000000000 DINH_LimDFCVerb 0.00 17.0000000000 FORMAT "%13.10" NUMBER 51 /end CHARACTERISTIC
/begin CHARACTERISTIC DINH_Lim.DFC_GEVlvPhaSlowIntkB1_CA "inhibit conditions / inhibit limit conditions for inhibit source DFC_GEVlvPhaSlowIntkB1" VAL_BLK 0x804FF0B6 ValA_Wu8 17.0000000000 DINH_LimDFCVerb 0.00 17.0000000000 FORMAT "%13.10" NUMBER 91 /end CHARACTERISTIC
/begin CHARACTERISTIC DINH_Lim.DFC_GEVlvPhaTargIntkB1_CA "inhibit conditions / inhibit limit conditions for inhibit source DFC_GEVlvPhaTargIntkB1" VAL_BLK 0x804FF111 ValA_Wu8 17.0000000000 DINH_LimDFCVerb 0.00 17.0000000000 FORMAT "%13.10" NUMBER 91 /end CHARACTERISTIC
/begin CHARACTERISTIC DINH_Lim.DFC_GbxRvsSwtStk_CA "inhibit conditions / inhibit limit conditions for inhibit source DFC_GbxRvsSwtStk" VAL_BLK 0x804FF16C ValA_Wu8 17.0000000000 DINH_LimDFCVerb 0.00 17.0000000000 FORMAT "%13.10" NUMBER 55 /end CHARACTERISTIC
/begin CHARACTERISTIC DINH_Lim.DFC_HDRKHmax_CA "inhibit conditions / inhibit limit conditions for inhibit source DFC_HDRKHmax" VAL_BLK 0x804FF1A3 ValA_Wu8 17.0000000000 DINH_LimDFCVerb 0.00 17.0000000000 FORMAT "%13.10" NUMBER 52 /end CHARACTERISTIC
/begin CHARACTERISTIC DINH_Lim.DFC_HDRKHmin_CA "inhibit conditions / inhibit limit conditions for inhibit source DFC_HDRKHmin" VAL_BLK 0x804FF1D7 ValA_Wu8 17.0000000000 DINH_LimDFCVerb 0.00 17.0000000000 FORMAT "%13.10" NUMBER 52 /end CHARACTERISTIC
/begin CHARACTERISTIC DINH_Lim.DFC_HDRPLmax_CA "inhibit conditions / inhibit limit conditions for inhibit source DFC_HDRPLmax" VAL_BLK 0x804FF20B ValA_Wu8 17.0000000000 DINH_LimDFCVerb 0.00 17.0000000000 FORMAT "%13.10" NUMBER 55 /end CHARACTERISTIC
/begin CHARACTERISTIC DINH_Lim.DFC_HDRPLmin_CA "inhibit conditions / inhibit limit conditions for inhibit source DFC_HDRPLmin" VAL_BLK 0x804FF242 ValA_Wu8 17.0000000000 DINH_LimDFCVerb 0.00 17.0000000000 FORMAT "%13.10" NUMBER 55 /end CHARACTERISTIC
/begin CHARACTERISTIC DINH_Lim.DFC_HDRmax_CA "inhibit conditions / inhibit limit conditions for inhibit source DFC_HDRmax" VAL_BLK 0x804FF279 ValA_Wu8 17.0000000000 DINH_LimDFCVerb 0.00 17.0000000000 FORMAT "%13.10" NUMBER 65 /end CHARACTERISTIC
/begin CHARACTERISTIC DINH_Lim.DFC_HDRmin_CA "inhibit conditions / inhibit limit conditions for inhibit source DFC_HDRmin" VAL_BLK 0x804FF2BA ValA_Wu8 17.0000000000 DINH_LimDFCVerb 0.00 17.0000000000 FORMAT "%13.10" NUMBER 68 /end CHARACTERISTIC
/begin CHARACTERISTIC DINH_Lim.DFC_HEGOS2B1ElecMax_CA "inhibit conditions / inhibit limit conditions for inhibit source DFC_HEGOS2B1ElecMax" VAL_BLK 0x804FF2FE ValA_Wu8 17.0000000000 DINH_LimDFCVerb 0.00 17.0000000000 FORMAT "%13.10" NUMBER 71 /end CHARACTERISTIC
/begin CHARACTERISTIC DINH_Lim.DFC_HEGOS2B1ElecMin_CA "inhibit conditions / inhibit limit conditions for inhibit source DFC_HEGOS2B1ElecMin" VAL_BLK 0x804FF345 ValA_Wu8 17.0000000000 DINH_LimDFCVerb 0.00 17.0000000000 FORMAT "%13.10" NUMBER 71 /end CHARACTERISTIC
/begin CHARACTERISTIC DINH_Lim.DFC_HEGOS2B1ElecSig_CA "inhibit conditions / inhibit limit conditions for inhibit source DFC_HEGOS2B1ElecSig" VAL_BLK 0x804FF38C ValA_Wu8 17.0000000000 DINH_LimDFCVerb 0.00 17.0000000000 FORMAT "%13.10" NUMBER 71 /end CHARACTERISTIC
/begin CHARACTERISTIC DINH_Lim.DFC_HEGOS2B1HtgNpl_CA "inhibit conditions / inhibit limit conditions for inhibit source DFC_HEGOS2B1HtgNpl" VAL_BLK 0x804FF3D3 ValA_Wu8 17.0000000000 DINH_LimDFCVerb 0.00 17.0000000000 FORMAT "%13.10" NUMBER 65 /end CHARACTERISTIC
/begin CHARACTERISTIC DINH_Lim.DFC_HEV00max_CA "inhibit conditions / inhibit limit conditions for inhibit source DFC_HEV00max" VAL_BLK 0x804FF414 ValA_Wu8 17.0000000000 DINH_LimDFCVerb 0.00 17.0000000000 FORMAT "%13.10" NUMBER 51 /end CHARACTERISTIC
/begin CHARACTERISTIC DINH_Lim.DFC_HEV01max_CA "inhibit conditions / inhibit limit conditions for inhibit source DFC_HEV01max" VAL_BLK 0x804FF447 ValA_Wu8 17.0000000000 DINH_LimDFCVerb 0.00 17.0000000000 FORMAT "%13.10" NUMBER 51 /end CHARACTERISTIC
/begin CHARACTERISTIC DINH_Lim.DFC_HEV02max_CA "inhibit conditions / inhibit limit conditions for inhibit source DFC_HEV02max" VAL_BLK 0x804FF47A ValA_Wu8 17.0000000000 DINH_LimDFCVerb 0.00 17.0000000000 FORMAT "%13.10" NUMBER 51 /end CHARACTERISTIC
/begin CHARACTERISTIC DINH_Lim.DFC_HEV03max_CA "inhibit conditions / inhibit limit conditions for inhibit source DFC_HEV03max" VAL_BLK 0x804FF4AD ValA_Wu8 17.0000000000 DINH_LimDFCVerb 0.00 17.0000000000 FORMAT "%13.10" NUMBER 51 /end CHARACTERISTIC
/begin CHARACTERISTIC DINH_Lim.DFC_HEVE0max_CA "inhibit conditions / inhibit limit conditions for inhibit source DFC_HEVE0max" VAL_BLK 0x804FF4E0 ValA_Wu8 17.0000000000 DINH_LimDFCVerb 0.00 17.0000000000 FORMAT "%13.10" NUMBER 53 /end CHARACTERISTIC
/begin CHARACTERISTIC DINH_Lim.DFC_HEVE1max_CA "inhibit conditions / inhibit limit conditions for inhibit source DFC_HEVE1max" VAL_BLK 0x804FF515 ValA_Wu8 17.0000000000 DINH_LimDFCVerb 0.00 17.0000000000 FORMAT "%13.10" NUMBER 53 /end CHARACTERISTIC
/begin CHARACTERISTIC DINH_Lim.DFC_HFMmax_CA "inhibit conditions / inhibit limit conditions for inhibit source DFC_HFMmax" VAL_BLK 0x804FF54A ValA_Wu8 17.0000000000 DINH_LimDFCVerb 0.00 17.0000000000 FORMAT "%13.10" NUMBER 64 /end CHARACTERISTIC
/begin CHARACTERISTIC DINH_Lim.DFC_HiPSysHiPMaxLimExcdd_CA "inhibit conditions / inhibit limit conditions for inhibit source DFC_HiPSysHiPMaxLimExcdd" VAL_BLK 0x804FF58A ValA_Wu8 17.0000000000 DINH_LimDFCVerb 0.00 17.0000000000 FORMAT "%13.10" NUMBER 51 /end CHARACTERISTIC
/begin CHARACTERISTIC DINH_Lim.DFC_IVGdiCtlCvoErrMax_0_CA "inhibit conditions / inhibit limit conditions for inhibit source DFC_IVGdiCtlCvoErrMax_0" VAL_BLK 0x804FF5BD ValA_Wu8 17.0000000000 DINH_LimDFCVerb 0.00 17.0000000000 FORMAT "%13.10" NUMBER 51 /end CHARACTERISTIC
/begin CHARACTERISTIC DINH_Lim.DFC_IVGdiCtlCvoErrMax_1_CA "inhibit conditions / inhibit limit conditions for inhibit source DFC_IVGdiCtlCvoErrMax_1" VAL_BLK 0x804FF5F0 ValA_Wu8 17.0000000000 DINH_LimDFCVerb 0.00 17.0000000000 FORMAT "%13.10" NUMBER 51 /end CHARACTERISTIC
/begin CHARACTERISTIC DINH_Lim.DFC_IVGdiCtlCvoErrMax_2_CA "inhibit conditions / inhibit limit conditions for inhibit source DFC_IVGdiCtlCvoErrMax_2" VAL_BLK 0x804FF623 ValA_Wu8 17.0000000000 DINH_LimDFCVerb 0.00 17.0000000000 FORMAT "%13.10" NUMBER 51 /end CHARACTERISTIC
/begin CHARACTERISTIC DINH_Lim.DFC_IVGdiCtlCvoErrMax_3_CA "inhibit conditions / inhibit limit conditions for inhibit source DFC_IVGdiCtlCvoErrMax_3" VAL_BLK 0x804FF656 ValA_Wu8 17.0000000000 DINH_LimDFCVerb 0.00 17.0000000000 FORMAT "%13.10" NUMBER 51 /end CHARACTERISTIC
/begin CHARACTERISTIC DINH_Lim.DFC_IVGdiCtlCvoErrMin_0_CA "inhibit conditions / inhibit limit conditions for inhibit source DFC_IVGdiCtlCvoErrMin_0" VAL_BLK 0x804FF689 ValA_Wu8 17.0000000000 DINH_LimDFCVerb 0.00 17.0000000000 FORMAT "%13.10" NUMBER 51 /end CHARACTERISTIC
/begin CHARACTERISTIC DINH_Lim.DFC_IVGdiCtlCvoErrMin_1_CA "inhibit conditions / inhibit limit conditions for inhibit source DFC_IVGdiCtlCvoErrMin_1" VAL_BLK 0x804FF6BC ValA_Wu8 17.0000000000 DINH_LimDFCVerb 0.00 17.0000000000 FORMAT "%13.10" NUMBER 51 /end CHARACTERISTIC
/begin CHARACTERISTIC DINH_Lim.DFC_IVGdiCtlCvoErrMin_2_CA "inhibit conditions / inhibit limit conditions for inhibit source DFC_IVGdiCtlCvoErrMin_2" VAL_BLK 0x804FF6EF ValA_Wu8 17.0000000000 DINH_LimDFCVerb 0.00 17.0000000000 FORMAT "%13.10" NUMBER 51 /end CHARACTERISTIC
/begin CHARACTERISTIC DINH_Lim.DFC_IVGdiCtlCvoErrMin_3_CA "inhibit conditions / inhibit limit conditions for inhibit source DFC_IVGdiCtlCvoErrMin_3" VAL_BLK 0x804FF722 ValA_Wu8 17.0000000000 DINH_LimDFCVerb 0.00 17.0000000000 FORMAT "%13.10" NUMBER 51 /end CHARACTERISTIC
/begin CHARACTERISTIC DINH_Lim.DFC_IVGdiCtlCvoErrMinMax_CA "inhibit conditions / inhibit limit conditions for inhibit source DFC_IVGdiCtlCvoErrMinMax" VAL_BLK 0x804FF755 ValA_Wu8 17.0000000000 DINH_LimDFCVerb 0.00 17.0000000000 FORMAT "%13.10" NUMBER 50 /end CHARACTERISTIC
/begin CHARACTERISTIC DINH_Lim.DFC_IVGdiCtlCvoSigPlausErrSmrCdn_CA "inhibit conditions / inhibit limit conditions for inhibit source DFC_IVGdiCtlCvoSigPlausErrSmrCdn" VAL_BLK 0x804FF787 ValA_Wu8 17.0000000000 DINH_LimDFCVerb 0.00 17.0000000000 FORMAT "%13.10" NUMBER 50 /end CHARACTERISTIC
/begin CHARACTERISTIC DINH_Lim.DFC_IVGdiCtl_CvoErr_CA "inhibit conditions / inhibit limit conditions for inhibit source DFC_IVGdiCtl_CvoErr" VAL_BLK 0x804FF7B9 ValA_Wu8 17.0000000000 DINH_LimDFCVerb 0.00 17.0000000000 FORMAT "%13.10" NUMBER 50 /end CHARACTERISTIC
/begin CHARACTERISTIC DINH_Lim.DFC_IVGdiCtl_CvoSigPlaus_0_CA "inhibit conditions / inhibit limit conditions for inhibit source DFC_IVGdiCtl_CvoSigPlaus_0" VAL_BLK 0x804FF7EB ValA_Wu8 17.0000000000 DINH_LimDFCVerb 0.00 17.0000000000 FORMAT "%13.10" NUMBER 51 /end CHARACTERISTIC
/begin CHARACTERISTIC DINH_Lim.DFC_IVGdiCtl_CvoSigPlaus_1_CA "inhibit conditions / inhibit limit conditions for inhibit source DFC_IVGdiCtl_CvoSigPlaus_1" VAL_BLK 0x804FF81E ValA_Wu8 17.0000000000 DINH_LimDFCVerb 0.00 17.0000000000 FORMAT "%13.10" NUMBER 51 /end CHARACTERISTIC
/begin CHARACTERISTIC DINH_Lim.DFC_IVGdiCtl_CvoSigPlaus_2_CA "inhibit conditions / inhibit limit conditions for inhibit source DFC_IVGdiCtl_CvoSigPlaus_2" VAL_BLK 0x804FF851 ValA_Wu8 17.0000000000 DINH_LimDFCVerb 0.00 17.0000000000 FORMAT "%13.10" NUMBER 51 /end CHARACTERISTIC
/begin CHARACTERISTIC DINH_Lim.DFC_IVGdiCtl_CvoSigPlaus_3_CA "inhibit conditions / inhibit limit conditions for inhibit source DFC_IVGdiCtl_CvoSigPlaus_3" VAL_BLK 0x804FF884 ValA_Wu8 17.0000000000 DINH_LimDFCVerb 0.00 17.0000000000 FORMAT "%13.10" NUMBER 51 /end CHARACTERISTIC
/begin CHARACTERISTIC DINH_Lim.DFC_IntkAirTAirFltDsCrssMax_CA "inhibit conditions / inhibit limit conditions for inhibit source DFC_IntkAirTAirFltDsCrssMax" VAL_BLK 0x804FF8B7 ValA_Wu8 17.0000000000 DINH_LimDFCVerb 0.00 17.0000000000 FORMAT "%13.10" NUMBER 52 /end CHARACTERISTIC
/begin CHARACTERISTIC DINH_Lim.DFC_IntkAirTAirFltDsCrssMin_CA "inhibit conditions / inhibit limit conditions for inhibit source DFC_IntkAirTAirFltDsCrssMin" VAL_BLK 0x804FF8EB ValA_Wu8 17.0000000000 DINH_LimDFCVerb 0.00 17.0000000000 FORMAT "%13.10" NUMBER 52 /end CHARACTERISTIC
/begin CHARACTERISTIC DINH_Lim.DFC_IntkAirTAirFltDsHSCMax_CA "inhibit conditions / inhibit limit conditions for inhibit source DFC_IntkAirTAirFltDsHSCMax" VAL_BLK 0x804FF91F ValA_Wu8 17.0000000000 DINH_LimDFCVerb 0.00 17.0000000000 FORMAT "%13.10" NUMBER 52 /end CHARACTERISTIC
/begin CHARACTERISTIC DINH_Lim.DFC_IntkAirTAirFltDsImps_CA "inhibit conditions / inhibit limit conditions for inhibit source DFC_IntkAirTAirFltDsImps" VAL_BLK 0x804FF953 ValA_Wu8 17.0000000000 DINH_LimDFCVerb 0.00 17.0000000000 FORMAT "%13.10" NUMBER 57 /end CHARACTERISTIC
/begin CHARACTERISTIC DINH_Lim.DFC_IntkAirTAirFltDsPRCMax_CA "inhibit conditions / inhibit limit conditions for inhibit source DFC_IntkAirTAirFltDsPRCMax" VAL_BLK 0x804FF98C ValA_Wu8 17.0000000000 DINH_LimDFCVerb 0.00 17.0000000000 FORMAT "%13.10" NUMBER 52 /end CHARACTERISTIC
/begin CHARACTERISTIC DINH_Lim.DFC_IntkAirTAirFltDsPRCMin_CA "inhibit conditions / inhibit limit conditions for inhibit source DFC_IntkAirTAirFltDsPRCMin" VAL_BLK 0x804FF9C0 ValA_Wu8 17.0000000000 DINH_LimDFCVerb 0.00 17.0000000000 FORMAT "%13.10" NUMBER 52 /end CHARACTERISTIC
/begin CHARACTERISTIC DINH_Lim.DFC_IntkAirTAirFltDsSRCMax_CA "inhibit conditions / inhibit limit conditions for inhibit source DFC_IntkAirTAirFltDsSRCMax" VAL_BLK 0x804FF9F4 ValA_Wu8 17.0000000000 DINH_LimDFCVerb 0.00 17.0000000000 FORMAT "%13.10" NUMBER 57 /end CHARACTERISTIC
/begin CHARACTERISTIC DINH_Lim.DFC_IntkAirTAirFltDsSRCMin_CA "inhibit conditions / inhibit limit conditions for inhibit source DFC_IntkAirTAirFltDsSRCMin" VAL_BLK 0x804FFA2D ValA_Wu8 17.0000000000 DINH_LimDFCVerb 0.00 17.0000000000 FORMAT "%13.10" NUMBER 57 /end CHARACTERISTIC
/begin CHARACTERISTIC DINH_Lim.DFC_IntkAirTAirFltDsSTC_CA "inhibit conditions / inhibit limit conditions for inhibit source DFC_IntkAirTAirFltDsSTC" VAL_BLK 0x804FFA66 ValA_Wu8 17.0000000000 DINH_LimDFCVerb 0.00 17.0000000000 FORMAT "%13.10" NUMBER 52 /end CHARACTERISTIC
/begin CHARACTERISTIC DINH_Lim.DFC_IntkAirTIntkMnfldCrssMax_CA "inhibit conditions / inhibit limit conditions for inhibit source DFC_IntkAirTIntkMnfldCrssMax" VAL_BLK 0x804FFA9A ValA_Wu8 17.0000000000 DINH_LimDFCVerb 0.00 17.0000000000 FORMAT "%13.10" NUMBER 90 /end CHARACTERISTIC
/begin CHARACTERISTIC DINH_Lim.DFC_IntkAirTIntkMnfldCrssMin_CA "inhibit conditions / inhibit limit conditions for inhibit source DFC_IntkAirTIntkMnfldCrssMin" VAL_BLK 0x804FFAF4 ValA_Wu8 17.0000000000 DINH_LimDFCVerb 0.00 17.0000000000 FORMAT "%13.10" NUMBER 90 /end CHARACTERISTIC
/begin CHARACTERISTIC DINH_Lim.DFC_IntkAirTIntkMnfldHSCMax_CA "inhibit conditions / inhibit limit conditions for inhibit source DFC_IntkAirTIntkMnfldHSCMax" VAL_BLK 0x804FFB4E ValA_Wu8 17.0000000000 DINH_LimDFCVerb 0.00 17.0000000000 FORMAT "%13.10" NUMBER 84 /end CHARACTERISTIC
/begin CHARACTERISTIC DINH_Lim.DFC_IntkAirTIntkMnfldImps_CA "inhibit conditions / inhibit limit conditions for inhibit source DFC_IntkAirTIntkMnfldImps" VAL_BLK 0x804FFBA2 ValA_Wu8 17.0000000000 DINH_LimDFCVerb 0.00 17.0000000000 FORMAT "%13.10" NUMBER 95 /end CHARACTERISTIC
/begin CHARACTERISTIC DINH_Lim.DFC_IntkAirTIntkMnfldPRCMax_CA "inhibit conditions / inhibit limit conditions for inhibit source DFC_IntkAirTIntkMnfldPRCMax" VAL_BLK 0x804FFC01 ValA_Wu8 17.0000000000 DINH_LimDFCVerb 0.00 17.0000000000 FORMAT "%13.10" NUMBER 84 /end CHARACTERISTIC
/begin CHARACTERISTIC DINH_Lim.DFC_IntkAirTIntkMnfldPRCMin_CA "inhibit conditions / inhibit limit conditions for inhibit source DFC_IntkAirTIntkMnfldPRCMin" VAL_BLK 0x804FFC55 ValA_Wu8 17.0000000000 DINH_LimDFCVerb 0.00 17.0000000000 FORMAT "%13.10" NUMBER 84 /end CHARACTERISTIC
/begin CHARACTERISTIC DINH_Lim.DFC_IntkAirTIntkMnfldSRCMax_CA "inhibit conditions / inhibit limit conditions for inhibit source DFC_IntkAirTIntkMnfldSRCMax" VAL_BLK 0x804FFCA9 ValA_Wu8 17.0000000000 DINH_LimDFCVerb 0.00 17.0000000000 FORMAT "%13.10" NUMBER 96 /end CHARACTERISTIC
/begin CHARACTERISTIC DINH_Lim.DFC_IntkAirTIntkMnfldSRCMin_CA "inhibit conditions / inhibit limit conditions for inhibit source DFC_IntkAirTIntkMnfldSRCMin" VAL_BLK 0x804FFD09 ValA_Wu8 17.0000000000 DINH_LimDFCVerb 0.00 17.0000000000 FORMAT "%13.10" NUMBER 96 /end CHARACTERISTIC
/begin CHARACTERISTIC DINH_Lim.DFC_IntkAirTIntkMnfldSTC_CA "inhibit conditions / inhibit limit conditions for inhibit source DFC_IntkAirTIntkMnfldSTC" VAL_BLK 0x804FFD69 ValA_Wu8 17.0000000000 DINH_LimDFCVerb 0.00 17.0000000000 FORMAT "%13.10" NUMBER 84 /end CHARACTERISTIC
/begin CHARACTERISTIC DINH_Lim.DFC_KRREGRLMX_CA "inhibit conditions / inhibit limit conditions for inhibit source DFC_KRREGRLMX" VAL_BLK 0x804FFDBD ValA_Wu8 17.0000000000 DINH_LimDFCVerb 0.00 17.0000000000 FORMAT "%13.10" NUMBER 50 /end CHARACTERISTIC
/begin CHARACTERISTIC DINH_Lim.DFC_KRVEKOCVLCI_CA "inhibit conditions / inhibit limit conditions for inhibit source DFC_KRVEKOCVLCI" VAL_BLK 0x804FFDEF ValA_Wu8 17.0000000000 DINH_LimDFCVerb 0.00 17.0000000000 FORMAT "%13.10" NUMBER 50 /end CHARACTERISTIC
/begin CHARACTERISTIC DINH_Lim.DFC_KRVEKOENCHMT_CA "inhibit conditions / inhibit limit conditions for inhibit source DFC_KRVEKOENCHMT" VAL_BLK 0x804FFE21 ValA_Wu8 17.0000000000 DINH_LimDFCVerb 0.00 17.0000000000 FORMAT "%13.10" NUMBER 50 /end CHARACTERISTIC
/begin CHARACTERISTIC DINH_Lim.DFC_KRVEKOENCHMT0_CA "inhibit conditions / inhibit limit conditions for inhibit source DFC_KRVEKOENCHMT0" VAL_BLK 0x804FFE53 ValA_Wu8 17.0000000000 DINH_LimDFCVerb 0.00 17.0000000000 FORMAT "%13.10" NUMBER 50 /end CHARACTERISTIC
/begin CHARACTERISTIC DINH_Lim.DFC_KRVEKOENCHMT1_CA "inhibit conditions / inhibit limit conditions for inhibit source DFC_KRVEKOENCHMT1" VAL_BLK 0x804FFE85 ValA_Wu8 17.0000000000 DINH_LimDFCVerb 0.00 17.0000000000 FORMAT "%13.10" NUMBER 50 /end CHARACTERISTIC
/begin CHARACTERISTIC DINH_Lim.DFC_KRVEKOENCHMT2_CA "inhibit conditions / inhibit limit conditions for inhibit source DFC_KRVEKOENCHMT2" VAL_BLK 0x804FFEB7 ValA_Wu8 17.0000000000 DINH_LimDFCVerb 0.00 17.0000000000 FORMAT "%13.10" NUMBER 50 /end CHARACTERISTIC
/begin CHARACTERISTIC DINH_Lim.DFC_KRVEKOENCHMT3_CA "inhibit conditions / inhibit limit conditions for inhibit source DFC_KRVEKOENCHMT3" VAL_BLK 0x804FFEE9 ValA_Wu8 17.0000000000 DINH_LimDFCVerb 0.00 17.0000000000 FORMAT "%13.10" NUMBER 50 /end CHARACTERISTIC
/begin CHARACTERISTIC DINH_Lim.DFC_KRVEKOENCHMT4_CA "inhibit conditions / inhibit limit conditions for inhibit source DFC_KRVEKOENCHMT4" VAL_BLK 0x804FFF1B ValA_Wu8 17.0000000000 DINH_LimDFCVerb 0.00 17.0000000000 FORMAT "%13.10" NUMBER 50 /end CHARACTERISTIC
/begin CHARACTERISTIC DINH_Lim.DFC_KRVEKOENCHMT5_CA "inhibit conditions / inhibit limit conditions for inhibit source DFC_KRVEKOENCHMT5" VAL_BLK 0x804FFF4D ValA_Wu8 17.0000000000 DINH_LimDFCVerb 0.00 17.0000000000 FORMAT "%13.10" NUMBER 50 /end CHARACTERISTIC
/begin CHARACTERISTIC DINH_Lim.DFC_KRVEKOENCHMT6_CA "inhibit conditions / inhibit limit conditions for inhibit source DFC_KRVEKOENCHMT6" VAL_BLK 0x804FFF7F ValA_Wu8 17.0000000000 DINH_LimDFCVerb 0.00 17.0000000000 FORMAT "%13.10" NUMBER 50 /end CHARACTERISTIC
/begin CHARACTERISTIC DINH_Lim.DFC_KRVEKOENCHMT7_CA "inhibit conditions / inhibit limit conditions for inhibit source DFC_KRVEKOENCHMT7" VAL_BLK 0x804FFFB1 ValA_Wu8 17.0000000000 DINH_LimDFCVerb 0.00 17.0000000000 FORMAT "%13.10" NUMBER 50 /end CHARACTERISTIC
/begin CHARACTERISTIC DINH_Lim.DFC_KRVEKORLMX_CA "inhibit conditions / inhibit limit conditions for inhibit source DFC_KRVEKORLMX" VAL_BLK 0x804FFFE3 ValA_Wu8 17.0000000000 DINH_LimDFCVerb 0.00 17.0000000000 FORMAT "%13.10" NUMBER 50 /end CHARACTERISTIC
/begin CHARACTERISTIC DINH_Lim.DFC_KRVEKORLMXL_CA "inhibit conditions / inhibit limit conditions for inhibit source DFC_KRVEKORLMXL" VAL_BLK 0x80500015 ValA_Wu8 17.0000000000 DINH_LimDFCVerb 0.00 17.0000000000 FORMAT "%13.10" NUMBER 50 /end CHARACTERISTIC
/begin CHARACTERISTIC DINH_Lim.DFC_KS1max_CA "inhibit conditions / inhibit limit conditions for inhibit source DFC_KS1max" VAL_BLK 0x80500047 ValA_Wu8 17.0000000000 DINH_LimDFCVerb 0.00 17.0000000000 FORMAT "%13.10" NUMBER 58 /end CHARACTERISTIC
/begin CHARACTERISTIC DINH_Lim.DFC_KS1min_CA "inhibit conditions / inhibit limit conditions for inhibit source DFC_KS1min" VAL_BLK 0x80500081 ValA_Wu8 17.0000000000 DINH_LimDFCVerb 0.00 17.0000000000 FORMAT "%13.10" NUMBER 58 /end CHARACTERISTIC
/begin CHARACTERISTIC DINH_Lim.DFC_LMmax_CA "inhibit conditions / inhibit limit conditions for inhibit source DFC_LMmax" VAL_BLK 0x805000BB ValA_Wu8 17.0000000000 DINH_LimDFCVerb 0.00 17.0000000000 FORMAT "%13.10" NUMBER 67 /end CHARACTERISTIC
/begin CHARACTERISTIC DINH_Lim.DFC_LZSRnpl_CA "inhibit conditions / inhibit limit conditions for inhibit source DFC_LZSRnpl" VAL_BLK 0x805000FE ValA_Wu8 17.0000000000 DINH_LimDFCVerb 0.00 17.0000000000 FORMAT "%13.10" NUMBER 57 /end CHARACTERISTIC
/begin CHARACTERISTIC DINH_Lim.DFC_LamDynDiagS1B1_CA "inhibit conditions / inhibit limit conditions for inhibit source DFC_LamDynDiagS1B1" VAL_BLK 0x80500137 ValA_Wu8 17.0000000000 DINH_LimDFCVerb 0.00 17.0000000000 FORMAT "%13.10" NUMBER 78 /end CHARACTERISTIC
/begin CHARACTERISTIC DINH_Lim.DFC_LeakIntkMnfldEmiInfl_CA "inhibit conditions / inhibit limit conditions for inhibit source DFC_LeakIntkMnfldEmiInfl" VAL_BLK 0x80500185 ValA_Wu8 17.0000000000 DINH_LimDFCVerb 0.00 17.0000000000 FORMAT "%13.10" NUMBER 52 /end CHARACTERISTIC
/begin CHARACTERISTIC DINH_Lim.DFC_LinFrameErrDCDC_CA "inhibit conditions / inhibit limit conditions for inhibit source DFC_LinFrameErrDCDC" VAL_BLK 0x805001B9 ValA_Wu8 17.0000000000 DINH_LimDFCVerb 0.00 17.0000000000 FORMAT "%13.10" NUMBER 52 /end CHARACTERISTIC
/begin CHARACTERISTIC DINH_Lim.DFC_LinOverrunErrDCDC_CA "inhibit conditions / inhibit limit conditions for inhibit source DFC_LinOverrunErrDCDC" VAL_BLK 0x805001ED ValA_Wu8 17.0000000000 DINH_LimDFCVerb 0.00 17.0000000000 FORMAT "%13.10" NUMBER 52 /end CHARACTERISTIC
/begin CHARACTERISTIC DINH_Lim.DFC_MD00max_CA "inhibit conditions / inhibit limit conditions for inhibit source DFC_MD00max" VAL_BLK 0x80500221 ValA_Wu8 17.0000000000 DINH_LimDFCVerb 0.00 17.0000000000 FORMAT "%13.10" NUMBER 50 /end CHARACTERISTIC
/begin CHARACTERISTIC DINH_Lim.DFC_MDBmax_CA "inhibit conditions / inhibit limit conditions for inhibit source DFC_MDBmax" VAL_BLK 0x80500253 ValA_Wu8 17.0000000000 DINH_LimDFCVerb 0.00 17.0000000000 FORMAT "%13.10" NUMBER 58 /end CHARACTERISTIC
/begin CHARACTERISTIC DINH_Lim.DFC_MDCat_CA "inhibit conditions / inhibit limit conditions for inhibit source DFC_MDCat" VAL_BLK 0x8050028D ValA_Wu8 17.0000000000 DINH_LimDFCVerb 0.00 17.0000000000 FORMAT "%13.10" NUMBER 56 /end CHARACTERISTIC
/begin CHARACTERISTIC DINH_Lim.DFC_MDCatCrit_CA "inhibit conditions / inhibit limit conditions for inhibit source DFC_MDCatCrit" VAL_BLK 0x805002C5 ValA_Wu8 17.0000000000 DINH_LimDFCVerb 0.00 17.0000000000 FORMAT "%13.10" NUMBER 50 /end CHARACTERISTIC
/begin CHARACTERISTIC DINH_Lim.DFC_MDCatCurr_CA "inhibit conditions / inhibit limit conditions for inhibit source DFC_MDCatCurr" VAL_BLK 0x805002F7 ValA_Wu8 17.0000000000 DINH_LimDFCVerb 0.00 17.0000000000 FORMAT "%13.10" NUMBER 53 /end CHARACTERISTIC
/begin CHARACTERISTIC DINH_Lim.DFC_MDCyl_0_CA "inhibit conditions / inhibit limit conditions for inhibit source DFC_MDCyl_0" VAL_BLK 0x8050032C ValA_Wu8 17.0000000000 DINH_LimDFCVerb 0.00 17.0000000000 FORMAT "%13.10" NUMBER 78 /end CHARACTERISTIC
/begin CHARACTERISTIC DINH_Lim.DFC_MDCyl_1_CA "inhibit conditions / inhibit limit conditions for inhibit source DFC_MDCyl_1" VAL_BLK 0x8050037A ValA_Wu8 17.0000000000 DINH_LimDFCVerb 0.00 17.0000000000 FORMAT "%13.10" NUMBER 78 /end CHARACTERISTIC
/begin CHARACTERISTIC DINH_Lim.DFC_MDCyl_2_CA "inhibit conditions / inhibit limit conditions for inhibit source DFC_MDCyl_2" VAL_BLK 0x805003C8 ValA_Wu8 17.0000000000 DINH_LimDFCVerb 0.00 17.0000000000 FORMAT "%13.10" NUMBER 78 /end CHARACTERISTIC
/begin CHARACTERISTIC DINH_Lim.DFC_MDCyl_3_CA "inhibit conditions / inhibit limit conditions for inhibit source DFC_MDCyl_3" VAL_BLK 0x80500416 ValA_Wu8 17.0000000000 DINH_LimDFCVerb 0.00 17.0000000000 FORMAT "%13.10" NUMBER 78 /end CHARACTERISTIC
/begin CHARACTERISTIC DINH_Lim.DFC_MDEmi_CA "inhibit conditions / inhibit limit conditions for inhibit source DFC_MDEmi" VAL_BLK 0x80500464 ValA_Wu8 17.0000000000 DINH_LimDFCVerb 0.00 17.0000000000 FORMAT "%13.10" NUMBER 56 /end CHARACTERISTIC
/begin CHARACTERISTIC DINH_Lim.DFC_MDEmiStrt_CA "inhibit conditions / inhibit limit conditions for inhibit source DFC_MDEmiStrt" VAL_BLK 0x8050049C ValA_Wu8 17.0000000000 DINH_LimDFCVerb 0.00 17.0000000000 FORMAT "%13.10" NUMBER 56 /end CHARACTERISTIC
/begin CHARACTERISTIC DINH_Lim.DFC_MDFco_CA "inhibit conditions / inhibit limit conditions for inhibit source DFC_MDFco" VAL_BLK 0x805004D4 ValA_Wu8 17.0000000000 DINH_LimDFCVerb 0.00 17.0000000000 FORMAT "%13.10" NUMBER 54 /end CHARACTERISTIC
/begin CHARACTERISTIC DINH_Lim.DFC_MDMpl_CA "inhibit conditions / inhibit limit conditions for inhibit source DFC_MDMpl" VAL_BLK 0x8050050A ValA_Wu8 17.0000000000 DINH_LimDFCVerb 0.00 17.0000000000 FORMAT "%13.10" NUMBER 78 /end CHARACTERISTIC
/begin CHARACTERISTIC DINH_Lim.DFC_MDSegTiAdpn_CA "inhibit conditions / inhibit limit conditions for inhibit source DFC_MDSegTiAdpn" VAL_BLK 0x80500558 ValA_Wu8 17.0000000000 DINH_LimDFCVerb 0.00 17.0000000000 FORMAT "%13.10" NUMBER 50 /end CHARACTERISTIC
/begin CHARACTERISTIC DINH_Lim.DFC_MDmax_CA "inhibit conditions / inhibit limit conditions for inhibit source DFC_MDmax" VAL_BLK 0x8050058A ValA_Wu8 17.0000000000 DINH_LimDFCVerb 0.00 17.0000000000 FORMAT "%13.10" NUMBER 50 /end CHARACTERISTIC
/begin CHARACTERISTIC DINH_Lim.DFC_MFuOilMax_CA "inhibit conditions / inhibit limit conditions for inhibit source DFC_MFuOilMax" VAL_BLK 0x805005BC ValA_Wu8 17.0000000000 DINH_LimDFCVerb 0.00 17.0000000000 FORMAT "%13.10" NUMBER 50 /end CHARACTERISTIC
/begin CHARACTERISTIC DINH_Lim.DFC_MOXEMM_SMU_ALM0_0_CA "inhibit conditions / inhibit limit conditions for inhibit source DFC_MOXEMM_SMU_ALM0_0" VAL_BLK 0x805005EE ValA_Wu8 17.0000000000 DINH_LimDFCVerb 0.00 17.0000000000 FORMAT "%13.10" NUMBER 50 /end CHARACTERISTIC
/begin CHARACTERISTIC DINH_Lim.DFC_MOXEMM_SMU_ALM0_1_CA "inhibit conditions / inhibit limit conditions for inhibit source DFC_MOXEMM_SMU_ALM0_1" VAL_BLK 0x80500620 ValA_Wu8 17.0000000000 DINH_LimDFCVerb 0.00 17.0000000000 FORMAT "%13.10" NUMBER 50 /end CHARACTERISTIC
/begin CHARACTERISTIC DINH_Lim.DFC_MOXEMM_SMU_ALM0_10_CA "inhibit conditions / inhibit limit conditions for inhibit source DFC_MOXEMM_SMU_ALM0_10" VAL_BLK 0x80500652 ValA_Wu8 17.0000000000 DINH_LimDFCVerb 0.00 17.0000000000 FORMAT "%13.10" NUMBER 50 /end CHARACTERISTIC
/begin CHARACTERISTIC DINH_Lim.DFC_MOXEMM_SMU_ALM0_11_CA "inhibit conditions / inhibit limit conditions for inhibit source DFC_MOXEMM_SMU_ALM0_11" VAL_BLK 0x80500684 ValA_Wu8 17.0000000000 DINH_LimDFCVerb 0.00 17.0000000000 FORMAT "%13.10" NUMBER 50 /end CHARACTERISTIC
/begin CHARACTERISTIC DINH_Lim.DFC_MOXEMM_SMU_ALM0_13_CA "inhibit conditions / inhibit limit conditions for inhibit source DFC_MOXEMM_SMU_ALM0_13" VAL_BLK 0x805006B6 ValA_Wu8 17.0000000000 DINH_LimDFCVerb 0.00 17.0000000000 FORMAT "%13.10" NUMBER 50 /end CHARACTERISTIC
/begin CHARACTERISTIC DINH_Lim.DFC_MOXEMM_SMU_ALM0_14_CA "inhibit conditions / inhibit limit conditions for inhibit source DFC_MOXEMM_SMU_ALM0_14" VAL_BLK 0x805006E8 ValA_Wu8 17.0000000000 DINH_LimDFCVerb 0.00 17.0000000000 FORMAT "%13.10" NUMBER 50 /end CHARACTERISTIC
/begin CHARACTERISTIC DINH_Lim.DFC_MOXEMM_SMU_ALM0_2_CA "inhibit conditions / inhibit limit conditions for inhibit source DFC_MOXEMM_SMU_ALM0_2" VAL_BLK 0x8050071A ValA_Wu8 17.0000000000 DINH_LimDFCVerb 0.00 17.0000000000 FORMAT "%13.10" NUMBER 50 /end CHARACTERISTIC
/begin CHARACTERISTIC DINH_Lim.DFC_MOXEMM_SMU_ALM0_22_CA "inhibit conditions / inhibit limit conditions for inhibit source DFC_MOXEMM_SMU_ALM0_22" VAL_BLK 0x8050074C ValA_Wu8 17.0000000000 DINH_LimDFCVerb 0.00 17.0000000000 FORMAT "%13.10" NUMBER 50 /end CHARACTERISTIC
/begin CHARACTERISTIC DINH_Lim.DFC_MOXEMM_SMU_ALM0_23_CA "inhibit conditions / inhibit limit conditions for inhibit source DFC_MOXEMM_SMU_ALM0_23" VAL_BLK 0x8050077E ValA_Wu8 17.0000000000 DINH_LimDFCVerb 0.00 17.0000000000 FORMAT "%13.10" NUMBER 50 /end CHARACTERISTIC
/begin CHARACTERISTIC DINH_Lim.DFC_MOXEMM_SMU_ALM0_4_CA "inhibit conditions / inhibit limit conditions for inhibit source DFC_MOXEMM_SMU_ALM0_4" VAL_BLK 0x805007B0 ValA_Wu8 17.0000000000 DINH_LimDFCVerb 0.00 17.0000000000 FORMAT "%13.10" NUMBER 50 /end CHARACTERISTIC
/begin CHARACTERISTIC DINH_Lim.DFC_MOXEMM_SMU_ALM0_5_CA "inhibit conditions / inhibit limit conditions for inhibit source DFC_MOXEMM_SMU_ALM0_5" VAL_BLK 0x805007E2 ValA_Wu8 17.0000000000 DINH_LimDFCVerb 0.00 17.0000000000 FORMAT "%13.10" NUMBER 50 /end CHARACTERISTIC
/begin CHARACTERISTIC DINH_Lim.DFC_MOXEMM_SMU_ALM0_7_CA "inhibit conditions / inhibit limit conditions for inhibit source DFC_MOXEMM_SMU_ALM0_7" VAL_BLK 0x80500814 ValA_Wu8 17.0000000000 DINH_LimDFCVerb 0.00 17.0000000000 FORMAT "%13.10" NUMBER 50 /end CHARACTERISTIC
/begin CHARACTERISTIC DINH_Lim.DFC_MOXEMM_SMU_ALM0_8_CA "inhibit conditions / inhibit limit conditions for inhibit source DFC_MOXEMM_SMU_ALM0_8" VAL_BLK 0x80500846 ValA_Wu8 17.0000000000 DINH_LimDFCVerb 0.00 17.0000000000 FORMAT "%13.10" NUMBER 50 /end CHARACTERISTIC
/begin CHARACTERISTIC DINH_Lim.DFC_MOXEMM_SMU_ALM10_16_CA "inhibit conditions / inhibit limit conditions for inhibit source DFC_MOXEMM_SMU_ALM10_16" VAL_BLK 0x80500878 ValA_Wu8 17.0000000000 DINH_LimDFCVerb 0.00 17.0000000000 FORMAT "%13.10" NUMBER 50 /end CHARACTERISTIC
/begin CHARACTERISTIC DINH_Lim.DFC_MOXEMM_SMU_ALM10_17_CA "inhibit conditions / inhibit limit conditions for inhibit source DFC_MOXEMM_SMU_ALM10_17" VAL_BLK 0x805008AA ValA_Wu8 17.0000000000 DINH_LimDFCVerb 0.00 17.0000000000 FORMAT "%13.10" NUMBER 50 /end CHARACTERISTIC
/begin CHARACTERISTIC DINH_Lim.DFC_MOXEMM_SMU_ALM10_21_CA "inhibit conditions / inhibit limit conditions for inhibit source DFC_MOXEMM_SMU_ALM10_21" VAL_BLK 0x805008DC ValA_Wu8 17.0000000000 DINH_LimDFCVerb 0.00 17.0000000000 FORMAT "%13.10" NUMBER 50 /end CHARACTERISTIC
/begin CHARACTERISTIC DINH_Lim.DFC_MOXEMM_SMU_ALM11_0_CA "inhibit conditions / inhibit limit conditions for inhibit source DFC_MOXEMM_SMU_ALM11_0" VAL_BLK 0x8050090E ValA_Wu8 17.0000000000 DINH_LimDFCVerb 0.00 17.0000000000 FORMAT "%13.10" NUMBER 50 /end CHARACTERISTIC
/begin CHARACTERISTIC DINH_Lim.DFC_MOXEMM_SMU_ALM11_1_CA "inhibit conditions / inhibit limit conditions for inhibit source DFC_MOXEMM_SMU_ALM11_1" VAL_BLK 0x80500940 ValA_Wu8 17.0000000000 DINH_LimDFCVerb 0.00 17.0000000000 FORMAT "%13.10" NUMBER 50 /end CHARACTERISTIC
/begin CHARACTERISTIC DINH_Lim.DFC_MOXEMM_SMU_ALM11_2_CA "inhibit conditions / inhibit limit conditions for inhibit source DFC_MOXEMM_SMU_ALM11_2" VAL_BLK 0x80500972 ValA_Wu8 17.0000000000 DINH_LimDFCVerb 0.00 17.0000000000 FORMAT "%13.10" NUMBER 50 /end CHARACTERISTIC
/begin CHARACTERISTIC DINH_Lim.DFC_MOXEMM_SMU_ALM11_3_CA "inhibit conditions / inhibit limit conditions for inhibit source DFC_MOXEMM_SMU_ALM11_3" VAL_BLK 0x805009A4 ValA_Wu8 17.0000000000 DINH_LimDFCVerb 0.00 17.0000000000 FORMAT "%13.10" NUMBER 50 /end CHARACTERISTIC
/begin CHARACTERISTIC DINH_Lim.DFC_MOXEMM_SMU_ALM11_4_CA "inhibit conditions / inhibit limit conditions for inhibit source DFC_MOXEMM_SMU_ALM11_4" VAL_BLK 0x805009D6 ValA_Wu8 17.0000000000 DINH_LimDFCVerb 0.00 17.0000000000 FORMAT "%13.10" NUMBER 50 /end CHARACTERISTIC
/begin CHARACTERISTIC DINH_Lim.DFC_MOXEMM_SMU_ALM11_5_CA "inhibit conditions / inhibit limit conditions for inhibit source DFC_MOXEMM_SMU_ALM11_5" VAL_BLK 0x80500A08 ValA_Wu8 17.0000000000 DINH_LimDFCVerb 0.00 17.0000000000 FORMAT "%13.10" NUMBER 50 /end CHARACTERISTIC
/begin CHARACTERISTIC DINH_Lim.DFC_MOXEMM_SMU_ALM11_8_CA "inhibit conditions / inhibit limit conditions for inhibit source DFC_MOXEMM_SMU_ALM11_8" VAL_BLK 0x80500A3A ValA_Wu8 17.0000000000 DINH_LimDFCVerb 0.00 17.0000000000 FORMAT "%13.10" NUMBER 50 /end CHARACTERISTIC
/begin CHARACTERISTIC DINH_Lim.DFC_MOXEMM_SMU_ALM11_9_CA "inhibit conditions / inhibit limit conditions for inhibit source DFC_MOXEMM_SMU_ALM11_9" VAL_BLK 0x80500A6C ValA_Wu8 17.0000000000 DINH_LimDFCVerb 0.00 17.0000000000 FORMAT "%13.10" NUMBER 50 /end CHARACTERISTIC
/begin CHARACTERISTIC DINH_Lim.DFC_MOXEMM_SMU_ALM1_0_CA "inhibit conditions / inhibit limit conditions for inhibit source DFC_MOXEMM_SMU_ALM1_0" VAL_BLK 0x80500A9E ValA_Wu8 17.0000000000 DINH_LimDFCVerb 0.00 17.0000000000 FORMAT "%13.10" NUMBER 50 /end CHARACTERISTIC
/begin CHARACTERISTIC DINH_Lim.DFC_MOXEMM_SMU_ALM1_1_CA "inhibit conditions / inhibit limit conditions for inhibit source DFC_MOXEMM_SMU_ALM1_1" VAL_BLK 0x80500AD0 ValA_Wu8 17.0000000000 DINH_LimDFCVerb 0.00 17.0000000000 FORMAT "%13.10" NUMBER 50 /end CHARACTERISTIC
/begin CHARACTERISTIC DINH_Lim.DFC_MOXEMM_SMU_ALM1_10_CA "inhibit conditions / inhibit limit conditions for inhibit source DFC_MOXEMM_SMU_ALM1_10" VAL_BLK 0x80500B02 ValA_Wu8 17.0000000000 DINH_LimDFCVerb 0.00 17.0000000000 FORMAT "%13.10" NUMBER 50 /end CHARACTERISTIC
/begin CHARACTERISTIC DINH_Lim.DFC_MOXEMM_SMU_ALM1_11_CA "inhibit conditions / inhibit limit conditions for inhibit source DFC_MOXEMM_SMU_ALM1_11" VAL_BLK 0x80500B34 ValA_Wu8 17.0000000000 DINH_LimDFCVerb 0.00 17.0000000000 FORMAT "%13.10" NUMBER 50 /end CHARACTERISTIC
/begin CHARACTERISTIC DINH_Lim.DFC_MOXEMM_SMU_ALM1_13_CA "inhibit conditions / inhibit limit conditions for inhibit source DFC_MOXEMM_SMU_ALM1_13" VAL_BLK 0x80500B66 ValA_Wu8 17.0000000000 DINH_LimDFCVerb 0.00 17.0000000000 FORMAT "%13.10" NUMBER 50 /end CHARACTERISTIC
/begin CHARACTERISTIC DINH_Lim.DFC_MOXEMM_SMU_ALM1_14_CA "inhibit conditions / inhibit limit conditions for inhibit source DFC_MOXEMM_SMU_ALM1_14" VAL_BLK 0x80500B98 ValA_Wu8 17.0000000000 DINH_LimDFCVerb 0.00 17.0000000000 FORMAT "%13.10" NUMBER 50 /end CHARACTERISTIC
/begin CHARACTERISTIC DINH_Lim.DFC_MOXEMM_SMU_ALM1_2_CA "inhibit conditions / inhibit limit conditions for inhibit source DFC_MOXEMM_SMU_ALM1_2" VAL_BLK 0x80500BCA ValA_Wu8 17.0000000000 DINH_LimDFCVerb 0.00 17.0000000000 FORMAT "%13.10" NUMBER 50 /end CHARACTERISTIC
/begin CHARACTERISTIC DINH_Lim.DFC_MOXEMM_SMU_ALM1_22_CA "inhibit conditions / inhibit limit conditions for inhibit source DFC_MOXEMM_SMU_ALM1_22" VAL_BLK 0x80500BFC ValA_Wu8 17.0000000000 DINH_LimDFCVerb 0.00 17.0000000000 FORMAT "%13.10" NUMBER 50 /end CHARACTERISTIC
/begin CHARACTERISTIC DINH_Lim.DFC_MOXEMM_SMU_ALM1_23_CA "inhibit conditions / inhibit limit conditions for inhibit source DFC_MOXEMM_SMU_ALM1_23" VAL_BLK 0x80500C2E ValA_Wu8 17.0000000000 DINH_LimDFCVerb 0.00 17.0000000000 FORMAT "%13.10" NUMBER 50 /end CHARACTERISTIC
/begin CHARACTERISTIC DINH_Lim.DFC_MOXEMM_SMU_ALM1_4_CA "inhibit conditions / inhibit limit conditions for inhibit source DFC_MOXEMM_SMU_ALM1_4" VAL_BLK 0x80500C60 ValA_Wu8 17.0000000000 DINH_LimDFCVerb 0.00 17.0000000000 FORMAT "%13.10" NUMBER 50 /end CHARACTERISTIC
/begin CHARACTERISTIC DINH_Lim.DFC_MOXEMM_SMU_ALM1_5_CA "inhibit conditions / inhibit limit conditions for inhibit source DFC_MOXEMM_SMU_ALM1_5" VAL_BLK 0x80500C92 ValA_Wu8 17.0000000000 DINH_LimDFCVerb 0.00 17.0000000000 FORMAT "%13.10" NUMBER 50 /end CHARACTERISTIC
/begin CHARACTERISTIC DINH_Lim.DFC_MOXEMM_SMU_ALM1_7_CA "inhibit conditions / inhibit limit conditions for inhibit source DFC_MOXEMM_SMU_ALM1_7" VAL_BLK 0x80500CC4 ValA_Wu8 17.0000000000 DINH_LimDFCVerb 0.00 17.0000000000 FORMAT "%13.10" NUMBER 50 /end CHARACTERISTIC
/begin CHARACTERISTIC DINH_Lim.DFC_MOXEMM_SMU_ALM1_8_CA "inhibit conditions / inhibit limit conditions for inhibit source DFC_MOXEMM_SMU_ALM1_8" VAL_BLK 0x80500CF6 ValA_Wu8 17.0000000000 DINH_LimDFCVerb 0.00 17.0000000000 FORMAT "%13.10" NUMBER 50 /end CHARACTERISTIC
/begin CHARACTERISTIC DINH_Lim.DFC_MOXEMM_SMU_ALM21_0_CA "inhibit conditions / inhibit limit conditions for inhibit source DFC_MOXEMM_SMU_ALM21_0" VAL_BLK 0x80500D28 ValA_Wu8 17.0000000000 DINH_LimDFCVerb 0.00 17.0000000000 FORMAT "%13.10" NUMBER 50 /end CHARACTERISTIC
/begin CHARACTERISTIC DINH_Lim.DFC_MOXEMM_SMU_ALM21_16_CA "inhibit conditions / inhibit limit conditions for inhibit source DFC_MOXEMM_SMU_ALM21_16" VAL_BLK 0x80500D5A ValA_Wu8 17.0000000000 DINH_LimDFCVerb 0.00 17.0000000000 FORMAT "%13.10" NUMBER 50 /end CHARACTERISTIC
/begin CHARACTERISTIC DINH_Lim.DFC_MOXEMM_SMU_ALM21_3_CA "inhibit conditions / inhibit limit conditions for inhibit source DFC_MOXEMM_SMU_ALM21_3" VAL_BLK 0x80500D8C ValA_Wu8 17.0000000000 DINH_LimDFCVerb 0.00 17.0000000000 FORMAT "%13.10" NUMBER 50 /end CHARACTERISTIC
/begin CHARACTERISTIC DINH_Lim.DFC_MOXEMM_SMU_ALM2_1_CA "inhibit conditions / inhibit limit conditions for inhibit source DFC_MOXEMM_SMU_ALM2_1" VAL_BLK 0x80500DBE ValA_Wu8 17.0000000000 DINH_LimDFCVerb 0.00 17.0000000000 FORMAT "%13.10" NUMBER 50 /end CHARACTERISTIC
/begin CHARACTERISTIC DINH_Lim.DFC_MOXEMM_SMU_ALM2_10_CA "inhibit conditions / inhibit limit conditions for inhibit source DFC_MOXEMM_SMU_ALM2_10" VAL_BLK 0x80500DF0 ValA_Wu8 17.0000000000 DINH_LimDFCVerb 0.00 17.0000000000 FORMAT "%13.10" NUMBER 50 /end CHARACTERISTIC
/begin CHARACTERISTIC DINH_Lim.DFC_MOXEMM_SMU_ALM2_11_CA "inhibit conditions / inhibit limit conditions for inhibit source DFC_MOXEMM_SMU_ALM2_11" VAL_BLK 0x80500E22 ValA_Wu8 17.0000000000 DINH_LimDFCVerb 0.00 17.0000000000 FORMAT "%13.10" NUMBER 50 /end CHARACTERISTIC
/begin CHARACTERISTIC DINH_Lim.DFC_MOXEMM_SMU_ALM2_13_CA "inhibit conditions / inhibit limit conditions for inhibit source DFC_MOXEMM_SMU_ALM2_13" VAL_BLK 0x80500E54 ValA_Wu8 17.0000000000 DINH_LimDFCVerb 0.00 17.0000000000 FORMAT "%13.10" NUMBER 50 /end CHARACTERISTIC
/begin CHARACTERISTIC DINH_Lim.DFC_MOXEMM_SMU_ALM2_14_CA "inhibit conditions / inhibit limit conditions for inhibit source DFC_MOXEMM_SMU_ALM2_14" VAL_BLK 0x80500E86 ValA_Wu8 17.0000000000 DINH_LimDFCVerb 0.00 17.0000000000 FORMAT "%13.10" NUMBER 50 /end CHARACTERISTIC
/begin CHARACTERISTIC DINH_Lim.DFC_MOXEMM_SMU_ALM2_22_CA "inhibit conditions / inhibit limit conditions for inhibit source DFC_MOXEMM_SMU_ALM2_22" VAL_BLK 0x80500EB8 ValA_Wu8 17.0000000000 DINH_LimDFCVerb 0.00 17.0000000000 FORMAT "%13.10" NUMBER 50 /end CHARACTERISTIC
/begin CHARACTERISTIC DINH_Lim.DFC_MOXEMM_SMU_ALM2_23_CA "inhibit conditions / inhibit limit conditions for inhibit source DFC_MOXEMM_SMU_ALM2_23" VAL_BLK 0x80500EEA ValA_Wu8 17.0000000000 DINH_LimDFCVerb 0.00 17.0000000000 FORMAT "%13.10" NUMBER 50 /end CHARACTERISTIC
/begin CHARACTERISTIC DINH_Lim.DFC_MOXEMM_SMU_ALM2_4_CA "inhibit conditions / inhibit limit conditions for inhibit source DFC_MOXEMM_SMU_ALM2_4" VAL_BLK 0x80500F1C ValA_Wu8 17.0000000000 DINH_LimDFCVerb 0.00 17.0000000000 FORMAT "%13.10" NUMBER 50 /end CHARACTERISTIC
/begin CHARACTERISTIC DINH_Lim.DFC_MOXEMM_SMU_ALM2_5_CA "inhibit conditions / inhibit limit conditions for inhibit source DFC_MOXEMM_SMU_ALM2_5" VAL_BLK 0x80500F4E ValA_Wu8 17.0000000000 DINH_LimDFCVerb 0.00 17.0000000000 FORMAT "%13.10" NUMBER 50 /end CHARACTERISTIC
/begin CHARACTERISTIC DINH_Lim.DFC_MOXEMM_SMU_ALM2_7_CA "inhibit conditions / inhibit limit conditions for inhibit source DFC_MOXEMM_SMU_ALM2_7" VAL_BLK 0x80500F80 ValA_Wu8 17.0000000000 DINH_LimDFCVerb 0.00 17.0000000000 FORMAT "%13.10" NUMBER 50 /end CHARACTERISTIC
/begin CHARACTERISTIC DINH_Lim.DFC_MOXEMM_SMU_ALM2_8_CA "inhibit conditions / inhibit limit conditions for inhibit source DFC_MOXEMM_SMU_ALM2_8" VAL_BLK 0x80500FB2 ValA_Wu8 17.0000000000 DINH_LimDFCVerb 0.00 17.0000000000 FORMAT "%13.10" NUMBER 50 /end CHARACTERISTIC
/begin CHARACTERISTIC DINH_Lim.DFC_MOXEMM_SMU_ALM6_0_CA "inhibit conditions / inhibit limit conditions for inhibit source DFC_MOXEMM_SMU_ALM6_0" VAL_BLK 0x80500FE4 ValA_Wu8 17.0000000000 DINH_LimDFCVerb 0.00 17.0000000000 FORMAT "%13.10" NUMBER 50 /end CHARACTERISTIC
/begin CHARACTERISTIC DINH_Lim.DFC_MOXEMM_SMU_ALM6_11_CA "inhibit conditions / inhibit limit conditions for inhibit source DFC_MOXEMM_SMU_ALM6_11" VAL_BLK 0x80501016 ValA_Wu8 17.0000000000 DINH_LimDFCVerb 0.00 17.0000000000 FORMAT "%13.10" NUMBER 50 /end CHARACTERISTIC
/begin CHARACTERISTIC DINH_Lim.DFC_MOXEMM_SMU_ALM6_12_CA "inhibit conditions / inhibit limit conditions for inhibit source DFC_MOXEMM_SMU_ALM6_12" VAL_BLK 0x80501048 ValA_Wu8 17.0000000000 DINH_LimDFCVerb 0.00 17.0000000000 FORMAT "%13.10" NUMBER 50 /end CHARACTERISTIC
/begin CHARACTERISTIC DINH_Lim.DFC_MOXEMM_SMU_ALM6_14_CA "inhibit conditions / inhibit limit conditions for inhibit source DFC_MOXEMM_SMU_ALM6_14" VAL_BLK 0x8050107A ValA_Wu8 17.0000000000 DINH_LimDFCVerb 0.00 17.0000000000 FORMAT "%13.10" NUMBER 50 /end CHARACTERISTIC
/begin CHARACTERISTIC DINH_Lim.DFC_MOXEMM_SMU_ALM6_15_CA "inhibit conditions / inhibit limit conditions for inhibit source DFC_MOXEMM_SMU_ALM6_15" VAL_BLK 0x805010AC ValA_Wu8 17.0000000000 DINH_LimDFCVerb 0.00 17.0000000000 FORMAT "%13.10" NUMBER 50 /end CHARACTERISTIC
/begin CHARACTERISTIC DINH_Lim.DFC_MOXEMM_SMU_ALM6_17_CA "inhibit conditions / inhibit limit conditions for inhibit source DFC_MOXEMM_SMU_ALM6_17" VAL_BLK 0x805010DE ValA_Wu8 17.0000000000 DINH_LimDFCVerb 0.00 17.0000000000 FORMAT "%13.10" NUMBER 50 /end CHARACTERISTIC
/begin CHARACTERISTIC DINH_Lim.DFC_MOXEMM_SMU_ALM6_18_CA "inhibit conditions / inhibit limit conditions for inhibit source DFC_MOXEMM_SMU_ALM6_18" VAL_BLK 0x80501110 ValA_Wu8 17.0000000000 DINH_LimDFCVerb 0.00 17.0000000000 FORMAT "%13.10" NUMBER 50 /end CHARACTERISTIC
/begin CHARACTERISTIC DINH_Lim.DFC_MOXEMM_SMU_ALM6_20_CA "inhibit conditions / inhibit limit conditions for inhibit source DFC_MOXEMM_SMU_ALM6_20" VAL_BLK 0x80501142 ValA_Wu8 17.0000000000 DINH_LimDFCVerb 0.00 17.0000000000 FORMAT "%13.10" NUMBER 50 /end CHARACTERISTIC
/begin CHARACTERISTIC DINH_Lim.DFC_MOXEMM_SMU_ALM6_21_CA "inhibit conditions / inhibit limit conditions for inhibit source DFC_MOXEMM_SMU_ALM6_21" VAL_BLK 0x80501174 ValA_Wu8 17.0000000000 DINH_LimDFCVerb 0.00 17.0000000000 FORMAT "%13.10" NUMBER 50 /end CHARACTERISTIC
/begin CHARACTERISTIC DINH_Lim.DFC_MOXEMM_SMU_ALM6_25_CA "inhibit conditions / inhibit limit conditions for inhibit source DFC_MOXEMM_SMU_ALM6_25" VAL_BLK 0x805011A6 ValA_Wu8 17.0000000000 DINH_LimDFCVerb 0.00 17.0000000000 FORMAT "%13.10" NUMBER 50 /end CHARACTERISTIC
/begin CHARACTERISTIC DINH_Lim.DFC_MOXEMM_SMU_ALM6_4_CA "inhibit conditions / inhibit limit conditions for inhibit source DFC_MOXEMM_SMU_ALM6_4" VAL_BLK 0x805011D8 ValA_Wu8 17.0000000000 DINH_LimDFCVerb 0.00 17.0000000000 FORMAT "%13.10" NUMBER 50 /end CHARACTERISTIC
/begin CHARACTERISTIC DINH_Lim.DFC_MOXEMM_SMU_ALM6_5_CA "inhibit conditions / inhibit limit conditions for inhibit source DFC_MOXEMM_SMU_ALM6_5" VAL_BLK 0x8050120A ValA_Wu8 17.0000000000 DINH_LimDFCVerb 0.00 17.0000000000 FORMAT "%13.10" NUMBER 50 /end CHARACTERISTIC
/begin CHARACTERISTIC DINH_Lim.DFC_MOXEMM_SMU_ALM6_7_CA "inhibit conditions / inhibit limit conditions for inhibit source DFC_MOXEMM_SMU_ALM6_7" VAL_BLK 0x8050123C ValA_Wu8 17.0000000000 DINH_LimDFCVerb 0.00 17.0000000000 FORMAT "%13.10" NUMBER 50 /end CHARACTERISTIC
/begin CHARACTERISTIC DINH_Lim.DFC_MOXEMM_SMU_ALM6_8_CA "inhibit conditions / inhibit limit conditions for inhibit source DFC_MOXEMM_SMU_ALM6_8" VAL_BLK 0x8050126E ValA_Wu8 17.0000000000 DINH_LimDFCVerb 0.00 17.0000000000 FORMAT "%13.10" NUMBER 50 /end CHARACTERISTIC
/begin CHARACTERISTIC DINH_Lim.DFC_MOXEMM_SMU_ALM7_1_CA "inhibit conditions / inhibit limit conditions for inhibit source DFC_MOXEMM_SMU_ALM7_1" VAL_BLK 0x805012A0 ValA_Wu8 17.0000000000 DINH_LimDFCVerb 0.00 17.0000000000 FORMAT "%13.10" NUMBER 50 /end CHARACTERISTIC
/begin CHARACTERISTIC DINH_Lim.DFC_MOXEMM_SMU_ALM7_12_CA "inhibit conditions / inhibit limit conditions for inhibit source DFC_MOXEMM_SMU_ALM7_12" VAL_BLK 0x805012D2 ValA_Wu8 17.0000000000 DINH_LimDFCVerb 0.00 17.0000000000 FORMAT "%13.10" NUMBER 50 /end CHARACTERISTIC
/begin CHARACTERISTIC DINH_Lim.DFC_MOXEMM_SMU_ALM7_13_CA "inhibit conditions / inhibit limit conditions for inhibit source DFC_MOXEMM_SMU_ALM7_13" VAL_BLK 0x80501304 ValA_Wu8 17.0000000000 DINH_LimDFCVerb 0.00 17.0000000000 FORMAT "%13.10" NUMBER 50 /end CHARACTERISTIC
/begin CHARACTERISTIC DINH_Lim.DFC_MOXEMM_SMU_ALM7_14_CA "inhibit conditions / inhibit limit conditions for inhibit source DFC_MOXEMM_SMU_ALM7_14" VAL_BLK 0x80501336 ValA_Wu8 17.0000000000 DINH_LimDFCVerb 0.00 17.0000000000 FORMAT "%13.10" NUMBER 50 /end CHARACTERISTIC
/begin CHARACTERISTIC DINH_Lim.DFC_MOXEMM_SMU_ALM7_15_CA "inhibit conditions / inhibit limit conditions for inhibit source DFC_MOXEMM_SMU_ALM7_15" VAL_BLK 0x80501368 ValA_Wu8 17.0000000000 DINH_LimDFCVerb 0.00 17.0000000000 FORMAT "%13.10" NUMBER 50 /end CHARACTERISTIC
/begin CHARACTERISTIC DINH_Lim.DFC_MOXEMM_SMU_ALM7_16_CA "inhibit conditions / inhibit limit conditions for inhibit source DFC_MOXEMM_SMU_ALM7_16" VAL_BLK 0x8050139A ValA_Wu8 17.0000000000 DINH_LimDFCVerb 0.00 17.0000000000 FORMAT "%13.10" NUMBER 50 /end CHARACTERISTIC
/begin CHARACTERISTIC DINH_Lim.DFC_MOXEMM_SMU_ALM7_17_CA "inhibit conditions / inhibit limit conditions for inhibit source DFC_MOXEMM_SMU_ALM7_17" VAL_BLK 0x805013CC ValA_Wu8 17.0000000000 DINH_LimDFCVerb 0.00 17.0000000000 FORMAT "%13.10" NUMBER 50 /end CHARACTERISTIC
/begin CHARACTERISTIC DINH_Lim.DFC_MOXEMM_SMU_ALM7_2_CA "inhibit conditions / inhibit limit conditions for inhibit source DFC_MOXEMM_SMU_ALM7_2" VAL_BLK 0x805013FE ValA_Wu8 17.0000000000 DINH_LimDFCVerb 0.00 17.0000000000 FORMAT "%13.10" NUMBER 50 /end CHARACTERISTIC
/begin CHARACTERISTIC DINH_Lim.DFC_MOXEMM_SMU_ALM7_20_CA "inhibit conditions / inhibit limit conditions for inhibit source DFC_MOXEMM_SMU_ALM7_20" VAL_BLK 0x80501430 ValA_Wu8 17.0000000000 DINH_LimDFCVerb 0.00 17.0000000000 FORMAT "%13.10" NUMBER 50 /end CHARACTERISTIC
/begin CHARACTERISTIC DINH_Lim.DFC_MOXEMM_SMU_ALM7_25_CA "inhibit conditions / inhibit limit conditions for inhibit source DFC_MOXEMM_SMU_ALM7_25" VAL_BLK 0x80501462 ValA_Wu8 17.0000000000 DINH_LimDFCVerb 0.00 17.0000000000 FORMAT "%13.10" NUMBER 50 /end CHARACTERISTIC
/begin CHARACTERISTIC DINH_Lim.DFC_MOXEMM_SMU_ALM7_26_CA "inhibit conditions / inhibit limit conditions for inhibit source DFC_MOXEMM_SMU_ALM7_26" VAL_BLK 0x80501494 ValA_Wu8 17.0000000000 DINH_LimDFCVerb 0.00 17.0000000000 FORMAT "%13.10" NUMBER 50 /end CHARACTERISTIC
/begin CHARACTERISTIC DINH_Lim.DFC_MOXEMM_SMU_ALM7_28_CA "inhibit conditions / inhibit limit conditions for inhibit source DFC_MOXEMM_SMU_ALM7_28" VAL_BLK 0x805014C6 ValA_Wu8 17.0000000000 DINH_LimDFCVerb 0.00 17.0000000000 FORMAT "%13.10" NUMBER 50 /end CHARACTERISTIC
/begin CHARACTERISTIC DINH_Lim.DFC_MOXEMM_SMU_ALM7_29_CA "inhibit conditions / inhibit limit conditions for inhibit source DFC_MOXEMM_SMU_ALM7_29" VAL_BLK 0x805014F8 ValA_Wu8 17.0000000000 DINH_LimDFCVerb 0.00 17.0000000000 FORMAT "%13.10" NUMBER 50 /end CHARACTERISTIC
/begin CHARACTERISTIC DINH_Lim.DFC_MOXEMM_SMU_ALM7_30_CA "inhibit conditions / inhibit limit conditions for inhibit source DFC_MOXEMM_SMU_ALM7_30" VAL_BLK 0x8050152A ValA_Wu8 17.0000000000 DINH_LimDFCVerb 0.00 17.0000000000 FORMAT "%13.10" NUMBER 50 /end CHARACTERISTIC
/begin CHARACTERISTIC DINH_Lim.DFC_MOXEMM_SMU_ALM7_31_CA "inhibit conditions / inhibit limit conditions for inhibit source DFC_MOXEMM_SMU_ALM7_31" VAL_BLK 0x8050155C ValA_Wu8 17.0000000000 DINH_LimDFCVerb 0.00 17.0000000000 FORMAT "%13.10" NUMBER 50 /end CHARACTERISTIC
/begin CHARACTERISTIC DINH_Lim.DFC_MOXEMM_SMU_ALM8_0_CA "inhibit conditions / inhibit limit conditions for inhibit source DFC_MOXEMM_SMU_ALM8_0" VAL_BLK 0x8050158E ValA_Wu8 17.0000000000 DINH_LimDFCVerb 0.00 17.0000000000 FORMAT "%13.10" NUMBER 50 /end CHARACTERISTIC
/begin CHARACTERISTIC DINH_Lim.DFC_MOXEMM_SMU_ALM8_1_CA "inhibit conditions / inhibit limit conditions for inhibit source DFC_MOXEMM_SMU_ALM8_1" VAL_BLK 0x805015C0 ValA_Wu8 17.0000000000 DINH_LimDFCVerb 0.00 17.0000000000 FORMAT "%13.10" NUMBER 50 /end CHARACTERISTIC
/begin CHARACTERISTIC DINH_Lim.DFC_MOXEMM_SMU_ALM8_10_CA "inhibit conditions / inhibit limit conditions for inhibit source DFC_MOXEMM_SMU_ALM8_10" VAL_BLK 0x805015F2 ValA_Wu8 17.0000000000 DINH_LimDFCVerb 0.00 17.0000000000 FORMAT "%13.10" NUMBER 50 /end CHARACTERISTIC
/begin CHARACTERISTIC DINH_Lim.DFC_MOXEMM_SMU_ALM8_11_CA "inhibit conditions / inhibit limit conditions for inhibit source DFC_MOXEMM_SMU_ALM8_11" VAL_BLK 0x80501624 ValA_Wu8 17.0000000000 DINH_LimDFCVerb 0.00 17.0000000000 FORMAT "%13.10" NUMBER 50 /end CHARACTERISTIC
/begin CHARACTERISTIC DINH_Lim.DFC_MOXEMM_SMU_ALM8_12_CA "inhibit conditions / inhibit limit conditions for inhibit source DFC_MOXEMM_SMU_ALM8_12" VAL_BLK 0x80501656 ValA_Wu8 17.0000000000 DINH_LimDFCVerb 0.00 17.0000000000 FORMAT "%13.10" NUMBER 50 /end CHARACTERISTIC
/begin CHARACTERISTIC DINH_Lim.DFC_MOXEMM_SMU_ALM8_16_CA "inhibit conditions / inhibit limit conditions for inhibit source DFC_MOXEMM_SMU_ALM8_16" VAL_BLK 0x80501688 ValA_Wu8 17.0000000000 DINH_LimDFCVerb 0.00 17.0000000000 FORMAT "%13.10" NUMBER 50 /end CHARACTERISTIC
/begin CHARACTERISTIC DINH_Lim.DFC_MOXEMM_SMU_ALM8_18_CA "inhibit conditions / inhibit limit conditions for inhibit source DFC_MOXEMM_SMU_ALM8_18" VAL_BLK 0x805016BA ValA_Wu8 17.0000000000 DINH_LimDFCVerb 0.00 17.0000000000 FORMAT "%13.10" NUMBER 50 /end CHARACTERISTIC
/begin CHARACTERISTIC DINH_Lim.DFC_MOXEMM_SMU_ALM8_2_CA "inhibit conditions / inhibit limit conditions for inhibit source DFC_MOXEMM_SMU_ALM8_2" VAL_BLK 0x805016EC ValA_Wu8 17.0000000000 DINH_LimDFCVerb 0.00 17.0000000000 FORMAT "%13.10" NUMBER 50 /end CHARACTERISTIC
/begin CHARACTERISTIC DINH_Lim.DFC_MOXEMM_SMU_ALM8_3_CA "inhibit conditions / inhibit limit conditions for inhibit source DFC_MOXEMM_SMU_ALM8_3" VAL_BLK 0x8050171E ValA_Wu8 17.0000000000 DINH_LimDFCVerb 0.00 17.0000000000 FORMAT "%13.10" NUMBER 50 /end CHARACTERISTIC
/begin CHARACTERISTIC DINH_Lim.DFC_MOXEMM_SMU_ALM8_31_CA "inhibit conditions / inhibit limit conditions for inhibit source DFC_MOXEMM_SMU_ALM8_31" VAL_BLK 0x80501750 ValA_Wu8 17.0000000000 DINH_LimDFCVerb 0.00 17.0000000000 FORMAT "%13.10" NUMBER 50 /end CHARACTERISTIC
/begin CHARACTERISTIC DINH_Lim.DFC_MOXEMM_SMU_ALM8_4_CA "inhibit conditions / inhibit limit conditions for inhibit source DFC_MOXEMM_SMU_ALM8_4" VAL_BLK 0x80501782 ValA_Wu8 17.0000000000 DINH_LimDFCVerb 0.00 17.0000000000 FORMAT "%13.10" NUMBER 50 /end CHARACTERISTIC
/begin FUNCTION DINH "30000.27.0_1.0.0Diagnostic Inhibit Handler"
 /begin DEF_CHARACTERISTIC DINH_Lim.DFC_ComMETATOutPstDrv_CA DINH_Lim.DFC_ComMETCChksum_CA DINH_Lim.DFC_ComMETCRingCnt_CA DINH_Lim.DFC_ComMETCTOut_CA DINH_Lim.DFC_ComMETDChksum_CA DINH_Lim.DFC_ComMETDRingCnt_CA DINH_Lim.DFC_ComMETDTOut_CA DINH_Lim.DFC_ComMETE2Chksum_CA DINH_Lim.DFC_ComMETE2RingCnt_CA DINH_Lim.DFC_ComMETE2TOut_CA DINH_Lim.DFC_ComMETFChksum_CA DINH_Lim.DFC_ComMETFRingCnt_CA DINH_Lim.DFC_ComMETFTOut_CA DINH_Lim.DFC_ComMETGChksum_CA DINH_Lim.DFC_ComMETGRingCnt_CA DINH_Lim.DFC_ComMETGTOut_CA DINH_Lim.DFC_ComMETH2Chksum_CA DINH_Lim.DFC_ComMETH2RingCnt_CA DINH_Lim.DFC_ComMETH2TOut_CA DINH_Lim.DFC_ComMETHChksum_CA DINH_Lim.DFC_ComMETHRingCnt_CA DINH_Lim.DFC_ComMETHTOut_CA DINH_Lim.DFC_ComMETIChksum_CA DINH_Lim.DFC_ComMETIRingCnt_CA DINH_Lim.DFC_ComMETITOut_CA DINH_Lim.DFC_ComMETKChksum_CA DINH_Lim.DFC_ComMETKRingCnt_CA DINH_Lim.DFC_ComMETKTOut_CA DINH_Lim.DFC_ComMETLChksum_CA DINH_Lim.DFC_ComMETLRingCnt_CA DINH_Lim.DFC_ComMETLTOut_CA DINH_Lim.DFC_ComMETMChksum_CA DINH_Lim.DFC_ComMETMRingCnt_CA DINH_Lim.DFC_ComMETMTOut_CA DINH_Lim.DFC_ComMETNChksum_CA DINH_Lim.DFC_ComMETNRingCnt_CA DINH_Lim.DFC_ComMETNTOut_CA DINH_Lim.DFC_ComMtrCom_CA DINH_Lim.DFC_ComPCUChkSum_CA DINH_Lim.DFC_ComPCURingCnt_CA DINH_Lim.DFC_ComPCUTOut_CA DINH_Lim.DFC_ComSRSAChksum_CA DINH_Lim.DFC_ComSRSARingCnt_CA DINH_Lim.DFC_ComSRSATOut_CA DINH_Lim.DFC_ComSRSBChksum_CA DINH_Lim.DFC_ComSRSBRingCnt_CA DINH_Lim.DFC_ComSRSBTOut_CA DINH_Lim.DFC_ComSRSChksum_CA DINH_Lim.DFC_ComSRSErr_CA DINH_Lim.DFC_ComSRSRingCnt_CA DINH_Lim.DFC_ComSRSTOut_CA DINH_Lim.DFC_ComVehSpdPndFltTCU_CA DINH_Lim.DFC_EbsChartcCurrErr_CA DINH_Lim.DFC_EbsSelfDiagErr_CA DINH_Lim.DFC_GEVlvPhaCsersIntkB1_CA DINH_Lim.DFC_GEVlvPhaPsOpenLoadIntkB1_CA DINH_Lim.DFC_GEVlvPhaPsShoToBattIntkB1_CA DINH_Lim.DFC_GEVlvPhaPsShoToGndIntkB1_CA DINH_Lim.DFC_GbxCANDigPlausErr_CA DINH_Lim.DFC_GbxNPos1SRCMax_CA DINH_Lim.DFC_GbxNPos1SRCMin_CA DINH_Lim.DFC_GbxNPos2SRCMax_CA DINH_Lim.DFC_GbxNPos2SRCMin_CA DINH_Lim.DFC_GbxNPosAlvChk_CA DINH_Lim.DFC_GbxNPosSyncErr_CA DINH_Lim.DFC_HEGOS2B1HtrPsMax_CA DINH_Lim.DFC_HEGOS2B1HtrPsMin_CA DINH_Lim.DFC_HEGOS2B1HtrPsSig_CA DINH_Lim.DFC_LinCSErrACG_CA DINH_Lim.DFC_LinCSErrAEV_CA DINH_Lim.DFC_LinCSErrDCDC_CA DINH_Lim.DFC_LinCSErrEBS_CA DINH_Lim.DFC_LinHdrTimeoutErrACG_CA DINH_Lim.DFC_LinHdrTimeoutErrAEV_CA DINH_Lim.DFC_LinHdrTimeoutErrDCDC_CA DINH_Lim.DFC_LinHdrTimeoutErrEBS_CA DINH_Lim.DFC_LinMsgTimeoutErrACG_CA DINH_Lim.DFC_LinMsgTimeoutErrAEV_CA DINH_Lim.DFC_LinMsgTimeoutErrDCDC_CA DINH_Lim.DFC_LinMsgTimeoutErrEBS_CA DINH_Lim.DFC_LinNoStrtComErr_CA DINH_Lim.DFC_LowPresOilP_CA DINH_Lim.DFC_MisfDetVWhlFrntLeOORHi_CA DINH_Lim.DFC_MisfDetVWhlFrntLeRatyHi_CA DINH_Lim.DFC_MisfDetVWhlFrntLeRatyLo_CA DINH_Lim.DFC_MisfDetVWhlFrntLeStuck_CA DINH_Lim.DFC_MisfDetVWhlFrntRiOORHi_CA DINH_Lim.DFC_MisfDetVWhlFrntRiRatyHi_CA DINH_Lim.DFC_MisfDetVWhlFrntRiRatyLo_CA DINH_Lim.DFC_MisfDetVWhlFrntRiStuck_CA DINH_Lim.DFC_MisfDetVWhlReLeOORHi_CA DINH_Lim.DFC_MisfDetVWhlReLeRatyHi_CA DINH_Lim.DFC_MisfDetVWhlReLeRatyLo_CA DINH_Lim.DFC_MisfDetVWhlReLeStuck_CA DINH_Lim.DFC_MisfDetVWhlReRiOORHi_CA DINH_Lim.DFC_MisfDetVWhlReRiRatyHi_CA DINH_Lim.DFC_MisfDetVWhlReRiRatyLo_CA DINH_Lim.DFC_MisfDetVWhlReRiStuck_CA DINH_Lim.DFC_MisfDetdVWhlFrntLePlaus_CA DINH_Lim.DFC_MisfDetdVWhlFrntRiPlaus_CA DINH_Lim.DFC_MisfDetdVWhlReLePlaus_CA DINH_Lim.DFC_MisfDetdVWhlReRiPlaus_CA DINH_Lim.DFC_PEnvSigRngMax_CA DINH_Lim.DFC_PEnvSigRngMin_CA DINH_Lim.DFC_StmFault_CA DINH_Lim.DFC_StrtCtOffPth_CA DINH_Lim.DFC_StrtCtlErr_CA DINH_Lim.DFC_StrtFault_CA DINH_Lim.DFC_StrtLckJudg1_CA DINH_Lim.DFC_StrtLckJudg2_CA DINH_Lim.DFC_StrtOL_CA DINH_Lim.DFC_StrtOL2_CA DINH_Lim.DFC_StrtSCB_CA DINH_Lim.DFC_StrtSCB2_CA DINH_Lim.DFC_StrtSCG_CA DINH_Lim.DFC_StrtSCG2_CA DINH_Lim.DFC_StrtStkRly1_CA DINH_Lim.DFC_StrtStkRly2_CA DINH_Lim.DFC_TEVEmax_CA DINH_Lim.DFC_TEVEmin_CA DINH_Lim.DFC_TEVEsig_CA DINH_Lim.DFC_UegoHeatrPrfmncLoS1B1_CA DINH_Lim.DFC_VehVAllPlaus_CA DINH_Lim.DFC_VehVNCSnsrElecFailr_CA DINH_Lim.DFC_VehVPlausCan_CA DINH_Lim.DFC_VehVPlausFco_CA DINH_Lim.DFC_VehVPlausPwr_CA DINH_Lim.DFC_VehVPlausV2N_CA DINH_Lim.DFC_VehVSpdSnsrAElecFailr_CA DINH_Lim.DFC_VehVSpdSnsrBElecFailr_CA DINH_Lim.DFC_ClthMax_CA DINH_Lim.DFC_IgnClPs_DevComErr_CA DINH_Lim.DFC_IgnClPs_LineOl_0_CA DINH_Lim.DFC_IgnClPs_LineOl_1_CA DINH_Lim.DFC_IgnClPs_LineOl_2_CA DINH_Lim.DFC_IgnClPs_LineOl_3_CA DINH_Lim.DFC_IgnClPs_LineScb_0_CA DINH_Lim.DFC_IgnClPs_LineScb_1_CA DINH_Lim.DFC_IgnClPs_LineScb_2_CA DINH_Lim.DFC_IgnClPs_LineScb_3_CA DINH_Lim.DFC_IgnClPs_LineScg_0_CA DINH_Lim.DFC_IgnClPs_LineScg_1_CA DINH_Lim.DFC_IgnClPs_LineScg_2_CA DINH_Lim.DFC_IgnClPs_LineScg_3_CA DINH_Lim.DFC_KRVEKOEVAB_CA DINH_Lim.DFC_KRVEKOEVAB0_CA DINH_Lim.DFC_KRVEKOEVAB1_CA DINH_Lim.DFC_KRVEKOEVAB2_CA DINH_Lim.DFC_KRVEKOEVAB3_CA DINH_Lim.DFC_UegoSigEcuAsicS1B1_CA DINH_Lim.DFC_UegoSigEcuComS1B1_CA DINH_Lim.DFC_UegoSigSnsrS1B1_CA DINH_Lim.DFC_UegoSigWireOlApesS1B1_CA DINH_Lim.DFC_UegoSigWireOlIpeS1B1_CA DINH_Lim.DFC_UegoSigWireOlReS1B1_CA DINH_Lim.DFC_UegoSigWireRCmpS1B1_CA DINH_Lim.DFC_UegoSigWireScbS1B1_CA DINH_Lim.DFC_UegoSigWireScgS1B1_CA DINH_Lim.DFC_AfsPhyRngHiB1_CA DINH_Lim.DFC_AfsPhyRngLoB1_CA DINH_Lim.DFC_AirCCmprOL_CA DINH_Lim.DFC_AirCCmprOvrTemp_CA DINH_Lim.DFC_AirCCmprSCB_CA DINH_Lim.DFC_AirCCmprSCG_CA DINH_Lim.DFC_AltErr_CA DINH_Lim.DFC_BattUSRCMax_CA DINH_Lim.DFC_BattUSRCMin_CA DINH_Lim.DFC_ComChksTCU1_CA DINH_Lim.DFC_ComChksTCU11_CA DINH_Lim.DFC_ComChksTCU12_CA DINH_Lim.DFC_ComChksTCU13_CA DINH_Lim.DFC_ComChksTCU2_CA DINH_Lim.DFC_ComChksTCU3_CA DINH_Lim.DFC_ComChksTCU4_CA DINH_Lim.DFC_ComCntTCU1_CA DINH_Lim.DFC_ComCntTCU11_CA DINH_Lim.DFC_ComCntTCU12_CA DINH_Lim.DFC_ComCntTCU13_CA DINH_Lim.DFC_ComCntTCU2_CA DINH_Lim.DFC_ComCntTCU3_CA DINH_Lim.DFC_ComCntTCU4_CA DINH_Lim.DFC_ComTOutTCU01_CA DINH_Lim.DFC_ComTOutTCU02_CA DINH_Lim.DFC_ComTOutTCU1_CA DINH_Lim.DFC_ComTOutTCU11_CA DINH_Lim.DFC_ComTOutTCU12_CA DINH_Lim.DFC_ComTOutTCU13_CA DINH_Lim.DFC_ComTOutTCU14_CA DINH_Lim.DFC_ComTOutTCU2_CA DINH_Lim.DFC_ComTOutTCU3_CA DINH_Lim.DFC_ComTOutTCU4_CA DINH_Lim.DFC_DevLibBattUHi_CA DINH_Lim.DFC_DevLibBattULo_CA DINH_Lim.DFC_EGRVlvFailSafeActv_CA DINH_Lim.DFC_EGRVlvGovDvtCld_CA DINH_Lim.DFC_EGRVlvPhysSRCMax_CA DINH_Lim.DFC_EGRVlvPhysSRCMin_CA DINH_Lim.DFC_FanDIOOL_0_CA DINH_Lim.DFC_FanDIOOL_1_CA DINH_Lim.DFC_FanDIOOvrTemp_0_CA DINH_Lim.DFC_FanDIOOvrTemp_1_CA DINH_Lim.DFC_FanDIOSCB_0_CA DINH_Lim.DFC_FanDIOSCB_1_CA DINH_Lim.DFC_FanDIOSCG_0_CA DINH_Lim.DFC_FanDIOSCG_1_CA DINH_Lim.DFC_MRlyDcOL_CA DINH_Lim.DFC_MRlyDcSCB_CA DINH_Lim.DFC_MRlyDcSCG_CA DINH_Lim.DFC_PSPOL_CA DINH_Lim.DFC_PSPOvrTemp_CA DINH_Lim.DFC_PSPSCB_CA DINH_Lim.DFC_PSPSCG_CA DINH_Lim.DFC_T50Err_CA DINH_Lim.DFC_ThrVlvLoBattB1_CA DINH_Lim.DFC_UegoSigOperPlausS1B1_CA DINH_Lim.DFC_VehVPhysRngHi_CA DINH_Lim.DFC_VehVSclOutOL_CA DINH_Lim.DFC_VehVSclOutOT_CA DINH_Lim.DFC_VehVSclOutSCB_CA DINH_Lim.DFC_VehVSclOutSCG_CA DINH_Lim.DFC_VehVSigFL_CA DINH_Lim.DFC_VehVSigFR_CA DINH_Lim.DFC_VehVSigRL_CA DINH_Lim.DFC_VehVSigRR_CA DINH_Lim.DFC_VehVSnsrARngHi_CA DINH_Lim.DFC_VehVSnsrBRngHi_CA DINH_Lim.DFC_VehVSpdRtyDiag_CA DINH_Lim.DFC_DHFHD_CA DINH_Lim.DFC_InjVlv_DI_DcDc_CA DINH_Lim.DFC_InjVlv_DI_NoLd_0_CA DINH_Lim.DFC_InjVlv_DI_NoLd_1_CA DINH_Lim.DFC_InjVlv_DI_NoLd_2_CA DINH_Lim.DFC_InjVlv_DI_NoLd_3_CA DINH_Lim.DFC_InjVlv_DI_ScBnk_0_CA DINH_Lim.DFC_InjVlv_DI_ScBnk_1_CA DINH_Lim.DFC_InjVlv_DI_ScBnk_2_CA DINH_Lim.DFC_InjVlv_DI_ScBnk_3_CA DINH_Lim.DFC_InjVlv_DI_ScCyl_0_CA DINH_Lim.DFC_InjVlv_DI_ScCyl_1_CA DINH_Lim.DFC_InjVlv_DI_ScCyl_2_CA DINH_Lim.DFC_InjVlv_DI_ScCyl_3_CA DINH_Lim.DFC_InjVlv_DI_ScHsLs_0_CA DINH_Lim.DFC_InjVlv_DI_ScHsLs_1_CA DINH_Lim.DFC_InjVlv_DI_ScHsLs_2_CA DINH_Lim.DFC_InjVlv_DI_ScHsLs_3_CA DINH_Lim.DFC_MfPsDiaOpenLoad1_CA DINH_Lim.DFC_MfPsDiaScHiS1_CA DINH_Lim.DFC_MfPsDiaScHiSLowS1_CA DINH_Lim.DFC_MfPsDiaScLowS1_CA DINH_Lim.DFC_ACEvpTPhysRngHi_CA DINH_Lim.DFC_ACEvpTPhysRngLo_CA DINH_Lim.DFC_ACEvpTSRCMax_CA DINH_Lim.DFC_ACEvpTSRCMin_CA DINH_Lim.DFC_AfsRawSigRngHiB1_CA DINH_Lim.DFC_AfsRawSigRngLoB1_CA DINH_Lim.DFC_AfsSnsrErrB1_CA DINH_Lim.DFC_AirCClntPAnaSRCMax_CA DINH_Lim.DFC_AirCClntPAnaSRCMin_CA DINH_Lim.DFC_AirCSwtNpl_CA DINH_Lim.DFC_AirCSwtSig_CA DINH_Lim.DFC_Brk_CA DINH_Lim.DFC_BrkBstSensSCB_CA DINH_Lim.DFC_BrkBstSensSCG_CA DINH_Lim.DFC_BrkSig_CA DINH_Lim.DFC_ClthSig_CA DINH_Lim.DFC_EGRVlvCurrLim_CA DINH_Lim.DFC_EGRVlvOL_CA DINH_Lim.DFC_EGRVlvOvrTemp_CA DINH_Lim.DFC_EGRVlvSCB_CA DINH_Lim.DFC_EGRVlvSCG_CA DINH_Lim.DFC_EGRVlvSRCMax_CA DINH_Lim.DFC_EGRVlvSRCMin_CA DINH_Lim.DFC_HLSDemOvhtEngLim_CA DINH_Lim.DFC_OilPSwmpSRCMax_CA DINH_Lim.DFC_OilPSwmpSRCMin_CA DINH_Lim.DFC_PIntkVUsLineHiB1_CA DINH_Lim.DFC_PIntkVUsLineLoB1_CA DINH_Lim.DFC_VehVPhysRngLo_CA DINH_Lim.DFC_VehVSigCan_CA DINH_Lim.DFC_VehVSigCanSafe_CA DINH_Lim.DFC_VlvLftFbOilPSnsrIntk11SRCMax_CA DINH_Lim.DFC_VlvLftFbOilPSnsrIntk11SRCMin_CA DINH_Lim.DFC_ClthNpl_CA DINH_Lim.DFC_GbxPNPosnDrvCdn_CA DINH_Lim.DFC_GbxPNPosnPlausy_CA DINH_Lim.DFC_AfsSigErrLineHiB1_CA DINH_Lim.DFC_AfsSigErrLineLoB1_CA DINH_Lim.DFC_PEnvCcMax_CA DINH_Lim.DFC_PEnvCcMin_CA DINH_Lim.DFC_PEnvRngChkMax_CA DINH_Lim.DFC_PEnvRngChkMin_CA DINH_Lim.DFC_PEnvSnsrPlaus_CA DINH_Lim.DFC_UEGOHeatrRlyPsOLS1B1_CA DINH_Lim.DFC_UEGOHeatrRlyPsSCBS1B1_CA DINH_Lim.DFC_UEGOHeatrRlyPsSCGS1B1_CA DINH_Lim.DFC_UegoHeatrWireOlS1B1_CA DINH_Lim.DFC_UegoHeatrWireScbS1B1_CA DINH_Lim.DFC_UegoHeatrWireScgS1B1_CA DINH_Lim.DFC_KnDetSens1PortAMax_CA DINH_Lim.DFC_KnDetSens1PortAMin_CA DINH_Lim.DFC_KnDetSens1PortBMax_CA DINH_Lim.DFC_KnDetSens1PortBMin_CA DINH_Lim.DFC_Clth2ONStuck_CA DINH_Lim.DFC_Clth2ONStuckLdc_CA DINH_Lim.DFC_Clth3ONStuckLdc_CA DINH_Lim.DFC_Clth3ONStuckPostDrv_CA DINH_Lim.DFC_Clth4ONStuck_CA DINH_Lim.DFC_Clth4ONStuckLdc_CA DINH_Lim.DFC_ComBCMUnit_CA DINH_Lim.DFC_ComDLCTCU01_CA DINH_Lim.DFC_ComDLCTCU02_CA DINH_Lim.DFC_ComDLCTCU1_CA DINH_Lim.DFC_ComDLCTCU11_CA DINH_Lim.DFC_ComDLCTCU12_CA DINH_Lim.DFC_ComDLCTCU13_CA DINH_Lim.DFC_ComDLCTCU14_CA DINH_Lim.DFC_ComDLCTCU2_CA DINH_Lim.DFC_ComDLCTCU3_CA DINH_Lim.DFC_ComDLCTCU4_CA DINH_Lim.DFC_ComEPSUnit_CA DINH_Lim.DFC_ComIDASBUnit_CA DINH_Lim.DFC_ComIMGUnit_CA DINH_Lim.DFC_ComMETUnit_CA DINH_Lim.DFC_ComSRSUnit_CA DINH_Lim.DFC_ComVSAUnit_CA DINH_Lim.DFC_EbsSocFlt_CA DINH_Lim.DFC_I14229VINErr_CA DINH_Lim.DFC_InjCatHeatgErr_CA DINH_Lim.DFC_InjSysMulInjDiagErr_CA DINH_Lim.DFC_LLRHmax_CA DINH_Lim.DFC_LLRHmin_CA DINH_Lim.DFC_LLRHnpl_CA DINH_Lim.DFC_LLRKHmax_CA DINH_Lim.DFC_LLRKHmin_CA DINH_Lim.DFC_LLRKHnpl_CA DINH_Lim.DFC_LinACGUnit_CA DINH_Lim.DFC_LinAEVUnit_CA DINH_Lim.DFC_LinEBSUnit_CA DINH_Lim.DFC_RoughRoad_CA DINH_Lim.DFC_SiaEEPRdErr_CA DINH_Lim.DFC_SiaEEPWrngCod_CA DINH_Lim.DFC_UegoHeatrStrtS1B1_CA DINH_Lim.DFC_BusDiagCANAPPLBusOff_CA DINH_Lim.DFC_BusDiagCANCANCBusOff_CA DINH_Lim.DFC_BusDiagCANVEHICLEBusOff_CA DINH_Lim.DFC_RBA_IODIAGPWR_rba_IoExtCy329_SignalVltSply_0_CA DINH_Lim.DFC_RBA_IODIAGPWR_rba_IoExtCy329_SignalVltSply_0OT_CA DINH_Lim.DFC_RBA_IODIAGPWR_rba_IoExtCy329_SignalVltSply_0OV_CA DINH_Lim.DFC_RBA_IODIAGPWR_rba_IoExtCy329_SignalVltSply_0SCG_CA DINH_Lim.DFC_RBA_IODIAGPWR_rba_IoExtCy329_SignalVltSply_0UV_CA DINH_Lim.DFC_RBA_IODIAGPWR_rba_IoExtCy329_SignalVltSply_1_CA DINH_Lim.DFC_RBA_IODIAGPWR_rba_IoExtCy329_SignalVltSply_1OT_CA DINH_Lim.DFC_RBA_IODIAGPWR_rba_IoExtCy329_SignalVltSply_1OV_CA DINH_Lim.DFC_RBA_IODIAGPWR_rba_IoExtCy329_SignalVltSply_1SCG_CA DINH_Lim.DFC_RBA_IODIAGPWR_rba_IoExtCy329_SignalVltSply_1UV_CA DINH_Lim.DFC_RBA_IODIAGPWR_rba_IoExtCy329_SignalVltSply_2_CA DINH_Lim.DFC_RBA_IODIAGPWR_rba_IoExtCy329_SignalVltSply_2OT_CA DINH_Lim.DFC_RBA_IODIAGPWR_rba_IoExtCy329_SignalVltSply_2OV_CA DINH_Lim.DFC_RBA_IODIAGPWR_rba_IoExtCy329_SignalVltSply_2SCG_CA DINH_Lim.DFC_RBA_IODIAGPWR_rba_IoExtCy329_SignalVltSply_2UV_CA DINH_Lim.DFC_CAN_E_TIMEOUT_CA DINH_Lim.DFC_LIN_E_TIMEOUT_CA DINH_Lim.DFC_MRlyOL_CA DINH_Lim.DFC_MRlySCB_CA DINH_Lim.DFC_MRlySCG_CA DINH_Lim.DFC_rba_MultiStackTrace_Threshold_CA DINH_Lim.DFC_BSWM_E_ACTION_FAILED_CA DINH_Lim.DFC_BSWM_E_INTRPTQUEUE_FULL_CA DINH_Lim.DFC_RBA_IOEXTLIB_KEEPALIVE_DRV_CA DINH_Lim.DFC_RBA_IOEXTLIB_KEEPALIVE_INI_CA DINH_Lim.DFC_rba_IoSigRtc_StopCounter_CA DINH_Lim.DFC_rba_MRly_Diag_Stk_Event_CA DINH_Lim.DFC_rba_MemDiag_MemReadErr_CA DINH_Lim.DFC_rba_MemDiag_MemWrErr_CA DINH_Lim.DFC_rba_SyC_IrrSwOffTrigEngRun_Event_CA DINH_Lim.DFC_rba_T15_Diag_ComInVld_Event_CA DINH_Lim.DFC_rba_T15_Diag_ComOff_HwOn_Event_CA DINH_Lim.DFC_rba_T15_Diag_ComOn_HwOff_Event_CA DINH_Lim.DFC_AAVmin_CA DINH_Lim.DFC_AGRSUS_CA DINH_Lim.DFC_AfsPlausDiagHi_CA DINH_Lim.DFC_AfsPlausDiagLo_CA DINH_Lim.DFC_AfsVrntDiagErrB1_CA DINH_Lim.DFC_AppAllSnsrDfct_CA DINH_Lim.DFC_BBKRnldg_CA DINH_Lim.DFC_BBKRsyne_CA DINH_Lim.DFC_BattUStdbyDiaOL_CA DINH_Lim.DFC_BigLeakIntkMnfldEmiInfl_CA DINH_Lim.DFC_BlkdLineTank_CA DINH_Lim.DFC_BrkMnSwtContOnWarnLmp_CA DINH_Lim.DFC_BrkMnSwtNotStpWarnLmp_CA DINH_Lim.DFC_BrkRdntSwtContOnWarnLmp_CA DINH_Lim.DFC_BrkRdntSwtNotStpWarnLmp_CA DINH_Lim.DFC_CEngDsTColdStrtMax_CA DINH_Lim.DFC_CEngDsTColdStrtMin_CA DINH_Lim.DFC_CEngDsTImps_CA DINH_Lim.DFC_CEngDsTPlausHSC_CA DINH_Lim.DFC_CEngDsTPlausLSC_CA DINH_Lim.DFC_CEngDsTPlausSTC_CA DINH_Lim.DFC_CEngDsTSRCMax_CA DINH_Lim.DFC_CEngDsTSRCMin_CA DINH_Lim.DFC_CEngDsTSig_CA DINH_Lim.DFC_CEngUsTColdStrtMax_CA DINH_Lim.DFC_CEngUsTColdStrtMin_CA DINH_Lim.DFC_CEngUsTLooseCnctn_CA DINH_Lim.DFC_CEngUsTSRCMax_CA DINH_Lim.DFC_CEngUsTSRCMin_CA DINH_Lim.DFC_ComDCDCACCFailr_CA DINH_Lim.DFC_DCDCFltDet_CA DINH_Lim.DFC_DKRSA_CA DINH_Lim.DFC_DKVSmax_CA DINH_Lim.DFC_DKnpl_CA DINH_Lim.DFC_DSKVRmax_CA DINH_Lim.DFC_DSKVRmin_CA DINH_Lim.DFC_DSKVRnpl_CA DINH_Lim.DFC_DSKVRsig_CA DINH_Lim.DFC_DSKVSsig_CA DINH_Lim.DFC_DSSmax_CA DINH_Lim.DFC_DSTDmax_CA DINH_Lim.DFC_DSTEmax_CA DINH_Lim.DFC_DSTEmin_CA DINH_Lim.DFC_DSTOFmax_CA DINH_Lim.DFC_DSTRmax_CA DINH_Lim.DFC_DSTRmin_CA DINH_Lim.DFC_DSTRnpl_CA DINH_Lim.DFC_DSTRsig_CA DINH_Lim.DFC_DSTTI_CA DINH_Lim.DFC_DSUmax_CA DINH_Lim.DFC_DiagCpv1DteskLoLoadStuckClsd_CA DINH_Lim.DFC_DiagCpv1DteskLoLoadStuckOpen_CA DINH_Lim.DFC_EGRVlvDrftClsd_CA DINH_Lim.DFC_EGRVlvDrftOpn_CA DINH_Lim.DFC_EGRVlvJamVlvClsd_CA DINH_Lim.DFC_EGRVlvJamVlvOpn_CA DINH_Lim.DFC_EGRVlvSprgBrk_CA DINH_Lim.DFC_EGRVlvTempMdlEEPErr_CA DINH_Lim.DFC_EGRVlvTmpErr_CA DINH_Lim.DFC_EGSDUS2B1LtrDly_CA DINH_Lim.DFC_EGSDUS2B1LtrPT1_CA DINH_Lim.DFC_EGSDUS2B1RtlDly_CA DINH_Lim.DFC_EGSDUS2B1RtlPT1_CA DINH_Lim.DFC_EGSDUS2B1TarLean_CA DINH_Lim.DFC_EGSDUS2B1TarRich_CA DINH_Lim.DFC_EONVmax_CA DINH_Lim.DFC_ETAKHLmax_CA DINH_Lim.DFC_ETAKHTmax_CA DINH_Lim.DFC_ETHSEmax_CA DINH_Lim.DFC_ETHSEmin_CA DINH_Lim.DFC_ETHSFmax_CA DINH_Lim.DFC_ETHSFmin_CA DINH_Lim.DFC_ETHSFsig_CA DINH_Lim.DFC_ETHSNPWmax_CA DINH_Lim.DFC_ETHSNPWmin_CA DINH_Lim.DFC_ETHSNPWsig_CA DINH_Lim.DFC_ETHSPLnpl_CA DINH_Lim.DFC_ETHSTPLnpl_CA DINH_Lim.DFC_EngICO_CA DINH_Lim.DFC_EngPrtOvrSpdMon_CA DINH_Lim.DFC_EpmCaSI1ErrSig_CA DINH_Lim.DFC_EpmCaSI1MntErr_CA DINH_Lim.DFC_EpmCaSI1NoSigMax_CA DINH_Lim.DFC_EpmCaSI1NoSigMin_CA DINH_Lim.DFC_EpmCaSI1OfsErr_CA DINH_Lim.DFC_EpmCrSDGI_CA DINH_Lim.DFC_EpmCrSErrSig_CA DINH_Lim.DFC_EpmCrSNoSig_CA DINH_Lim.DFC_EtaEngIdleNonCsers_CA DINH_Lim.DFC_EtaEngPtlNonCsers_CA DINH_Lim.DFC_FRAmax_CA DINH_Lim.DFC_FRAmin_CA DINH_Lim.DFC_FSTEmax_CA DINH_Lim.DFC_FSTEmin_CA DINH_Lim.DFC_FSTRmax_CA DINH_Lim.DFC_FSTRmin_CA DINH_Lim.DFC_FSTRnpl_CA DINH_Lim.DFC_FSTmax_CA DINH_Lim.DFC_FTDLAmax_CA DINH_Lim.DFC_FTDLAmin_CA DINH_Lim.DFC_FuPHiSnsrEleclmax_CA DINH_Lim.DFC_FuPHiSnsrEleclmin_CA DINH_Lim.DFC_FuPHiSnsrEleclnpl_CA DINH_Lim.DFC_FuPHiSnsrURngMax_CA DINH_Lim.DFC_FuPHiSnsrURngMin_CA DINH_Lim.DFC_FuSnsrPhyRngMaxErr_CA DINH_Lim.DFC_FuSnsrPhyRngMinErr_CA DINH_Lim.DFC_GEVlvLockPinDiagIntkB1_CA DINH_Lim.DFC_GEVlvPhaSlowIntkB1_CA DINH_Lim.DFC_GEVlvPhaTargIntkB1_CA DINH_Lim.DFC_GbxRvsSwtStk_CA DINH_Lim.DFC_HDRKHmax_CA DINH_Lim.DFC_HDRKHmin_CA DINH_Lim.DFC_HDRPLmax_CA DINH_Lim.DFC_HDRPLmin_CA DINH_Lim.DFC_HDRmax_CA DINH_Lim.DFC_HDRmin_CA DINH_Lim.DFC_HEGOS2B1ElecMax_CA DINH_Lim.DFC_HEGOS2B1ElecMin_CA DINH_Lim.DFC_HEGOS2B1ElecSig_CA DINH_Lim.DFC_HEGOS2B1HtgNpl_CA DINH_Lim.DFC_HEV00max_CA DINH_Lim.DFC_HEV01max_CA DINH_Lim.DFC_HEV02max_CA DINH_Lim.DFC_HEV03max_CA DINH_Lim.DFC_HEVE0max_CA DINH_Lim.DFC_HEVE1max_CA DINH_Lim.DFC_HFMmax_CA DINH_Lim.DFC_HiPSysHiPMaxLimExcdd_CA DINH_Lim.DFC_IVGdiCtlCvoErrMax_0_CA DINH_Lim.DFC_IVGdiCtlCvoErrMax_1_CA DINH_Lim.DFC_IVGdiCtlCvoErrMax_2_CA DINH_Lim.DFC_IVGdiCtlCvoErrMax_3_CA DINH_Lim.DFC_IVGdiCtlCvoErrMin_0_CA DINH_Lim.DFC_IVGdiCtlCvoErrMin_1_CA DINH_Lim.DFC_IVGdiCtlCvoErrMin_2_CA DINH_Lim.DFC_IVGdiCtlCvoErrMin_3_CA DINH_Lim.DFC_IVGdiCtlCvoErrMinMax_CA DINH_Lim.DFC_IVGdiCtlCvoSigPlausErrSmrCdn_CA DINH_Lim.DFC_IVGdiCtl_CvoErr_CA DINH_Lim.DFC_IVGdiCtl_CvoSigPlaus_0_CA DINH_Lim.DFC_IVGdiCtl_CvoSigPlaus_1_CA DINH_Lim.DFC_IVGdiCtl_CvoSigPlaus_2_CA DINH_Lim.DFC_IVGdiCtl_CvoSigPlaus_3_CA DINH_Lim.DFC_IntkAirTAirFltDsCrssMax_CA DINH_Lim.DFC_IntkAirTAirFltDsCrssMin_CA DINH_Lim.DFC_IntkAirTAirFltDsHSCMax_CA DINH_Lim.DFC_IntkAirTAirFltDsImps_CA DINH_Lim.DFC_IntkAirTAirFltDsPRCMax_CA DINH_Lim.DFC_IntkAirTAirFltDsPRCMin_CA DINH_Lim.DFC_IntkAirTAirFltDsSRCMax_CA DINH_Lim.DFC_IntkAirTAirFltDsSRCMin_CA DINH_Lim.DFC_IntkAirTAirFltDsSTC_CA DINH_Lim.DFC_IntkAirTIntkMnfldCrssMax_CA DINH_Lim.DFC_IntkAirTIntkMnfldCrssMin_CA DINH_Lim.DFC_IntkAirTIntkMnfldHSCMax_CA DINH_Lim.DFC_IntkAirTIntkMnfldImps_CA DINH_Lim.DFC_IntkAirTIntkMnfldPRCMax_CA DINH_Lim.DFC_IntkAirTIntkMnfldPRCMin_CA DINH_Lim.DFC_IntkAirTIntkMnfldSRCMax_CA DINH_Lim.DFC_IntkAirTIntkMnfldSRCMin_CA DINH_Lim.DFC_IntkAirTIntkMnfldSTC_CA DINH_Lim.DFC_KRREGRLMX_CA DINH_Lim.DFC_KRVEKOCVLCI_CA DINH_Lim.DFC_KRVEKOENCHMT_CA DINH_Lim.DFC_KRVEKOENCHMT0_CA DINH_Lim.DFC_KRVEKOENCHMT1_CA DINH_Lim.DFC_KRVEKOENCHMT2_CA DINH_Lim.DFC_KRVEKOENCHMT3_CA DINH_Lim.DFC_KRVEKOENCHMT4_CA DINH_Lim.DFC_KRVEKOENCHMT5_CA DINH_Lim.DFC_KRVEKOENCHMT6_CA DINH_Lim.DFC_KRVEKOENCHMT7_CA DINH_Lim.DFC_KRVEKORLMX_CA DINH_Lim.DFC_KRVEKORLMXL_CA DINH_Lim.DFC_KS1max_CA DINH_Lim.DFC_KS1min_CA DINH_Lim.DFC_LMmax_CA DINH_Lim.DFC_LZSRnpl_CA DINH_Lim.DFC_LamDynDiagS1B1_CA DINH_Lim.DFC_LeakIntkMnfldEmiInfl_CA DINH_Lim.DFC_LinFrameErrDCDC_CA DINH_Lim.DFC_LinOverrunErrDCDC_CA DINH_Lim.DFC_MD00max_CA DINH_Lim.DFC_MDBmax_CA DINH_Lim.DFC_MDCat_CA DINH_Lim.DFC_MDCatCrit_CA DINH_Lim.DFC_MDCatCurr_CA DINH_Lim.DFC_MDCyl_0_CA DINH_Lim.DFC_MDCyl_1_CA DINH_Lim.DFC_MDCyl_2_CA DINH_Lim.DFC_MDCyl_3_CA DINH_Lim.DFC_MDEmi_CA DINH_Lim.DFC_MDEmiStrt_CA DINH_Lim.DFC_MDFco_CA DINH_Lim.DFC_MDMpl_CA DINH_Lim.DFC_MDSegTiAdpn_CA DINH_Lim.DFC_MDmax_CA DINH_Lim.DFC_MFuOilMax_CA DINH_Lim.DFC_MOXEMM_SMU_ALM0_0_CA DINH_Lim.DFC_MOXEMM_SMU_ALM0_1_CA DINH_Lim.DFC_MOXEMM_SMU_ALM0_10_CA DINH_Lim.DFC_MOXEMM_SMU_ALM0_11_CA DINH_Lim.DFC_MOXEMM_SMU_ALM0_13_CA DINH_Lim.DFC_MOXEMM_SMU_ALM0_14_CA DINH_Lim.DFC_MOXEMM_SMU_ALM0_2_CA DINH_Lim.DFC_MOXEMM_SMU_ALM0_22_CA DINH_Lim.DFC_MOXEMM_SMU_ALM0_23_CA DINH_Lim.DFC_MOXEMM_SMU_ALM0_4_CA DINH_Lim.DFC_MOXEMM_SMU_ALM0_5_CA DINH_Lim.DFC_MOXEMM_SMU_ALM0_7_CA DINH_Lim.DFC_MOXEMM_SMU_ALM0_8_CA DINH_Lim.DFC_MOXEMM_SMU_ALM10_16_CA DINH_Lim.DFC_MOXEMM_SMU_ALM10_17_CA DINH_Lim.DFC_MOXEMM_SMU_ALM10_21_CA DINH_Lim.DFC_MOXEMM_SMU_ALM11_0_CA DINH_Lim.DFC_MOXEMM_SMU_ALM11_1_CA DINH_Lim.DFC_MOXEMM_SMU_ALM11_2_CA DINH_Lim.DFC_MOXEMM_SMU_ALM11_3_CA DINH_Lim.DFC_MOXEMM_SMU_ALM11_4_CA DINH_Lim.DFC_MOXEMM_SMU_ALM11_5_CA DINH_Lim.DFC_MOXEMM_SMU_ALM11_8_CA DINH_Lim.DFC_MOXEMM_SMU_ALM11_9_CA DINH_Lim.DFC_MOXEMM_SMU_ALM1_0_CA DINH_Lim.DFC_MOXEMM_SMU_ALM1_1_CA DINH_Lim.DFC_MOXEMM_SMU_ALM1_10_CA DINH_Lim.DFC_MOXEMM_SMU_ALM1_11_CA DINH_Lim.DFC_MOXEMM_SMU_ALM1_13_CA DINH_Lim.DFC_MOXEMM_SMU_ALM1_14_CA DINH_Lim.DFC_MOXEMM_SMU_ALM1_2_CA DINH_Lim.DFC_MOXEMM_SMU_ALM1_22_CA DINH_Lim.DFC_MOXEMM_SMU_ALM1_23_CA DINH_Lim.DFC_MOXEMM_SMU_ALM1_4_CA DINH_Lim.DFC_MOXEMM_SMU_ALM1_5_CA DINH_Lim.DFC_MOXEMM_SMU_ALM1_7_CA DINH_Lim.DFC_MOXEMM_SMU_ALM1_8_CA DINH_Lim.DFC_MOXEMM_SMU_ALM21_0_CA DINH_Lim.DFC_MOXEMM_SMU_ALM21_16_CA DINH_Lim.DFC_MOXEMM_SMU_ALM21_3_CA DINH_Lim.DFC_MOXEMM_SMU_ALM2_1_CA DINH_Lim.DFC_MOXEMM_SMU_ALM2_10_CA DINH_Lim.DFC_MOXEMM_SMU_ALM2_11_CA DINH_Lim.DFC_MOXEMM_SMU_ALM2_13_CA DINH_Lim.DFC_MOXEMM_SMU_ALM2_14_CA DINH_Lim.DFC_MOXEMM_SMU_ALM2_22_CA DINH_Lim.DFC_MOXEMM_SMU_ALM2_23_CA DINH_Lim.DFC_MOXEMM_SMU_ALM2_4_CA DINH_Lim.DFC_MOXEMM_SMU_ALM2_5_CA DINH_Lim.DFC_MOXEMM_SMU_ALM2_7_CA DINH_Lim.DFC_MOXEMM_SMU_ALM2_8_CA DINH_Lim.DFC_MOXEMM_SMU_ALM6_0_CA DINH_Lim.DFC_MOXEMM_SMU_ALM6_11_CA DINH_Lim.DFC_MOXEMM_SMU_ALM6_12_CA DINH_Lim.DFC_MOXEMM_SMU_ALM6_14_CA DINH_Lim.DFC_MOXEMM_SMU_ALM6_15_CA DINH_Lim.DFC_MOXEMM_SMU_ALM6_17_CA DINH_Lim.DFC_MOXEMM_SMU_ALM6_18_CA DINH_Lim.DFC_MOXEMM_SMU_ALM6_20_CA DINH_Lim.DFC_MOXEMM_SMU_ALM6_21_CA DINH_Lim.DFC_MOXEMM_SMU_ALM6_25_CA DINH_Lim.DFC_MOXEMM_SMU_ALM6_4_CA DINH_Lim.DFC_MOXEMM_SMU_ALM6_5_CA DINH_Lim.DFC_MOXEMM_SMU_ALM6_7_CA DINH_Lim.DFC_MOXEMM_SMU_ALM6_8_CA DINH_Lim.DFC_MOXEMM_SMU_ALM7_1_CA DINH_Lim.DFC_MOXEMM_SMU_ALM7_12_CA DINH_Lim.DFC_MOXEMM_SMU_ALM7_13_CA DINH_Lim.DFC_MOXEMM_SMU_ALM7_14_CA DINH_Lim.DFC_MOXEMM_SMU_ALM7_15_CA DINH_Lim.DFC_MOXEMM_SMU_ALM7_16_CA DINH_Lim.DFC_MOXEMM_SMU_ALM7_17_CA DINH_Lim.DFC_MOXEMM_SMU_ALM7_2_CA DINH_Lim.DFC_MOXEMM_SMU_ALM7_20_CA DINH_Lim.DFC_MOXEMM_SMU_ALM7_25_CA DINH_Lim.DFC_MOXEMM_SMU_ALM7_26_CA DINH_Lim.DFC_MOXEMM_SMU_ALM7_28_CA DINH_Lim.DFC_MOXEMM_SMU_ALM7_29_CA DINH_Lim.DFC_MOXEMM_SMU_ALM7_30_CA DINH_Lim.DFC_MOXEMM_SMU_ALM7_31_CA DINH_Lim.DFC_MOXEMM_SMU_ALM8_0_CA DINH_Lim.DFC_MOXEMM_SMU_ALM8_1_CA DINH_Lim.DFC_MOXEMM_SMU_ALM8_10_CA DINH_Lim.DFC_MOXEMM_SMU_ALM8_11_CA DINH_Lim.DFC_MOXEMM_SMU_ALM8_12_CA DINH_Lim.DFC_MOXEMM_SMU_ALM8_16_CA DINH_Lim.DFC_MOXEMM_SMU_ALM8_18_CA DINH_Lim.DFC_MOXEMM_SMU_ALM8_2_CA DINH_Lim.DFC_MOXEMM_SMU_ALM8_3_CA DINH_Lim.DFC_MOXEMM_SMU_ALM8_31_CA DINH_Lim.DFC_MOXEMM_SMU_ALM8_4_CA /end DEF_CHARACTERISTIC
 FUNCTION_VERSION "30000.27.0_1.0.0" /end FUNCTION
/begin COMPU_METHOD DINH_LimDFCVerb "" TAB_VERB "%6.3" "-" COMPU_TAB_REF DINH_LimDFCVerb /end COMPU_METHOD
/begin COMPU_VTAB DINH_LimDFCVerb "" TAB_VERB 18 0 "No_Inhibit" 1 "Def50_Deb100" 2 "Def100_Deb100" 3 "Def50_Deb100_Tst" 4 "Def100_Deb100_Tst" 5 "Def50_Deb100_or_NTst" 6 "Def100_Deb100_or_NTst" 7 "Tested" 8 "NotTested" 9 "Def100_Deb0" 10 "Def50_Deb0" 11 "Def25_Deb0" 12 "Def0_Deb0" 13 "Def50_Deb100_Tst_Trip" 14 "Def100_Deb100_Tst_Trip" 15 "Def50_Deb100_MILOn" 16 "Def50_Deb100_Trip" 17 "Def100_Deb100_Trip" /end COMPU_VTAB
/begin RECORD_LAYOUT ValA_Wu8 FNC_VALUES 1 UBYTE COLUMN_DIR DIRECT /end RECORD_LAYOUT
/end MODULE
/end PROJECT
