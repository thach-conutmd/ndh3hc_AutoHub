ASAP2_VERSION 1 60
/begin PROJECT MG1CS022 "MG1CS022"
/begin HEADER "" VERSION "MG1CS022_62XSC_V037_TPROT" PROJECT_NO MG1CS022 /end HEADER
/begin MODULE DIM ""
/begin MOD_COMMON "" BYTE_ORDER MSB_LAST ALIGNMENT_BYTE 1 ALIGNMENT_WORD 2 ALIGNMENT_LONG 4 ALIGNMENT_INT64 4 ALIGNMENT_FLOAT32_IEEE 4 ALIGNMENT_FLOAT64_IEEE 4 DATA_SIZE 32 /end MOD_COMMON
/begin CHARACTERISTIC ThrVlv_ATS.LimitTypeMsk_C "Actuator test ThrVlv_ATS / Tester demand monitoring enable mask for actuators" VALUE 0x8058A86C Val_Wu8 255.0 OneToOne 0.00 255.0 FORMAT "%5.1" /end CHARACTERISTIC
/begin CHARACTERISTIC ThrVlv_ATS.CnvNorm_C "Actuator test ThrVlv_ATS / Conversion norm used for conversion to/from internal scaling" VALUE 0x8058A86D Val_Wu8 255.0 OneToOne 0.00 255.0 FORMAT "%5.1" /end CHARACTERISTIC
/begin CHARACTERISTIC ThrVlv_ATS.LowLim_C "Actuator test ThrVlv_ATS / Lower limit for monitoring" VALUE 0x8058A86E Val_Ws16 511.9922 rel_q0p0078125 -256.0000 255.9922 FORMAT "%8.4" /end CHARACTERISTIC
/begin CHARACTERISTIC ThrVlv_ATS.UpLim_C "Actuator test ThrVlv_ATS / Upper limit for monitoring" VALUE 0x8058A870 Val_Ws16 511.9922 rel_q0p0078125 -256.0000 255.9922 FORMAT "%8.4" /end CHARACTERISTIC
/begin CHARACTERISTIC ThrVlv_ATS.CnvFac_C "Actuator test ThrVlv_ATS / Factor used for conversion to/from internal scaling" VALUE 0x8058A874 Val_Ws32 4294967295.00 OneToOne -2147483648.00 2147483647.00 FORMAT "%13.2" /end CHARACTERISTIC
/begin CHARACTERISTIC ThrVlv_ATS.CnvOfs_C "Actuator test ThrVlv_ATS / Offset used for conversion to/from internal scaling" VALUE 0x8058A878 Val_Ws16 65535.00 OneToOne -32768.00 32767.00 FORMAT "%8.2" /end CHARACTERISTIC
/begin CHARACTERISTIC ThrVlv_ATS.DfltVal_C "Actuator test ThrVlv_ATS / Default value for standbytest" VALUE 0x8058A87A Val_Ws16 65535.00 OneToOne -32768.00 32767.00 FORMAT "%8.2" /end CHARACTERISTIC
/begin CHARACTERISTIC ThrVlv_IfDetLimpAirPosnRegnB1_I.dUIntglSldgModLhp_CUR "interface class for detection of the limp air position, bank 1 / gain of integral part at limp air postion" CURVE 0x80505754 Cur_Xs16Ws16 1638.350 RBPtCel_du_0p05_1 0.00 1638.350 FORMAT "%8.3" EXTENDED_LIMITS -1638.400 1638.350
 /begin AXIS_DESCR STD_AXIS NO_INPUT_QUANTITY rel_q0p0078125 4 -256.0000 255.9922 FORMAT "%8.4" DEPOSIT ABSOLUTE /end AXIS_DESCR
/end CHARACTERISTIC
/begin CHARACTERISTIC ThrVlv_IfDetLimpAirPosnRegnB1_I.facCtrlIntglLimpAirPosn_C "interface class for detection of the limp air position, bank 1 / gain of i part at limp air postion" VALUE 0x80505766 Val_Wu16 655.3500 fak_q0p01 0.00 655.3500 FORMAT "%8.4" /end CHARACTERISTIC
/begin CHARACTERISTIC ThrVlv_IfDetLimpAirPosnRegnB1_I.facCtrlSldgModLhp_C "interface class for detection of the limp air position, bank 1 / gain of the proportional derivative controller at limp air postion" VALUE 0x80505768 Val_Ws16 65.53500 Fact1000 -32.76800 32.76700 FORMAT "%8.5" /end CHARACTERISTIC
/begin CHARACTERISTIC ThrVlv_IfDetLimpAirPosnRegnB1_I.ratDeCtrlrThdLhpStuckDetn_C "interface class for detection of the limp air position, bank 1 / threshold control deviation to detect a stuck valve at limp home position" VALUE 0x8050576A Val_Ws16 511.9922 rel_q0p0078125 -256.0000 255.9922 FORMAT "%8.4" /end CHARACTERISTIC
/begin CHARACTERISTIC ThrVlv_IfDetLimpAirPosnRegnB1_I.ratDeLimpAirPosn_C "interface class for detection of the limp air position, bank 1 / distance between trajectory to the limp air position" VALUE 0x8050576C Val_Ws16 511.9922 rel_q0p0078125 -256.0000 255.9922 FORMAT "%8.4" /end CHARACTERISTIC
/begin CHARACTERISTIC ThrVlv_IfDetLimpAirPosnRegnB1_I.ratLimpAirPosnBand_C "interface class for detection of the limp air position, bank 1 / band around limp air position area" VALUE 0x8050576E Val_Wu16 511.9844 rel_q0p0078125 0.0078 511.9922 FORMAT "%8.4" EXTENDED_LIMITS 0.00 511.9922 /end CHARACTERISTIC
/begin CHARACTERISTIC ThrVlv_IfDetLimpAirPosnRegnB1_I.uDifOpngSprg_C "interface class for detection of the limp air position, bank 1 / differential voltage between the feedforward of the upper and the lower spring" VALUE 0x80505770 Val_Ws32 1677721.59961 spg_q0p00039 -838860.800000 838860.799609 FORMAT "%13.6" /end CHARACTERISTIC
/begin CHARACTERISTIC ThrVlv_IfDetLimpAirPosnRegnB1_I.uMinOpngSprg_C "interface class for detection of the limp air position, bank 1 / maximum differential voltage between the feedforward of the upper and the lower spring" VALUE 0x80505774 Val_Ws32 1677721.59961 spg_q0p00039 -838860.800000 838860.799609 FORMAT "%13.6" /end CHARACTERISTIC
/begin CHARACTERISTIC ThrVlv_IfDiagB1_I.dRatDesPreCtrlGrdtThd_C "interface class diagnosis, bank1 / threshold for gradient of the trajectory to release duty cycle diagnosis" VALUE 0x80505778 Val_Ws16 511992.2 relgrd_q7p8125 -256000.0 255992.2 FORMAT "%8.1" /end CHARACTERISTIC
/begin CHARACTERISTIC ThrVlv_IfDiagB1_I.facDeCtrlTolr_C "interface class diagnosis, bank1 / factor for allowed control deviation" VALUE 0x8050577A Val_Wu16 65.53500 Fact1000 0.00 65.53500 FORMAT "%8.5" /end CHARACTERISTIC
/begin CHARACTERISTIC ThrVlv_IfDiagB1_I.facDiagHeal_C "interface class diagnosis, bank1 / healing factor" VALUE 0x8050577C Val_Wu16 31.49951 fak_q0p000488 0.50000 31.99951 FORMAT "%8.5" EXTENDED_LIMITS 0.00 31.99951 /end CHARACTERISTIC
/begin CHARACTERISTIC ThrVlv_IfDiagB1_I.ratDeCtrlTolrMin_C "interface class diagnosis, bank1 / allowed control deviation in steady state" VALUE 0x8050577E Val_Wu16 255.9922 rel_q0p0078125 0.00 255.9922 FORMAT "%8.4" EXTENDED_LIMITS 0.00 511.9922 /end CHARACTERISTIC
/begin CHARACTERISTIC ThrVlv_IfDiagB1_I.ratDutyCycDiagMaxLoBatt_C "interface class diagnosis, bank1 / upper threshold for duty cycle diagnosis in case of low battery voltage" VALUE 0x80505780 Val_Ws16 511.9922 rel_q0p0078125 -256.0000 255.9922 FORMAT "%8.4" /end CHARACTERISTIC
/begin CHARACTERISTIC ThrVlv_IfDiagB1_I.ratDutyCycDiagMax_C "interface class diagnosis, bank1 / upper threshold for duty cycle diagnosis" VALUE 0x80505782 Val_Ws16 511.9922 rel_q0p0078125 -256.0000 255.9922 FORMAT "%8.4" /end CHARACTERISTIC
/begin CHARACTERISTIC ThrVlv_IfDiagB1_I.ratOffsTestMax_C "interface class diagnosis, bank1 / upper threshold for cycle flag" VALUE 0x80505784 Val_Ws16 255.9922 rel_q0p0078125 0.00 255.9922 FORMAT "%8.4" EXTENDED_LIMITS -256.0000 255.9922 /end CHARACTERISTIC
/begin CHARACTERISTIC ThrVlv_IfDiagB1_I.ratOffsTestMin_C "interface class diagnosis, bank1 / lower threshold for cycle flag" VALUE 0x80505786 Val_Ws16 255.9922 rel_q0p0078125 0.00 255.9922 FORMAT "%8.4" EXTENDED_LIMITS -256.0000 255.9922 /end CHARACTERISTIC
/begin CHARACTERISTIC ThrVlv_IfDiagB1_I.tiCtrlDeMax_C "interface class diagnosis, bank1 / maximum debounce time control deviation" VALUE 0x80505788 Val_Wu16 31.99951 t_tev0p0005 0.00 31.99951 FORMAT "%8.5" /end CHARACTERISTIC
/begin CHARACTERISTIC ThrVlv_IfDiagB1_I.tiDutyCycExcd_C "interface class diagnosis, bank1 / maximum debounce time duty cycle" VALUE 0x8050578A Val_Wu16 31.99951 t_tev0p0005 0.00 31.99951 FORMAT "%8.5" /end CHARACTERISTIC
/begin CHARACTERISTIC ThrVlv_IfExtdPostDrvB1_I.tiExtdPostDrv_C "interface class postdrive prolongation / time for postdrive prolongation" VALUE 0x8050578C Val_Wu16 33.34912 RBPtCel_ti_5p12em4_1 0.20480 33.55392 FORMAT "%8.5" EXTENDED_LIMITS 0.00 33.55392 /end CHARACTERISTIC
/begin CHARACTERISTIC ThrVlv_IfLimpAirPosnChkB1_I.ratOffsLimpAirPosnNotRea_C "interface class check for reaching of limp air position, bank 1 / tolerance for reaching of limp air position" VALUE 0x8050578E Val_Ws16 255.9922 rel_q0p0078125 0.00 255.9922 FORMAT "%8.4" EXTENDED_LIMITS -256.0000 255.9922 /end CHARACTERISTIC
/begin CHARACTERISTIC ThrVlv_IfLimpAirPosnChkB1_I.tiToReaLimpAirPosn_C "interface class check for reaching of limp air position, bank 1 / allowed time to reach limp air position" VALUE 0x80505790 Val_Wu16 33.55392 RBPtCel_ti_5p12em4_1 0.00 33.55392 FORMAT "%8.5" /end CHARACTERISTIC
/begin CHARACTERISTIC ThrVlv_IfLimpHomeSubB1_I.stMask_C "Interface class: Replacement values for the limp air position / Codeword mask for LImpHomeSub method" VALUE 0x805059D0 Val_Wu8 255.0 OneToOne 0.00 255.0 FORMAT "%5.1" /end CHARACTERISTIC
/begin CHARACTERISTIC ThrVlv_IfMainFillgCompB1_I.nMinForChrgComp_C "Interface class: Parameter for sensor comparison with main load sensor / Required engine speed for sensor comparison with main charge sensor" VALUE 0x805059D2 Val_Ws16 32767.50 EngN -16384.00 16383.50 FORMAT "%8.2" /end CHARACTERISTIC
/begin CHARACTERISTIC ThrVlv_IfMainFillgCompB1_I.ratSens1ChrgMaxDe_C "Interface class: Parameter for sensor comparison with main load sensor / Maximal allowed deviation between throttle sensor 1 and main charge sensor" VALUE 0x805059D4 Val_Ws16 511.9922 rel_q0p0078125 -256.0000 255.9922 FORMAT "%8.4" /end CHARACTERISTIC
/begin CHARACTERISTIC ThrVlv_IfMainFillgCompB1_I.ratSens2ChrgMaxDe_C "Interface class: Parameter for sensor comparison with main load sensor / Maximal allowed deviation between throttle sensor 2 and main charge sensor" VALUE 0x805059D6 Val_Ws16 511.9922 rel_q0p0078125 -256.0000 255.9922 FORMAT "%8.4" /end CHARACTERISTIC
/begin CHARACTERISTIC ThrVlv_IfMainFillgCompB1_I.tiDebMaiChrgSensErr_C "Interface class: Parameter for sensor comparison with main load sensor / Debounce time: Main charge sensor error" VALUE 0x805059D8 Val_Wu8 2.550 t10msxs_ub_b2p55 0.00 2.550 FORMAT "%5.3" /end CHARACTERISTIC
/begin CHARACTERISTIC ThrVlv_IfMainFillgCompB1_I.tiDebSens1ChrgSyncErr_C "Interface class: Parameter for sensor comparison with main load sensor / Debounce time for maximal deviation between throttle sensor 1 and main load sensor" VALUE 0x805059D9 Val_Wu8 2.550 t10msxs_ub_b2p55 0.00 2.550 FORMAT "%5.3" /end CHARACTERISTIC
/begin CHARACTERISTIC ThrVlv_IfMainFillgCompB1_I.tiDebSens2ChrgSyncErr_C "Interface class: Parameter for sensor comparison with main load sensor / Debounce time for maximal deviation between throttle sensor 2 and main load sensor" VALUE 0x805059DA Val_Wu8 2.550 t10msxs_ub_b2p55 0.00 2.550 FORMAT "%5.3" /end CHARACTERISTIC
/begin CHARACTERISTIC ThrVlv_IfMainFillgCompB1_I.tiDlySensSel_C "Interface class: Parameter for sensor comparison with main load sensor / Time for active comparison of the throttle sensors with the main charge sensor" VALUE 0x805059DB Val_Wu8 2.550 t10msxs_ub_b2p55 0.00 2.550 FORMAT "%5.3" /end CHARACTERISTIC
/begin CHARACTERISTIC ThrVlv_IfMainFillgCompB1_I.tiFildCompChrg_CUR "Interface class: Parameter for sensor comparison with main load sensor / Engine speed dependent time constant for filtering of the throttle valve angles" CURVE 0x805059DC Cur_Xs16Ws16 327.6600 Time_s 0.0100 327.6700 FORMAT "%8.4" EXTENDED_LIMITS -327.6800 327.6700
 /begin AXIS_DESCR STD_AXIS NO_INPUT_QUANTITY EngN 6 -16384.00 16383.50 FORMAT "%8.2" DEPOSIT ABSOLUTE /end AXIS_DESCR
/end CHARACTERISTIC
/begin CHARACTERISTIC ThrVlv_IfPwrSaveB1_I.ratDeCtrlrThd_C "interface class powersave / threshold for control deviation" VALUE 0x80505792 Val_Ws16 511.9922 rel_q0p0078125 -256.0000 255.9922 FORMAT "%8.4" /end CHARACTERISTIC
/begin CHARACTERISTIC ThrVlv_IfPwrSaveB1_I.ratDesThdOffs_C "interface class powersave / threshold of desired value" VALUE 0x80505794 Val_Ws16 511.9922 rel_q0p0078125 -256.0000 255.9922 FORMAT "%8.4" /end CHARACTERISTIC
/begin CHARACTERISTIC ThrVlv_IfPwrSaveB1_I.swtPosnCdnOpen_C "interface class powersave / position condition of powersave set to open position" VALUE 0x80505796 Val_Wu8 1.000 OneToOne 0.00 1.000 FORMAT "%5.3" EXTENDED_LIMITS 0.00 255.0 /end CHARACTERISTIC
/begin CHARACTERISTIC ThrVlv_IfPwrSaveB1_I.swtWakeup_C "interface class powersave / enable switch for wake up in postdrive" VALUE 0x80505797 Val_Wu8 1.000 OneToOne 0.00 1.000 FORMAT "%5.3" EXTENDED_LIMITS 0.00 255.0 /end CHARACTERISTIC
/begin CHARACTERISTIC ThrVlv_IfPwrSaveB1_I.tiPwrSave_C "interface class powersave / time delay until power save" VALUE 0x80505798 Val_Wu16 33.45152 RBPtCel_ti_5p12em4_1 0.10240 33.55392 FORMAT "%8.5" EXTENDED_LIMITS 0.00 33.55392 /end CHARACTERISTIC
/begin CHARACTERISTIC ThrVlv_IfRampDwnB1_I.ratOffsBtwVal_C "interface class drive to lower stop by ramping / offset for between value" VALUE 0x8050579A Val_Ws16 511.9922 rel_q0p0078125 -256.0000 255.9922 FORMAT "%8.4" /end CHARACTERISTIC
/begin CHARACTERISTIC ThrVlv_IfRampDwnB1_I.ratStepSize_C "interface class drive to lower stop by ramping / step size" VALUE 0x8050579C Val_Ws16 511.9922 rel_q0p0078125 -256.0000 255.9922 FORMAT "%8.4" /end CHARACTERISTIC
/begin CHARACTERISTIC ThrVlv_IfRampDwnB1_I.ratStrtPosn_C "interface class drive to lower stop by ramping / start position" VALUE 0x8050579E Val_Ws16 511.9922 rel_q0p0078125 -256.0000 255.9922 FORMAT "%8.4" /end CHARACTERISTIC
/begin CHARACTERISTIC ThrVlv_IfRampDwnB1_I.swtRampDwnEna_C "interface class drive to lower stop by ramping / enable switch" VALUE 0x805057A0 Val_Wu8 1.000 OneToOne 0.00 1.000 FORMAT "%5.3" EXTENDED_LIMITS 0.00 255.0 /end CHARACTERISTIC
/begin CHARACTERISTIC ThrVlv_IfSens2B1_I.ratMaxSensDe_CUR "Interface class: sensor 2 available / Maximal allowed throttle angle deviation" CURVE 0x805059F6 Cur_Xs16Ws16 511.9922 rel_q0p0078125 -256.0000 255.9922 FORMAT "%8.4"
 /begin AXIS_DESCR STD_AXIS NO_INPUT_QUANTITY rel_q0p0078125 5 -256.0000 255.9922 FORMAT "%8.4" DEPOSIT ABSOLUTE /end AXIS_DESCR
/end CHARACTERISTIC
/begin CHARACTERISTIC ThrVlv_IfSens2B1_I.tiDebSens1Sens2SyncErr_C "Interface class: sensor 2 available / Debounce time for synchronization error between ETB sensor 1 and sensor 2" VALUE 0x80505A0C Val_Wu8 2.550 t10msxs_ub_b2p55 0.00 2.550 FORMAT "%5.3" /end CHARACTERISTIC
/begin CHARACTERISTIC ThrVlv_IfSens2B1_I.tiDebSens2Err_C "Interface class: sensor 2 available / Debounce time for ETB sensor 2 error" VALUE 0x80505A0D Val_Wu8 2.550 t10msxs_ub_b2p55 0.00 2.550 FORMAT "%5.3" /end CHARACTERISTIC
/begin CHARACTERISTIC ThrVlv_IfSens2B1_I.uSens2Max_C "Interface class: sensor 2 available / Upper diagnosis threshold sensor 2" VALUE 0x80505A0E Val_Wu16 79.99878 spg_q1p221Em3_V 0.00 79.99878 FORMAT "%8.5" /end CHARACTERISTIC
/begin CHARACTERISTIC ThrVlv_IfSens2B1_I.uSens2Min_C "Interface class: sensor 2 available / Lower diagnosis threshold sensor 2" VALUE 0x80505A10 Val_Wu16 79.99878 spg_q1p221Em3_V 0.00 79.99878 FORMAT "%8.5" /end CHARACTERISTIC
/begin CHARACTERISTIC ThrVlv_IfSens2B1_I.uVltgOffs_C "Interface class: sensor 2 available / Voltage offset for Visteon ETB" VALUE 0x80505A12 Val_Wu16 79.99878 spg_q1p221_mV 0.00 79.99878 FORMAT "%8.5" /end CHARACTERISTIC
/begin CHARACTERISTIC ThrVlv_IfSens2B1_I.uVltgSlop_C "Interface class: sensor 2 available / Slope for Visteon ETB" VALUE 0x80505A14 Val_Wu16 79.99878 spg_q1p221_mV 0.00 79.99878 FORMAT "%8.5" /end CHARACTERISTIC
/begin CHARACTERISTIC ThrVlv_IfSens2B1_I.uVltgThd_C "Interface class: sensor 2 available / Threshold for switching over between the throttle characteristic sensor curves for Visteon ETB" VALUE 0x80505A16 Val_Wu16 79.99878 spg_q1p221_mV 0.00 79.99878 FORMAT "%8.5" /end CHARACTERISTIC
/begin CHARACTERISTIC ThrVlv_IfSoftLdgB1_I.dRadSpdLimDecel_C "instance of the interface class softlanding / speed limit for deceleration" VALUE 0x805057A2 Val_Ws16 1023.984 q0p01562_rad_DIV_s -512.0000 511.9844 FORMAT "%8.4" /end CHARACTERISTIC
/begin CHARACTERISTIC ThrVlv_IfSoftLdgB1_I.dRadSpdLimSoftLdg_C "instance of the interface class softlanding / speed limit for softlanding" VALUE 0x805057A4 Val_Ws16 1023.984 q0p01562_rad_DIV_s -512.0000 511.9844 FORMAT "%8.4" /end CHARACTERISTIC
/begin CHARACTERISTIC ThrVlv_IfSoftLdgB1_I.ratOffsDecel_C "instance of the interface class softlanding / position offset where deceleration starts" VALUE 0x805057A6 Val_Ws16 511.9922 rel_q0p0078125 -256.0000 255.9922 FORMAT "%8.4" /end CHARACTERISTIC
/begin CHARACTERISTIC ThrVlv_IfSoftLdgB1_I.ratStrtPosn_C "instance of the interface class softlanding / start position" VALUE 0x805057A8 Val_Ws16 511.9922 rel_q0p0078125 -256.0000 255.9922 FORMAT "%8.4" /end CHARACTERISTIC
/begin CHARACTERISTIC ThrVlv_IfSoftLdgB1_I.swtSoftLdgEna_C "instance of the interface class softlanding / enable switch" VALUE 0x805057AA Val_Wu8 1.000 OneToOne 0.00 1.000 FORMAT "%5.3" EXTENDED_LIMITS 0.00 255.0 /end CHARACTERISTIC
/begin CHARACTERISTIC ThrVlv_IfSoftLdgB1_I.tiFilSwtSpdLimSoftLdg_C "instance of the interface class softlanding / time constant filtered switchover of the speed limit" VALUE 0x805057AC Val_Wu16 1.000000 t_q0p001 0.00 1.000000 FORMAT "%8.6" EXTENDED_LIMITS 0.00 65.53500 /end CHARACTERISTIC
/begin CHARACTERISTIC ThrVlv_PosnCtrlB1_I.PreCtrlFacB1_C "Position Controller of the throttle valve of motor bench one / pre-controller parameter" VALUE 0x805057B8 Val_Wu16 0.9999847 fak_q1p526Em5 0.00 0.9999847 FORMAT "%9.7" /end CHARACTERISTIC
/begin CHARACTERISTIC ThrVlv_PosnCtrlB1_I.PreCtrlFacB2_C "Position Controller of the throttle valve of motor bench one / pre-controller parameter" VALUE 0x805057BA Val_Wu16 0.9999847 fak_q1p526Em5 0.00 0.9999847 FORMAT "%9.7" /end CHARACTERISTIC
/begin CHARACTERISTIC ThrVlv_PosnCtrlB1_I.PreCtrlFacC1_C "Position Controller of the throttle valve of motor bench one / pre-controller parameter" VALUE 0x805057BC Val_Wu16 0.9999847 fak_q1p526Em5 0.00 0.9999847 FORMAT "%9.7" /end CHARACTERISTIC
/begin CHARACTERISTIC ThrVlv_PosnCtrlB1_I.PreCtrlFacC2_C "Position Controller of the throttle valve of motor bench one / pre-controller parameter" VALUE 0x805057BE Val_Wu16 0.9999847 fak_q1p526Em5 0.00 0.9999847 FORMAT "%9.7" /end CHARACTERISTIC
/begin CHARACTERISTIC ThrVlv_PosnCtrlB1_I.PreCtrlFacD_C "Position Controller of the throttle valve of motor bench one / pre-controller parameter" VALUE 0x805057C0 Val_Wu16 1.999939 fak_q3p0518Em5 0.000031 1.999969 FORMAT "%8.6" EXTENDED_LIMITS 0.00 1.999969 /end CHARACTERISTIC
/begin CHARACTERISTIC ThrVlv_PosnCtrlB1_I.PreCtrlFacE_C "Position Controller of the throttle valve of motor bench one / pre-controller parameter" VALUE 0x805057C2 Val_Ws16 3.999756 spg_q0p000122 -1.999878 1.999878 FORMAT "%8.6" EXTENDED_LIMITS -4.000000 3.999878 /end CHARACTERISTIC
/begin CHARACTERISTIC ThrVlv_PosnCtrlB1_I.dRatActThdSwtOffCtrlDer_C "Position Controller of the throttle valve of motor bench one / threshold of nonlinear filtering of derivative of actual position to switch off derivative part" VALUE 0x805057C4 Val_Wu16 6553.500 q0p1_Perc_DIV_s 0.00 6553.500 FORMAT "%8.3" /end CHARACTERISTIC
/begin CHARACTERISTIC ThrVlv_PosnCtrlB1_I.dUIntglSldgMod_CUR "Position Controller of the throttle valve of motor bench one / gain of integral part part" CURVE 0x805057C6 Cur_Xs16Ws16 1638.350 RBPtCel_du_0p05_1 0.00 1638.350 FORMAT "%8.3" EXTENDED_LIMITS -1638.400 1638.350
 /begin AXIS_DESCR STD_AXIS ThrVlv_PosnCtrlB1_I.ratDeCtrlrEndValAbslt rel_q0p0078125 4 -256.0000 255.9922 FORMAT "%8.4" DEPOSIT ABSOLUTE /end AXIS_DESCR
/end CHARACTERISTIC
/begin CHARACTERISTIC ThrVlv_PosnCtrlB1_I.facCnvnIdn_C "Position Controller of the throttle valve of motor bench one / conversion factor between software in electronic control unit and parameter estimation tool" VALUE 0x805057D8 Val_Wu16 65.53500 Fact1000 0.00 65.53500 FORMAT "%8.5" /end CHARACTERISTIC
/begin CHARACTERISTIC ThrVlv_PosnCtrlB1_I.facCtrlDer_C "Position Controller of the throttle valve of motor bench one / gain of derivative part" VALUE 0x805057DA Val_Wu16 6.553500 RBPtCel_fac_1p0em4_1 0.00 6.553500 FORMAT "%8.6" /end CHARACTERISTIC
/begin CHARACTERISTIC ThrVlv_PosnCtrlB1_I.facCtrlDer_MAP "Position Controller of the throttle valve of motor bench one / gain of derivative part" MAP 0x805057DC Map_Xs16Ys16Ws16 3.276700 RBPtCel_fac_1p0em4_1 0.00 3.276700 FORMAT "%8.6" EXTENDED_LIMITS -3.276800 3.276700
 /begin AXIS_DESCR STD_AXIS ThrVlv_PosnCtrlB1_I.ratDeCtrlrSdlg rel_q0p0078125 6 -256.0000 255.9922 FORMAT "%8.4" DEPOSIT ABSOLUTE /end AXIS_DESCR
 /begin AXIS_DESCR STD_AXIS ThrVlv_PosnCtrlB1_I.ratActPosnSdlg rel_q0p0078125 6 -256.0000 255.9922 FORMAT "%8.4" DEPOSIT ABSOLUTE /end AXIS_DESCR
/end CHARACTERISTIC
/begin CHARACTERISTIC ThrVlv_PosnCtrlB1_I.facCtrlIntglMin_C "Position Controller of the throttle valve of motor bench one / gain of integral part at small control deviation" VALUE 0x80505840 Val_Wu16 655.3500 fak_q0p01 0.00 655.3500 FORMAT "%8.4" /end CHARACTERISTIC
/begin CHARACTERISTIC ThrVlv_PosnCtrlB1_I.facCtrlIntglSlowTrj_C "Position Controller of the throttle valve of motor bench one / gain of integral part at slow trajectory" VALUE 0x80505842 Val_Wu16 655.3500 fak_q0p01 0.00 655.3500 FORMAT "%8.4" /end CHARACTERISTIC
/begin CHARACTERISTIC ThrVlv_PosnCtrlB1_I.facCtrlIntgl_C "Position Controller of the throttle valve of motor bench one / gain of i part" VALUE 0x80505844 Val_Wu16 655.3500 fak_q0p01 0.00 655.3500 FORMAT "%8.4" /end CHARACTERISTIC
/begin CHARACTERISTIC ThrVlv_PosnCtrlB1_I.facCtrlIntgl_MAP "Position Controller of the throttle valve of motor bench one / gain of integral part part" MAP 0x80505846 Map_Xs16Ys16Ws16 327.6700 fak_q0p01 0.00 327.6700 FORMAT "%8.4" EXTENDED_LIMITS -327.6800 327.6700
 /begin AXIS_DESCR STD_AXIS ThrVlv_PosnCtrlB1_I.ratDeCtrlrSdlg rel_q0p0078125 6 -256.0000 255.9922 FORMAT "%8.4" DEPOSIT ABSOLUTE /end AXIS_DESCR
 /begin AXIS_DESCR STD_AXIS ThrVlv_PosnCtrlB1_I.ratActPosnSdlg rel_q0p0078125 6 -256.0000 255.9922 FORMAT "%8.4" DEPOSIT ABSOLUTE /end AXIS_DESCR
/end CHARACTERISTIC
/begin CHARACTERISTIC ThrVlv_PosnCtrlB1_I.facCtrlK_C "Position Controller of the throttle valve of motor bench one / loop gain" VALUE 0x805058AA Val_Wu16 1.999969 fak_q3p0518Em5 0.00 1.999969 FORMAT "%8.6" /end CHARACTERISTIC
/begin CHARACTERISTIC ThrVlv_PosnCtrlB1_I.facCtrlPropSlowTrj_C "Position Controller of the throttle valve of motor bench one / gain of proportional part at slow trajectory" VALUE 0x805058AC Val_Wu16 655.3500 fak_q0p01 0.00 655.3500 FORMAT "%8.4" /end CHARACTERISTIC
/begin CHARACTERISTIC ThrVlv_PosnCtrlB1_I.facCtrlProp_C "Position Controller of the throttle valve of motor bench one / gain of proportional part" VALUE 0x805058AE Val_Wu16 655.3500 fak_q0p01 0.00 655.3500 FORMAT "%8.4" /end CHARACTERISTIC
/begin CHARACTERISTIC ThrVlv_PosnCtrlB1_I.facCtrlProp_MAP "Position Controller of the throttle valve of motor bench one / gain of proportional part" MAP 0x805058B0 Map_Xs16Ys16Ws16 327.6700 fak_q0p01 0.00 327.6700 FORMAT "%8.4" EXTENDED_LIMITS -327.6800 327.6700
 /begin AXIS_DESCR STD_AXIS ThrVlv_PosnCtrlB1_I.ratDeCtrlrSdlg rel_q0p0078125 6 -256.0000 255.9922 FORMAT "%8.4" DEPOSIT ABSOLUTE /end AXIS_DESCR
 /begin AXIS_DESCR STD_AXIS ThrVlv_PosnCtrlB1_I.ratActPosnSdlg rel_q0p0078125 6 -256.0000 255.9922 FORMAT "%8.4" DEPOSIT ABSOLUTE /end AXIS_DESCR
/end CHARACTERISTIC
/begin CHARACTERISTIC ThrVlv_PosnCtrlB1_I.facCtrlSldgMod_CUR "Position Controller of the throttle valve of motor bench one / gain of the proportional derivative controller" CURVE 0x80505914 Cur_Xs16Ws16 65.53500 Fact1000 -32.76800 32.76700 FORMAT "%8.5"
 /begin AXIS_DESCR STD_AXIS NO_INPUT_QUANTITY q0p1_Perc_DIV_s 2 -3276.800 3276.700 FORMAT "%8.3" DEPOSIT ABSOLUTE /end AXIS_DESCR
/end CHARACTERISTIC
/begin CHARACTERISTIC ThrVlv_PosnCtrlB1_I.facDly_C "Position Controller of the throttle valve of motor bench one / Factor for the delay part of the proportional proportional with lag" VALUE 0x8050591E Val_Wu16 1.000000 Fact1000 0.00 1.000000 FORMAT "%8.6" EXTENDED_LIMITS 0.00 65.53500 /end CHARACTERISTIC
/begin CHARACTERISTIC ThrVlv_PosnCtrlB1_I.facElecMotIndtCmp_CUR "Position Controller of the throttle valve of motor bench one / compensation of induction voltage" CURVE 0x80505920 Cur_Xs16Ws16 6.553500 RBPtCel_fac_1p0em4_1 -3.276800 3.276700 FORMAT "%8.6"
 /begin AXIS_DESCR STD_AXIS NO_INPUT_QUANTITY q0p1_Perc_DIV_s 4 -3276.800 3276.700 FORMAT "%8.3" DEPOSIT ABSOLUTE /end AXIS_DESCR
/end CHARACTERISTIC
/begin CHARACTERISTIC ThrVlv_PosnCtrlB1_I.facGainSldgSfcCubic_CUR "Position Controller of the throttle valve of motor bench one / weighting factor of the sliding surface cubic part" CURVE 0x80505932 Cur_Xs16Ws16 0.3276700 RBPtCel_fac_0p00001_1 0.00 0.3276700 FORMAT "%9.7" EXTENDED_LIMITS -0.3276800 0.3276700
 /begin AXIS_DESCR STD_AXIS NO_INPUT_QUANTITY rel_q0p0078125 2 -256.0000 255.9922 FORMAT "%8.4" DEPOSIT ABSOLUTE /end AXIS_DESCR
/end CHARACTERISTIC
/begin CHARACTERISTIC ThrVlv_PosnCtrlB1_I.facGainSldgSfcSqrt_C "Position Controller of the throttle valve of motor bench one / weighting factor Sliding Surface square root part" VALUE 0x8050593C Val_Wu16 655.3500 fak_q0p01 0.00 655.3500 FORMAT "%8.4" /end CHARACTERISTIC
/begin CHARACTERISTIC ThrVlv_PosnCtrlB1_I.facWghtSignIntglSldgMod_C "Position Controller of the throttle valve of motor bench one / weighting factor sign of sliding surface" VALUE 0x8050593E Val_Ws16 655.3500 fak_q0p01 -327.6800 327.6700 FORMAT "%8.4" /end CHARACTERISTIC
/begin CHARACTERISTIC ThrVlv_PosnCtrlB1_I.nrFbCtrlSdlg_C "Position Controller of the throttle valve of motor bench one / selection of the method for scheduling of the controller" VALUE 0x80505940 Val_Wu8 1.000 OneToOne 1.000 2.000 FORMAT "%5.3" EXTENDED_LIMITS 0.00 255.0 /end CHARACTERISTIC
/begin CHARACTERISTIC ThrVlv_PosnCtrlB1_I.nrMethDerCalcn_C "Position Controller of the throttle valve of motor bench one / selection of the method for derivative calculation" VALUE 0x80505941 Val_Wu8 2.000 OneToOne 1.000 3.000 FORMAT "%5.3" EXTENDED_LIMITS 0.00 255.0 /end CHARACTERISTIC
/begin CHARACTERISTIC ThrVlv_PosnCtrlB1_I.ratActThdIntglRst_C "Position Controller of the throttle valve of motor bench one / position threshold for reset of the integrator" VALUE 0x80505942 Val_Ws16 511.9922 rel_q0p0078125 -256.0000 255.9922 FORMAT "%8.4" /end CHARACTERISTIC
/begin CHARACTERISTIC ThrVlv_PosnCtrlB1_I.ratDeCtrlrThdIntglRst_C "Position Controller of the throttle valve of motor bench one / control deviation threshold for reset of the integrator" VALUE 0x80505944 Val_Ws16 511.9922 rel_q0p0078125 -256.0000 255.9922 FORMAT "%8.4" /end CHARACTERISTIC
/begin CHARACTERISTIC ThrVlv_PosnCtrlB1_I.ratDeCtrlrThdSlowTrj_C "Position Controller of the throttle valve of motor bench one / threshold of the absolute control deviation for slow trajectory" VALUE 0x80505946 Val_Ws16 511.9922 rel_q0p0078125 -256.0000 255.9922 FORMAT "%8.4" /end CHARACTERISTIC
/begin CHARACTERISTIC ThrVlv_PosnCtrlB1_I.ratDeCtrlrThdSwtOffCtrlStaty_C "Position Controller of the throttle valve of motor bench one / threshold of absolute control deviation to switch parts of the controller off" VALUE 0x80505948 Val_Ws16 511.9922 rel_q0p0078125 -256.0000 255.9922 FORMAT "%8.4" /end CHARACTERISTIC
/begin CHARACTERISTIC ThrVlv_PosnCtrlB1_I.ratDesPstDrv_C "Position Controller of the throttle valve of motor bench one / desired value in post drive" VALUE 0x8050594A Val_Ws16 511.9922 rel_q0p0078125 -256.0000 255.9922 FORMAT "%8.4" /end CHARACTERISTIC
/begin CHARACTERISTIC ThrVlv_PosnCtrlB1_I.ratDftlThdSlowTrj_C "Position Controller of the throttle valve of motor bench one / threshold for the gradient of the trajectory to detect a slow trajectory" VALUE 0x8050594C Val_Ws32 199.999984741 fak_q1p526Em5 -100.000000000 99.999984741 FORMAT "%13.9" EXTENDED_LIMITS -32768.0000000 32767.9999847 /end CHARACTERISTIC
/begin CHARACTERISTIC ThrVlv_PosnCtrlB1_I.ratDutyCycMax_C "Position Controller of the throttle valve of motor bench one / upper limit for the duty cycle" VALUE 0x80505950 Val_Ws16 511.9922 rel_q0p0078125 -256.0000 255.9922 FORMAT "%8.4" /end CHARACTERISTIC
/begin CHARACTERISTIC ThrVlv_PosnCtrlB1_I.ratDutyCycMin_C "Position Controller of the throttle valve of motor bench one / lower limit for the duty cycle" VALUE 0x80505952 Val_Ws16 511.9922 rel_q0p0078125 -256.0000 255.9922 FORMAT "%8.4" /end CHARACTERISTIC
/begin CHARACTERISTIC ThrVlv_PosnCtrlB1_I.ratGear_C "Position Controller of the throttle valve of motor bench one / gear box ratio" VALUE 0x80505954 Val_Wu16 127.9980 fak_q0p00195 0.00 127.9980 FORMAT "%8.4" /end CHARACTERISTIC
/begin CHARACTERISTIC ThrVlv_PosnCtrlB1_I.ratLrgDeltaSpIntglRst_C "Position Controller of the throttle valve of motor bench one / setpoint change for integral part reset" VALUE 0x80505956 Val_Ws16 511.9922 rel_q0p0078125 -256.0000 255.9922 FORMAT "%8.4" /end CHARACTERISTIC
/begin CHARACTERISTIC ThrVlv_PosnCtrlB1_I.ratOffsDutyCycMax_C "Position Controller of the throttle valve of motor bench one / maximum duty cycle at offset learning" VALUE 0x80505958 Val_Ws16 511.9922 rel_q0p0078125 -256.0000 255.9922 FORMAT "%8.4" /end CHARACTERISTIC
/begin CHARACTERISTIC ThrVlv_PosnCtrlB1_I.ratOffsDutyCycMin_C "Position Controller of the throttle valve of motor bench one / minimum duty cycle at offset learning" VALUE 0x8050595A Val_Ws16 511.9922 rel_q0p0078125 -256.0000 255.9922 FORMAT "%8.4" /end CHARACTERISTIC
/begin CHARACTERISTIC ThrVlv_PosnCtrlB1_I.ratSmallDeltaSpIntglRst_C "Position Controller of the throttle valve of motor bench one / setpoint change for integral part reset" VALUE 0x8050595C Val_Ws16 511.9922 rel_q0p0078125 -256.0000 255.9922 FORMAT "%8.4" /end CHARACTERISTIC
/begin CHARACTERISTIC ThrVlv_PosnCtrlB1_I.swtCtrlDerActPosn_C "Position Controller of the throttle valve of motor bench one / activation of the derivative part based on the actual position" VALUE 0x8050595E Val_Wu8 1.000 OneToOne 0.00 1.000 FORMAT "%5.3" EXTENDED_LIMITS 0.00 255.0 /end CHARACTERISTIC
/begin CHARACTERISTIC ThrVlv_PosnCtrlB1_I.swtNLFF_C "Position Controller of the throttle valve of motor bench one / activate nonlinear feedforward" VALUE 0x8050595F Val_Wu8 1.000 OneToOne 0.00 1.000 FORMAT "%5.3" EXTENDED_LIMITS 0.00 255.0 /end CHARACTERISTIC
/begin CHARACTERISTIC ThrVlv_PosnCtrlB1_I.swtOffDRatActSldgModStaty_C "Position Controller of the throttle valve of motor bench one / release switch stationary switch off of derivative part" VALUE 0x80505960 Val_Wu8 1.000 OneToOne 0.00 1.000 FORMAT "%5.3" EXTENDED_LIMITS 0.00 255.0 /end CHARACTERISTIC
/begin CHARACTERISTIC ThrVlv_PosnCtrlB1_I.swtOffIntglSldgModStaty_C "Position Controller of the throttle valve of motor bench one / release switch stationary switch off of integral part" VALUE 0x80505961 Val_Wu8 1.000 OneToOne 0.00 1.000 FORMAT "%5.3" EXTENDED_LIMITS 0.00 255.0 /end CHARACTERISTIC
/begin CHARACTERISTIC ThrVlv_PosnCtrlB1_I.swtPidCtrlEna_C "Position Controller of the throttle valve of motor bench one / usage of proportional integral derivative controller" VALUE 0x80505962 Val_Wu8 1.000 OneToOne 0.00 1.000 FORMAT "%5.3" EXTENDED_LIMITS 0.00 255.0 /end CHARACTERISTIC
/begin CHARACTERISTIC ThrVlv_PosnCtrlB1_I.swtTrjAdpnDurgSatn_C "Position Controller of the throttle valve of motor bench one / release switch" VALUE 0x80505963 Val_Wu8 1.000 OneToOne 0.00 1.000 FORMAT "%5.3" EXTENDED_LIMITS 0.00 255.0 /end CHARACTERISTIC
/begin CHARACTERISTIC ThrVlv_PosnCtrlB1_I.tiCtrlDerFil_C "Position Controller of the throttle valve of motor bench one / time constant low pass filter derivative part" VALUE 0x80505964 Val_Wu16 6.553500 q1Em4_s 0.00 6.553500 FORMAT "%8.6" /end CHARACTERISTIC
/begin CHARACTERISTIC ThrVlv_PosnCtrlB1_I.tiDebOpenLoad_C "Position Controller of the throttle valve of motor bench one / debounce time for open load diagnosis" VALUE 0x80505966 Val_Wu16 33.55392 RBPtCel_ti_5p12em4_1 0.00 33.55392 FORMAT "%8.5" /end CHARACTERISTIC
/begin CHARACTERISTIC ThrVlv_PosnCtrlB1_I.tiFilDRatAct_C "Position Controller of the throttle valve of motor bench one / filter time constant" VALUE 0x80505968 Val_Wu16 1.000000 t_q0p001 0.00 1.000000 FORMAT "%8.6" EXTENDED_LIMITS 0.00 65.53500 /end CHARACTERISTIC
/begin CHARACTERISTIC ThrVlv_PosnCtrlB1_I.tiFilElecMotIndtCmp_C "Position Controller of the throttle valve of motor bench one / filter time constant compensation of induction voltage" VALUE 0x8050596A Val_Wu16 6.553500 q1Em4_s 0.00 6.553500 FORMAT "%8.6" /end CHARACTERISTIC
/begin CHARACTERISTIC ThrVlv_PosnCtrlB1_I.tiFilSwtPreCtrl_C "Position Controller of the throttle valve of motor bench one / filter time constant for switching between filter times of the feed forward" VALUE 0x8050596C Val_Wu16 1.000000 t_q0p001 0.00 1.000000 FORMAT "%8.6" EXTENDED_LIMITS 0.00 65.53500 /end CHARACTERISTIC
/begin CHARACTERISTIC ThrVlv_PosnCtrlB1_I.tiFricDwn_C "Position Controller of the throttle valve of motor bench one / time constant for friciton model" VALUE 0x8050596E Val_Wu16 65.53400 t_q0p001 0.00100 65.53500 FORMAT "%8.5" EXTENDED_LIMITS 0.00 65.53500 /end CHARACTERISTIC
/begin CHARACTERISTIC ThrVlv_PosnCtrlB1_I.tiFricUp_C "Position Controller of the throttle valve of motor bench one / time constant for friciton model" VALUE 0x80505970 Val_Wu16 65.53400 t_q0p001 0.00100 65.53500 FORMAT "%8.5" EXTENDED_LIMITS 0.00 65.53500 /end CHARACTERISTIC
/begin CHARACTERISTIC ThrVlv_PosnCtrlB1_I.tiPPT1_CUR "Position Controller of the throttle valve of motor bench one / curve time constant of proportional proportional with lag" CURVE 0x80505972 Cur_Xs16Ws16 1.000000 t_q0p001 0.00 1.000000 FORMAT "%8.6" EXTENDED_LIMITS -32.76800 32.76700
 /begin AXIS_DESCR STD_AXIS ThrVlv_PosnCtrlB1_I.ratDeCtrlrEndValAbslt rel_q0p0078125 3 0.00 255.9922 FORMAT "%8.4" EXTENDED_LIMITS -256.0000 255.9922 DEPOSIT ABSOLUTE /end AXIS_DESCR
/end CHARACTERISTIC
/begin CHARACTERISTIC ThrVlv_PosnCtrlB1_I.tiPreCtrlGrdtBasd_CUR "Position Controller of the throttle valve of motor bench one / gradient based filter time feedforward" CURVE 0x80505980 Cur_Xs16Ws16 0.2988281 t_tev0p0005 0.0014648 0.3002930 FORMAT "%9.7" EXTENDED_LIMITS -16.00000 15.99951
 /begin AXIS_DESCR STD_AXIS ThrVlv_PosnCtrlB1_I.dRatDesPreCtrlGrdt relgrd_q7p8125 6 -256000.0 255992.2 FORMAT "%8.1" DEPOSIT ABSOLUTE /end AXIS_DESCR
/end CHARACTERISTIC
/begin CHARACTERISTIC ThrVlv_PosnCtrlB1_I.tiSdlFacCtrl_C "Position Controller of the throttle valve of motor bench one / time constant for scheduling of controller parameters" VALUE 0x8050599A Val_Ws16 32.76700 t_q0p001 0.00 32.76700 FORMAT "%8.5" EXTENDED_LIMITS -32.76800 32.76700 /end CHARACTERISTIC
/begin CHARACTERISTIC ThrVlv_PosnCtrlB1_I.tiSldgSfcDer_C "Position Controller of the throttle valve of motor bench one / time constant to weight the velocity dependent part of the Sliding Surface" VALUE 0x8050599C Val_Wu16 65.53500 t_q0p001 0.00 65.53500 FORMAT "%8.5" /end CHARACTERISTIC
/begin CHARACTERISTIC ThrVlv_PosnCtrlB1_I.tiSlowTrjCdn_C "Position Controller of the throttle valve of motor bench one / debounce time for detection of a slow trajectory" VALUE 0x8050599E Val_Wu16 33.55392 RBPtCel_ti_5p12em4_1 0.00 33.55392 FORMAT "%8.5" /end CHARACTERISTIC
/begin CHARACTERISTIC ThrVlv_PosnCtrlB1_I.tiSwtOffCtrlStaty_C "Position Controller of the throttle valve of motor bench one / debounce time for switch off of the derivative part" VALUE 0x805059A0 Val_Wu16 33.55392 RBPtCel_ti_5p12em4_1 0.00 33.55392 FORMAT "%8.5" /end CHARACTERISTIC
/begin CHARACTERISTIC ThrVlv_PosnCtrlB1_I.uCtrlIntglRst_C "Position Controller of the throttle valve of motor bench one / voltage integral part reset value" VALUE 0x805059A4 Val_Ws32 1279.99999970 q2p98023Em7_V -640.000000000 639.999999702 FORMAT "%13.9" /end CHARACTERISTIC
/begin CHARACTERISTIC ThrVlv_PosnCtrlB1_I.uFricCmp_C "Position Controller of the throttle valve of motor bench one / voltage friction compensator" VALUE 0x805059A8 Val_Ws16 65.53500 spg_q0p001 -32.76800 32.76700 FORMAT "%8.5" /end CHARACTERISTIC
/begin CHARACTERISTIC ThrVlv_PosnCtrlB1_I.uInpDsbc_C "Position Controller of the throttle valve of motor bench one / voltage input disturbance controller test" VALUE 0x805059AA Val_Ws16 65.53500 spg_q0p001 -32.76800 32.76700 FORMAT "%8.5" /end CHARACTERISTIC
/begin CHARACTERISTIC ThrVlv_PosnCtrlB1_I.uSprgCmp_CUR "Position Controller of the throttle valve of motor bench one / spring compensation" CURVE 0x805059AC Cur_Xs16Ws16 65.53500 spg_q0p001 -32.76800 32.76700 FORMAT "%8.5"
 /begin AXIS_DESCR STD_AXIS NO_INPUT_QUANTITY rel_q0p0078125 5 -256.0000 255.9922 FORMAT "%8.4" DEPOSIT ABSOLUTE /end AXIS_DESCR
/end CHARACTERISTIC
/begin CHARACTERISTIC ThrVlv_ratDesCalcB1_C "Calibration value to define setpoint manually" VALUE 0x80505750 Val_Ws16 511.9922 rel_q0p0078125 -256.0000 255.9922 FORMAT "%8.4" /end CHARACTERISTIC
/begin CHARACTERISTIC ThrVlv_Sens_B1_I.ratActCharThdMax_C "Class instance from AirActr_Sens / Maximal characteristic angle threshold in a defined driving cycle" VALUE 0x80505A1C Val_Ws16 511.9922 rel_q0p0078125 -256.0000 255.9922 FORMAT "%8.4" /end CHARACTERISTIC
/begin CHARACTERISTIC ThrVlv_Sens_B1_I.ratActCharThdMin_C "Class instance from AirActr_Sens / Minimal characteristic angle threshold in a defined driving cycle" VALUE 0x80505A1E Val_Ws16 511.9922 rel_q0p0078125 -256.0000 255.9922 FORMAT "%8.4" /end CHARACTERISTIC
/begin CHARACTERISTIC ThrVlv_Sens_B1_I.ratLimpHomePosn_C "Class instance from AirActr_Sens / Replacement angle in case of total sensor error" VALUE 0x80505A20 Val_Ws16 511.9922 rel_q0p0078125 -256.0000 255.9922 FORMAT "%8.4" /end CHARACTERISTIC
/begin CHARACTERISTIC ThrVlv_Sens_B1_I.swtNrmActrChar_C "Class instance from AirActr_Sens / Parameter for normalizing of the sensor characteristic curve" VALUE 0x80505A22 Val_Wu8 1.000 OneToOne 0.00 1.000 FORMAT "%5.3" EXTENDED_LIMITS 0.00 255.0 /end CHARACTERISTIC
/begin CHARACTERISTIC ThrVlv_Sens_B1_I.tiDebCycFlg_C "Class instance from AirActr_Sens / Debounce time for setting of the cycle flag" VALUE 0x80505A23 Val_Wu8 2.550 t10msxs_ub_b2p55 0.00 2.550 FORMAT "%5.3" /end CHARACTERISTIC
/begin CHARACTERISTIC ThrVlv_Sens_B1_I.tiDebSens1Err_C "Class instance from AirActr_Sens / Debounce time: Sensor 1 error" VALUE 0x80505A24 Val_Wu8 2.550 t10msxs_ub_b2p55 0.00 2.550 FORMAT "%5.3" /end CHARACTERISTIC
/begin CHARACTERISTIC ThrVlv_Sens_B1_I.uSens1Max_C "Class instance from AirActr_Sens / Upper diagnosis threshold sensor 1" VALUE 0x80505A26 Val_Wu16 79.99878 spg_q1p221Em3_V 0.00 79.99878 FORMAT "%8.5" /end CHARACTERISTIC
/begin CHARACTERISTIC ThrVlv_Sens_B1_I.uSens1Min_C "Class instance from AirActr_Sens / Lower diagnosis threshold sensor 1" VALUE 0x80505A28 Val_Wu16 79.99878 spg_q1p221Em3_V 0.00 79.99878 FORMAT "%8.5" /end CHARACTERISTIC
/begin CHARACTERISTIC ThrVlv_stActrCfg_C "Codeword for configuration of the actuator" VALUE 0x805914A2 Val_Wu8 255.0 OneToOne 0.00 255.0 FORMAT "%5.1" /end CHARACTERISTIC
/begin CHARACTERISTIC ThrVlv_stPsIfCfgB1_C "PsIf configuration codeword" VALUE 0x805059C4 Val_Wu8 255.0 OneToOne 0.00 255.0 FORMAT "%5.1" /end CHARACTERISTIC
/begin CHARACTERISTIC ThrVlv_stPwrStgEnaCdnMask_C "Mask for power stage enable condition used for disabling power stage after flashing" VALUE 0x805059C6 Val_Wu16 65535.00 OneToOne 0.00 65535.00 FORMAT "%8.2" /end CHARACTERISTIC
/begin CHARACTERISTIC ThrVlv_swtDesCalcB1_C "switch for desired value for calibration of throttle valve motor bench 1" VALUE 0x80505752 Val_Wu8 1.000 OneToOne 0.00 1.000 FORMAT "%5.3" EXTENDED_LIMITS 0.00 255.0 /end CHARACTERISTIC
/begin CHARACTERISTIC ThrVlv_tiClrSc_C "Debounce time for clearing of a short circuit error reported by the core SW" VALUE 0x805059C8 Val_Wu8 2.550 t10msxs_ub_b2p55 0.00 2.550 FORMAT "%5.3" /end CHARACTERISTIC
/begin CHARACTERISTIC ThrVlv_tiSetOutPerdB1_C "Cyclic period duration for the control line bank 1" VALUE 0x805059CC Val_Wu32 4294967294.00 Per_Dur 1.00 4294967295.00 FORMAT "%13.2" EXTENDED_LIMITS 0.00 4294967295.00 /end CHARACTERISTIC
/begin CHARACTERISTIC TiEngOffBasc_CW "Codeword reset of engine off time in EngReStrt task" VALUE 0x8057FE64 RB_Val_Wu8 255.0 OneToOne 0.00 255.0 FORMAT "%5.1" /end CHARACTERISTIC
/begin CHARACTERISTIC TiEngOff_tiBEngTmrRstDeb_C "Holding tiime for TiEngOff_bRst after detection of engine stall" VALUE 0x8057FE68 RB_Val_Ws32 4294967.29500 t_q0p001 -2147483.64800 2147483.64700 FORMAT "%13.5" /end CHARACTERISTIC
/begin CHARACTERISTIC TiEngOff_tiEngRotDeb_C "Holding time from Epm_stSpd to TiEngOff_bEngRot." VALUE 0x8057FE6C RB_Val_Ws32 4294967.29500 t_q0p001 -2147483.64800 2147483.64700 FORMAT "%13.5" /end CHARACTERISTIC
/begin CHARACTERISTIC TiEngOn_cfgRtId.RtId_TotIdleRt_C " / Configuration of Runtime RtId_TotIdleRt" VALUE 0x8057FD5A Val_Wu8 255.0 OneToOne 0.00 255.0 FORMAT "%5.1" /end CHARACTERISTIC
/begin CHARACTERISTIC TiEngOn_cfgRtId.RtId_TotPtoRt_C " / Configuration of Runtime RtId_TotPtoRt" VALUE 0x8057FD5B Val_Wu8 255.0 OneToOne 0.00 255.0 FORMAT "%5.1" /end CHARACTERISTIC
/begin CHARACTERISTIC TiEngOn_cfgRtId.RtId_TotRtObd_C " / Configuration of Runtime RtId_TotRtObd" VALUE 0x8057FD5C Val_Wu8 255.0 OneToOne 0.00 255.0 FORMAT "%5.1" /end CHARACTERISTIC
/begin CHARACTERISTIC TiEngOn_nIdleSpdPrmId7F_C "Engine speed that represents a running engine based on OBD definition" VALUE 0x8057FD5E RB_Val_Ws16 16383.50 EngN 0.00 16383.50 FORMAT "%8.2" EXTENDED_LIMITS -16384.00 16383.50 /end CHARACTERISTIC
/begin CHARACTERISTIC TiEngOn_swtCfgPrmId7F_C "Configuration parameter for TiEngOn_PrmId7F" VALUE 0x8057FD60 RB_Val_Wu8 255.0 OneToOne 0.00 255.0 FORMAT "%5.1" /end CHARACTERISTIC
/begin CHARACTERISTIC TiOff_bStrtEndOffRstDeb_C "Debounce time for reset bit of start end off time" VALUE 0x8057FE78 RB_Val_Wu16 655.3500 t_q0p01 0.00 655.3500 FORMAT "%8.4" /end CHARACTERISTIC
/begin CHARACTERISTIC TiOff_ratCoolDwnTBasdChkFastMax_C "maximum ratio of current cool down compared to last T15-off-event to release fast check" VALUE 0x8057FD84 RB_Val_Wu16 1.000000 fak_q0p000488 0.00 1.000000 FORMAT "%8.6" EXTENDED_LIMITS 0.00 31.99951 /end CHARACTERISTIC
/begin CHARACTERISTIC TiOff_ratCoolDwnTBasdChkFastMin_C "minimum ratio of current cool down compared to last T15-off-event to release fast check" VALUE 0x8057FD86 RB_Val_Wu16 1.000000 fak_q0p000488 0.00 1.000000 FORMAT "%8.6" EXTENDED_LIMITS 0.00 31.99951 /end CHARACTERISTIC
/begin CHARACTERISTIC TiOff_ratCoolDwnTBasdChkSlowMax_C "maximum ratio of current cool down compared to last T15-off-event to release slow check" VALUE 0x8057FD88 RB_Val_Wu16 1.000000 fak_q0p000488 0.00 1.000000 FORMAT "%8.6" EXTENDED_LIMITS 0.00 31.99951 /end CHARACTERISTIC
/begin CHARACTERISTIC TiOff_ratCoolDwnTBasdChkSlowMin_C "minimum ratio of current cool down compared to last T15-off-event to release slow check" VALUE 0x8057FD8A RB_Val_Wu16 1.000000 fak_q0p000488 0.00 1.000000 FORMAT "%8.6" EXTENDED_LIMITS 0.00 31.99951 /end CHARACTERISTIC
/begin CHARACTERISTIC TiOff_stCfgTBasdChk_C "code word to configure Temperature based check features" VALUE 0x8057FD8C RB_Val_Wu8 255.0 OneToOne 0.00 255.0 FORMAT "%5.1" /end CHARACTERISTIC
/begin CHARACTERISTIC TiOff_stClkIntCfg_CW "Codeword to configure TiOff_VdClk" VALUE 0x8057FD64 RB_Val_Wu8 255.0 OneToOne 0.00 255.0 FORMAT "%5.1" /end CHARACTERISTIC
/begin CHARACTERISTIC TiOff_stTestClk_CW "Codewort for testconfiguration of TiOff_VdClk" VALUE 0x8057FD65 RB_Val_Wu8 255.0 OneToOne 0.00 255.0 FORMAT "%5.1" /end CHARACTERISTIC
/begin CHARACTERISTIC TiOff_stTiEngOffDef_C "Default value for engine off time" VALUE 0x8057FE70 RB_Val_Wu8 255.0 OneToOne 0.00 255.0 FORMAT "%5.1" /end CHARACTERISTIC
/begin CHARACTERISTIC TiOff_stTiEngOffHwOvf_C "Default value for status of engine off time in case of overflow of HW-clock" VALUE 0x8057FE71 RB_Val_Wu8 2.000 OneToOne 1.000 3.000 FORMAT "%5.3" EXTENDED_LIMITS 0.00 255.0 /end CHARACTERISTIC
/begin CHARACTERISTIC TiOff_stTiEngOff_CW "Codeword to configure TiOff_VdTiEngOff" VALUE 0x8057FE72 RB_Val_Wu8 255.0 OneToOne 0.00 255.0 FORMAT "%5.1" /end CHARACTERISTIC
/begin CHARACTERISTIC TiOff_stTiStrtEndOffDef_C "Defaultvalue of start-end time" VALUE 0x8057FE7A RB_Val_Wu8 255.0 OneToOne 0.00 255.0 FORMAT "%5.1" /end CHARACTERISTIC
/begin CHARACTERISTIC TiOff_stTiStrtEndOffHwOvf_C "Default value of the start- end time with overflow" VALUE 0x8057FE7B RB_Val_Wu8 2.000 OneToOne 1.000 3.000 FORMAT "%5.3" EXTENDED_LIMITS 0.00 255.0 /end CHARACTERISTIC
/begin CHARACTERISTIC TiOff_stTiStrtEndOff_CW "Codeword to configure TiOff_VdTiStrtEndOff" VALUE 0x8057FE7C RB_Val_Wu8 255.0 OneToOne 0.00 255.0 FORMAT "%5.1" /end CHARACTERISTIC
/begin CHARACTERISTIC TiOff_tCEngDsTT15StopTBasdChkFastMin_C "minimum engine coolant temperature at last T15-off-event to enable the fast check" VALUE 0x8057FD8E RB_Val_Ws16 6553.500 Temp_Cels -3549.940 3003.560 FORMAT "%8.3" /end CHARACTERISTIC
/begin CHARACTERISTIC TiOff_tCEngDsTT15StopTBasdChkSlowMin_C "minimum engine coolant temperature at last T15-off-event to enable the slow check" VALUE 0x8057FD90 RB_Val_Ws16 6553.500 Temp_Cels -3549.940 3003.560 FORMAT "%8.3" /end CHARACTERISTIC
/begin CHARACTERISTIC TiOff_tDiffCEngDsTPsblTBasdChkFastMin_C "minimum limit for possible cool down of the coolant temperature wihtin the last T15-off-phase to enable the fast check" VALUE 0x8057FD92 RB_Val_Ws16 6553.500 TempDiff_Kelv -3276.800 3276.700 FORMAT "%8.3" /end CHARACTERISTIC
/begin CHARACTERISTIC TiOff_tDiffCEngDsTPsblTBasdChkSlowMin_C "minimum limit for possible cool down of the coolant temperature wihtin the last T15-off-phase to enable the slow check" VALUE 0x8057FD94 RB_Val_Ws16 6553.500 TempDiff_Kelv -3276.800 3276.700 FORMAT "%8.3" /end CHARACTERISTIC
/begin CHARACTERISTIC TiOff_tDiffCEngDsTTBasdChkFastMax_C "maximum cool down of the engine coolant temperature within the last T15-off-phase to enable the fast check" VALUE 0x8057FD96 RB_Val_Ws16 6553.500 TempDiff_Kelv -3276.800 3276.700 FORMAT "%8.3" /end CHARACTERISTIC
/begin CHARACTERISTIC TiOff_tDiffCEngDsTTBasdChkSlowMin_C "minimum cool down of the engine coolant temperature within the last T15-off-phase to enable the slow check" VALUE 0x8057FD98 RB_Val_Ws16 6553.500 TempDiff_Kelv -3276.800 3276.700 FORMAT "%8.3" /end CHARACTERISTIC
/begin CHARACTERISTIC TiOff_tiBTiHwClkRst_C "Duration of Bit TiOff_bTiHwClkRst = TRUE after a reset of TiOff_tiHwClkLoc to 0" VALUE 0x8057FD68 RB_Val_Ws32 2147483647.00 Time_sec_q1_COMPU 0.00 2147483647.00 FORMAT "%13.2" EXTENDED_LIMITS -2147483648.00 2147483647.00 /end CHARACTERISTIC
/begin CHARACTERISTIC TiOff_tiClkStopTst_C "testvalue for TiOff_tiHwClkStop in test mode" VALUE 0x8057FD6C RB_Val_Ws32 4294967295.00 Time_sec_q1_COMPU -2147483648.00 2147483647.00 FORMAT "%13.2" /end CHARACTERISTIC
/begin CHARACTERISTIC TiOff_tiClkTst_C "Testvalue within TiOff_VdClk" VALUE 0x8057FD70 RB_Val_Ws32 4294967295.00 Time_sec_q1_COMPU -2147483648.00 2147483647.00 FORMAT "%13.2" /end CHARACTERISTIC
/begin CHARACTERISTIC TiOff_tiEcuOffIntMax_C "maximum value off ECU-off-time" VALUE 0x8057FD74 RB_Val_Ws32 4294967295.00 Time_sec_q1_COMPU -2147483648.00 2147483647.00 FORMAT "%13.2" /end CHARACTERISTIC
/begin CHARACTERISTIC TiOff_tiEcuOffTst_C "Testvalue for SyC_tiEcuOff in testmode" VALUE 0x8057FD78 RB_Val_Ws32 4294967295.00 Time_sec_q1_COMPU -2147483648.00 2147483647.00 FORMAT "%13.2" /end CHARACTERISTIC
/begin CHARACTERISTIC TiOff_tiEngOffDef_C "Default value of engine off time" VALUE 0x8057FE74 RB_Val_Ws32 2147483647.00 Time_sec_q1_COMPU 0.00 2147483647.00 FORMAT "%13.2" EXTENDED_LIMITS -2147483648.00 2147483647.00 /end CHARACTERISTIC
/begin CHARACTERISTIC TiOff_tiHwClkAddWakeup_C "time after reset of the generalized HW clock" VALUE 0x8057FD7C RB_Val_Ws32 2147483647.00 Time_sec_q1_COMPU 0.00 2147483647.00 FORMAT "%13.2" EXTENDED_LIMITS -2147483648.00 2147483647.00 /end CHARACTERISTIC
/begin CHARACTERISTIC TiOff_tiHwClkMax_C "maximum time which shall be defined TiOff_tiHwClkLoc" VALUE 0x8057FD80 RB_Val_Ws32 2147483647.00 Time_sec_q1_COMPU 0.00 2147483647.00 FORMAT "%13.2" EXTENDED_LIMITS -2147483648.00 2147483647.00 /end CHARACTERISTIC
/begin CHARACTERISTIC TiOff_tiStrtEndOffDef_C "Defaultvalue of start-end time" VALUE 0x8057FE80 RB_Val_Ws32 2147483647.00 Time_sec_q1_COMPU 0.00 2147483647.00 FORMAT "%13.2" EXTENDED_LIMITS -2147483648.00 2147483647.00 /end CHARACTERISTIC
/begin CHARACTERISTIC TiOff_tiT15OffEcuOnTBasdChkFastMax_T "maximum accumulated ecu-on-time since last T15-off-event to enable the fast check" CURVE 0x8057FD9A RB_Curve_U16_U16 65535.00 t_q1 0.00 65535.00 FORMAT "%8.2"
 /begin AXIS_DESCR STD_AXIS TiOff_ratCoolDwnTBasdChk fak_q0p000488 12 0.00 1.000000 FORMAT "%8.6" EXTENDED_LIMITS 0.00 31.99951 DEPOSIT ABSOLUTE /end AXIS_DESCR
/end CHARACTERISTIC
/begin CHARACTERISTIC TiOff_tiT15OffEcuOnTBasdChkSlowMax_T "maximum accumulated ecu-on-time since last T15-off-event to enable the slow check" CURVE 0x8057FDCC RB_Curve_U16_U16 65535.00 t_q1 0.00 65535.00 FORMAT "%8.2"
 /begin AXIS_DESCR STD_AXIS TiOff_ratCoolDwnTBasdChk fak_q0p000488 12 0.00 1.000000 FORMAT "%8.6" EXTENDED_LIMITS 0.00 31.99951 DEPOSIT ABSOLUTE /end AXIS_DESCR
/end CHARACTERISTIC
/begin CHARACTERISTIC TiOff_tiT15OffTBasdChkFastRef_T "reference value for temperature based check (fast)" CURVE 0x8057FDFE RB_Curve_U16_U16 65535.00 Time_min_q1_COMPU 0.00 65535.00 FORMAT "%8.2"
 /begin AXIS_DESCR STD_AXIS TiOff_ratCoolDwnTBasdChk fak_q0p000488 12 0.00 31.99951 FORMAT "%8.5" DEPOSIT ABSOLUTE /end AXIS_DESCR
/end CHARACTERISTIC
/begin CHARACTERISTIC TiOff_tiT15OffTBasdChkSlowRef_T "reference value for temperature based check (slow)" CURVE 0x8057FE30 RB_Curve_U16_U16 65535.00 Time_min_q1_COMPU 0.00 65535.00 FORMAT "%8.2"
 /begin AXIS_DESCR STD_AXIS TiOff_ratCoolDwnTBasdChk fak_q0p000488 12 0.00 31.99951 FORMAT "%8.5" DEPOSIT ABSOLUTE /end AXIS_DESCR
/end CHARACTERISTIC
/begin CHARACTERISTIC TiOff_tiTBasdChkDly_C "Diagnosis delay (after T15 on) for temperature based check" VALUE 0x8057FE62 RB_Val_Wu8 12.75 t_q0p05 0.00 12.75 FORMAT "%5.2" /end CHARACTERISTIC
/begin CHARACTERISTIC TiOff_tiTBasdChkLst_C "Diagnosis timeout (after T15 on) for temperature based check" VALUE 0x8057FE63 RB_Val_Wu8 12.75 t_q0p05 0.00 12.75 FORMAT "%5.2" /end CHARACTERISTIC
/begin MEASUREMENT CoCTM_trqMaxAC "Maximum allowed AC compressor torque" SWORD Trq 1 100 -3276.800 3276.700 FORMAT "%8.3" ECU_ADDRESS 0x6000933C /end MEASUREMENT
/begin MEASUREMENT dzwo2ka_msg "ignition angle correction depending on 2nd fuel" SBYTE kw_q0p75 1 100 -96.00 95.25 FORMAT "%5.2" ECU_ADDRESS 0x7000373C /end MEASUREMENT
/begin MEASUREMENT dzwohsp_msg "shift of optimized model reference ignition angle in HSP mode" SBYTE kw_q0p75 1 100 -96.00 95.25 FORMAT "%5.2" ECU_ADDRESS 0x7000373B /end MEASUREMENT
/begin MEASUREMENT dzwolb_msg "correction of the optimized model reference ignition angle depending on charge motion" SBYTE kw_q0p75 1 100 -96.00 95.25 FORMAT "%5.2" ECU_ADDRESS 0x70003739 /end MEASUREMENT
/begin MEASUREMENT dzwol_msg "Lambda-dependent correction of optimized model reference ignition angle" SBYTE kw_q0p75 1 100 -96.00 95.25 FORMAT "%5.2" ECU_ADDRESS 0x7000373A /end MEASUREMENT
/begin MEASUREMENT dzworriref_msg "Shift of optimum ignition angle for reference ratio of residual gas" SBYTE kw_q0p75 1 100 -96.00 95.25 FORMAT "%5.2" ECU_ADDRESS 0x60000999 /end MEASUREMENT
/begin MEASUREMENT dzworri_msg "inert gas rate dependent correction of optimized model reference ignition angle" SBYTE kw_q0p75 1 100 -96.00 95.25 FORMAT "%5.2" ECU_ADDRESS 0x60000998 /end MEASUREMENT
/begin MEASUREMENT dzwotm_msg "temperature-dependent correction of optimized model reference ignition angle" SBYTE kw_q0p75 1 100 -96.00 95.25 FORMAT "%5.2" ECU_ADDRESS 0x70003738 /end MEASUREMENT
/begin MEASUREMENT ThrVlv_cntrSens1SelB1 "Counter sensor comparison: sensor 1 suits to charge signal" UBYTE OneToOne 1 100 0.00 255.0 FORMAT "%5.1" ECU_ADDRESS 0x7000546B /end MEASUREMENT
/begin MEASUREMENT ThrVlv_cntrSens2SelB1 "Counter sensor comparison: sensor 2 suits to charge signal" UBYTE OneToOne 1 100 0.00 255.0 FORMAT "%5.1" ECU_ADDRESS 0x7000546C /end MEASUREMENT
/begin MEASUREMENT ThrVlv_facUBattB1 "factor for battery voltage compensation" UWORD fak_q6p1035Em5 1 100 0.00 3.999939 FORMAT "%8.6" ECU_ADDRESS 0x6000944A /end MEASUREMENT
/begin MEASUREMENT ThrVlv_flgActPosnVldB1 "Actual position is valid" UBYTE OneToOne 1 100 0.00 1.000 BIT_MASK 0x1 FORMAT "%5.3" ECU_ADDRESS 0x6000F907 /end MEASUREMENT
/begin MEASUREMENT ThrVlv_flgActrOnB1 "The powerstage of the actuator is switched on" UBYTE OneToOne 1 100 0.00 1.000 BIT_MASK 0x1 FORMAT "%5.3" ECU_ADDRESS 0x6000F906 /end MEASUREMENT
/begin MEASUREMENT ThrVlv_flgAvrgSens1Sens2SelB1 "Flag: Actual position calculated based on the average from both sensor voltages" UBYTE OneToOne 1 100 0.00 1.000 BIT_MASK 0x1 FORMAT "%5.3" ECU_ADDRESS 0x700054A7 /end MEASUREMENT
/begin MEASUREMENT ThrVlv_flgChrgSens1SyncErrSuspcB1 "Suspicion error: Deviation between sensor 1 and charge signal" UBYTE OneToOne 1 100 0.00 1.000 BIT_MASK 0x1 FORMAT "%5.3" ECU_ADDRESS 0x7000546D /end MEASUREMENT
/begin MEASUREMENT ThrVlv_flgChrgSens2SyncErrSuspcB1 "Suspicion error: Deviation between sensor 2 and charge signal" UBYTE OneToOne 1 100 0.00 1.000 BIT_MASK 0x1 FORMAT "%5.3" ECU_ADDRESS 0x7000546E /end MEASUREMENT
/begin MEASUREMENT ThrVlv_flgDblSensErrB1 "Flag: Both throttle valve sensors defect" UBYTE OneToOne 1 100 0.00 1.000 BIT_MASK 0x1 FORMAT "%5.3" ECU_ADDRESS 0x6000F902 /end MEASUREMENT
/begin MEASUREMENT ThrVlv_flgDblSensErrSuspcB1 "Suspicion error on both throttle angle sensors" UBYTE OneToOne 1 100 0.00 1.000 BIT_MASK 0x1 FORMAT "%5.3" ECU_ADDRESS 0x6000F901 /end MEASUREMENT
/begin MEASUREMENT ThrVlv_flgDesTstrB1 "desired value from tester is active throttle valve bench 1" UBYTE OneToOne 1 100 0.00 1.000 BIT_MASK 0x1 FORMAT "%5.3" ECU_ADDRESS 0x6000F900 /end MEASUREMENT
/begin MEASUREMENT ThrVlv_flgDesValVldB1 "desired value valid throttle valve motor bench one" UBYTE OneToOne 1 100 0.00 1.000 BIT_MASK 0x1 FORMAT "%5.3" ECU_ADDRESS 0x6000F8FF /end MEASUREMENT
/begin MEASUREMENT ThrVlv_flgLimpAirPosnNotReaB1 "Limp home position not reached" UBYTE OneToOne 1 100 0.00 1.000 BIT_MASK 0x1 FORMAT "%5.3" ECU_ADDRESS 0x6000F8FD /end MEASUREMENT
/begin MEASUREMENT ThrVlv_flgLmsPsdB1 "Valve is pressed to mechanical stop" UBYTE OneToOne 1 100 0.00 1.000 BIT_MASK 0x1 FORMAT "%5.3" ECU_ADDRESS 0x6000F8FC /end MEASUREMENT
/begin MEASUREMENT ThrVlv_flgLstUnthrSensSelB1 "Last selected angle in unthrottled operation range" UBYTE OneToOne 1 100 0.00 1.000 BIT_MASK 0x1 FORMAT "%5.3" ECU_ADDRESS 0x7000546F /end MEASUREMENT
/begin MEASUREMENT ThrVlv_flgOpenLoadDiagFinshdB1 "Status flag: open load diagnosis finished" UBYTE OneToOne 1 100 0.00 1.000 BIT_MASK 0x1 FORMAT "%5.3" ECU_ADDRESS 0x6000F8F9 /end MEASUREMENT
/begin MEASUREMENT ThrVlv_flgOpenLoopOpngVvtEndPosnB1 "Limp home driving with VVT: End position of throttle valve reached" UBYTE OneToOne 1 100 0.00 1.000 BIT_MASK 0x1 FORMAT "%5.3" ECU_ADDRESS 0x700054AA /end MEASUREMENT
/begin MEASUREMENT ThrVlv_flgPosnCtrlDsmClrDmdB1 "Request for DMS-Clear position controller error, bank1" UBYTE OneToOne 1 100 0.00 1.000 BIT_MASK 0x1 FORMAT "%5.3" ECU_ADDRESS 0x6000ADAA /end MEASUREMENT
/begin MEASUREMENT ThrVlv_flgPosnCtrlPsOffB1 "Request powerstage off from ThrVlv_PosnCtrl" UBYTE OneToOne 1 100 0.00 1.000 BIT_MASK 0x1 FORMAT "%5.3" ECU_ADDRESS 0x6000F8F8 /end MEASUREMENT
/begin MEASUREMENT ThrVlv_flgReqPsOffB1 "Request powerstage off (accumulative bit)" UBYTE OneToOne 1 100 0.00 1.000 BIT_MASK 0x1 FORMAT "%5.3" ECU_ADDRESS 0x6000F8F6 /end MEASUREMENT
/begin MEASUREMENT ThrVlv_flgSens1ErrB1 "Flag: Sensor 1 defect" UBYTE OneToOne 1 100 0.00 1.000 BIT_MASK 0x1 FORMAT "%5.3" ECU_ADDRESS 0x700054AB /end MEASUREMENT
/begin MEASUREMENT ThrVlv_flgSens1ErrSuspcB1 "Sensor 1 suspicion error" UBYTE OneToOne 1 100 0.00 1.000 BIT_MASK 0x1 FORMAT "%5.3" ECU_ADDRESS 0x700054AC /end MEASUREMENT
/begin MEASUREMENT ThrVlv_flgSens1SelB1 "Flag: Actual position calculated based on sensor 1 voltage" UBYTE OneToOne 1 100 0.00 1.000 BIT_MASK 0x1 FORMAT "%5.3" ECU_ADDRESS 0x700054AD /end MEASUREMENT
/begin MEASUREMENT ThrVlv_flgSens1Sens2SyncErrSuspcB1 "Suspicion error: Deviation between voltage sensor 1 and voltage sensor 2" UBYTE OneToOne 1 100 0.00 1.000 BIT_MASK 0x1 FORMAT "%5.3" ECU_ADDRESS 0x70005470 /end MEASUREMENT
/begin MEASUREMENT ThrVlv_flgSens1SigRngSuspcB1 "Sensor 1 outside of the valid signal range (undebounced)" UBYTE OneToOne 1 100 0.00 1.000 BIT_MASK 0x1 FORMAT "%5.3" ECU_ADDRESS 0x70005471 /end MEASUREMENT
/begin MEASUREMENT ThrVlv_flgSens2CharPosnMaxExcddB1 "Characteristic maximal actual position exceeded by sensor 2" UBYTE OneToOne 1 100 0.00 1.000 BIT_MASK 0x1 FORMAT "%5.3" ECU_ADDRESS 0x70005472 /end MEASUREMENT
/begin MEASUREMENT ThrVlv_flgSens2CharPosnMinExcddB1 "Characteristic minimal actual position exceeded by sensor 2" UBYTE OneToOne 1 100 0.00 1.000 BIT_MASK 0x1 FORMAT "%5.3" ECU_ADDRESS 0x70005473 /end MEASUREMENT
/begin MEASUREMENT ThrVlv_flgSens2ErrB1 "Flag: Sensor 2 defect" UBYTE OneToOne 1 100 0.00 1.000 BIT_MASK 0x1 FORMAT "%5.3" ECU_ADDRESS 0x70005474 /end MEASUREMENT
/begin MEASUREMENT ThrVlv_flgSens2ErrSuspcB1 "Sensor 2 suspicion error" UBYTE OneToOne 1 100 0.00 1.000 BIT_MASK 0x1 FORMAT "%5.3" ECU_ADDRESS 0x700054AE /end MEASUREMENT
/begin MEASUREMENT ThrVlv_flgSens2SelB1 "Flag: Actual position calculated based on sensor 2 voltage" UBYTE OneToOne 1 100 0.00 1.000 BIT_MASK 0x1 FORMAT "%5.3" ECU_ADDRESS 0x700054AF /end MEASUREMENT
/begin MEASUREMENT ThrVlv_flgSens2SigRngSuspcB1 "Sensor 2 outside of the valid signal range (undebounced)" UBYTE OneToOne 1 100 0.00 1.000 BIT_MASK 0x1 FORMAT "%5.3" ECU_ADDRESS 0x70005475 /end MEASUREMENT
/begin MEASUREMENT ThrVlv_flgSensCompActvdB1 "Flag: Sensor comparison with the charge signal demanded" UBYTE OneToOne 1 100 0.00 1.000 BIT_MASK 0x1 FORMAT "%5.3" ECU_ADDRESS 0x700054B0 /end MEASUREMENT
/begin MEASUREMENT ThrVlv_flgSensCompDmdDurgUnthrB1 "Flag: Sensor comparison with the charge signal in unthrottled operation mode demanded" UBYTE OneToOne 1 100 0.00 1.000 BIT_MASK 0x1 FORMAT "%5.3" ECU_ADDRESS 0x70005476 /end MEASUREMENT
/begin MEASUREMENT ThrVlv_flgSngSensErrB1 "One throttle valve sensor faulty" UBYTE OneToOne 1 100 0.00 1.000 BIT_MASK 0x1 FORMAT "%5.3" ECU_ADDRESS 0x5000605F /end MEASUREMENT
/begin MEASUREMENT ThrVlv_flgSngSensErrSuspcB1 "Suspicion error on one throttle valve sensor" UBYTE OneToOne 1 100 0.00 1.000 BIT_MASK 0x1 FORMAT "%5.3" ECU_ADDRESS 0x6000F8F4 /end MEASUREMENT
/begin MEASUREMENT ThrVlv_flgSwtOffDiagStrtB1 "Open Load diagnosis started bank 1" UBYTE OneToOne 1 100 0.00 1.000 BIT_MASK 0x1 FORMAT "%5.3" ECU_ADDRESS 0x6000ADA8 /end MEASUREMENT
/begin MEASUREMENT ThrVlv_flgTstrCdn "conditions for desired value from tester throttle valve are given" UBYTE OneToOne 1 100 0.00 1.000 BIT_MASK 0x1 FORMAT "%5.3" ECU_ADDRESS 0x6000ADA9 /end MEASUREMENT
/begin MEASUREMENT ThrVlv_flgXPostDrvB1 "Request extend PostDrive" UBYTE OneToOne 1 100 0.00 1.000 BIT_MASK 0x1 FORMAT "%5.3" ECU_ADDRESS 0x6000F8F2 /end MEASUREMENT
/begin MEASUREMENT ThrVlv_PosnCtrlB1_I.PwrLossHeat "Position Controller of the throttle valve of motor bench one / power loss as heat" UWORD leist_q0p015625 1 100 0.00 1023.984 FORMAT "%8.3" ECU_ADDRESS 0x50001E08 /end MEASUREMENT
/begin MEASUREMENT ThrVlv_PosnCtrlB1_I.dRadSpdLimSoftLdg "Position Controller of the throttle valve of motor bench one / speed limit for softlanding" SLONG fak_q1p526Em5 1 100 -100.000000000 99.999984741 FORMAT "%13.9" ECU_ADDRESS 0x50001E0C /end MEASUREMENT
/begin MEASUREMENT ThrVlv_PosnCtrlB1_I.dRadSpdLimSoftLmsLvng "Position Controller of the throttle valve of motor bench one / speed limit for soft leaving" SLONG fak_q1p526Em5 1 100 -100.000000000 99.999984741 FORMAT "%13.9" ECU_ADDRESS 0x50001E10 /end MEASUREMENT
/begin MEASUREMENT ThrVlv_PosnCtrlB1_I.dRatActFild "Position Controller of the throttle valve of motor bench one / filtered derivative of actual position" SWORD relgrd_q7p8125 1 100 -256000.0 255992.2 FORMAT "%8.1" ECU_ADDRESS 0x50001E14 /end MEASUREMENT
/begin MEASUREMENT ThrVlv_PosnCtrlB1_I.dRatActSldgModFild "Position Controller of the throttle valve of motor bench one / nonlinear filtered derivative of actual position" SLONG q0p1_Perc_DIV_s 1 100 -214748364.800 214748364.700 FORMAT "%13.3" ECU_ADDRESS 0x50001E18 /end MEASUREMENT
/begin MEASUREMENT ThrVlv_PosnCtrlB1_I.dRatActSldgModFildAbslt "Position Controller of the throttle valve of motor bench one / nonlinear filtered derivative of actual position" SLONG q0p1_Perc_DIV_s 1 100 -214748364.800 214748364.700 FORMAT "%13.3" ECU_ADDRESS 0x50001E1C /end MEASUREMENT
/begin MEASUREMENT ThrVlv_PosnCtrlB1_I.dRatDesPreCtrlGrdt "Position Controller of the throttle valve of motor bench one / gradient of the filtered desired value" SWORD relgrd_q7p8125 1 100 -256000.0 255992.2 FORMAT "%8.1" ECU_ADDRESS 0x50001E20 /end MEASUREMENT
/begin MEASUREMENT ThrVlv_PosnCtrlB1_I.dUIntglSldgMod "Position Controller of the throttle valve of motor bench one / gain of integral part" UWORD RBPtCel_du_0p05_1 1 100 0.00 3276.750 FORMAT "%8.3" ECU_ADDRESS 0x50001E22 /end MEASUREMENT
/begin MEASUREMENT ThrVlv_PosnCtrlB1_I.dUIntglSldgModLhp "Position Controller of the throttle valve of motor bench one / gain of integral part at limp air postion" SWORD RBPtCel_du_0p05_1 1 100 0.00 1638.350 FORMAT "%8.3" ECU_ADDRESS 0x50001E24 /end MEASUREMENT
/begin MEASUREMENT ThrVlv_PosnCtrlB1_I.dt_fac_u16 "Position Controller of the throttle valve of motor bench one / internal dT" UWORD t_q3p815Em6 1 100 0.00 0.006000519 FORMAT "%11.9" ECU_ADDRESS 0x50001E2C /end MEASUREMENT
/begin MEASUREMENT ThrVlv_PosnCtrlB1_I.dt_ms_0p04881_u16 "Position Controller of the throttle valve of motor bench one / internal dT" UWORD t_tev0p0005 1 100 0.00 11.00000 FORMAT "%8.5" ECU_ADDRESS 0x50001E2E /end MEASUREMENT
/begin MEASUREMENT ThrVlv_PosnCtrlB1_I.egyHeatOld "Position Controller of the throttle valve of motor bench one / absorbed heat energy" FLOAT32_IEEE OneToOne 1 100 -1.00000000E+037 1.00000000E+037 FORMAT "%13.3" ECU_ADDRESS 0x60038AC4 /end MEASUREMENT
/begin MEASUREMENT ThrVlv_PosnCtrlB1_I.facCtrlDer "Position Controller of the throttle valve of motor bench one / gain of derivative part" UWORD RBPtCel_fac_1p0em4_1 1 100 0.00 6.553500 FORMAT "%8.6" ECU_ADDRESS 0x50001E32 /end MEASUREMENT
/begin MEASUREMENT ThrVlv_PosnCtrlB1_I.facCtrlIntgl "Position Controller of the throttle valve of motor bench one / gain of i part" UWORD fak_q0p01 1 100 0.00 655.3500 FORMAT "%8.4" ECU_ADDRESS 0x50001E34 /end MEASUREMENT
/begin MEASUREMENT ThrVlv_PosnCtrlB1_I.facCtrlIntglLimpAirPosn "Position Controller of the throttle valve of motor bench one / gain of i part at limp air postion" UWORD fak_q0p01 1 100 0.00 655.3500 FORMAT "%8.4" ECU_ADDRESS 0x50001E36 /end MEASUREMENT
/begin MEASUREMENT ThrVlv_PosnCtrlB1_I.facCtrlProp "Position Controller of the throttle valve of motor bench one / gain of proportional part" UWORD fak_q0p01 1 100 0.00 655.3500 FORMAT "%8.4" ECU_ADDRESS 0x50001E38 /end MEASUREMENT
/begin MEASUREMENT ThrVlv_PosnCtrlB1_I.facCtrlSldgMod "Position Controller of the throttle valve of motor bench one / gain of the proportional derivative controller" SWORD Fact1000 1 100 -32.76800 32.76700 FORMAT "%8.5" ECU_ADDRESS 0x50001E3A /end MEASUREMENT
/begin MEASUREMENT ThrVlv_PosnCtrlB1_I.facCtrlSldgModLhp "Position Controller of the throttle valve of motor bench one / gain of the proportional derivative controller at limp air postion" SWORD Fact1000 1 100 -32.76800 32.76700 FORMAT "%8.5" ECU_ADDRESS 0x50001E3C /end MEASUREMENT
/begin MEASUREMENT ThrVlv_PosnCtrlB1_I.facPreCtrlA1 "Position Controller of the throttle valve of motor bench one / pre-controller parameter" FLOAT32_IEEE OneToOne 1 100 -1.00000000E+037 1.00000000E+037 FORMAT "%13.3" ECU_ADDRESS 0x50001E40 /end MEASUREMENT
/begin MEASUREMENT ThrVlv_PosnCtrlB1_I.facPreCtrlA2 "Position Controller of the throttle valve of motor bench one / pre-controller parameter" FLOAT32_IEEE OneToOne 1 100 -1.00000000E+037 1.00000000E+037 FORMAT "%13.3" ECU_ADDRESS 0x50001E44 /end MEASUREMENT
/begin MEASUREMENT ThrVlv_PosnCtrlB1_I.facPreCtrlA3 "Position Controller of the throttle valve of motor bench one / pre-controller parameter" FLOAT32_IEEE OneToOne 1 100 -1.00000000E+037 1.00000000E+037 FORMAT "%13.3" ECU_ADDRESS 0x50001E48 /end MEASUREMENT
/begin MEASUREMENT ThrVlv_PosnCtrlB1_I.facPreCtrlB "Position Controller of the throttle valve of motor bench one / pre-controller parameter" FLOAT32_IEEE OneToOne 1 100 -1.00000000E+037 1.00000000E+037 FORMAT "%13.3" ECU_ADDRESS 0x50001E4C /end MEASUREMENT
/begin MEASUREMENT ThrVlv_PosnCtrlB1_I.facPreCtrlC "Position Controller of the throttle valve of motor bench one / pre-controller parameter" FLOAT32_IEEE OneToOne 1 100 -1.00000000E+037 1.00000000E+037 FORMAT "%13.3" ECU_ADDRESS 0x50001E50 /end MEASUREMENT
/begin MEASUREMENT ThrVlv_PosnCtrlB1_I.facUBatt "Position Controller of the throttle valve of motor bench one / factor for battery voltage compensation" UWORD fak_q6p1035Em5 1 100 0.00 3.999939 FORMAT "%8.6" ECU_ADDRESS 0x50001E54 /end MEASUREMENT
/begin MEASUREMENT ThrVlv_PosnCtrlB1_I.flgClsdPosnReaSuc "Position Controller of the throttle valve of motor bench one / valve fully closed" UBYTE OneToOne 1 100 0.00 1.000 BIT_MASK 0x1 FORMAT "%5.3" ECU_ADDRESS 0x50001E56 /end MEASUREMENT
/begin MEASUREMENT ThrVlv_PosnCtrlB1_I.flgCompProt "Position Controller of the throttle valve of motor bench one / component protection active" UBYTE OneToOne 1 100 0.00 1.000 BIT_MASK 0x1 FORMAT "%5.3" ECU_ADDRESS 0x50001E57 /end MEASUREMENT
/begin MEASUREMENT ThrVlv_PosnCtrlB1_I.flgCoolgDone "Position Controller of the throttle valve of motor bench one / actuator cooled down" UBYTE OneToOne 1 100 0.00 1.000 BIT_MASK 0x1 FORMAT "%5.3" ECU_ADDRESS 0x50001E58 /end MEASUREMENT
/begin MEASUREMENT ThrVlv_PosnCtrlB1_I.flgCsersDiagActv "Position Controller of the throttle valve of motor bench one / CSERS diagnosis active" UBYTE OneToOne 1 100 0.00 1.000 BIT_MASK 0x1 FORMAT "%5.3" ECU_ADDRESS 0x50001E59 /end MEASUREMENT
/begin MEASUREMENT ThrVlv_PosnCtrlB1_I.flgCsersDiagActvAtErrSet "Position Controller of the throttle valve of motor bench one / CSERS diagnosis was active at error setting" UBYTE OneToOne 1 100 0.00 1.000 BIT_MASK 0x1 FORMAT "%5.3" ECU_ADDRESS 0x50001E5A /end MEASUREMENT
/begin MEASUREMENT ThrVlv_PosnCtrlB1_I.flgCsersDiumprDenom "Position Controller of the throttle valve of motor bench one / increment of the DIUMPR (Diagnostic In-Use Monitor Performance Ratio) denominator" UBYTE OneToOne 1 100 0.00 1.000 BIT_MASK 0x1 FORMAT "%5.3" ECU_ADDRESS 0x50001E5B /end MEASUREMENT
/begin MEASUREMENT ThrVlv_PosnCtrlB1_I.flgCsersDiumprNumr "Position Controller of the throttle valve of motor bench one / increment of the DIUMPR (Diagnostic In-Use Monitor Performance Ratio) numerator" UBYTE OneToOne 1 100 0.00 1.000 BIT_MASK 0x1 FORMAT "%5.3" ECU_ADDRESS 0x50001E5C /end MEASUREMENT
/begin MEASUREMENT ThrVlv_PosnCtrlB1_I.flgCsersEnaCdn "Position Controller of the throttle valve of motor bench one / conditions of CSERS diagnosis fulfilled" UBYTE OneToOne 1 100 0.00 1.000 BIT_MASK 0x1 FORMAT "%5.3" ECU_ADDRESS 0x50001E5D /end MEASUREMENT
/begin MEASUREMENT ThrVlv_PosnCtrlB1_I.flgCtrlDeDeb "Position Controller of the throttle valve of motor bench one / control deviation is debounced" UBYTE OneToOne 1 100 0.00 1.000 BIT_MASK 0x1 FORMAT "%5.3" ECU_ADDRESS 0x50001E5E /end MEASUREMENT
/begin MEASUREMENT ThrVlv_PosnCtrlB1_I.flgCtrlDeDebCsers "Position Controller of the throttle valve of motor bench one / control deviation is debounced" UBYTE OneToOne 1 100 0.00 1.000 BIT_MASK 0x1 FORMAT "%5.3" ECU_ADDRESS 0x50001E5F /end MEASUREMENT
/begin MEASUREMENT ThrVlv_PosnCtrlB1_I.flgCtrlDeDfcLdc "Position Controller of the throttle valve of motor bench one / control deviation DFC in last driving cycle" UBYTE OneToOne 1 100 0.00 1.000 BIT_MASK 0x1 FORMAT "%5.3" ECU_ADDRESS 0x50001E60 /end MEASUREMENT
/begin MEASUREMENT ThrVlv_PosnCtrlB1_I.flgCtrlDeDfcLdcCsers "Position Controller of the throttle valve of motor bench one / control deviation DFC (CSERS) in last driving cycle" UBYTE OneToOne 1 100 0.00 1.000 BIT_MASK 0x1 FORMAT "%5.3" ECU_ADDRESS 0x50001E61 /end MEASUREMENT
/begin MEASUREMENT ThrVlv_PosnCtrlB1_I.flgCycCtrlDeMax "Position Controller of the throttle valve of motor bench one / cycle flag upper position" UBYTE OneToOne 1 100 0.00 1.000 BIT_MASK 0x1 FORMAT "%5.3" ECU_ADDRESS 0x50001E62 /end MEASUREMENT
/begin MEASUREMENT ThrVlv_PosnCtrlB1_I.flgCycCtrlDeMin "Position Controller of the throttle valve of motor bench one / cycle flag lower position" UBYTE OneToOne 1 100 0.00 1.000 BIT_MASK 0x1 FORMAT "%5.3" ECU_ADDRESS 0x50001E63 /end MEASUREMENT
/begin MEASUREMENT ThrVlv_PosnCtrlB1_I.flgCycDutyCycPsMax "Position Controller of the throttle valve of motor bench one / cycle flag upper position" UBYTE OneToOne 1 100 0.00 1.000 BIT_MASK 0x1 FORMAT "%5.3" ECU_ADDRESS 0x50001E64 /end MEASUREMENT
/begin MEASUREMENT ThrVlv_PosnCtrlB1_I.flgCycDutyCycPsMin "Position Controller of the throttle valve of motor bench one / cycle flag lower position" UBYTE OneToOne 1 100 0.00 1.000 BIT_MASK 0x1 FORMAT "%5.3" ECU_ADDRESS 0x50001E65 /end MEASUREMENT
/begin MEASUREMENT ThrVlv_PosnCtrlB1_I.flgDEDIA "Position Controller of the throttle valve of motor bench one / DEDIA active (local)" UBYTE OneToOne 1 100 0.00 1.000 BIT_MASK 0x1 FORMAT "%5.3" ECU_ADDRESS 0x50001E66 /end MEASUREMENT
/begin MEASUREMENT ThrVlv_PosnCtrlB1_I.flgDebLowUBatt "Position Controller of the throttle valve of motor bench one / low battery voltage debounced" UBYTE OneToOne 1 100 0.00 1.000 BIT_MASK 0x1 FORMAT "%5.3" ECU_ADDRESS 0x50001E67 /end MEASUREMENT
/begin MEASUREMENT ThrVlv_PosnCtrlB1_I.flgDebOpenLoad "Position Controller of the throttle valve of motor bench one / openload diagnosis is debounced" UBYTE OneToOne 1 100 0.00 1.000 BIT_MASK 0x1 FORMAT "%5.3" ECU_ADDRESS 0x50001E68 /end MEASUREMENT
/begin MEASUREMENT ThrVlv_PosnCtrlB1_I.flgDesValFromHeal "Position Controller of the throttle valve of motor bench one / desired value comes from healing function" UBYTE OneToOne 1 100 0.00 1.000 BIT_MASK 0x1 FORMAT "%5.3" ECU_ADDRESS 0x50001E69 /end MEASUREMENT
/begin MEASUREMENT ThrVlv_PosnCtrlB1_I.flgDesValVld "Position Controller of the throttle valve of motor bench one / desired value valid" UBYTE OneToOne 1 100 0.00 1.000 BIT_MASK 0x1 FORMAT "%5.3" ECU_ADDRESS 0x50001E6A /end MEASUREMENT
/begin MEASUREMENT ThrVlv_PosnCtrlB1_I.flgDetDfcDoneDcyc "Position Controller of the throttle valve of motor bench one / DFC detection done in this driving cycle" UBYTE OneToOne 1 100 0.00 1.000 BIT_MASK 0x1 FORMAT "%5.3" ECU_ADDRESS 0x50001E6B /end MEASUREMENT
/begin MEASUREMENT ThrVlv_PosnCtrlB1_I.flgDfcLdc "Position Controller of the throttle valve of motor bench one / Lageregler-DFC aus letztem Fahrzyklus uebernommen" UBYTE OneToOne 1 100 0.00 1.000 BIT_MASK 0x1 FORMAT "%5.3" ECU_ADDRESS 0x50001E6C /end MEASUREMENT
/begin MEASUREMENT ThrVlv_PosnCtrlB1_I.flgDfcSaved "Position Controller of the throttle valve of motor bench one / DFC saved in last driving cycle" UBYTE OneToOne 1 100 0.00 1.000 BIT_MASK 0x1 FORMAT "%5.3" ECU_ADDRESS 0x60038AC8 /end MEASUREMENT
/begin MEASUREMENT ThrVlv_PosnCtrlB1_I.flgDrvToLimpAirPosn "Position Controller of the throttle valve of motor bench one / driving to limp air position by electric motor is active" UBYTE OneToOne 1 100 0.00 1.000 BIT_MASK 0x1 FORMAT "%5.3" ECU_ADDRESS 0x50001E6D /end MEASUREMENT
/begin MEASUREMENT ThrVlv_PosnCtrlB1_I.flgDsmRdyDcyc "Position Controller of the throttle valve of motor bench one / DSM was ready in this driving cycle" UBYTE OneToOne 1 100 0.00 1.000 BIT_MASK 0x1 FORMAT "%5.3" ECU_ADDRESS 0x50001E6E /end MEASUREMENT
/begin MEASUREMENT ThrVlv_PosnCtrlB1_I.flgDstRea "Position Controller of the throttle valve of motor bench one / distance to reach healing" UBYTE OneToOne 1 100 0.00 1.000 BIT_MASK 0x1 FORMAT "%5.3" ECU_ADDRESS 0x50001E6F /end MEASUREMENT
/begin MEASUREMENT ThrVlv_PosnCtrlB1_I.flgDutyCycExcdDeb "Position Controller of the throttle valve of motor bench one / too high duty cycle is debounced" UBYTE OneToOne 1 100 0.00 1.000 BIT_MASK 0x1 FORMAT "%5.3" ECU_ADDRESS 0x50001E70 /end MEASUREMENT
/begin MEASUREMENT ThrVlv_PosnCtrlB1_I.flgDutyCycOpenLoopOpng "Position Controller of the throttle valve of motor bench one / open loop opening of the valve is active" UBYTE OneToOne 1 100 0.00 1.000 BIT_MASK 0x1 FORMAT "%5.3" ECU_ADDRESS 0x50001E71 /end MEASUREMENT
/begin MEASUREMENT ThrVlv_PosnCtrlB1_I.flgErrRprt "Position Controller of the throttle valve of motor bench one / error reported" UBYTE OneToOne 1 100 0.00 1.000 BIT_MASK 0x1 FORMAT "%5.3" ECU_ADDRESS 0x50001E72 /end MEASUREMENT
/begin MEASUREMENT ThrVlv_PosnCtrlB1_I.flgFailSafe "Position Controller of the throttle valve of motor bench one / moving to fail safe position accomplished" UBYTE OneToOne 1 100 0.00 1.000 BIT_MASK 0x1 FORMAT "%5.3" ECU_ADDRESS 0x50001E73 /end MEASUREMENT
/begin MEASUREMENT ThrVlv_PosnCtrlB1_I.flgFailSafeHealDfcActv "Position Controller of the throttle valve of motor bench one / moving to fail safe position in progress" UBYTE OneToOne 1 100 0.00 1.000 BIT_MASK 0x1 FORMAT "%5.3" ECU_ADDRESS 0x50001E74 /end MEASUREMENT
/begin MEASUREMENT ThrVlv_PosnCtrlB1_I.flgFailSafeOlcActv "Position Controller of the throttle valve of motor bench one / open loop opening respectively closing active" UBYTE OneToOne 1 100 0.00 1.000 BIT_MASK 0x1 FORMAT "%5.3" ECU_ADDRESS 0x50001E75 /end MEASUREMENT
/begin MEASUREMENT ThrVlv_PosnCtrlB1_I.flgFilRst "Position Controller of the throttle valve of motor bench one / reset filter of desired value" UBYTE OneToOne 1 100 0.00 1.000 BIT_MASK 0x1 FORMAT "%5.3" ECU_ADDRESS 0x50001E76 /end MEASUREMENT
/begin MEASUREMENT ThrVlv_PosnCtrlB1_I.flgFixdCtrlGain "Position Controller of the throttle valve of motor bench one / constant values for PID gains active" UBYTE OneToOne 1 100 0.00 1.000 BIT_MASK 0x1 FORMAT "%5.3" ECU_ADDRESS 0x50001E77 /end MEASUREMENT
/begin MEASUREMENT ThrVlv_PosnCtrlB1_I.flgGpfProtnActv "Position Controller of the throttle valve of motor bench one / particulate filter protection active" UBYTE OneToOne 1 100 0.00 1.000 BIT_MASK 0x1 FORMAT "%5.3" ECU_ADDRESS 0x50001E78 /end MEASUREMENT
/begin MEASUREMENT ThrVlv_PosnCtrlB1_I.flgHealAllwd "Position Controller of the throttle valve of motor bench one / conditions for healing are true" UBYTE OneToOne 1 100 0.00 1.000 BIT_MASK 0x1 FORMAT "%5.3" ECU_ADDRESS 0x50001E79 /end MEASUREMENT
/begin MEASUREMENT ThrVlv_PosnCtrlB1_I.flgHealDesValActv "Position Controller of the throttle valve of motor bench one / healing function active" UBYTE OneToOne 1 100 0.00 1.000 BIT_MASK 0x1 FORMAT "%5.3" ECU_ADDRESS 0x50001E7A /end MEASUREMENT
/begin MEASUREMENT ThrVlv_PosnCtrlB1_I.flgHealDfcActv "Position Controller of the throttle valve of motor bench one / healing function active" UBYTE OneToOne 1 100 0.00 1.000 BIT_MASK 0x1 FORMAT "%5.3" ECU_ADDRESS 0x50001E7B /end MEASUREMENT
/begin MEASUREMENT ThrVlv_PosnCtrlB1_I.flgHealDfcClsd "Position Controller of the throttle valve of motor bench one / healing function could close valve" UBYTE OneToOne 1 100 0.00 1.000 BIT_MASK 0x1 FORMAT "%5.3" ECU_ADDRESS 0x50001E7C /end MEASUREMENT
/begin MEASUREMENT ThrVlv_PosnCtrlB1_I.flgHealDfcOpend "Position Controller of the throttle valve of motor bench one / healing function could open valve" UBYTE OneToOne 1 100 0.00 1.000 BIT_MASK 0x1 FORMAT "%5.3" ECU_ADDRESS 0x50001E7D /end MEASUREMENT
/begin MEASUREMENT ThrVlv_PosnCtrlB1_I.flgHealFail "Position Controller of the throttle valve of motor bench one / healing failed" UBYTE OneToOne 1 100 0.00 1.000 BIT_MASK 0x1 FORMAT "%5.3" ECU_ADDRESS 0x50001E7E /end MEASUREMENT
/begin MEASUREMENT ThrVlv_PosnCtrlB1_I.flgHealSuc "Position Controller of the throttle valve of motor bench one / healing was successful" UBYTE OneToOne 1 100 0.00 1.000 BIT_MASK 0x1 FORMAT "%5.3" ECU_ADDRESS 0x50001E7F /end MEASUREMENT
/begin MEASUREMENT ThrVlv_PosnCtrlB1_I.flgHldClsdAbortIniFil "Position Controller of the throttle valve of motor bench one / hold closed deactivated reset filters" UBYTE OneToOne 1 100 0.00 1.000 BIT_MASK 0x1 FORMAT "%5.3" ECU_ADDRESS 0x50001E80 /end MEASUREMENT
/begin MEASUREMENT ThrVlv_PosnCtrlB1_I.flgHldClsdActv "Position Controller of the throttle valve of motor bench one / hold closed active" UBYTE OneToOne 1 100 0.00 1.000 BIT_MASK 0x1 FORMAT "%5.3" ECU_ADDRESS 0x50001E81 /end MEASUREMENT
/begin MEASUREMENT ThrVlv_PosnCtrlB1_I.flgHldClsdAvl "Position Controller of the throttle valve of motor bench one / hold closed available" UBYTE OneToOne 1 100 0.00 1.000 BIT_MASK 0x1 FORMAT "%5.3" ECU_ADDRESS 0x50001E82 /end MEASUREMENT
/begin MEASUREMENT ThrVlv_PosnCtrlB1_I.flgHldClsdDynPeak "Position Controller of the throttle valve of motor bench one / hold closed dynamic peak active" UBYTE OneToOne 1 100 0.00 1.000 BIT_MASK 0x1 FORMAT "%5.3" ECU_ADDRESS 0x50001E83 /end MEASUREMENT
/begin MEASUREMENT ThrVlv_PosnCtrlB1_I.flgHldClsdMaps "Position Controller of the throttle valve of motor bench one / duty cycle maps for hldclosed active" UBYTE OneToOne 1 100 0.00 1.000 BIT_MASK 0x1 FORMAT "%5.3" ECU_ADDRESS 0x50001E84 /end MEASUREMENT
/begin MEASUREMENT ThrVlv_PosnCtrlB1_I.flgHldOpenActv "Position Controller of the throttle valve of motor bench one / hold open active" UBYTE OneToOne 1 100 0.00 1.000 BIT_MASK 0x1 FORMAT "%5.3" ECU_ADDRESS 0x50001E85 /end MEASUREMENT
/begin MEASUREMENT ThrVlv_PosnCtrlB1_I.flgIniDesFil "Position Controller of the throttle valve of motor bench one / initialise desired position filters" UBYTE OneToOne 1 100 0.00 1.000 BIT_MASK 0x1 FORMAT "%5.3" ECU_ADDRESS 0x50001E86 /end MEASUREMENT
/begin MEASUREMENT ThrVlv_PosnCtrlB1_I.flgIniDesFilNegSp "Position Controller of the throttle valve of motor bench one / initialise desired position filters (after negative desired positions)" UBYTE OneToOne 1 100 0.00 1.000 BIT_MASK 0x1 FORMAT "%5.3" ECU_ADDRESS 0x50001E87 /end MEASUREMENT
/begin MEASUREMENT ThrVlv_PosnCtrlB1_I.flgIniDesFilUnlimSp "Position Controller of the throttle valve of motor bench one / initialise desired position filters (after unlimited desired positions)" UBYTE OneToOne 1 100 0.00 1.000 BIT_MASK 0x1 FORMAT "%5.3" ECU_ADDRESS 0x50001E88 /end MEASUREMENT
/begin MEASUREMENT ThrVlv_PosnCtrlB1_I.flgIntglRst "Position Controller of the throttle valve of motor bench one / reset of the integrator" UBYTE OneToOne 1 100 0.00 1.000 BIT_MASK 0x1 FORMAT "%5.3" ECU_ADDRESS 0x50001E89 /end MEASUREMENT
/begin MEASUREMENT ThrVlv_PosnCtrlB1_I.flgLhpStuck "Position Controller of the throttle valve of motor bench one / stuck detection at limp air position" UBYTE OneToOne 1 100 0.00 1.000 BIT_MASK 0x1 FORMAT "%5.3" ECU_ADDRESS 0x50001E8A /end MEASUREMENT
/begin MEASUREMENT ThrVlv_PosnCtrlB1_I.flgLimpAirPosnNotRea "Position Controller of the throttle valve of motor bench one / limp home driving: limp home position not reached" UBYTE OneToOne 1 100 0.00 1.000 BIT_MASK 0x1 FORMAT "%5.3" ECU_ADDRESS 0x50001E8B /end MEASUREMENT
/begin MEASUREMENT ThrVlv_PosnCtrlB1_I.flgLimpAirPosnRegn "Position Controller of the throttle valve of motor bench one / trajectory is near the limp air position" UBYTE OneToOne 1 100 0.00 1.000 BIT_MASK 0x1 FORMAT "%5.3" ECU_ADDRESS 0x50001E8C /end MEASUREMENT
/begin MEASUREMENT ThrVlv_PosnCtrlB1_I.flgLimpAirPosnRegnSp "Position Controller of the throttle valve of motor bench one / desired and actal position are near to the limp air position" UBYTE OneToOne 1 100 0.00 1.000 BIT_MASK 0x1 FORMAT "%5.3" ECU_ADDRESS 0x50001E8D /end MEASUREMENT
/begin MEASUREMENT ThrVlv_PosnCtrlB1_I.flgLmsClsngActv "Position Controller of the throttle valve of motor bench one / lower mechanical stop closing active" UBYTE OneToOne 1 100 0.00 1.000 BIT_MASK 0x1 FORMAT "%5.3" ECU_ADDRESS 0x50001E8E /end MEASUREMENT
/begin MEASUREMENT ThrVlv_PosnCtrlB1_I.flgLmsClsngDeactvtPwrSave "Position Controller of the throttle valve of motor bench one / lower mechanical stop closing requests deactivation of power save" UBYTE OneToOne 1 100 0.00 1.000 BIT_MASK 0x1 FORMAT "%5.3" ECU_ADDRESS 0x50001E8F /end MEASUREMENT
/begin MEASUREMENT ThrVlv_PosnCtrlB1_I.flgLmsClsngDone "Position Controller of the throttle valve of motor bench one / lower mechanical stop closing successfully done" UBYTE OneToOne 1 100 0.00 1.000 BIT_MASK 0x1 FORMAT "%5.3" ECU_ADDRESS 0x50001E90 /end MEASUREMENT
/begin MEASUREMENT ThrVlv_PosnCtrlB1_I.flgLmsPsd "Position Controller of the throttle valve of motor bench one / Valve is pressed to mechanical stop" UBYTE OneToOne 1 100 0.00 1.000 BIT_MASK 0x1 FORMAT "%5.3" ECU_ADDRESS 0x50001E91 /end MEASUREMENT
/begin MEASUREMENT ThrVlv_PosnCtrlB1_I.flgLmsRea "Position Controller of the throttle valve of motor bench one / LmsClsng is pressing mechanical stop" UBYTE OneToOne 1 100 0.00 1.000 BIT_MASK 0x1 FORMAT "%5.3" ECU_ADDRESS 0x50001E92 /end MEASUREMENT
/begin MEASUREMENT ThrVlv_PosnCtrlB1_I.flgLongTermOffs "Position Controller of the throttle valve of motor bench one / long term adaptation value in use" UBYTE OneToOne 1 100 0.00 1.000 BIT_MASK 0x1 FORMAT "%5.3" ECU_ADDRESS 0x50001E93 /end MEASUREMENT
/begin MEASUREMENT ThrVlv_PosnCtrlB1_I.flgOffsLrnPsErr "Position Controller of the throttle valve of motor bench one / powerstage error reported by OffsLrn" UBYTE OneToOne 1 100 0.00 1.000 BIT_MASK 0x1 FORMAT "%5.3" ECU_ADDRESS 0x50001E94 /end MEASUREMENT
/begin MEASUREMENT ThrVlv_PosnCtrlB1_I.flgOpenPosnReaSuc "Position Controller of the throttle valve of motor bench one / valve fully open" UBYTE OneToOne 1 100 0.00 1.000 BIT_MASK 0x1 FORMAT "%5.3" ECU_ADDRESS 0x50001E95 /end MEASUREMENT
/begin MEASUREMENT ThrVlv_PosnCtrlB1_I.flgOpngAftLongHldClsd "Position Controller of the throttle valve of motor bench one / opening after long HldClsd active" UBYTE OneToOne 1 100 0.00 1.000 BIT_MASK 0x1 FORMAT "%5.3" ECU_ADDRESS 0x50001E96 /end MEASUREMENT
/begin MEASUREMENT ThrVlv_PosnCtrlB1_I.flgPosnCtrlErr "Position Controller of the throttle valve of motor bench one / Debounced error in position controller" UBYTE OneToOne 1 100 0.00 1.000 BIT_MASK 0x1 FORMAT "%5.3" ECU_ADDRESS 0x50001E97 /end MEASUREMENT
/begin MEASUREMENT ThrVlv_PosnCtrlB1_I.flgPosnCtrlPsOff "Position Controller of the throttle valve of motor bench one / central switch off of powerstage" UBYTE OneToOne 1 100 0.00 1.000 BIT_MASK 0x1 FORMAT "%5.3" ECU_ADDRESS 0x50001E98 /end MEASUREMENT
/begin MEASUREMENT ThrVlv_PosnCtrlB1_I.flgPosnCtrlSlow "Position Controller of the throttle valve of motor bench one / Flag for slow position control mode" UBYTE OneToOne 1 100 0.00 1.000 BIT_MASK 0x1 FORMAT "%5.3" ECU_ADDRESS 0x50001E99 /end MEASUREMENT
/begin MEASUREMENT ThrVlv_PosnCtrlB1_I.flgPsOff "Position Controller of the throttle valve of motor bench one / powerstage switched off" UBYTE OneToOne 1 100 0.00 1.000 BIT_MASK 0x1 FORMAT "%5.3" ECU_ADDRESS 0x50001E9A /end MEASUREMENT
/begin MEASUREMENT ThrVlv_PosnCtrlB1_I.flgPsRdy "Position Controller of the throttle valve of motor bench one / power stage ready" UBYTE OneToOne 1 100 0.00 1.000 BIT_MASK 0x1 FORMAT "%5.3" ECU_ADDRESS 0x50001E9B /end MEASUREMENT
/begin MEASUREMENT ThrVlv_PosnCtrlB1_I.flgPsRst "Position Controller of the throttle valve of motor bench one / powerstage reset" UBYTE OneToOne 1 100 0.00 1.000 BIT_MASK 0x1 FORMAT "%5.3" ECU_ADDRESS 0x50001E9C /end MEASUREMENT
/begin MEASUREMENT ThrVlv_PosnCtrlB1_I.flgPsSwtOffDiag "Position Controller of the throttle valve of motor bench one / powerstage switched off by diagnosis" UBYTE OneToOne 1 100 0.00 1.000 BIT_MASK 0x1 FORMAT "%5.3" ECU_ADDRESS 0x50001E9D /end MEASUREMENT
/begin MEASUREMENT ThrVlv_PosnCtrlB1_I.flgPwrSaveCdn "Position Controller of the throttle valve of motor bench one / condition for powersave fulfilled" UBYTE OneToOne 1 100 0.00 1.000 BIT_MASK 0x1 FORMAT "%5.3" ECU_ADDRESS 0x50001E9E /end MEASUREMENT
/begin MEASUREMENT ThrVlv_PosnCtrlB1_I.flgRampDwn "Position Controller of the throttle valve of motor bench one / ramp towards lower electrical stop is active" UBYTE OneToOne 1 100 0.00 1.000 BIT_MASK 0x1 FORMAT "%5.3" ECU_ADDRESS 0x50001E9F /end MEASUREMENT
/begin MEASUREMENT ThrVlv_PosnCtrlB1_I.flgRampDwnDutyLim "Position Controller of the throttle valve of motor bench one / lower duty cycle limit for driving to the lower mechanical stop switched on" UBYTE OneToOne 1 100 0.00 1.000 BIT_MASK 0x1 FORMAT "%5.3" ECU_ADDRESS 0x50001EA0 /end MEASUREMENT
/begin MEASUREMENT ThrVlv_PosnCtrlB1_I.flgRampDwnEna "Position Controller of the throttle valve of motor bench one / function ramp towards lower electrical stop is enabled" UBYTE OneToOne 1 100 0.00 1.000 BIT_MASK 0x1 FORMAT "%5.3" ECU_ADDRESS 0x50001EA1 /end MEASUREMENT
/begin MEASUREMENT ThrVlv_PosnCtrlB1_I.flgReqPsOffBattChk "Position Controller of the throttle valve of motor bench one / switch off powerstage too low battery voltage" UBYTE OneToOne 1 100 0.00 1.000 BIT_MASK 0x1 FORMAT "%5.3" ECU_ADDRESS 0x50001EA2 /end MEASUREMENT
/begin MEASUREMENT ThrVlv_PosnCtrlB1_I.flgReqPsOffCtrlErr "Position Controller of the throttle valve of motor bench one / switch off of the powerstage due to controller error" UBYTE OneToOne 1 100 0.00 1.000 BIT_MASK 0x1 FORMAT "%5.3" ECU_ADDRESS 0x50001EA3 /end MEASUREMENT
/begin MEASUREMENT ThrVlv_PosnCtrlB1_I.flgReqPsOffExtdPostDrv "Position Controller of the throttle valve of motor bench one / switch off powerstage by postdrive prolongation" UBYTE OneToOne 1 100 0.00 1.000 BIT_MASK 0x1 FORMAT "%5.3" ECU_ADDRESS 0x50001EA4 /end MEASUREMENT
/begin MEASUREMENT ThrVlv_PosnCtrlB1_I.flgReqPsOffPwrSave "Position Controller of the throttle valve of motor bench one / switch off powerstage powersave" UBYTE OneToOne 1 100 0.00 1.000 BIT_MASK 0x1 FORMAT "%5.3" ECU_ADDRESS 0x50001EA5 /end MEASUREMENT
/begin MEASUREMENT ThrVlv_PosnCtrlB1_I.flgRstIPrtn "Position Controller of the throttle valve of motor bench one / reset of the integral part" UBYTE OneToOne 1 100 0.00 1.000 BIT_MASK 0x1 FORMAT "%5.3" ECU_ADDRESS 0x50001EA6 /end MEASUREMENT
/begin MEASUREMENT ThrVlv_PosnCtrlB1_I.flgRstIPrtnFailSafe "Position Controller of the throttle valve of motor bench one / reset of the integral part" UBYTE OneToOne 1 100 0.00 1.000 BIT_MASK 0x1 FORMAT "%5.3" ECU_ADDRESS 0x50001EA7 /end MEASUREMENT
/begin MEASUREMENT ThrVlv_PosnCtrlB1_I.flgRstIPrtnHealDesVal "Position Controller of the throttle valve of motor bench one / reset of the integral part" UBYTE OneToOne 1 100 0.00 1.000 BIT_MASK 0x1 FORMAT "%5.3" ECU_ADDRESS 0x50001EA8 /end MEASUREMENT
/begin MEASUREMENT ThrVlv_PosnCtrlB1_I.flgSftyInhb "Position Controller of the throttle valve of motor bench one / Safety Inhibit of the position controller" UBYTE OneToOne 1 100 0.00 1.000 BIT_MASK 0x1 FORMAT "%5.3" ECU_ADDRESS 0x50001EA9 /end MEASUREMENT
/begin MEASUREMENT ThrVlv_PosnCtrlB1_I.flgSlowTrj "Position Controller of the throttle valve of motor bench one / slow trajectory" UBYTE OneToOne 1 100 0.00 1.000 BIT_MASK 0x1 FORMAT "%5.3" ECU_ADDRESS 0x50001EAA /end MEASUREMENT
/begin MEASUREMENT ThrVlv_PosnCtrlB1_I.flgSoftLdgActv "Position Controller of the throttle valve of motor bench one / softlanding active" UBYTE OneToOne 1 100 0.00 1.000 BIT_MASK 0x1 FORMAT "%5.3" ECU_ADDRESS 0x50001EAB /end MEASUREMENT
/begin MEASUREMENT ThrVlv_PosnCtrlB1_I.flgSoftLdgEna "Position Controller of the throttle valve of motor bench one / softlanding switched on" UBYTE OneToOne 1 100 0.00 1.000 BIT_MASK 0x1 FORMAT "%5.3" ECU_ADDRESS 0x50001EAC /end MEASUREMENT
/begin MEASUREMENT ThrVlv_PosnCtrlB1_I.flgSoftLdgRegn "Position Controller of the throttle valve of motor bench one / position condition softlanding valid" UBYTE OneToOne 1 100 0.00 1.000 BIT_MASK 0x1 FORMAT "%5.3" ECU_ADDRESS 0x50001EAD /end MEASUREMENT
/begin MEASUREMENT ThrVlv_PosnCtrlB1_I.flgSoftLmsLvngActv "Position Controller of the throttle valve of motor bench one / soft leaving active" UBYTE OneToOne 1 100 0.00 1.000 BIT_MASK 0x1 FORMAT "%5.3" ECU_ADDRESS 0x50001EAE /end MEASUREMENT
/begin MEASUREMENT ThrVlv_PosnCtrlB1_I.flgSoftLmsLvngIniFil "Position Controller of the throttle valve of motor bench one / initialise desired position filter" UBYTE OneToOne 1 100 0.00 1.000 BIT_MASK 0x1 FORMAT "%5.3" ECU_ADDRESS 0x50001EAF /end MEASUREMENT
/begin MEASUREMENT ThrVlv_PosnCtrlB1_I.flgSoftLmsLvngRegn "Position Controller of the throttle valve of motor bench one / position condition soft leaving valid" UBYTE OneToOne 1 100 0.00 1.000 BIT_MASK 0x1 FORMAT "%5.3" ECU_ADDRESS 0x50001EB0 /end MEASUREMENT
/begin MEASUREMENT ThrVlv_PosnCtrlB1_I.flgStrtEnd "Position Controller of the throttle valve of motor bench one / Local variable: end of start" UBYTE OneToOne 1 100 0.00 1.000 BIT_MASK 0x1 FORMAT "%5.3" ECU_ADDRESS 0x50001EB1 /end MEASUREMENT
/begin MEASUREMENT ThrVlv_PosnCtrlB1_I.flgStuckAtCls "Position Controller of the throttle valve of motor bench one / valve stuck at closing" UBYTE OneToOne 1 100 0.00 1.000 BIT_MASK 0x1 FORMAT "%5.3" ECU_ADDRESS 0x50001EB2 /end MEASUREMENT
/begin MEASUREMENT ThrVlv_PosnCtrlB1_I.flgStuckAtOpng "Position Controller of the throttle valve of motor bench one / valve stuck at opening" UBYTE OneToOne 1 100 0.00 1.000 BIT_MASK 0x1 FORMAT "%5.3" ECU_ADDRESS 0x50001EB3 /end MEASUREMENT
/begin MEASUREMENT ThrVlv_PosnCtrlB1_I.flgStuckPosnClsd "Position Controller of the throttle valve of motor bench one / valve is stuck in closed position" UBYTE OneToOne 1 100 0.00 1.000 BIT_MASK 0x1 FORMAT "%5.3" ECU_ADDRESS 0x50001EB4 /end MEASUREMENT
/begin MEASUREMENT ThrVlv_PosnCtrlB1_I.flgStuckPosnDetnActv "Position Controller of the throttle valve of motor bench one / stuck position detection active" UBYTE OneToOne 1 100 0.00 1.000 BIT_MASK 0x1 FORMAT "%5.3" ECU_ADDRESS 0x50001EB5 /end MEASUREMENT
/begin MEASUREMENT ThrVlv_PosnCtrlB1_I.flgStuckPosnOpen "Position Controller of the throttle valve of motor bench one / valve is stuck in open position" UBYTE OneToOne 1 100 0.00 1.000 BIT_MASK 0x1 FORMAT "%5.3" ECU_ADDRESS 0x50001EB6 /end MEASUREMENT
/begin MEASUREMENT ThrVlv_PosnCtrlB1_I.flgStuckStrd "Position Controller of the throttle valve of motor bench one / stuckposition stored" UBYTE OneToOne 1 100 0.00 1.000 BIT_MASK 0x1 FORMAT "%5.3" ECU_ADDRESS 0x50001EB7 /end MEASUREMENT
/begin MEASUREMENT ThrVlv_PosnCtrlB1_I.flgSwtOffCtrlStatyCdn "Position Controller of the throttle valve of motor bench one / stationary switch off of controller parts possible" UBYTE OneToOne 1 100 0.00 1.000 BIT_MASK 0x1 FORMAT "%5.3" ECU_ADDRESS 0x50001EB8 /end MEASUREMENT
/begin MEASUREMENT ThrVlv_PosnCtrlB1_I.flgTDpdtDutyCycOffsLrnLim "Position Controller of the throttle valve of motor bench one / state dependent duty cycle limitation at offset learning active" UBYTE OneToOne 1 100 0.00 1.000 BIT_MASK 0x1 FORMAT "%5.3" ECU_ADDRESS 0x50001EB9 /end MEASUREMENT
/begin MEASUREMENT ThrVlv_PosnCtrlB1_I.flgTInvldDebd "Position Controller of the throttle valve of motor bench one / invalid temperature signal debounced" UBYTE OneToOne 1 100 0.00 1.000 BIT_MASK 0x1 FORMAT "%5.3" ECU_ADDRESS 0x50001EBA /end MEASUREMENT
/begin MEASUREMENT ThrVlv_PosnCtrlB1_I.flgTSnsrAdpnDoneDcyc "Position Controller of the throttle valve of motor bench one / temperature sensor adaptation done in this driving cycle" UBYTE OneToOne 1 100 0.00 1.000 BIT_MASK 0x1 FORMAT "%5.3" ECU_ADDRESS 0x50001EBB /end MEASUREMENT
/begin MEASUREMENT ThrVlv_PosnCtrlB1_I.flgTSnsrOffsAdpd "Position Controller of the throttle valve of motor bench one / status that temperature offset was adapted" UBYTE OneToOne 1 100 0.00 1.000 BIT_MASK 0x1 FORMAT "%5.3" ECU_ADDRESS 0x60038AC9 /end MEASUREMENT
/begin MEASUREMENT ThrVlv_PosnCtrlB1_I.flgTVldDcyc "Position Controller of the throttle valve of motor bench one / temperature signal was valid in this driving cycle" UBYTE OneToOne 1 100 0.00 1.000 BIT_MASK 0x1 FORMAT "%5.3" ECU_ADDRESS 0x50001EBC /end MEASUREMENT
/begin MEASUREMENT ThrVlv_PosnCtrlB1_I.flgTiEngOffCdn "Position Controller of the throttle valve of motor bench one / Time Engine Off Sufficient" UBYTE OneToOne 1 100 0.00 1.000 BIT_MASK 0x1 FORMAT "%5.3" ECU_ADDRESS 0x50001EBD /end MEASUREMENT
/begin MEASUREMENT ThrVlv_PosnCtrlB1_I.flgTiSuffToReaLimpAirPosn "Position Controller of the throttle valve of motor bench one / time to reach limp air position is over" UBYTE OneToOne 1 100 0.00 1.000 BIT_MASK 0x1 FORMAT "%5.3" ECU_ADDRESS 0x50001EBE /end MEASUREMENT
/begin MEASUREMENT ThrVlv_PosnCtrlB1_I.flgTrigHealDfc "Position Controller of the throttle valve of motor bench one / trigger for healing of DFC" UBYTE OneToOne 1 100 0.00 1.000 BIT_MASK 0x1 FORMAT "%5.3" ECU_ADDRESS 0x50001EBF /end MEASUREMENT
/begin MEASUREMENT ThrVlv_PosnCtrlB1_I.flgTrjAdpnDurgSatn "Position Controller of the throttle valve of motor bench one / trajectory adaptation active" UBYTE OneToOne 1 100 0.00 1.000 BIT_MASK 0x1 FORMAT "%5.3" ECU_ADDRESS 0x50001EC0 /end MEASUREMENT
/begin MEASUREMENT ThrVlv_PosnCtrlB1_I.flgTrjAdpnInhb "Position Controller of the throttle valve of motor bench one / trajectory adaptation inhibited" UBYTE OneToOne 1 100 0.00 1.000 BIT_MASK 0x1 FORMAT "%5.3" ECU_ADDRESS 0x50001EC1 /end MEASUREMENT
/begin MEASUREMENT ThrVlv_PosnCtrlB1_I.flgVlvDrv "Position Controller of the throttle valve of motor bench one / valve driven to fail safe position" UBYTE OneToOne 1 100 0.00 1.000 BIT_MASK 0x1 FORMAT "%5.3" ECU_ADDRESS 0x50001EC2 /end MEASUREMENT
/begin MEASUREMENT ThrVlv_PosnCtrlB1_I.flgVvtEndPosn "Position Controller of the throttle valve of motor bench one / limp home driving with vvt: time for end position is over" UBYTE OneToOne 1 100 0.00 1.000 BIT_MASK 0x1 FORMAT "%5.3" ECU_ADDRESS 0x50001EC3 /end MEASUREMENT
/begin MEASUREMENT ThrVlv_PosnCtrlB1_I.flgXPostDrv "Position Controller of the throttle valve of motor bench one / extension of post drive" UBYTE OneToOne 1 100 0.00 1.000 BIT_MASK 0x1 FORMAT "%5.3" ECU_ADDRESS 0x50001EC4 /end MEASUREMENT
/begin MEASUREMENT ThrVlv_PosnCtrlB1_I.iElecMot "Position Controller of the throttle valve of motor bench one / current through actuator without countervoltage" SWORD i_q0p001_A 1 100 -32.76800 32.76700 FORMAT "%8.5" ECU_ADDRESS 0x50001EC6 /end MEASUREMENT
/begin MEASUREMENT ThrVlv_PosnCtrlB1_I.idxActrTyp "Position Controller of the throttle valve of motor bench one / actuator type" UBYTE OneToOne 1 100 0.00 255.0 FORMAT "%5.1" ECU_ADDRESS 0x50001EC8 /end MEASUREMENT
/begin MEASUREMENT ThrVlv_PosnCtrlB1_I.idxSnsrOffsAdpd "Position Controller of the throttle valve of motor bench one / index of array" UBYTE OneToOne 1 100 0.00 255.0 FORMAT "%5.1" ECU_ADDRESS 0x60038ACA /end MEASUREMENT
/begin MEASUREMENT ThrVlv_PosnCtrlB1_I.nrPntsSnsrOffsAdpd "Position Controller of the throttle valve of motor bench one / number of adapted offsets" UBYTE OneToOne 1 100 0.00 255.0 FORMAT "%5.1" ECU_ADDRESS 0x60038ACB /end MEASUREMENT
/begin MEASUREMENT ThrVlv_PosnCtrlB1_I.nrRepHeal "Position Controller of the throttle valve of motor bench one / number of accomplished healing trials" UBYTE OneToOne 1 100 0.00 255.0 FORMAT "%5.1" ECU_ADDRESS 0x50001EC9 /end MEASUREMENT
/begin MEASUREMENT ThrVlv_PosnCtrlB1_I.nrRepHealDfc "Position Controller of the throttle valve of motor bench one / number of healing trials" UBYTE OneToOne 1 100 0.00 255.0 FORMAT "%5.1" ECU_ADDRESS 0x50001ECA /end MEASUREMENT
/begin MEASUREMENT ThrVlv_PosnCtrlB1_I.nrRepRamp "Position Controller of the throttle valve of motor bench one / number of pressure checks" UBYTE OneToOne 1 100 0.00 255.0 FORMAT "%5.1" ECU_ADDRESS 0x50001ECB /end MEASUREMENT
/begin MEASUREMENT ThrVlv_PosnCtrlB1_I.nrStepDetDfc "Position Controller of the throttle valve of motor bench one / step in detection of DFC" UBYTE OneToOne 1 100 0.00 255.0 FORMAT "%5.1" ECU_ADDRESS 0x50001ECC /end MEASUREMENT
/begin MEASUREMENT ThrVlv_PosnCtrlB1_I.nrStepFailSafeOlc "Position Controller of the throttle valve of motor bench one / step in open loop opening respectively closing" UBYTE OneToOne 1 100 0.00 255.0 FORMAT "%5.1" ECU_ADDRESS 0x50001ECD /end MEASUREMENT
/begin MEASUREMENT ThrVlv_PosnCtrlB1_I.nrStepHeal "Position Controller of the throttle valve of motor bench one / step in healing by desired value" UWORD OneToOne 1 100 0.00 65535.00 FORMAT "%8.2" ECU_ADDRESS 0x50001ECE /end MEASUREMENT
/begin MEASUREMENT ThrVlv_PosnCtrlB1_I.nrStepHealDfc "Position Controller of the throttle valve of motor bench one / step in healing of DFC" UBYTE OneToOne 1 100 0.00 255.0 FORMAT "%5.1" ECU_ADDRESS 0x50001ED0 /end MEASUREMENT
/begin MEASUREMENT ThrVlv_PosnCtrlB1_I.nrStepLmsClsng "Position Controller of the throttle valve of motor bench one / step in valve closing to lower mechanical stop" UBYTE OneToOne 1 100 0.00 255.0 FORMAT "%5.1" ECU_ADDRESS 0x50001ED1 /end MEASUREMENT
/begin MEASUREMENT ThrVlv_PosnCtrlB1_I.nrStepOpngAftLongHldClsd "Position Controller of the throttle valve of motor bench one / step in opening after long HldClsd" UWORD OneToOne 1 100 0.00 65535.00 FORMAT "%8.2" ECU_ADDRESS 0x50001ED2 /end MEASUREMENT
/begin MEASUREMENT ThrVlv_PosnCtrlB1_I.nrStepTSnsrAdpn "Position Controller of the throttle valve of motor bench one / step in finite state machine" UBYTE OneToOne 1 100 0.00 255.0 FORMAT "%5.1" ECU_ADDRESS 0x50001ED4 /end MEASUREMENT
/begin MEASUREMENT ThrVlv_PosnCtrlB1_I.rElecMot "Position Controller of the throttle valve of motor bench one / ohmic resistor" UWORD r_q0p001_Ohm 1 100 0.00100 65.53500 FORMAT "%8.5" ECU_ADDRESS 0x50001ED6 /end MEASUREMENT
/begin MEASUREMENT ThrVlv_PosnCtrlB1_I.ratActPosnSdlg "Position Controller of the throttle valve of motor bench one / actual position for controller scheduling" SWORD rel_q0p0078125 1 100 -256.0000 255.9922 FORMAT "%8.4" ECU_ADDRESS 0x50001EDA /end MEASUREMENT
/begin MEASUREMENT ThrVlv_PosnCtrlB1_I.ratActSldgModOld "Position Controller of the throttle valve of motor bench one / actual position (old value)" SWORD rel_q0p0078125 1 100 -256.0000 255.9922 FORMAT "%8.4" ECU_ADDRESS 0x50001EDC /end MEASUREMENT
/begin MEASUREMENT ThrVlv_PosnCtrlB1_I.ratActSldgModOldOld "Position Controller of the throttle valve of motor bench one / actual position (old value)" SWORD rel_q0p0078125 1 100 -256.0000 255.9922 FORMAT "%8.4" ECU_ADDRESS 0x50001EDE /end MEASUREMENT
/begin MEASUREMENT ThrVlv_PosnCtrlB1_I.ratActSldgModOldOldOld "Position Controller of the throttle valve of motor bench one / actual position (old value)" SWORD rel_q0p0078125 1 100 -256.0000 255.9922 FORMAT "%8.4" ECU_ADDRESS 0x50001EE0 /end MEASUREMENT
/begin MEASUREMENT ThrVlv_PosnCtrlB1_I.ratActThd "Position Controller of the throttle valve of motor bench one / threshold for actual position" SWORD rel_q0p0078125 1 100 -256.0000 255.9922 FORMAT "%8.4" ECU_ADDRESS 0x50001EE2 /end MEASUREMENT
/begin MEASUREMENT ThrVlv_PosnCtrlB1_I.ratActVCalcnOld "Position Controller of the throttle valve of motor bench one / actual value (old value)" SWORD rel_q0p0078125 1 100 -256.0000 255.9922 FORMAT "%8.4" ECU_ADDRESS 0x50001EE4 /end MEASUREMENT
/begin MEASUREMENT ThrVlv_PosnCtrlB1_I.ratDeCtrlr "Position Controller of the throttle valve of motor bench one / control deviation" SWORD rel_q0p0078125 1 100 -256.0000 255.9922 FORMAT "%8.4" ECU_ADDRESS 0x50001EE6 /end MEASUREMENT
/begin MEASUREMENT ThrVlv_PosnCtrlB1_I.ratDeCtrlrEndVal "Position Controller of the throttle valve of motor bench one / control deviation relative to hard desired value" SWORD rel_q0p0078125 1 100 -256.0000 255.9922 FORMAT "%8.4" ECU_ADDRESS 0x50001EE8 /end MEASUREMENT
/begin MEASUREMENT ThrVlv_PosnCtrlB1_I.ratDeCtrlrEndValAbslt "Position Controller of the throttle valve of motor bench one / absolute value of the control deviation relative to hard desired value" SWORD rel_q0p0078125 1 100 -256.0000 255.9922 FORMAT "%8.4" ECU_ADDRESS 0x50001EEA /end MEASUREMENT
/begin MEASUREMENT ThrVlv_PosnCtrlB1_I.ratDeCtrlrOld "Position Controller of the throttle valve of motor bench one / control deviation old value" SWORD rel_q0p0078125 1 100 -256.0000 255.9922 FORMAT "%8.4" ECU_ADDRESS 0x50001EEC /end MEASUREMENT
/begin MEASUREMENT ThrVlv_PosnCtrlB1_I.ratDeCtrlrSdlg "Position Controller of the throttle valve of motor bench one / control deviation for scheduling of the controller parameters" SWORD rel_q0p0078125 1 100 -256.0000 255.9922 FORMAT "%8.4" ECU_ADDRESS 0x50001EEE /end MEASUREMENT
/begin MEASUREMENT ThrVlv_PosnCtrlB1_I.ratDes "Position Controller of the throttle valve of motor bench one / desired position" SWORD rel_q0p0078125 1 100 -256.0000 255.9922 FORMAT "%8.4" ECU_ADDRESS 0x50001EF0 /end MEASUREMENT
/begin MEASUREMENT ThrVlv_PosnCtrlB1_I.ratDesFil "Position Controller of the throttle valve of motor bench one / filtered desired value" SWORD rel_q0p0078125 1 100 -256.0000 255.9922 FORMAT "%8.4" ECU_ADDRESS 0x50001EF2 /end MEASUREMENT
/begin MEASUREMENT ThrVlv_PosnCtrlB1_I.ratDesFilLowrLim "Position Controller of the throttle valve of motor bench one / lower limit for the allowed actual position" SWORD rel_q0p0078125 1 100 -256.0000 255.9922 FORMAT "%8.4" ECU_ADDRESS 0x50001EF4 /end MEASUREMENT
/begin MEASUREMENT ThrVlv_PosnCtrlB1_I.ratDesFilUpprLim "Position Controller of the throttle valve of motor bench one / upper limit for the allowed actual position" SWORD rel_q0p0078125 1 100 -256.0000 255.9922 FORMAT "%8.4" ECU_ADDRESS 0x50001EF6 /end MEASUREMENT
/begin MEASUREMENT ThrVlv_PosnCtrlB1_I.ratDesHldClsdAndOpen "Position Controller of the throttle valve of motor bench one / Desired Value at hold closed and hold open" SWORD rel_q0p0078125 1 100 -256.0000 255.9922 FORMAT "%8.4" ECU_ADDRESS 0x50001EF8 /end MEASUREMENT
/begin MEASUREMENT ThrVlv_PosnCtrlB1_I.ratDesLim "Position Controller of the throttle valve of motor bench one / limited desired value from ASW" SWORD rel_q0p0078125 1 100 -256.0000 255.9922 FORMAT "%8.4" ECU_ADDRESS 0x50001EFA /end MEASUREMENT
/begin MEASUREMENT ThrVlv_PosnCtrlB1_I.ratDesOpngAftLongHldClsd "Position Controller of the throttle valve of motor bench one / desired position" SWORD rel_q0p0078125 1 100 -256.0000 255.9922 FORMAT "%8.4" ECU_ADDRESS 0x50001EFC /end MEASUREMENT
/begin MEASUREMENT ThrVlv_PosnCtrlB1_I.ratDesPreCtrl "Position Controller of the throttle valve of motor bench one / desired value pre-controller" SWORD rel_q0p0078125 1 100 -256.0000 255.9922 FORMAT "%8.4" ECU_ADDRESS 0x50001EFE /end MEASUREMENT
/begin MEASUREMENT ThrVlv_PosnCtrlB1_I.ratDesPreCtrlDftl "Position Controller of the throttle valve of motor bench one / desired value pre-controller" SLONG fak_q1p526Em5 1 100 -100.000000000 99.999984741 FORMAT "%13.9" ECU_ADDRESS 0x50001F00 /end MEASUREMENT
/begin MEASUREMENT ThrVlv_PosnCtrlB1_I.ratDesPreCtrlDftl2 "Position Controller of the throttle valve of motor bench one / desired value pre-controller" SLONG fak_q0p00195 1 100 -10000.0000000 9999.9980469 FORMAT "%13.7" ECU_ADDRESS 0x50001F04 /end MEASUREMENT
/begin MEASUREMENT ThrVlv_PosnCtrlB1_I.ratDesPreCtrlDftl2Old "Position Controller of the throttle valve of motor bench one / desired value pre-controller" SLONG fak_q0p00195 1 100 -10000.0000000 9999.9980469 FORMAT "%13.7" ECU_ADDRESS 0x50001F08 /end MEASUREMENT
/begin MEASUREMENT ThrVlv_PosnCtrlB1_I.ratDesPreCtrlDftlOld "Position Controller of the throttle valve of motor bench one / desired value pre-controller" SLONG fak_q1p526Em5 1 100 -100.000000000 99.999984741 FORMAT "%13.9" ECU_ADDRESS 0x50001F0C /end MEASUREMENT
/begin MEASUREMENT ThrVlv_PosnCtrlB1_I.ratDesPreCtrlOld "Position Controller of the throttle valve of motor bench one / desired value pre-controller" SWORD rel_q0p0078125 1 100 -256.0000 255.9922 FORMAT "%8.4" ECU_ADDRESS 0x50001F10 /end MEASUREMENT
/begin MEASUREMENT ThrVlv_PosnCtrlB1_I.ratDesPreCtrlRad "Position Controller of the throttle valve of motor bench one / desired value pre-controller" SLONG fak_sw_b0p03125 1 100 -2048.00000000 2047.99999905 FORMAT "%13.8" ECU_ADDRESS 0x50001F14 /end MEASUREMENT
/begin MEASUREMENT ThrVlv_PosnCtrlB1_I.ratDesPreCtrlRadOld "Position Controller of the throttle valve of motor bench one / desired value pre-controller" SLONG fak_sw_b0p03125 1 100 -2048.00000000 2047.99999905 FORMAT "%13.8" ECU_ADDRESS 0x50001F18 /end MEASUREMENT
/begin MEASUREMENT ThrVlv_PosnCtrlB1_I.ratDesRad "Position Controller of the throttle valve of motor bench one / filtered desired value radiant" FLOAT32_IEEE OneToOne 1 100 -1.00000000E+037 1.00000000E+037 FORMAT "%13.3" ECU_ADDRESS 0x50001F1C /end MEASUREMENT
/begin MEASUREMENT ThrVlv_PosnCtrlB1_I.ratDesRampDwn "Position Controller of the throttle valve of motor bench one / desired value to ramp down to the lower electric stop" SWORD rel_q0p0078125 1 100 -256.0000 255.9922 FORMAT "%8.4" ECU_ADDRESS 0x50001F20 /end MEASUREMENT
/begin MEASUREMENT ThrVlv_PosnCtrlB1_I.ratDesRampMem "Position Controller of the throttle valve of motor bench one / desired value to ramp down to the lower electric stop (stored value)" SWORD rel_q0p0078125 1 100 -256.0000 255.9922 FORMAT "%8.4" ECU_ADDRESS 0x50001F22 /end MEASUREMENT
/begin MEASUREMENT ThrVlv_PosnCtrlB1_I.ratDesSwt "Position Controller of the throttle valve of motor bench one / switched desired value" SWORD rel_q0p0078125 1 100 -256.0000 255.9922 FORMAT "%8.4" ECU_ADDRESS 0x50001F24 /end MEASUREMENT
/begin MEASUREMENT ThrVlv_PosnCtrlB1_I.ratDesSwtDeltaAbslt "Position Controller of the throttle valve of motor bench one / absolute change in desired value" SWORD rel_q0p0078125 1 100 -256.0000 255.9922 FORMAT "%8.4" ECU_ADDRESS 0x50001F26 /end MEASUREMENT
/begin MEASUREMENT ThrVlv_PosnCtrlB1_I.ratDesSwtOld "Position Controller of the throttle valve of motor bench one / switched desired value" SWORD rel_q0p0078125 1 100 -256.0000 255.9922 FORMAT "%8.4" ECU_ADDRESS 0x50001F28 /end MEASUREMENT
/begin MEASUREMENT ThrVlv_PosnCtrlB1_I.ratDesSwtUnlimSpOld "Position Controller of the throttle valve of motor bench one / switched desired value" SWORD rel_q0p0078125 1 100 -256.0000 255.9922 FORMAT "%8.4" ECU_ADDRESS 0x50001F2A /end MEASUREMENT
/begin MEASUREMENT ThrVlv_PosnCtrlB1_I.ratDesValFromHeal "Position Controller of the throttle valve of motor bench one / desired value from healing function" SWORD rel_q0p0078125 1 100 -256.0000 255.9922 FORMAT "%8.4" ECU_ADDRESS 0x50001F2C /end MEASUREMENT
/begin MEASUREMENT ThrVlv_PosnCtrlB1_I.ratDutyCycCompProtMax "Position Controller of the throttle valve of motor bench one / upper threshold for duty cycle limiting at component protection" SWORD rel_q0p0078125 1 100 -256.0000 255.9922 FORMAT "%8.4" ECU_ADDRESS 0x50001F2E /end MEASUREMENT
/begin MEASUREMENT ThrVlv_PosnCtrlB1_I.ratDutyCycCompProtMin "Position Controller of the throttle valve of motor bench one / lower threshold for duty cycle limiting at component protection" SWORD rel_q0p0078125 1 100 -256.0000 255.9922 FORMAT "%8.4" ECU_ADDRESS 0x50001F30 /end MEASUREMENT
/begin MEASUREMENT ThrVlv_PosnCtrlB1_I.ratDutyCycCtrl "Position Controller of the throttle valve of motor bench one / duty cycle output of the position controller after anti wind up" SWORD rel_q0p0078125 1 100 -256.0000 255.9922 FORMAT "%8.4" ECU_ADDRESS 0x50001F32 /end MEASUREMENT
/begin MEASUREMENT ThrVlv_PosnCtrlB1_I.ratDutyCycFailSafeOlc "Position Controller of the throttle valve of motor bench one / duty cycle at open loop opening respectively closing" SWORD rel_q0p0078125 1 100 -256.0000 255.9922 FORMAT "%8.4" ECU_ADDRESS 0x50001F34 /end MEASUREMENT
/begin MEASUREMENT ThrVlv_PosnCtrlB1_I.ratDutyCycGpfProtn "Position Controller of the throttle valve of motor bench one / controller output when particulate filter protection is active" SWORD rel_q0p0078125 1 100 -256.0000 255.9922 FORMAT "%8.4" ECU_ADDRESS 0x50001F36 /end MEASUREMENT
/begin MEASUREMENT ThrVlv_PosnCtrlB1_I.ratDutyCycHldClsd "Position Controller of the throttle valve of motor bench one / duty cycle at HldClosed" SWORD rel_q0p0078125 1 100 -256.0000 255.9922 FORMAT "%8.4" ECU_ADDRESS 0x50001F38 /end MEASUREMENT
/begin MEASUREMENT ThrVlv_PosnCtrlB1_I.ratDutyCycHldClsdCompProt "Position Controller of the throttle valve of motor bench one / duty cycle at HldClosed component protection" SWORD rel_q0p0078125 1 100 -256.0000 255.9922 FORMAT "%8.4" ECU_ADDRESS 0x50001F3A /end MEASUREMENT
/begin MEASUREMENT ThrVlv_PosnCtrlB1_I.ratDutyCycHldClsdDynPeak "Position Controller of the throttle valve of motor bench one / duty cycle hold closed dynamic peak" SWORD rel_q0p0078125 1 100 -256.0000 255.9922 FORMAT "%8.4" ECU_ADDRESS 0x50001F3C /end MEASUREMENT
/begin MEASUREMENT ThrVlv_PosnCtrlB1_I.ratDutyCycHldClsdMap "Position Controller of the throttle valve of motor bench one / duty cycle at HldClosed from map" SWORD rel_q0p0078125 1 100 -256.0000 255.9922 FORMAT "%8.4" ECU_ADDRESS 0x50001F3E /end MEASUREMENT
/begin MEASUREMENT ThrVlv_PosnCtrlB1_I.ratDutyCycHldOpen "Position Controller of the throttle valve of motor bench one / duty cycle at hold open" SWORD rel_q0p0078125 1 100 -256.0000 255.9922 FORMAT "%8.4" ECU_ADDRESS 0x50001F40 /end MEASUREMENT
/begin MEASUREMENT ThrVlv_PosnCtrlB1_I.ratDutyCycLmsClsng "Position Controller of the throttle valve of motor bench one / duty cycle at LmsClsng" SWORD rel_q0p0078125 1 100 -256.0000 255.9922 FORMAT "%8.4" ECU_ADDRESS 0x50001F42 /end MEASUREMENT
/begin MEASUREMENT ThrVlv_PosnCtrlB1_I.ratDutyCycMax "Position Controller of the throttle valve of motor bench one / upper limit for the duty cycle" SWORD rel_q0p0078125 1 100 -256.0000 255.9922 FORMAT "%8.4" ECU_ADDRESS 0x50001F44 /end MEASUREMENT
/begin MEASUREMENT ThrVlv_PosnCtrlB1_I.ratDutyCycMin "Position Controller of the throttle valve of motor bench one / lower limit for the duty cycle" SWORD rel_q0p0078125 1 100 -256.0000 255.9922 FORMAT "%8.4" ECU_ADDRESS 0x50001F46 /end MEASUREMENT
/begin MEASUREMENT ThrVlv_PosnCtrlB1_I.ratDutyCycOffsLrnLimNeg "Position Controller of the throttle valve of motor bench one / lower limit for the duty cycle at offset learning" SWORD rel_q0p0078125 1 100 -256.0000 255.9922 FORMAT "%8.4" ECU_ADDRESS 0x50001F48 /end MEASUREMENT
/begin MEASUREMENT ThrVlv_PosnCtrlB1_I.ratDutyCycOpenLoopOpng "Position Controller of the throttle valve of motor bench one / duty cycle at open loop opening" SWORD rel_q0p0078125 1 100 -256.0000 255.9922 FORMAT "%8.4" ECU_ADDRESS 0x50001F4A /end MEASUREMENT
/begin MEASUREMENT ThrVlv_PosnCtrlB1_I.ratDutyCycOpenLoopOpngCntr "Position Controller of the throttle valve of motor bench one / ramped duty cycle at open loop opening" SWORD rel_q0p0078125 1 100 -256.0000 255.9922 FORMAT "%8.4" ECU_ADDRESS 0x50001F4C /end MEASUREMENT
/begin MEASUREMENT ThrVlv_PosnCtrlB1_I.ratDutyCycOpenLoopOpngWoBattCmp "Position Controller of the throttle valve of motor bench one / duty cycle at open loop opening without compensation of the battery voltage" SWORD rel_q0p0078125 1 100 -256.0000 255.9922 FORMAT "%8.4" ECU_ADDRESS 0x50001F4E /end MEASUREMENT
/begin MEASUREMENT ThrVlv_PosnCtrlB1_I.ratDutyCycPreCtrl "Position Controller of the throttle valve of motor bench one / duty cycle of feed forward" SWORD rel_q0p0078125 1 100 -256.0000 255.9922 FORMAT "%8.4" ECU_ADDRESS 0x50001F50 /end MEASUREMENT
/begin MEASUREMENT ThrVlv_PosnCtrlB1_I.ratDutyCycRampDwnMin "Position Controller of the throttle valve of motor bench one / lower duty cycle limit near lower mechanical stop" SWORD rel_q0p0078125 1 100 -256.0000 255.9922 FORMAT "%8.4" ECU_ADDRESS 0x50001F52 /end MEASUREMENT
/begin MEASUREMENT ThrVlv_PosnCtrlB1_I.ratFilDlyOld "Position Controller of the throttle valve of motor bench one / old value of P-T1 of PD-T1" FLOAT32_IEEE OneToOne 1 100 -1.00000000E+037 1.00000000E+037 FORMAT "%13.3" ECU_ADDRESS 0x50001F54 /end MEASUREMENT
/begin MEASUREMENT ThrVlv_PosnCtrlB1_I.ratHldClsdAbortThd "Position Controller of the throttle valve of motor bench one / position where hold closed is deactivated" SWORD rel_q0p0078125 1 100 -256.0000 255.9922 FORMAT "%8.4" ECU_ADDRESS 0x50001F58 /end MEASUREMENT
/begin MEASUREMENT ThrVlv_PosnCtrlB1_I.ratHldClsdPosn "Position Controller of the throttle valve of motor bench one / position where hold closed is activated" SWORD rel_q0p0078125 1 100 -256.0000 255.9922 FORMAT "%8.4" ECU_ADDRESS 0x50001F5A /end MEASUREMENT
/begin MEASUREMENT ThrVlv_PosnCtrlB1_I.ratLimpAirPosnBand "Position Controller of the throttle valve of motor bench one / band around limp air position area" FLOAT32_IEEE OneToOne 1 100 -1.00000000E+037 1.00000000E+037 FORMAT "%13.3" ECU_ADDRESS 0x50001F5C /end MEASUREMENT
/begin MEASUREMENT ThrVlv_PosnCtrlB1_I.ratOffsClsdPosn "Position Controller of the throttle valve of motor bench one / offset on lower mechanical stop" SWORD rel_q0p0078125 1 100 -256.0000 255.9922 FORMAT "%8.4" ECU_ADDRESS 0x50001F60 /end MEASUREMENT
/begin MEASUREMENT ThrVlv_PosnCtrlB1_I.ratPPT1 "Position Controller of the throttle valve of motor bench one / output of the proportional proportional with lag" FLOAT32_IEEE OneToOne 1 100 -1.00000000E+037 1.00000000E+037 FORMAT "%13.3" ECU_ADDRESS 0x50001F64 /end MEASUREMENT
/begin MEASUREMENT ThrVlv_PosnCtrlB1_I.ratRampDwnStrt "Position Controller of the throttle valve of motor bench one / starting position where the ramp to the lower mechanical stop starts" SWORD rel_q0p0078125 1 100 -256.0000 255.9922 FORMAT "%8.4" ECU_ADDRESS 0x50001F68 /end MEASUREMENT
/begin MEASUREMENT ThrVlv_PosnCtrlB1_I.ratSldgSfc "Position Controller of the throttle valve of motor bench one / Sliding Surface" SLONG q0p0001_Perc 1 100 -214748.364800 214748.364700 FORMAT "%13.6" ECU_ADDRESS 0x50001F6C /end MEASUREMENT
/begin MEASUREMENT ThrVlv_PosnCtrlB1_I.ratSldgSfcCubic "Position Controller of the throttle valve of motor bench one / Sliding Surface cubic part" SLONG q0p0001_Perc 1 100 -214748.364800 214748.364700 FORMAT "%13.6" ECU_ADDRESS 0x50001F70 /end MEASUREMENT
/begin MEASUREMENT ThrVlv_PosnCtrlB1_I.ratSldgSfcDer "Position Controller of the throttle valve of motor bench one / Sliding Surface velocity dependent part" SLONG q0p0001_Perc 1 100 -214748.364800 214748.364700 FORMAT "%13.6" ECU_ADDRESS 0x50001F74 /end MEASUREMENT
/begin MEASUREMENT ThrVlv_PosnCtrlB1_I.ratSldgSfcOld "Position Controller of the throttle valve of motor bench one / Sliding Surface" SLONG q0p0001_Perc 1 100 -214748.364800 214748.364700 FORMAT "%13.6" ECU_ADDRESS 0x50001F78 /end MEASUREMENT
/begin MEASUREMENT ThrVlv_PosnCtrlB1_I.ratSldgSfcSqrt "Position Controller of the throttle valve of motor bench one / Sliding Surface square root part" SLONG q0p0001_Perc 1 100 -214748.364800 214748.364700 FORMAT "%13.6" ECU_ADDRESS 0x50001F7C /end MEASUREMENT
/begin MEASUREMENT ThrVlv_PosnCtrlB1_I.ratSoftLdgDecel "Position Controller of the throttle valve of motor bench one / start position for deceleration" SWORD rel_q0p0078125 1 100 -256.0000 255.9922 FORMAT "%8.4" ECU_ADDRESS 0x50001F80 /end MEASUREMENT
/begin MEASUREMENT ThrVlv_PosnCtrlB1_I.ratSoftLdgStrt "Position Controller of the throttle valve of motor bench one / start position for softlanding" SWORD rel_q0p0078125 1 100 -256.0000 255.9922 FORMAT "%8.4" ECU_ADDRESS 0x50001F82 /end MEASUREMENT
/begin MEASUREMENT ThrVlv_PosnCtrlB1_I.ratStuck "Position Controller of the throttle valve of motor bench one / actual position at which valve got stuck" SWORD rel_q0p0078125 1 100 -256.0000 255.9922 FORMAT "%8.4" ECU_ADDRESS 0x50001F84 /end MEASUREMENT
/begin MEASUREMENT ThrVlv_PosnCtrlB1_I.ratStuckPosnOpenThd "Position Controller of the throttle valve of motor bench one / position threshold to detect a stuck open valve" SWORD rel_q0p0078125 1 100 -256.0000 255.9922 FORMAT "%8.4" ECU_ADDRESS 0x50001F86 /end MEASUREMENT
/begin MEASUREMENT ThrVlv_PosnCtrlB1_I.stMonPosnCtrl "Position Controller of the throttle valve of motor bench one / bit string with error and cycle flags" UWORD OneToOne 1 100 0.00 65535.00 FORMAT "%8.2" ECU_ADDRESS 0x50001F88 /end MEASUREMENT
/begin MEASUREMENT ThrVlv_PosnCtrlB1_I.stMonTSnsrAdpn "Position Controller of the throttle valve of motor bench one / bit string with error and cycle flags" UBYTE OneToOne 1 100 0.00 255.0 FORMAT "%5.1" ECU_ADDRESS 0x50001F8A /end MEASUREMENT
/begin MEASUREMENT ThrVlv_PosnCtrlB1_I.tElecMotEstimd "Position Controller of the throttle valve of motor bench one / estimated actuator temperature" SWORD Temp_Cels 1 100 -3549.940 3003.560 FORMAT "%8.3" ECU_ADDRESS 0x50001F8C /end MEASUREMENT
/begin MEASUREMENT ThrVlv_PosnCtrlB1_I.tOffsElecMotSelfHeatg "Position Controller of the throttle valve of motor bench one / offset actuator temperature" SWORD Temp_Cels 1 100 -3549.940 3003.560 FORMAT "%8.3" ECU_ADDRESS 0x50001F8E /end MEASUREMENT
/begin MEASUREMENT ThrVlv_PosnCtrlB1_I.tOffsSample "Position Controller of the throttle valve of motor bench one / in this driving cycle calculated temperature offset" SWORD Temp_Cels 1 100 -3549.940 3003.560 FORMAT "%8.3" ECU_ADDRESS 0x50001F90 /end MEASUREMENT
/begin MEASUREMENT ThrVlv_PosnCtrlB1_I.tSnsrCorrd "Position Controller of the throttle valve of motor bench one / corrected temperature" SWORD Temp_Cels 1 100 -3549.940 3003.560 FORMAT "%8.3" ECU_ADDRESS 0x50001F92 /end MEASUREMENT
/begin MEASUREMENT ThrVlv_PosnCtrlB1_I.tSnsrCorrdFild "Position Controller of the throttle valve of motor bench one / filtered corrected temperature" SWORD Temp_Cels 1 100 -3549.940 3003.560 FORMAT "%8.3" ECU_ADDRESS 0x50001F94 /end MEASUREMENT
/begin MEASUREMENT ThrVlv_PosnCtrlB1_I.tSnsrOffsAdpd "Position Controller of the throttle valve of motor bench one / mean adapted temperature offset" SWORD Temp_Cels 1 100 -3549.940 3003.560 FORMAT "%8.3" ECU_ADDRESS 0x60038ACC /end MEASUREMENT
/begin MEASUREMENT ThrVlv_PosnCtrlB1_I.tSnsrOffsAdpd_a "Position Controller of the throttle valve of motor bench one / array of adapted temperature offsets" SWORD Temp_Cels 1 100 -3549.940 3003.560 FORMAT "%8.3" ARRAY_SIZE 5 ECU_ADDRESS 0x60038ACE /end MEASUREMENT
/begin MEASUREMENT ThrVlv_PosnCtrlB1_I.tiCtrlDe "Position Controller of the throttle valve of motor bench one / debounce time control deviation" UWORD t_tev0p0005 1 100 0.00 31.99951 FORMAT "%8.5" ECU_ADDRESS 0x50001F96 /end MEASUREMENT
/begin MEASUREMENT ThrVlv_PosnCtrlB1_I.tiCtrlDeCsers "Position Controller of the throttle valve of motor bench one / debounce time control deviation" UWORD t_tev0p0005 1 100 0.00 31.99951 FORMAT "%8.5" ECU_ADDRESS 0x50001F98 /end MEASUREMENT
/begin MEASUREMENT ThrVlv_PosnCtrlB1_I.tiCtrlDeMaxCsers "Position Controller of the throttle valve of motor bench one / maximum debounce time control deviation" UWORD t_tev0p0005 1 100 0.00 31.99951 FORMAT "%8.5" ECU_ADDRESS 0x50001F9A /end MEASUREMENT
/begin MEASUREMENT ThrVlv_PosnCtrlB1_I.tiDebLowUBatt "Position Controller of the throttle valve of motor bench one / debounce time for a too low battery voltage" UWORD t_tev0p0005 1 100 0.00 31.99951 FORMAT "%8.5" ECU_ADDRESS 0x50001F9C /end MEASUREMENT
/begin MEASUREMENT ThrVlv_PosnCtrlB1_I.tiDutyCycExcd "Position Controller of the throttle valve of motor bench one / debounce time duty cycle" UWORD t_tev0p0005 1 100 0.00 31.99951 FORMAT "%8.5" ECU_ADDRESS 0x50001F9E /end MEASUREMENT
/begin MEASUREMENT ThrVlv_PosnCtrlB1_I.tiFilSwtSpdLimSoftLdg "Position Controller of the throttle valve of motor bench one / time constant filtered switchover of the speed limit" UWORD t_q0p001 1 100 0.00 1.000000 FORMAT "%8.6" ECU_ADDRESS 0x50001FA0 /end MEASUREMENT
/begin MEASUREMENT ThrVlv_PosnCtrlB1_I.tiHldClsdActv "Position Controller of the throttle valve of motor bench one / time after which opening after long HldClsd is allowed" ULONG t_tev0p0005 1 100 0.00 2097151.99951 FORMAT "%13.5" ECU_ADDRESS 0x50001FA4 /end MEASUREMENT
/begin MEASUREMENT ThrVlv_PosnCtrlB1_I.tiHldClsdDynPeak "Position Controller of the throttle valve of motor bench one / active time hold closed dynamic peak" UWORD t_tev0p0005 1 100 0.00 31.99951 FORMAT "%8.5" ECU_ADDRESS 0x50001FA8 /end MEASUREMENT
/begin MEASUREMENT ThrVlv_PosnCtrlB1_I.tiOpng "Position Controller of the throttle valve of motor bench one / time at opening of the valve" UWORD t_tev0p0005 1 100 0.00 31.99951 FORMAT "%8.5" ECU_ADDRESS 0x50001FAA /end MEASUREMENT
/begin MEASUREMENT ThrVlv_PosnCtrlB1_I.tiPreCtrlFildOld "Position Controller of the throttle valve of motor bench one / filter time feedforward" FLOAT32_IEEE OneToOne 1 100 -1.00000000E+037 1.00000000E+037 FORMAT "%13.3" ECU_ADDRESS 0x50001FAC /end MEASUREMENT
/begin MEASUREMENT ThrVlv_PosnCtrlB1_I.tiPreCtrlSlow "Position Controller of the throttle valve of motor bench one / filter time feedforward" SWORD t_tev0p0005 1 100 0.0014648 0.3002930 FORMAT "%9.7" ECU_ADDRESS 0x50001FB0 /end MEASUREMENT
/begin MEASUREMENT ThrVlv_PosnCtrlB1_I.tiPsRdy "Position Controller of the throttle valve of motor bench one / timer for detection of powerstage readiness" UWORD t_tev0p0005 1 100 0.00 31.99951 FORMAT "%8.5" ECU_ADDRESS 0x50001FB2 /end MEASUREMENT
/begin MEASUREMENT ThrVlv_PosnCtrlB1_I.tiReaDesPosn "Position Controller of the throttle valve of motor bench one / debounce time for reaching the desired value" UWORD t_tev0p0005 1 100 0.00 31.99951 FORMAT "%8.5" ECU_ADDRESS 0x50001FB4 /end MEASUREMENT
/begin MEASUREMENT ThrVlv_PosnCtrlB1_I.tiReaDesPosnFailSafe "Position Controller of the throttle valve of motor bench one / debounce time for reaching of fail safe position" UWORD t_tev0p0005 1 100 0.00 31.99951 FORMAT "%8.5" ECU_ADDRESS 0x50001FB6 /end MEASUREMENT
/begin MEASUREMENT ThrVlv_PosnCtrlB1_I.tiVvtEndPosn "Position Controller of the throttle valve of motor bench one / limp home driving with vvt: delay time till ramp may be new triggered" UWORD t_tev0p0005 1 100 0.00 31.99951 FORMAT "%8.5" ECU_ADDRESS 0x50001FB8 /end MEASUREMENT
/begin MEASUREMENT ThrVlv_PosnCtrlB1_I.tqFric "Position Controller of the throttle valve of motor bench one / friction torque" FLOAT32_IEEE OneToOne 1 100 -1.00000000E+037 1.00000000E+037 FORMAT "%13.3" ECU_ADDRESS 0x50001FBC /end MEASUREMENT
/begin MEASUREMENT ThrVlv_PosnCtrlB1_I.tqFricOld "Position Controller of the throttle valve of motor bench one / friction torque" FLOAT32_IEEE OneToOne 1 100 -1.00000000E+037 1.00000000E+037 FORMAT "%13.3" ECU_ADDRESS 0x50001FC0 /end MEASUREMENT
/begin MEASUREMENT ThrVlv_PosnCtrlB1_I.uBalStrmInfl "Position Controller of the throttle valve of motor bench one / voltage feedforward of stream influences" SWORD spg_q0p001 1 100 -32.76800 32.76700 FORMAT "%8.5" ECU_ADDRESS 0x50001FC4 /end MEASUREMENT
/begin MEASUREMENT ThrVlv_PosnCtrlB1_I.uBattLimNeg "Position Controller of the throttle valve of motor bench one / lower limit of manipulated variable" SWORD fak_q0p0009766 1 100 -32.00000 31.99902 FORMAT "%8.5" ECU_ADDRESS 0x50001FC6 /end MEASUREMENT
/begin MEASUREMENT ThrVlv_PosnCtrlB1_I.uBattLimPos "Position Controller of the throttle valve of motor bench one / upper limit of manipulated variable" SWORD fak_q0p0009766 1 100 -32.00000 31.99902 FORMAT "%8.5" ECU_ADDRESS 0x50001FC8 /end MEASUREMENT
/begin MEASUREMENT ThrVlv_PosnCtrlB1_I.uCtrl "Position Controller of the throttle valve of motor bench one / voltage controller final output" SWORD spg_q0p001 1 100 -32.76800 32.76700 FORMAT "%8.5" ECU_ADDRESS 0x50001FCA /end MEASUREMENT
/begin MEASUREMENT ThrVlv_PosnCtrlB1_I.uCtrlDer "Position Controller of the throttle valve of motor bench one / voltage d part" SWORD spg_q0p001 1 100 -32.76800 32.76700 FORMAT "%8.5" ECU_ADDRESS 0x50001FCC /end MEASUREMENT
/begin MEASUREMENT ThrVlv_PosnCtrlB1_I.uCtrlDerFild "Position Controller of the throttle valve of motor bench one / voltage d part filtered" SWORD spg_q0p001 1 100 -32.76800 32.76700 FORMAT "%8.5" ECU_ADDRESS 0x50001FCE /end MEASUREMENT
/begin MEASUREMENT ThrVlv_PosnCtrlB1_I.uCtrlIntgl "Position Controller of the throttle valve of motor bench one / voltage integral part" SLONG q2p98023Em7_V 1 100 -640.000000000 639.999999702 FORMAT "%13.9" ECU_ADDRESS 0x50001FD0 /end MEASUREMENT
/begin MEASUREMENT ThrVlv_PosnCtrlB1_I.uCtrlIntglOld "Position Controller of the throttle valve of motor bench one / voltage integral part old" SLONG q2p98023Em7_V 1 100 -640.000000000 639.999999702 FORMAT "%13.9" ECU_ADDRESS 0x50001FD4 /end MEASUREMENT
/begin MEASUREMENT ThrVlv_PosnCtrlB1_I.uCtrlIntglRstAftLmsClsng "Position Controller of the throttle valve of motor bench one / voltage integral part reset value after lower mechanical stop closing" SLONG q2p98023Em7_V 1 100 -640.000000000 639.999999702 FORMAT "%13.9" ECU_ADDRESS 0x50001FD8 /end MEASUREMENT
/begin MEASUREMENT ThrVlv_PosnCtrlB1_I.uCtrlProp "Position Controller of the throttle valve of motor bench one / voltage P part" SWORD spg_q0p001 1 100 -32.76800 32.76700 FORMAT "%8.5" ECU_ADDRESS 0x50001FDC /end MEASUREMENT
/begin MEASUREMENT ThrVlv_PosnCtrlB1_I.uCtrlSldgMod "Position Controller of the throttle valve of motor bench one / sliding mode controller output" SWORD spg_q0p001 1 100 -32.76800 32.76700 FORMAT "%8.5" ECU_ADDRESS 0x50001FDE /end MEASUREMENT
/begin MEASUREMENT ThrVlv_PosnCtrlB1_I.uDesPreCtrl "Position Controller of the throttle valve of motor bench one / voltage feedforward" SWORD fak_q0p0009766 1 100 -32.00000 31.99902 FORMAT "%8.5" ECU_ADDRESS 0x50001FE0 /end MEASUREMENT
/begin MEASUREMENT ThrVlv_PosnCtrlB1_I.uDifOpngSprg "Position Controller of the throttle valve of motor bench one / differential voltage between the feedforward of the upper and the lower spring" FLOAT32_IEEE OneToOne 1 100 -1.00000000E+037 1.00000000E+037 FORMAT "%13.3" ECU_ADDRESS 0x50001FE4 /end MEASUREMENT
/begin MEASUREMENT ThrVlv_PosnCtrlB1_I.uElecMotIndt "Position Controller of the throttle valve of motor bench one / induced voltage" SWORD spg_q0p001 1 100 -32.76800 32.76700 FORMAT "%8.5" ECU_ADDRESS 0x50001FE8 /end MEASUREMENT
/begin MEASUREMENT ThrVlv_PosnCtrlB1_I.uElecMotIndtCmp "Position Controller of the throttle valve of motor bench one / compensation of induction voltage" SWORD spg_q0p001 1 100 -32.76800 32.76700 FORMAT "%8.5" ECU_ADDRESS 0x50001FEA /end MEASUREMENT
/begin MEASUREMENT ThrVlv_PosnCtrlB1_I.uElecMotIndtCmpFild "Position Controller of the throttle valve of motor bench one / compensation of induction voltage" SWORD spg_q0p001 1 100 -32.76800 32.76700 FORMAT "%8.5" ECU_ADDRESS 0x50001FEC /end MEASUREMENT
/begin MEASUREMENT ThrVlv_PosnCtrlB1_I.uElecMotTerminal "Position Controller of the throttle valve of motor bench one / terminal voltage" SWORD spg_q0p001 1 100 -32.76800 32.76700 FORMAT "%8.5" ECU_ADDRESS 0x50001FEE /end MEASUREMENT
/begin MEASUREMENT ThrVlv_PosnCtrlB1_I.uFbCtrlUnlim "Position Controller of the throttle valve of motor bench one / unlimited output of the feedback controller" SWORD spg_q0p001 1 100 -32.76800 32.76700 FORMAT "%8.5" ECU_ADDRESS 0x50001FF0 /end MEASUREMENT
/begin MEASUREMENT ThrVlv_PosnCtrlB1_I.uFric "Position Controller of the throttle valve of motor bench one / voltage for friction feedforward" FLOAT32_IEEE OneToOne 1 100 -1.00000000E+037 1.00000000E+037 FORMAT "%13.3" ECU_ADDRESS 0x50001FF4 /end MEASUREMENT
/begin MEASUREMENT ThrVlv_PosnCtrlB1_I.uLnrPreCtrl "Position Controller of the throttle valve of motor bench one / linear part of the feedforward voltage" FLOAT32_IEEE OneToOne 1 100 -1.00000000E+037 1.00000000E+037 FORMAT "%13.3" ECU_ADDRESS 0x50001FF8 /end MEASUREMENT
/begin MEASUREMENT ThrVlv_PosnCtrlB1_I.uMinOpngSprg "Position Controller of the throttle valve of motor bench one / maximum differential voltage between the feedforward of the upper and the lower spring" FLOAT32_IEEE OneToOne 1 100 -1.00000000E+037 1.00000000E+037 FORMAT "%13.3" ECU_ADDRESS 0x50001FFC /end MEASUREMENT
/begin MEASUREMENT ThrVlv_PosnCtrlB1_I.uOffsTranLineOpngSprg "Position Controller of the throttle valve of motor bench one / offset of the transition line for compensation of the opening spring" FLOAT32_IEEE OneToOne 1 100 -1.00000000E+037 1.00000000E+037 FORMAT "%13.3" ECU_ADDRESS 0x50002000 /end MEASUREMENT
/begin MEASUREMENT ThrVlv_PosnCtrlB1_I.uOhmR "Position Controller of the throttle valve of motor bench one / voltage drop at ohmic resistor" SWORD spg_q0p001 1 100 -32.76800 32.76700 FORMAT "%8.5" ECU_ADDRESS 0x50002004 /end MEASUREMENT
/begin MEASUREMENT ThrVlv_PosnCtrlB1_I.uOpngSprgComp "Position Controller of the throttle valve of motor bench one / compensation of the opening spring" FLOAT32_IEEE OneToOne 1 100 -1.00000000E+037 1.00000000E+037 FORMAT "%13.3" ECU_ADDRESS 0x50002008 /end MEASUREMENT
/begin MEASUREMENT ThrVlv_PosnCtrlB1_I.uSlopLowrLineOpngSprg "Position Controller of the throttle valve of motor bench one / gradient of the lower line for compensation of the opening spring" FLOAT32_IEEE OneToOne 1 100 -1.00000000E+037 1.00000000E+037 FORMAT "%13.3" ECU_ADDRESS 0x5000200C /end MEASUREMENT
/begin MEASUREMENT ThrVlv_PosnCtrlB1_I.uSlopTranLineOpngSprg "Position Controller of the throttle valve of motor bench one / gradient of the transition line for compensation of the opening spring" FLOAT32_IEEE OneToOne 1 100 -1.00000000E+037 1.00000000E+037 FORMAT "%13.3" ECU_ADDRESS 0x50002010 /end MEASUREMENT
/begin MEASUREMENT ThrVlv_PosnCtrlB1_I.uSprgCmp "Position Controller of the throttle valve of motor bench one / voltage spring compensation" SWORD spg_q0p001 1 100 -32.76800 32.76700 FORMAT "%8.5" ECU_ADDRESS 0x50002014 /end MEASUREMENT
/begin MEASUREMENT ThrVlv_PosnCtrlB1_I.wghtSignIntglSldgMod "Position Controller of the throttle valve of motor bench one / weighted sum of sign of sliding surface and sign of gradient of sliding surface" SWORD fak_q0p01 1 100 -327.6800 327.6700 FORMAT "%8.4" ECU_ADDRESS 0x50002016 /end MEASUREMENT
/begin MEASUREMENT ThrVlv_ratActAvrgB1 "Relative actual position calculated based on the average of both sensor voltages" SWORD rel_q0p0078125 1 100 -256.0000 255.9922 FORMAT "%8.4" ECU_ADDRESS 0x700052B6 /end MEASUREMENT
/begin MEASUREMENT ThrVlv_ratActIntB1 "Position of the throttle valve on motor bench one" SWORD rel_q0p0078125 1 100 -256.0000 255.9922 FORMAT "%8.4" ECU_ADDRESS 0x600094EE /end MEASUREMENT
/begin MEASUREMENT ThrVlv_ratActMnChrgSensFildB1 "Relative filtered charge signal" SWORD rel_q0p0078125 1 100 -256.0000 255.9922 FORMAT "%8.4" ECU_ADDRESS 0x700052B8 /end MEASUREMENT
/begin MEASUREMENT ThrVlv_ratActPosnB1 "Autosar named Actuatorposition" SWORD rel_q0p0078125 1 100 -256.0000 255.9922 FORMAT "%8.4" ECU_ADDRESS 0x50005DE4 /end MEASUREMENT
/begin MEASUREMENT ThrVlv_ratActPosnMaxB1 "Maximal relative position of the throttle valve" SWORD rel_q0p0078125 1 100 -256.0000 255.9922 FORMAT "%8.4" ECU_ADDRESS 0x50005DE8 /end MEASUREMENT
/begin MEASUREMENT ThrVlv_ratActPosnMinB1 "Minimal relative position of the throttle valve" SWORD rel_q0p0078125 1 100 -256.0000 255.9922 FORMAT "%8.4" ECU_ADDRESS 0x50005DEA /end MEASUREMENT
/begin MEASUREMENT ThrVlv_ratActSens1AbsltB1_u8 "Absolute throttle valve position in 0-100 of supply voltage" UBYTE relDK_q0p3922 1 100 0.00 100.0 FORMAT "%5.1" ECU_ADDRESS 0x6001414F /end MEASUREMENT
/begin MEASUREMENT ThrVlv_ratActSens1B1 "Relative actual angle calculated based on voltage from sensor 1" SWORD rel_q0p0078125 1 100 -256.0000 255.9922 FORMAT "%8.4" ECU_ADDRESS 0x700052BA /end MEASUREMENT
/begin MEASUREMENT ThrVlv_ratActSens1FildB1 "Filtered relative actual angle calculated based on voltage from sensor 1" SWORD rel_q0p0078125 1 100 -256.0000 255.9922 FORMAT "%8.4" ECU_ADDRESS 0x700052BC /end MEASUREMENT
/begin MEASUREMENT ThrVlv_ratActSens1RelB1_u8 "Relative throttle valve position in of supply voltage above mechanical stop" UBYTE relDK_q0p3922 1 100 0.00 100.0 FORMAT "%5.1" ECU_ADDRESS 0x60014150 /end MEASUREMENT
/begin MEASUREMENT ThrVlv_ratActSens2AbsltB1_u8 "Absolute throttle valve position in 0-100 of supply voltage reversed characteristics for sensor 2" UBYTE relDK_q0p3922 1 100 0.00 100.0 FORMAT "%5.1" ECU_ADDRESS 0x700054B1 /end MEASUREMENT
/begin MEASUREMENT ThrVlv_ratActSens2B1 "Relative actual angle calculated based on voltage from sensor 2" SWORD rel_q0p0078125 1 100 -256.0000 255.9922 FORMAT "%8.4" ECU_ADDRESS 0x700052BE /end MEASUREMENT
/begin MEASUREMENT ThrVlv_ratActSens2FildB1 "Filtered relative actual angle calculated based on voltage from sensor 2" SWORD rel_q0p0078125 1 100 -256.0000 255.9922 FORMAT "%8.4" ECU_ADDRESS 0x700052C0 /end MEASUREMENT
/begin MEASUREMENT ThrVlv_ratDeCtrlrB1 "Control deviation of throttle valve of motor bench one" SWORD rel_q0p0078125 1 100 -256.0000 255.9922 FORMAT "%8.4" ECU_ADDRESS 0x700053DE /end MEASUREMENT
/begin MEASUREMENT ThrVlv_ratDesB1 "Desired throttle plate position" SWORD rel_q0p0078125 1 100 -256.0000 255.9922 FORMAT "%8.4" ECU_ADDRESS 0x600094EA /end MEASUREMENT
/begin MEASUREMENT ThrVlv_ratDesTstrB1 "Desired value from tester throttle valve motor bench 1" SWORD rel_q0p0078125 1 100 -256.0000 255.9922 FORMAT "%8.4" ECU_ADDRESS 0x600094E8 /end MEASUREMENT
/begin MEASUREMENT ThrVlv_ratDutyCycB1 "Calculated duty cycle ratio" SWORD rel_q0p0078125 1 100 -256.0000 255.9922 FORMAT "%8.4" ECU_ADDRESS 0x600094E6 /end MEASUREMENT
/begin MEASUREMENT ThrVlv_ratDutyCycB1_mp "Calculated duty cycle ratio measurement point" SWORD rel_q0p003052 1 100 -100.0000 99.9969 FORMAT "%8.4" ECU_ADDRESS 0x70009C3C /end MEASUREMENT
/begin MEASUREMENT ThrVlv_Sens_B1_I.Snsr1DiagPrms "Class instance from AirActr_Sens / Diagnosis is released for sensor 1" UBYTE OneToOne 1 100 0.00 1.000 BIT_MASK 0x1 FORMAT "%5.3" ECU_ADDRESS 0x5000208E /end MEASUREMENT
/begin MEASUREMENT ThrVlv_Sens_B1_I.cntComErr "Class instance from AirActr_Sens / Maximal number of communication errors for fast debouncing" UWORD OneToOne 1 100 0.00 65535.00 FORMAT "%8.2" ECU_ADDRESS 0x50002090 /end MEASUREMENT
/begin MEASUREMENT ThrVlv_Sens_B1_I.cntNoVldDataFast "Class instance from AirActr_Sens / Maximal number of no valid data frames for fast debouncing" UWORD OneToOne 1 100 0.00 65535.00 FORMAT "%8.2" ECU_ADDRESS 0x50002092 /end MEASUREMENT
/begin MEASUREMENT ThrVlv_Sens_B1_I.cntSnsrErrFast "Class instance from AirActr_Sens / Maximal number of internal sensor errors for fast debouncing" UWORD OneToOne 1 100 0.00 65535.00 FORMAT "%8.2" ECU_ADDRESS 0x50002094 /end MEASUREMENT
/begin MEASUREMENT ThrVlv_Sens_B1_I.flgSens1CharPosnMaxExcdd "Class instance from AirActr_Sens / Maximal characteristic angle threshold exceeded in a defined driving cycle by sensor 1" UBYTE OneToOne 1 100 0.00 1.000 BIT_MASK 0x1 FORMAT "%5.3" ECU_ADDRESS 0x500020A5 /end MEASUREMENT
/begin MEASUREMENT ThrVlv_Sens_B1_I.flgSens1CharPosnMinExcdd "Class instance from AirActr_Sens / Minimal characteristic angle threshold exceeded in a defined driving cycle by sensor 1" UBYTE OneToOne 1 100 0.00 1.000 BIT_MASK 0x1 FORMAT "%5.3" ECU_ADDRESS 0x500020A6 /end MEASUREMENT
/begin MEASUREMENT ThrVlv_Sens_B1_I.flgSentComErrFast "Class instance from AirActr_Sens / Communication error for fast debouncing" UBYTE OneToOne 1 100 0.00 1.000 BIT_MASK 0x1 FORMAT "%5.3" ECU_ADDRESS 0x500020BC /end MEASUREMENT
/begin MEASUREMENT ThrVlv_Sens_B1_I.flgSentNoVldDataFast "Class instance from AirActr_Sens / Errorno valid data frames" UBYTE OneToOne 1 100 0.00 1.000 BIT_MASK 0x1 FORMAT "%5.3" ECU_ADDRESS 0x500020C1 /end MEASUREMENT
/begin MEASUREMENT ThrVlv_Sens_B1_I.flgSnsrErrFast "Class instance from AirActr_Sens / Internal SENT sensor error" UBYTE OneToOne 1 100 0.00 1.000 BIT_MASK 0x1 FORMAT "%5.3" ECU_ADDRESS 0x500020CA /end MEASUREMENT
/begin MEASUREMENT ThrVlv_Sens_B1_I.idxActrTyp "Class instance from AirActr_Sens / Type index of the air actuator" UBYTE OneToOne 1 100 0.00 8.000 FORMAT "%5.3" ECU_ADDRESS 0x500020CC /end MEASUREMENT
/begin MEASUREMENT ThrVlv_Sens_B1_I.ratActIntSnsr "Class instance from AirActr_Sens / Position of the throttle valve on motor bench one" SWORD rel_q0p0078125 1 100 -256.0000 255.9922 FORMAT "%8.4" ECU_ADDRESS 0x500020D2 /end MEASUREMENT
/begin MEASUREMENT ThrVlv_stHbrdgB1 "State of the thottle valve powerstage bank 1" UBYTE OneToOne 1 100 0.00 255.0 FORMAT "%5.1" ECU_ADDRESS 0x6000ADA7 /end MEASUREMENT
/begin MEASUREMENT ThrVlv_stMonPosnCtrlB1 "Monitoring status of the controller" UWORD OneToOne 1 100 0.00 65535.00 FORMAT "%8.2" ECU_ADDRESS 0x60009448 /end MEASUREMENT
/begin MEASUREMENT ThrVlv_stMonPsIfB1 "Error status of the powerstage bank 1" UBYTE OneToOne 1 100 0.00 255.0 FORMAT "%5.1" ECU_ADDRESS 0x6000F7D9 /end MEASUREMENT
/begin MEASUREMENT ThrVlv_stMonSensB1 "Status of sensor monitoring" UWORD OneToOne 1 100 0.00 65535.00 FORMAT "%8.2" ECU_ADDRESS 0x60009446 /end MEASUREMENT
/begin MEASUREMENT ThrVlv_stPosnCtrlStB1 "status label of position controller throttle valve bench 1" UBYTE OneToOne 1 100 0.00 255.0 FORMAT "%5.1" ECU_ADDRESS 0x6000F7D7 /end MEASUREMENT
/begin MEASUREMENT ThrVlv_stPsErrB1_mp "Content of the powertage diagnosis register bank 1" ULONG OneToOne 1 100 0.00 4294967295.00 FORMAT "%13.2" ECU_ADDRESS 0x70009A00 /end MEASUREMENT
/begin MEASUREMENT ThrVlv_uRawSens1B1 "Raw throttle valve voltage sensor 1 message" UWORD spg_q1p221_mV 1 100 0.00 79.99878 FORMAT "%8.5" ECU_ADDRESS 0x6000943E /end MEASUREMENT
/begin MEASUREMENT ThrVlv_uRawSens2B1 "Raw throttle valve voltage sensor 2 message" UWORD spg_q1p221_mV 1 100 0.00 79.99878 FORMAT "%8.5" ECU_ADDRESS 0x6000943C /end MEASUREMENT
/begin MEASUREMENT ThrVlv_uSens1B1 "Component package internal voltage sensor 1 throttle valve" UWORD spg_q1p221_mV 1 100 0.00 79.99878 FORMAT "%8.5" ECU_ADDRESS 0x6000943A /end MEASUREMENT
/begin MEASUREMENT ThrVlv_uSens2B1 "Component package internal voltage sensor 2 throttle valve" UWORD spg_q1p221_mV 1 100 0.00 79.99878 FORMAT "%8.5" ECU_ADDRESS 0x60009438 /end MEASUREMENT
/begin MEASUREMENT TiEngOff_bEngRot "Definition of engine Rotation for engine off time" UBYTE B_TRUE 1 100 0.00 1.00000000000 BIT_MASK 0x1 FORMAT "%13.11" ECU_ADDRESS 0x6000F083 /end MEASUREMENT
/begin MEASUREMENT TiEngOff_bRst "Definition of moment of reset of engine off time" UBYTE B_TRUE 1 100 0.00 1.00000000000 BIT_MASK 0x1 FORMAT "%13.11" ECU_ADDRESS 0x6000F082 /end MEASUREMENT
/begin MEASUREMENT TiEngOff_bTiEngOffEcuActv "condition ECU time off since the last engine stop activ" UBYTE B_TRUE 1 100 0.00 1.00000000000 BIT_MASK 0x1 FORMAT "%13.11" ECU_ADDRESS 0x6000F081 /end MEASUREMENT
/begin MEASUREMENT TiEngOff_stTi "State of engine off time" UBYTE OneToOne 1 100 0.00 255.0 FORMAT "%5.1" ECU_ADDRESS 0x6000F334 /end MEASUREMENT
/begin MEASUREMENT TiEngOff_stTiFirstStrt "state of engine stop time copied at the time of first engine start in the driving cycle" UBYTE OneToOne 1 100 0.00 255.0 FORMAT "%5.1" ECU_ADDRESS 0x6000F333 /end MEASUREMENT
/begin MEASUREMENT TiEngOff_stTiFirstStrtLoc "state of variable tengslst (local)" UBYTE OneToOne 1 100 0.00 255.0 FORMAT "%5.1" ECU_ADDRESS 0x6000AD9C /end MEASUREMENT
/begin MEASUREMENT TiEngOff_ti "engine off time" SLONG Time_sec_q1_COMPU 1 100 -2147483648.00 2147483647.00 FORMAT "%13.2" ECU_ADDRESS 0x6000393C /end MEASUREMENT
/begin MEASUREMENT TiEngOff_tiFirstStrt "engine stop time copied at the time of first engine start in the driving cycle" SLONG Time_sec_q1_COMPU 1 100 -2147483648.00 2147483647.00 FORMAT "%13.2" ECU_ADDRESS 0x600131D4 /end MEASUREMENT
/begin MEASUREMENT TiEngOff_tiFirstStrtLoc "engine stop time copied at the time of first engine start in the driving cycle (local)" SLONG Time_sec_q1_COMPU 1 100 0.00 2147483647.00 FORMAT "%13.2" ECU_ADDRESS 0x50002198 /end MEASUREMENT
/begin MEASUREMENT TiEngOn_AvsCntr "Number of AVS set requests since initialization" UBYTE OneToOne 1 100 0.00 255.0 FORMAT "%5.1" ECU_ADDRESS 0x6000ADA2 /end MEASUREMENT
/begin MEASUREMENT TiEngOn_AvsCntrLst "Local number of AVS set requests since initialization" UBYTE OneToOne 1 100 0.00 255.0 FORMAT "%5.1" ECU_ADDRESS 0x6000ADA1 /end MEASUREMENT
/begin MEASUREMENT TiEngOn_flgEngRunTiPid7F "Condition : Engine running according to PID 0x7F" UBYTE B_TRUE 1 100 0.00 1.00000000000 BIT_MASK 0x1 FORMAT "%13.11" ECU_ADDRESS 0x6000ADA5 /end MEASUREMENT
/begin MEASUREMENT TiEngOn_flgEngRunTiPtoPrmId7F "Condition : Engine running with PTO active according to PID 0x7F" UBYTE B_TRUE 1 100 0.00 1.00000000000 BIT_MASK 0x1 FORMAT "%13.11" ECU_ADDRESS 0x6000ADA4 /end MEASUREMENT
/begin MEASUREMENT TiEngOn_flgIdleEngRunTiPrmId7F "Condition : Engine idle according to PID 0x7F" UBYTE B_TRUE 1 100 0.00 1.00000000000 BIT_MASK 0x1 FORMAT "%13.11" ECU_ADDRESS 0x6000ADA3 /end MEASUREMENT
/begin MEASUREMENT TiEngOn_flgProgmEve "Condition : Reprogramming event detected" UBYTE B_TRUE 1 100 0.00 1.00000000000 BIT_MASK 0x1 FORMAT "%13.11" ECU_ADDRESS 0x6000ADA6 /end MEASUREMENT
/begin MEASUREMENT TiEngOn_stRtId.RtId_TotIdleRt " / Status of Run Time RtId_TotIdleRt" UBYTE OneToOne 1 100 0.00 255.0 FORMAT "%5.1" ECU_ADDRESS 0x70004B89 /end MEASUREMENT
/begin MEASUREMENT TiEngOn_stRtId.RtId_TotPtoRt " / Status of Run Time RtId_TotPtoRt" UBYTE OneToOne 1 100 0.00 255.0 FORMAT "%5.1" ECU_ADDRESS 0x70004B8A /end MEASUREMENT
/begin MEASUREMENT TiEngOn_stRtId.RtId_TotRtObd " / Status of Run Time RtId_TotRtObd" UBYTE OneToOne 1 100 0.00 255.0 FORMAT "%5.1" ECU_ADDRESS 0x70004B8B /end MEASUREMENT
/begin MEASUREMENT TiEngOn_tiRtId.RtId_TotIdleRt " / Total idle run time (OBD)" ULONG t_q1 1 100 0.00 4294967295.00 FORMAT "%13.2" ECU_ADDRESS 0x5000219C /end MEASUREMENT
/begin MEASUREMENT TiEngOn_tiRtId.RtId_TotPtoRt " / Total run time with PTO active (OBD)" ULONG t_q1 1 100 0.00 4294967295.00 FORMAT "%13.2" ECU_ADDRESS 0x500021A0 /end MEASUREMENT
/begin MEASUREMENT TiEngOn_tiRtId.RtId_TotRtObd " / Total engine run time (OBD)" ULONG t_q1 1 100 0.00 4294967295.00 FORMAT "%13.2" ECU_ADDRESS 0x500021A4 /end MEASUREMENT
/begin MEASUREMENT TiEngOn_tiTotEngRt "Total engine runtime" ULONG t_q1 1 100 0.00 4294967295.00 FORMAT "%13.2" ECU_ADDRESS 0x50004FDC /end MEASUREMENT
/begin MEASUREMENT TiEngOn_tiTotEngRtAux "Auxiliary counter of total engine runtime" SLONG Time_Dt 1 100 -2147.48364800 2147.48364700 FORMAT "%13.8" ECU_ADDRESS 0x500021A8 /end MEASUREMENT
/begin MEASUREMENT TiEngOn_tiTotEngRtAvs "Total engine runtime set by AVS interface" ULONG t_q1 1 100 0.00 4294967295.00 FORMAT "%13.2" ECU_ADDRESS 0x500021AC /end MEASUREMENT
/begin MEASUREMENT TiEngOn_tiTotEngRtNV "Total engine runtime stored in non volatile memory" ULONG t_q1 1 100 0.00 4294967295.00 FORMAT "%13.2" ECU_ADDRESS 0x500021B0 /end MEASUREMENT
/begin MEASUREMENT TiEngOn_tiTotIgnOn "Total ignition on time" ULONG t_q1 1 100 0.00 4294967295.00 FORMAT "%13.2" ECU_ADDRESS 0x50004FE4 /end MEASUREMENT
/begin MEASUREMENT TiEngOn_tiTotIgnOnAux "Auxiliary counter of total ignition on time" SLONG Time_Dt 1 100 -2147.48364800 2147.48364700 FORMAT "%13.8" ECU_ADDRESS 0x60002650 /end MEASUREMENT
/begin MEASUREMENT TiEngOn_tiTotIgnOnNv "Total ignition on time stored in non volatile memory" ULONG t_q1 1 100 0.00 4294967295.00 FORMAT "%13.2" ECU_ADDRESS 0x500021B4 /end MEASUREMENT
/begin MEASUREMENT TiOff_bEngOffFirstStrtFinLoc "Bit: Detection of first engine stop after initialisation" UBYTE B_TRUE 1 100 0.00 1.00000000000 BIT_MASK 0x1 FORMAT "%13.11" ECU_ADDRESS 0x6000AD97 /end MEASUREMENT
/begin MEASUREMENT TiOff_bEngOffSwLoc "Bit. internal clock was just reset (local)" UBYTE B_TRUE 1 100 0.00 1.00000000000 BIT_MASK 0x1 FORMAT "%13.11" ECU_ADDRESS 0x70039B6C /end MEASUREMENT
/begin MEASUREMENT TiOff_bEngRotLoc "Bit: Engine rotation detected (local)" UBYTE B_TRUE 1 100 0.00 1.00000000000 BIT_MASK 0x1 FORMAT "%13.11" ECU_ADDRESS 0x70039B6B /end MEASUREMENT
/begin MEASUREMENT TiOff_bEngRstDeb "Bit: Engine off time has just been reset" UBYTE B_TRUE 1 100 0.00 1.00000000000 BIT_MASK 0x1 FORMAT "%13.11" ECU_ADDRESS 0x70039BF8 /end MEASUREMENT
/begin MEASUREMENT TiOff_bEngRstLoc "Bit: Engine stop detected (local)" UBYTE B_TRUE 1 100 0.00 1.00000000000 BIT_MASK 0x1 FORMAT "%13.11" ECU_ADDRESS 0x6000AD96 /end MEASUREMENT
/begin MEASUREMENT TiOff_bIniGap "Bit: detection of phase ecu was off" UBYTE B_TRUE 1 100 0.00 1.00000000000 BIT_MASK 0x1 FORMAT "%13.11" ECU_ADDRESS 0x70000748 /end MEASUREMENT
/begin MEASUREMENT TiOff_bIniGapLoc "Bit: detection of phase ecu was off (local)" UBYTE B_TRUE 1 100 0.00 1.00000000000 BIT_MASK 0x1 FORMAT "%13.11" ECU_ADDRESS 0x6000ADA0 /end MEASUREMENT
/begin MEASUREMENT TiOff_bStrtEndOffActive "Bit: start-end off-time in hold mode (bit start end active)" UBYTE B_TRUE 1 100 0.00 1.00000000000 BIT_MASK 0x1 FORMAT "%13.11" ECU_ADDRESS 0x6000EE18 /end MEASUREMENT
/begin MEASUREMENT TiOff_bStrtEndOffActiveFall "Bit: Engine stop detected (local)" UBYTE B_TRUE 1 100 0.00 1.00000000000 BIT_MASK 0x1 FORMAT "%13.11" ECU_ADDRESS 0x6000AD94 /end MEASUREMENT
/begin MEASUREMENT TiOff_bStrtEndOffActiveLoc "Bit: Engine rotation detected (local)" UBYTE B_TRUE 1 100 0.00 1.00000000000 BIT_MASK 0x1 FORMAT "%13.11" ECU_ADDRESS 0x6000EE17 /end MEASUREMENT
/begin MEASUREMENT TiOff_bStrtEndOffFirstStrtFinLoc "Bit: Detection of first engine stop after initialisation" UBYTE B_TRUE 1 100 0.00 1.00000000000 BIT_MASK 0x1 FORMAT "%13.11" ECU_ADDRESS 0x6000AD93 /end MEASUREMENT
/begin MEASUREMENT TiOff_bStrtEndOffRst "Bit: Start end off time has recently been reset" UBYTE B_TRUE 1 100 0.00 1.00000000000 BIT_MASK 0x1 FORMAT "%13.11" ECU_ADDRESS 0x6000EE16 /end MEASUREMENT
/begin MEASUREMENT TiOff_bStrtEndOffRstDeb "Bit: Start end off time has recently been reset (debounced)" UBYTE B_TRUE 1 100 0.00 1.00000000000 BIT_MASK 0x1 FORMAT "%13.11" ECU_ADDRESS 0x70039B57 /end MEASUREMENT
/begin MEASUREMENT TiOff_bStrtEndOffRstLoc "Bit: Start end off time has recently been reset (local)" UBYTE B_TRUE 1 100 0.00 1.00000000000 BIT_MASK 0x1 FORMAT "%13.11" ECU_ADDRESS 0x6000AD92 /end MEASUREMENT
/begin MEASUREMENT TiOff_bStrtEndOffRstReIni "Bit: Engine rotation ReIni detected (local)" UBYTE B_TRUE 1 100 0.00 1.00000000000 BIT_MASK 0x1 FORMAT "%13.11" ECU_ADDRESS 0x6000AD91 /end MEASUREMENT
/begin MEASUREMENT TiOff_bStrtEndOffRstRstrt "Bit: Engine stop in Proc_EngReStrt detected (local)" UBYTE B_TRUE 1 100 0.00 1.00000000000 BIT_MASK 0x1 FORMAT "%13.11" ECU_ADDRESS 0x6000EE15 /end MEASUREMENT
/begin MEASUREMENT TiOff_bStrtEndOffSwLoc "Bit. internal clock was just reset (local)" UBYTE B_TRUE 1 100 0.00 1.00000000000 BIT_MASK 0x1 FORMAT "%13.11" ECU_ADDRESS 0x70039B56 /end MEASUREMENT
/begin MEASUREMENT TiOff_bTiEngOffEcuActvLoc "Bit: No powerfail has occured since last engine stop (local)" UBYTE B_TRUE 1 100 0.00 1.00000000000 BIT_MASK 0x1 FORMAT "%13.11" ECU_ADDRESS 0x60038AC1 /end MEASUREMENT
/begin MEASUREMENT TiOff_bTiEngOffRstReIni "Bit: Engine stop detected in ReIni" UBYTE B_TRUE 1 100 0.00 1.00000000000 BIT_MASK 0x1 FORMAT "%13.11" ECU_ADDRESS 0x6000AD9B /end MEASUREMENT
/begin MEASUREMENT TiOff_bTiEngOffRstRstrt "Bit: Engine stop detected by EngReStrt" UBYTE B_TRUE 1 100 0.00 1.00000000000 BIT_MASK 0x1 FORMAT "%13.11" ECU_ADDRESS 0x6000F080 /end MEASUREMENT
/begin MEASUREMENT TiOff_bTiHwClk "Bit. generic HW-Clock available" UBYTE B_TRUE 1 100 0.00 1.00000000000 BIT_MASK 0x1 FORMAT "%13.11" ECU_ADDRESS 0x70000747 /end MEASUREMENT
/begin MEASUREMENT TiOff_bTiHwClkRst "Bit. generic HW-Clock was just reset" UBYTE B_TRUE 1 100 0.00 1.00000000000 BIT_MASK 0x1 FORMAT "%13.11" ECU_ADDRESS 0x70000746 /end MEASUREMENT
/begin MEASUREMENT TiOff_bTiHwClkRstDiagDisbl "Bit: Reset of clock by diagnosis is disabled" UBYTE B_TRUE 1 100 0.00 1.00000000000 BIT_MASK 0x1 FORMAT "%13.11" ECU_ADDRESS 0x70039B80 /end MEASUREMENT
/begin MEASUREMENT TiOff_bTiHwClkRstLoc "Bit. generic HW-Clock was just reset (local)" UBYTE B_TRUE 1 100 0.00 1.00000000000 BIT_MASK 0x1 FORMAT "%13.11" ECU_ADDRESS 0x6000AD9F /end MEASUREMENT
/begin MEASUREMENT TiOff_bTiStrtEndActOld "Bit: last state start-end system activ" UBYTE B_TRUE 1 100 0.00 1.00000000000 BIT_MASK 0x1 FORMAT "%13.11" ECU_ADDRESS 0x70039B55 /end MEASUREMENT
/begin MEASUREMENT TiOff_bXPostDrvTiEngOff "Bit: Post drive extension by TiOff_VdTiEngOff" UBYTE B_TRUE 1 100 0.00 1.00000000000 BIT_MASK 0x1 FORMAT "%13.11" ECU_ADDRESS 0x6000AD95 /end MEASUREMENT
/begin MEASUREMENT TiOff_bXPostDrvTiStrtEndOff "Bit to request post drive prolonguation within TiStrtEnd" UBYTE B_TRUE 1 100 0.00 1.00000000000 BIT_MASK 0x1 FORMAT "%13.11" ECU_ADDRESS 0x6000AD90 /end MEASUREMENT
/begin MEASUREMENT TiOff_cntrDsmClearTBasdChk "DSM-Clear-counter" UBYTE OneToOne 1 100 0.00 255.0 FORMAT "%5.1" ECU_ADDRESS 0x6000EF25 /end MEASUREMENT
/begin MEASUREMENT TiOff_cntrDsmClearTBasdChkLst "DSM-Clear-counter (reference)" UBYTE OneToOne 1 100 0.00 255.0 FORMAT "%5.1" ECU_ADDRESS 0x6000AD9E /end MEASUREMENT
/begin MEASUREMENT TiOff_cntrEngOffRst "Reset-counter of engine off time based on engine rotation" UBYTE OneToOne 1 100 0.00 255.0 FORMAT "%5.1" ECU_ADDRESS 0x6000EF24 /end MEASUREMENT
/begin MEASUREMENT TiOff_cntrEngOffRstLoc "Local reset-counter of engine of engine off time based on engine rotation" UBYTE OneToOne 1 100 0.00 255.0 FORMAT "%5.1" ECU_ADDRESS 0x70039BF9 /end MEASUREMENT
/begin MEASUREMENT TiOff_cntrEngOffRstOld "Local reset-counter of engine of engine off time based on engine rotation from last call" UBYTE OneToOne 1 100 0.00 255.0 FORMAT "%5.1" ECU_ADDRESS 0x70039B6A /end MEASUREMENT
/begin MEASUREMENT TiOff_cntrStrtEndOffRst "reset-counter of engine of engine off time based on start-end" UBYTE OneToOne 1 100 0.00 255.0 FORMAT "%5.1" ECU_ADDRESS 0x6000EF23 /end MEASUREMENT
/begin MEASUREMENT TiOff_cntrStrtEndOffRstLoc "Local reset-counter of engine of engine off time based on start-end" UBYTE OneToOne 1 100 0.00 255.0 FORMAT "%5.1" ECU_ADDRESS 0x70039B54 /end MEASUREMENT
/begin MEASUREMENT TiOff_cntrStrtEndOffRstOld "Local reset-counter of engine of engine off time based on start-end from last call" UBYTE OneToOne 1 100 0.00 255.0 FORMAT "%5.1" ECU_ADDRESS 0x70039B53 /end MEASUREMENT
/begin MEASUREMENT TiOff_ctEngOffReIni "internal delay time for ReIni recognition" UBYTE OneToOne 1 100 0.00 255.0 FORMAT "%5.1" ECU_ADDRESS 0x6000AD9A /end MEASUREMENT
/begin MEASUREMENT TiOff_ctStrtEndOffReIni "internal counter for ReIni detection" UBYTE OneToOne 1 100 0.00 255.0 FORMAT "%5.1" ECU_ADDRESS 0x6000AD8F /end MEASUREMENT
/begin MEASUREMENT TiOff_flgEcuNotOffTBasdChkProt "local flag in protected ram to indicate the status of ecu right before initialisation" UBYTE B_TRUE 1 100 0.00 1.00000000000 BIT_MASK 0x1 FORMAT "%13.11" ECU_ADDRESS 0x600365BA /end MEASUREMENT
/begin MEASUREMENT TiOff_flgTBasdChkFastPhyEna "Phyiscal enable for T-Based check (fast)" UBYTE B_TRUE 1 100 0.00 1.00000000000 BIT_MASK 0x1 FORMAT "%13.11" ECU_ADDRESS 0x70000106 /end MEASUREMENT
/begin MEASUREMENT TiOff_flgTBasdChkSlowPhyEna "Phyiscal enable for T-Based check (slow)" UBYTE B_TRUE 1 100 0.00 1.00000000000 BIT_MASK 0x1 FORMAT "%13.11" ECU_ADDRESS 0x70000105 /end MEASUREMENT
/begin MEASUREMENT TiOff_ratCoolDwnTBasdChk "Ratio of current cool down compared to last T15-off-event" UWORD fak_q0p000488 1 100 0.00 1.000000 FORMAT "%8.6" ECU_ADDRESS 0x600068BE /end MEASUREMENT
/begin MEASUREMENT TiOff_stTBasdChk "state of temperature based check of the ecu-off-time clock" UBYTE OneToOne 1 100 0.00 255.0 FORMAT "%5.1" ECU_ADDRESS 0x6000AD9D /end MEASUREMENT
/begin MEASUREMENT TiOff_stTiEngOffHw "Status of engine off time based on HW-clock" UBYTE OneToOne 1 100 0.00 255.0 FORMAT "%5.1" ECU_ADDRESS 0x6000AD99 /end MEASUREMENT
/begin MEASUREMENT TiOff_stTiEngOffHwEnd "Status of end timestamp of HW clock" UBYTE OneToOne 1 100 0.00 255.0 FORMAT "%5.1" ECU_ADDRESS 0x70039B69 /end MEASUREMENT
/begin MEASUREMENT TiOff_stTiEngOffHwStart "Status of start timestamp of HW clock" UBYTE OneToOne 1 100 0.00 255.0 FORMAT "%5.1" ECU_ADDRESS 0x70039B68 /end MEASUREMENT
/begin MEASUREMENT TiOff_stTiEngOffLoc "Status of engine off time (local)" UBYTE OneToOne 1 100 0.00 255.0 FORMAT "%5.1" ECU_ADDRESS 0x6000AD98 /end MEASUREMENT
/begin MEASUREMENT TiOff_stTiStrtEndActn "State to detremine what start- end time has to do" UBYTE OneToOne 1 100 0.00 255.0 FORMAT "%5.1" ECU_ADDRESS 0x70039B52 /end MEASUREMENT
/begin MEASUREMENT TiOff_stTiStrtEndOff "state of off time based on start-end recognition" UBYTE OneToOne 1 100 0.00 255.0 FORMAT "%5.1" ECU_ADDRESS 0x6000EF22 /end MEASUREMENT
/begin MEASUREMENT TiOff_stTiStrtEndOffFirstStrt "start-end-time after start" UBYTE OneToOne 1 100 0.00 255.0 FORMAT "%5.1" ECU_ADDRESS 0x6000EF21 /end MEASUREMENT
/begin MEASUREMENT TiOff_stTiStrtEndOffFirstStrtLoc "start-end time after start (local)" UBYTE OneToOne 1 100 0.00 255.0 FORMAT "%5.1" ECU_ADDRESS 0x6000AD8E /end MEASUREMENT
/begin MEASUREMENT TiOff_stTiStrtEndOffHw "start-end time using a start-end clock" UBYTE OneToOne 1 100 0.00 255.0 FORMAT "%5.1" ECU_ADDRESS 0x70039B51 /end MEASUREMENT
/begin MEASUREMENT TiOff_stTiStrtEndOffHwEnd "End point of the start-end -time based on HW-Clock" UBYTE OneToOne 1 100 0.00 255.0 FORMAT "%5.1" ECU_ADDRESS 0x70039B50 /end MEASUREMENT
/begin MEASUREMENT TiOff_stTiStrtEndOffHwStart "State of the start point of the start-end time using a HW-clock" UBYTE OneToOne 1 100 0.00 255.0 FORMAT "%5.1" ECU_ADDRESS 0x70039B4F /end MEASUREMENT
/begin MEASUREMENT TiOff_stTiStrtEndOffLoc "State of the start- end time (local)" UBYTE OneToOne 1 100 0.00 255.0 FORMAT "%5.1" ECU_ADDRESS 0x70039B4E /end MEASUREMENT
/begin MEASUREMENT TiOff_stTiStrtEndOffMdlEnd "End point of the start-end -time based on model-clock" UBYTE OneToOne 1 100 0.00 255.0 FORMAT "%5.1" ECU_ADDRESS 0x70039B4D /end MEASUREMENT
/begin MEASUREMENT TiOff_stTiStrtEndOffMdlStart "State of the start point of the start-end time using a model-clock" UBYTE OneToOne 1 100 0.00 255.0 FORMAT "%5.1" ECU_ADDRESS 0x70039B4C /end MEASUREMENT
/begin MEASUREMENT TiOff_stVdClkEcuOnIndcn "semaphore to detect an ecu-off-phase" ULONG OneToOne 1 100 0.00 4294967295.00 FORMAT "%13.2" ECU_ADDRESS 0x70039B7C /end MEASUREMENT
/begin MEASUREMENT TiOff_stVdTiEngOffEcuOnIndcn "Indiciation, to detect, if the ECU had been shutdown before the initialization" ULONG OneToOne 1 100 0.00 4294967295.00 FORMAT "%13.2" ECU_ADDRESS 0x70039B64 /end MEASUREMENT
/begin MEASUREMENT TiOff_stVdTiStrtEndOffEcuOnIndcn "ECU off indication" ULONG OneToOne 1 100 0.00 4294967295.00 FORMAT "%13.2" ECU_ADDRESS 0x70039B48 /end MEASUREMENT
/begin MEASUREMENT TiOff_tCEngDsTT15StopTBasdChk "engine coolant temperature at last T15-off-event" SWORD Temp_Cels 1 100 -3549.940 3003.560 FORMAT "%8.3" ECU_ADDRESS 0x600068BC /end MEASUREMENT
/begin MEASUREMENT TiOff_tCEngDsTT15StrtTBasdChk "engine coolant tempeature at last T15-on-event" SWORD Temp_Cels 1 100 -3549.940 3003.560 FORMAT "%8.3" ECU_ADDRESS 0x600068BA /end MEASUREMENT
/begin MEASUREMENT TiOff_tDiffCEngDsTPsblTBasdChk "possible cool down of the coolant temperature within last T15-off-phase" SWORD TempDiff_Kelv 1 100 -3276.800 3276.700 FORMAT "%8.3" ECU_ADDRESS 0x600068B8 /end MEASUREMENT
/begin MEASUREMENT TiOff_tDiffCEngDsTTBasdChk "cool down of the engine coolant temperature within the last T15-off-phase" SWORD TempDiff_Kelv 1 100 -3276.800 3276.700 FORMAT "%8.3" ECU_ADDRESS 0x600068B6 /end MEASUREMENT
/begin MEASUREMENT TiOff_tEnvTSensT15StrtTBasdChk "ambient air temperature at last T15-on-event" SWORD Temp_Cels 1 100 -3549.940 3003.560 FORMAT "%8.3" ECU_ADDRESS 0x600068B4 /end MEASUREMENT
/begin MEASUREMENT TiOff_tiCumEcuOffTBasdChk "accumulated ecu-off-time since last T15-off-event" SLONG t_q1 1 100 -2147483648.00 2147483647.00 FORMAT "%13.2" ECU_ADDRESS 0x6000264C /end MEASUREMENT
/begin MEASUREMENT TiOff_tiEngOffHw "Engine off time based on HW clock" SLONG Time_sec_q1_COMPU 1 100 0.00 2147483647.00 FORMAT "%13.2" ECU_ADDRESS 0x60002644 /end MEASUREMENT
/begin MEASUREMENT TiOff_tiEngOffHwEnd "End timestamp of HW clock" SLONG Time_sec_q1_COMPU 1 100 -2147483648.00 2147483647.00 FORMAT "%13.2" ECU_ADDRESS 0x70039B60 /end MEASUREMENT
/begin MEASUREMENT TiOff_tiEngOffHwStart "Start timestamp of HW-clock" SLONG Time_sec_q1_COMPU 1 100 -2147483648.00 2147483647.00 FORMAT "%13.2" ECU_ADDRESS 0x70039B5C /end MEASUREMENT
/begin MEASUREMENT TiOff_tiEngOffLoc "Engine off time (local)" SLONG Time_sec_q1_COMPU 1 100 0.00 2147483647.00 FORMAT "%13.2" ECU_ADDRESS 0x500021B8 /end MEASUREMENT
/begin MEASUREMENT TiOff_tiEngOffSwAux "Internal counter of software clock" SLONG Time_Dt 1 100 0.00 2147.48364700 FORMAT "%13.8" ECU_ADDRESS 0x60002640 /end MEASUREMENT
/begin MEASUREMENT TiOff_tiEngOffSwLoc "Engine off time based on software clock" SLONG Time_sec_q1_COMPU 1 100 0.00 2147483647.00 FORMAT "%13.2" ECU_ADDRESS 0x70039B58 /end MEASUREMENT
/begin MEASUREMENT TiOff_tiHwClk "value of generic HW-Clock" SLONG Time_sec_q1_COMPU 1 100 -2147483648.00 2147483647.00 FORMAT "%13.2" ECU_ADDRESS 0x60003778 /end MEASUREMENT
/begin MEASUREMENT TiOff_tiHwClkLoc "value of generic HW-Clock (lokal)" SLONG Time_sec_q1_COMPU 1 100 0.00 2147483647.00 FORMAT "%13.2" ECU_ADDRESS 0x70039B78 /end MEASUREMENT
/begin MEASUREMENT TiOff_tiHwClkLstGap "value of the last gap of the generic HW-Clock" SLONG Time_sec_q1_COMPU 1 100 -2147483648.00 2147483647.00 FORMAT "%13.2" ECU_ADDRESS 0x60003774 /end MEASUREMENT
/begin MEASUREMENT TiOff_tiHwClkStop "Time value of last stop of HW-Clock" SLONG Time_sec_q1_COMPU 1 100 -2147483648.00 2147483647.00 FORMAT "%13.2" ECU_ADDRESS 0x60003770 /end MEASUREMENT
/begin MEASUREMENT TiOff_tiHwClkStopLoc "Time value of last stop of HW-Clock (local)" SLONG Time_sec_q1_COMPU 1 100 0.00 2147483647.00 FORMAT "%13.2" ECU_ADDRESS 0x70039B74 /end MEASUREMENT
/begin MEASUREMENT TiOff_tiHwClkWakeupLoc "value of the generalized HW clock after reset (locally)" SLONG Time_sec_q1_COMPU 1 100 0.00 2147483647.00 FORMAT "%13.2" ECU_ADDRESS 0x70039B70 /end MEASUREMENT
/begin MEASUREMENT TiOff_tiStrtEndOff "off time based on start- end recognition" SLONG Time_sec_q1_COMPU 1 100 -2147483648.00 2147483647.00 FORMAT "%13.2" ECU_ADDRESS 0x600131D8 /end MEASUREMENT
/begin MEASUREMENT TiOff_tiStrtEndOffFirstStrt "start end time after start" SLONG Time_sec_q1_COMPU 1 100 -2147483648.00 2147483647.00 FORMAT "%13.2" ECU_ADDRESS 0x6000376C /end MEASUREMENT
/begin MEASUREMENT TiOff_tiStrtEndOffFirstStrtLoc "start-end time after start (local)" SLONG Time_sec_q1_COMPU 1 100 -2147483648.00 2147483647.00 FORMAT "%13.2" ECU_ADDRESS 0x500021BC /end MEASUREMENT
/begin MEASUREMENT TiOff_tiStrtEndOffHw "start-end time using a HW-Clock" SLONG Time_sec_q1_COMPU 1 100 0.00 2147483647.00 FORMAT "%13.2" ECU_ADDRESS 0x70039B44 /end MEASUREMENT
/begin MEASUREMENT TiOff_tiStrtEndOffHwEnd "End point of the start-end-time based on HW-Clock" SLONG Time_sec_q1_COMPU 1 100 -2147483648.00 2147483647.00 FORMAT "%13.2" ECU_ADDRESS 0x70039B40 /end MEASUREMENT
/begin MEASUREMENT TiOff_tiStrtEndOffHwStart "Start point of the start -end-time based on HW-Clock" SLONG Time_sec_q1_COMPU 1 100 -2147483648.00 2147483647.00 FORMAT "%13.2" ECU_ADDRESS 0x70039B3C /end MEASUREMENT
/begin MEASUREMENT TiOff_tiStrtEndOffLoc "start- end time (local)" SLONG Time_sec_q1_COMPU 1 100 0.00 2147483647.00 FORMAT "%13.2" ECU_ADDRESS 0x70039B38 /end MEASUREMENT
/begin MEASUREMENT TiOff_tiStrtEndOffMdlEnd "End point of the start-end-time based on model-clock" SLONG Time_sec_q1_COMPU 1 100 -2147483648.00 2147483647.00 FORMAT "%13.2" ECU_ADDRESS 0x70039B34 /end MEASUREMENT
/begin MEASUREMENT TiOff_tiStrtEndOffSwAux "low counter of the generic internal-Clock" SLONG Time_Dt 1 100 -2147.48364800 2147.48364700 FORMAT "%13.8" ECU_ADDRESS 0x70039B30 /end MEASUREMENT
/begin MEASUREMENT TiOff_tiStrtEndOffSwLoc "value of generic internal-Clock (lokal)" SLONG Time_sec_q1_COMPU 1 100 -2147483648.00 2147483647.00 FORMAT "%13.2" ECU_ADDRESS 0x70039B2C /end MEASUREMENT
/begin MEASUREMENT TiOff_tiSwClkAux "low counter of the generic HW-Clock" SLONG Time_Dt 1 100 -2147.48364800 2147.48364700 FORMAT "%13.8" ECU_ADDRESS 0x500021C0 /end MEASUREMENT
/begin MEASUREMENT TiOff_tiT15OffEcuOnTBasdChk "accumulated ecu-on-time since last T15-off-event" SLONG t_q1 1 100 -2147483648.00 2147483647.00 FORMAT "%13.2" ECU_ADDRESS 0x500021C4 /end MEASUREMENT
/begin MEASUREMENT TiOff_tiT15OffMinsTBasdChk "off time in minutes for temperatur based check" UWORD Time_min_q1_COMPU 1 100 0.00 65535.00 FORMAT "%8.2" ECU_ADDRESS 0x600068B2 /end MEASUREMENT
/begin MEASUREMENT TiOff_tiT15OffSecTrigTBasdChk "local counter to trigger temperature based check" SLONG Time_Dt 1 100 -2147.48364800 2147.48364700 FORMAT "%13.8" ECU_ADDRESS 0x60002648 /end MEASUREMENT
/begin MEASUREMENT TiOff_tiT15OffTBasdChkFastRef "reference value for temperature based check (fast)" UWORD Time_min_q1_COMPU 1 100 0.00 65535.00 FORMAT "%8.2" ECU_ADDRESS 0x600068B0 /end MEASUREMENT
/begin MEASUREMENT TiOff_tiT15OffTBasdChkSlowRef "reference value for temperature based check (slow)" UWORD Time_min_q1_COMPU 1 100 0.00 65535.00 FORMAT "%8.2" ECU_ADDRESS 0x600068AE /end MEASUREMENT
/begin MEASUREMENT TiOff_tiTBasdChkTrig "local counter to trigger temperature based check" SLONG Time_Dt 1 100 -2147.48364800 2147.48364700 FORMAT "%13.8" ECU_ADDRESS 0x500021C8 /end MEASUREMENT
/begin MEASUREMENT TS_stMnSwtAC "Status of air condition main switch" UBYTE OneToOne 1 100 0.00 255.0 FORMAT "%5.1" ECU_ADDRESS 0x5000605C /end MEASUREMENT
/begin MEASUREMENT zwopt_msg "Optimized model reference ignition angle" SBYTE kw_q0p75 1 100 -96.00 95.25 FORMAT "%5.2" ECU_ADDRESS 0x600009A7 /end MEASUREMENT
/begin MEASUREMENT zwsol_msg "desired ignition angle from torque intervention" SBYTE kw_q0p75 1 100 -96.00 95.25 FORMAT "%5.2" ECU_ADDRESS 0x500009C2 /end MEASUREMENT
/begin FUNCTION ThrVlv_PosnCtrl "1.34.0    Position Controller"
 /begin DEF_CHARACTERISTIC ThrVlv_ATS.LimitTypeMsk_C ThrVlv_ATS.CnvNorm_C ThrVlv_ATS.LowLim_C ThrVlv_ATS.UpLim_C ThrVlv_ATS.CnvFac_C ThrVlv_ATS.CnvOfs_C ThrVlv_ATS.DfltVal_C ThrVlv_IfDetLimpAirPosnRegnB1_I.dUIntglSldgModLhp_CUR ThrVlv_IfDetLimpAirPosnRegnB1_I.facCtrlIntglLimpAirPosn_C ThrVlv_IfDetLimpAirPosnRegnB1_I.facCtrlSldgModLhp_C ThrVlv_IfDetLimpAirPosnRegnB1_I.ratDeCtrlrThdLhpStuckDetn_C ThrVlv_IfDetLimpAirPosnRegnB1_I.ratDeLimpAirPosn_C ThrVlv_IfDetLimpAirPosnRegnB1_I.ratLimpAirPosnBand_C ThrVlv_IfDetLimpAirPosnRegnB1_I.uDifOpngSprg_C ThrVlv_IfDetLimpAirPosnRegnB1_I.uMinOpngSprg_C ThrVlv_IfDiagB1_I.dRatDesPreCtrlGrdtThd_C ThrVlv_IfDiagB1_I.facDeCtrlTolr_C ThrVlv_IfDiagB1_I.facDiagHeal_C ThrVlv_IfDiagB1_I.ratDeCtrlTolrMin_C ThrVlv_IfDiagB1_I.ratDutyCycDiagMaxLoBatt_C ThrVlv_IfDiagB1_I.ratDutyCycDiagMax_C ThrVlv_IfDiagB1_I.ratOffsTestMax_C ThrVlv_IfDiagB1_I.ratOffsTestMin_C ThrVlv_IfDiagB1_I.tiCtrlDeMax_C ThrVlv_IfDiagB1_I.tiDutyCycExcd_C ThrVlv_IfExtdPostDrvB1_I.tiExtdPostDrv_C ThrVlv_IfLimpAirPosnChkB1_I.ratOffsLimpAirPosnNotRea_C ThrVlv_IfLimpAirPosnChkB1_I.tiToReaLimpAirPosn_C ThrVlv_IfPwrSaveB1_I.ratDeCtrlrThd_C ThrVlv_IfPwrSaveB1_I.ratDesThdOffs_C ThrVlv_IfPwrSaveB1_I.swtPosnCdnOpen_C ThrVlv_IfPwrSaveB1_I.swtWakeup_C ThrVlv_IfPwrSaveB1_I.tiPwrSave_C ThrVlv_IfRampDwnB1_I.ratOffsBtwVal_C ThrVlv_IfRampDwnB1_I.ratStepSize_C ThrVlv_IfRampDwnB1_I.ratStrtPosn_C ThrVlv_IfRampDwnB1_I.swtRampDwnEna_C ThrVlv_IfSoftLdgB1_I.dRadSpdLimDecel_C ThrVlv_IfSoftLdgB1_I.dRadSpdLimSoftLdg_C ThrVlv_IfSoftLdgB1_I.ratOffsDecel_C ThrVlv_IfSoftLdgB1_I.ratStrtPosn_C ThrVlv_IfSoftLdgB1_I.swtSoftLdgEna_C ThrVlv_IfSoftLdgB1_I.tiFilSwtSpdLimSoftLdg_C ThrVlv_PosnCtrlB1_I.PreCtrlFacB1_C ThrVlv_PosnCtrlB1_I.PreCtrlFacB2_C ThrVlv_PosnCtrlB1_I.PreCtrlFacC1_C ThrVlv_PosnCtrlB1_I.PreCtrlFacC2_C ThrVlv_PosnCtrlB1_I.PreCtrlFacD_C ThrVlv_PosnCtrlB1_I.PreCtrlFacE_C ThrVlv_PosnCtrlB1_I.dRatActThdSwtOffCtrlDer_C ThrVlv_PosnCtrlB1_I.dUIntglSldgMod_CUR ThrVlv_PosnCtrlB1_I.facCnvnIdn_C ThrVlv_PosnCtrlB1_I.facCtrlDer_C ThrVlv_PosnCtrlB1_I.facCtrlDer_MAP ThrVlv_PosnCtrlB1_I.facCtrlIntglMin_C ThrVlv_PosnCtrlB1_I.facCtrlIntglSlowTrj_C ThrVlv_PosnCtrlB1_I.facCtrlIntgl_C ThrVlv_PosnCtrlB1_I.facCtrlIntgl_MAP ThrVlv_PosnCtrlB1_I.facCtrlK_C ThrVlv_PosnCtrlB1_I.facCtrlPropSlowTrj_C ThrVlv_PosnCtrlB1_I.facCtrlProp_C ThrVlv_PosnCtrlB1_I.facCtrlProp_MAP ThrVlv_PosnCtrlB1_I.facCtrlSldgMod_CUR ThrVlv_PosnCtrlB1_I.facDly_C ThrVlv_PosnCtrlB1_I.facElecMotIndtCmp_CUR ThrVlv_PosnCtrlB1_I.facGainSldgSfcCubic_CUR ThrVlv_PosnCtrlB1_I.facGainSldgSfcSqrt_C ThrVlv_PosnCtrlB1_I.facWghtSignIntglSldgMod_C ThrVlv_PosnCtrlB1_I.nrFbCtrlSdlg_C ThrVlv_PosnCtrlB1_I.nrMethDerCalcn_C ThrVlv_PosnCtrlB1_I.ratActThdIntglRst_C ThrVlv_PosnCtrlB1_I.ratDeCtrlrThdIntglRst_C ThrVlv_PosnCtrlB1_I.ratDeCtrlrThdSlowTrj_C ThrVlv_PosnCtrlB1_I.ratDeCtrlrThdSwtOffCtrlStaty_C ThrVlv_PosnCtrlB1_I.ratDesPstDrv_C ThrVlv_PosnCtrlB1_I.ratDftlThdSlowTrj_C ThrVlv_PosnCtrlB1_I.ratDutyCycMax_C ThrVlv_PosnCtrlB1_I.ratDutyCycMin_C ThrVlv_PosnCtrlB1_I.ratGear_C ThrVlv_PosnCtrlB1_I.ratLrgDeltaSpIntglRst_C ThrVlv_PosnCtrlB1_I.ratOffsDutyCycMax_C ThrVlv_PosnCtrlB1_I.ratOffsDutyCycMin_C ThrVlv_PosnCtrlB1_I.ratSmallDeltaSpIntglRst_C ThrVlv_PosnCtrlB1_I.swtCtrlDerActPosn_C ThrVlv_PosnCtrlB1_I.swtNLFF_C ThrVlv_PosnCtrlB1_I.swtOffDRatActSldgModStaty_C ThrVlv_PosnCtrlB1_I.swtOffIntglSldgModStaty_C ThrVlv_PosnCtrlB1_I.swtPidCtrlEna_C ThrVlv_PosnCtrlB1_I.swtTrjAdpnDurgSatn_C ThrVlv_PosnCtrlB1_I.tiCtrlDerFil_C ThrVlv_PosnCtrlB1_I.tiDebOpenLoad_C ThrVlv_PosnCtrlB1_I.tiFilDRatAct_C ThrVlv_PosnCtrlB1_I.tiFilElecMotIndtCmp_C ThrVlv_PosnCtrlB1_I.tiFilSwtPreCtrl_C ThrVlv_PosnCtrlB1_I.tiFricDwn_C ThrVlv_PosnCtrlB1_I.tiFricUp_C ThrVlv_PosnCtrlB1_I.tiPPT1_CUR ThrVlv_PosnCtrlB1_I.tiPreCtrlGrdtBasd_CUR ThrVlv_PosnCtrlB1_I.tiSdlFacCtrl_C ThrVlv_PosnCtrlB1_I.tiSldgSfcDer_C ThrVlv_PosnCtrlB1_I.tiSlowTrjCdn_C ThrVlv_PosnCtrlB1_I.tiSwtOffCtrlStaty_C ThrVlv_PosnCtrlB1_I.uCtrlIntglRst_C ThrVlv_PosnCtrlB1_I.uFricCmp_C ThrVlv_PosnCtrlB1_I.uInpDsbc_C ThrVlv_PosnCtrlB1_I.uSprgCmp_CUR ThrVlv_ratDesCalcB1_C ThrVlv_swtDesCalcB1_C /end DEF_CHARACTERISTIC
 /begin REF_CHARACTERISTIC ThrVlv_stActrCfg_C /end REF_CHARACTERISTIC
 /begin IN_MEASUREMENT BattU_u ChrCtl_ratDesPosnThrVlvB1 Epm_nEng SyC_stSub ThrVlv_flgActPosnVldB1 ThrVlv_flgActrOnB1 ThrVlv_flgAdpnRelsB1 ThrVlv_flgLimpModeB1 ThrVlv_flgOffsLrnPsOffB1 ThrVlv_flgReqFuCutOffB1 ThrVlv_flgReqPsOffB1 ThrVlv_flgUBattSuffB1 ThrVlv_ratActIntB1 ThrVlv_ratAdpnB1 ThrVlv_ratLimpAirPosnB1 ThrVlv_ratOffsClsdPosnB1 ThrVlv_ratOpenPosnMaxB1 ThrVlv_stMonPsIfB1 ThrVlv_stOffsLrnStB1 /end IN_MEASUREMENT
 /begin OUT_MEASUREMENT ThrVlv_facUBattB1 ThrVlv_flgDesTstrB1 ThrVlv_flgDesValVldB1 ThrVlv_flgLimpAirPosnNotReaB1 ThrVlv_flgLmsPsdB1 ThrVlv_flgOpenLoopOpngVvtEndPosnB1 ThrVlv_flgPosnCtrlPsOffB1 ThrVlv_flgXPostDrvB1 ThrVlv_ratDeCtrlrB1 ThrVlv_ratDesB1 ThrVlv_ratDesTstrB1 ThrVlv_ratDutyCycB1 ThrVlv_stMonPosnCtrlB1 ThrVlv_stPosnCtrlStB1 /end OUT_MEASUREMENT
 /begin LOC_MEASUREMENT ThrVlv_flgPosnCtrlDsmClrDmdB1 ThrVlv_flgTstrCdn ThrVlv_PosnCtrlB1_I.PwrLossHeat ThrVlv_PosnCtrlB1_I.dRadSpdLimSoftLdg ThrVlv_PosnCtrlB1_I.dRadSpdLimSoftLmsLvng ThrVlv_PosnCtrlB1_I.dRatActFild ThrVlv_PosnCtrlB1_I.dRatActSldgModFild ThrVlv_PosnCtrlB1_I.dRatActSldgModFildAbslt ThrVlv_PosnCtrlB1_I.dRatDesPreCtrlGrdt ThrVlv_PosnCtrlB1_I.dUIntglSldgMod ThrVlv_PosnCtrlB1_I.dUIntglSldgModLhp ThrVlv_PosnCtrlB1_I.dt_fac_u16 ThrVlv_PosnCtrlB1_I.dt_ms_0p04881_u16 ThrVlv_PosnCtrlB1_I.egyHeatOld ThrVlv_PosnCtrlB1_I.facCtrlDer ThrVlv_PosnCtrlB1_I.facCtrlIntgl ThrVlv_PosnCtrlB1_I.facCtrlIntglLimpAirPosn ThrVlv_PosnCtrlB1_I.facCtrlProp ThrVlv_PosnCtrlB1_I.facCtrlSldgMod ThrVlv_PosnCtrlB1_I.facCtrlSldgModLhp ThrVlv_PosnCtrlB1_I.facPreCtrlA1 ThrVlv_PosnCtrlB1_I.facPreCtrlA2 ThrVlv_PosnCtrlB1_I.facPreCtrlA3 ThrVlv_PosnCtrlB1_I.facPreCtrlB ThrVlv_PosnCtrlB1_I.facPreCtrlC ThrVlv_PosnCtrlB1_I.facUBatt ThrVlv_PosnCtrlB1_I.flgClsdPosnReaSuc ThrVlv_PosnCtrlB1_I.flgCompProt ThrVlv_PosnCtrlB1_I.flgCoolgDone ThrVlv_PosnCtrlB1_I.flgCsersDiagActv ThrVlv_PosnCtrlB1_I.flgCsersDiagActvAtErrSet ThrVlv_PosnCtrlB1_I.flgCsersDiumprDenom ThrVlv_PosnCtrlB1_I.flgCsersDiumprNumr ThrVlv_PosnCtrlB1_I.flgCsersEnaCdn ThrVlv_PosnCtrlB1_I.flgCtrlDeDeb ThrVlv_PosnCtrlB1_I.flgCtrlDeDebCsers ThrVlv_PosnCtrlB1_I.flgCtrlDeDfcLdc ThrVlv_PosnCtrlB1_I.flgCtrlDeDfcLdcCsers ThrVlv_PosnCtrlB1_I.flgCycCtrlDeMax ThrVlv_PosnCtrlB1_I.flgCycCtrlDeMin ThrVlv_PosnCtrlB1_I.flgCycDutyCycPsMax ThrVlv_PosnCtrlB1_I.flgCycDutyCycPsMin ThrVlv_PosnCtrlB1_I.flgDEDIA ThrVlv_PosnCtrlB1_I.flgDebLowUBatt ThrVlv_PosnCtrlB1_I.flgDebOpenLoad ThrVlv_PosnCtrlB1_I.flgDesValFromHeal ThrVlv_PosnCtrlB1_I.flgDesValVld ThrVlv_PosnCtrlB1_I.flgDetDfcDoneDcyc ThrVlv_PosnCtrlB1_I.flgDfcLdc ThrVlv_PosnCtrlB1_I.flgDfcSaved ThrVlv_PosnCtrlB1_I.flgDrvToLimpAirPosn ThrVlv_PosnCtrlB1_I.flgDsmRdyDcyc ThrVlv_PosnCtrlB1_I.flgDstRea ThrVlv_PosnCtrlB1_I.flgDutyCycExcdDeb ThrVlv_PosnCtrlB1_I.flgDutyCycOpenLoopOpng ThrVlv_PosnCtrlB1_I.flgErrRprt ThrVlv_PosnCtrlB1_I.flgFailSafe ThrVlv_PosnCtrlB1_I.flgFailSafeHealDfcActv ThrVlv_PosnCtrlB1_I.flgFailSafeOlcActv ThrVlv_PosnCtrlB1_I.flgFilRst ThrVlv_PosnCtrlB1_I.flgFixdCtrlGain ThrVlv_PosnCtrlB1_I.flgGpfProtnActv ThrVlv_PosnCtrlB1_I.flgHealAllwd ThrVlv_PosnCtrlB1_I.flgHealDesValActv ThrVlv_PosnCtrlB1_I.flgHealDfcActv ThrVlv_PosnCtrlB1_I.flgHealDfcClsd ThrVlv_PosnCtrlB1_I.flgHealDfcOpend ThrVlv_PosnCtrlB1_I.flgHealFail ThrVlv_PosnCtrlB1_I.flgHealSuc ThrVlv_PosnCtrlB1_I.flgHldClsdAbortIniFil ThrVlv_PosnCtrlB1_I.flgHldClsdActv ThrVlv_PosnCtrlB1_I.flgHldClsdAvl ThrVlv_PosnCtrlB1_I.flgHldClsdDynPeak ThrVlv_PosnCtrlB1_I.flgHldClsdMaps ThrVlv_PosnCtrlB1_I.flgHldOpenActv ThrVlv_PosnCtrlB1_I.flgIniDesFil ThrVlv_PosnCtrlB1_I.flgIniDesFilNegSp ThrVlv_PosnCtrlB1_I.flgIniDesFilUnlimSp ThrVlv_PosnCtrlB1_I.flgIntglRst ThrVlv_PosnCtrlB1_I.flgLhpStuck ThrVlv_PosnCtrlB1_I.flgLimpAirPosnNotRea ThrVlv_PosnCtrlB1_I.flgLimpAirPosnRegn ThrVlv_PosnCtrlB1_I.flgLimpAirPosnRegnSp ThrVlv_PosnCtrlB1_I.flgLmsClsngActv ThrVlv_PosnCtrlB1_I.flgLmsClsngDeactvtPwrSave ThrVlv_PosnCtrlB1_I.flgLmsClsngDone ThrVlv_PosnCtrlB1_I.flgLmsPsd ThrVlv_PosnCtrlB1_I.flgLmsRea ThrVlv_PosnCtrlB1_I.flgLongTermOffs ThrVlv_PosnCtrlB1_I.flgOffsLrnPsErr ThrVlv_PosnCtrlB1_I.flgOpenPosnReaSuc ThrVlv_PosnCtrlB1_I.flgOpngAftLongHldClsd ThrVlv_PosnCtrlB1_I.flgPosnCtrlErr ThrVlv_PosnCtrlB1_I.flgPosnCtrlPsOff ThrVlv_PosnCtrlB1_I.flgPosnCtrlSlow ThrVlv_PosnCtrlB1_I.flgPsOff ThrVlv_PosnCtrlB1_I.flgPsRdy ThrVlv_PosnCtrlB1_I.flgPsRst ThrVlv_PosnCtrlB1_I.flgPsSwtOffDiag ThrVlv_PosnCtrlB1_I.flgPwrSaveCdn ThrVlv_PosnCtrlB1_I.flgRampDwn ThrVlv_PosnCtrlB1_I.flgRampDwnDutyLim ThrVlv_PosnCtrlB1_I.flgRampDwnEna ThrVlv_PosnCtrlB1_I.flgReqPsOffBattChk ThrVlv_PosnCtrlB1_I.flgReqPsOffCtrlErr ThrVlv_PosnCtrlB1_I.flgReqPsOffExtdPostDrv ThrVlv_PosnCtrlB1_I.flgReqPsOffPwrSave ThrVlv_PosnCtrlB1_I.flgRstIPrtn ThrVlv_PosnCtrlB1_I.flgRstIPrtnFailSafe ThrVlv_PosnCtrlB1_I.flgRstIPrtnHealDesVal ThrVlv_PosnCtrlB1_I.flgSftyInhb ThrVlv_PosnCtrlB1_I.flgSlowTrj ThrVlv_PosnCtrlB1_I.flgSoftLdgActv ThrVlv_PosnCtrlB1_I.flgSoftLdgEna ThrVlv_PosnCtrlB1_I.flgSoftLdgRegn ThrVlv_PosnCtrlB1_I.flgSoftLmsLvngActv ThrVlv_PosnCtrlB1_I.flgSoftLmsLvngIniFil ThrVlv_PosnCtrlB1_I.flgSoftLmsLvngRegn ThrVlv_PosnCtrlB1_I.flgStrtEnd ThrVlv_PosnCtrlB1_I.flgStuckAtCls ThrVlv_PosnCtrlB1_I.flgStuckAtOpng ThrVlv_PosnCtrlB1_I.flgStuckPosnClsd ThrVlv_PosnCtrlB1_I.flgStuckPosnDetnActv ThrVlv_PosnCtrlB1_I.flgStuckPosnOpen ThrVlv_PosnCtrlB1_I.flgStuckStrd ThrVlv_PosnCtrlB1_I.flgSwtOffCtrlStatyCdn ThrVlv_PosnCtrlB1_I.flgTDpdtDutyCycOffsLrnLim ThrVlv_PosnCtrlB1_I.flgTInvldDebd ThrVlv_PosnCtrlB1_I.flgTSnsrAdpnDoneDcyc ThrVlv_PosnCtrlB1_I.flgTSnsrOffsAdpd ThrVlv_PosnCtrlB1_I.flgTVldDcyc ThrVlv_PosnCtrlB1_I.flgTiEngOffCdn ThrVlv_PosnCtrlB1_I.flgTiSuffToReaLimpAirPosn ThrVlv_PosnCtrlB1_I.flgTrigHealDfc ThrVlv_PosnCtrlB1_I.flgTrjAdpnDurgSatn ThrVlv_PosnCtrlB1_I.flgTrjAdpnInhb ThrVlv_PosnCtrlB1_I.flgVlvDrv ThrVlv_PosnCtrlB1_I.flgVvtEndPosn ThrVlv_PosnCtrlB1_I.flgXPostDrv ThrVlv_PosnCtrlB1_I.iElecMot ThrVlv_PosnCtrlB1_I.idxActrTyp ThrVlv_PosnCtrlB1_I.idxSnsrOffsAdpd ThrVlv_PosnCtrlB1_I.nrPntsSnsrOffsAdpd ThrVlv_PosnCtrlB1_I.nrRepHeal ThrVlv_PosnCtrlB1_I.nrRepHealDfc ThrVlv_PosnCtrlB1_I.nrRepRamp ThrVlv_PosnCtrlB1_I.nrStepDetDfc ThrVlv_PosnCtrlB1_I.nrStepFailSafeOlc ThrVlv_PosnCtrlB1_I.nrStepHeal ThrVlv_PosnCtrlB1_I.nrStepHealDfc ThrVlv_PosnCtrlB1_I.nrStepLmsClsng ThrVlv_PosnCtrlB1_I.nrStepOpngAftLongHldClsd ThrVlv_PosnCtrlB1_I.nrStepTSnsrAdpn ThrVlv_PosnCtrlB1_I.rElecMot ThrVlv_PosnCtrlB1_I.ratActPosnSdlg ThrVlv_PosnCtrlB1_I.ratActSldgModOld ThrVlv_PosnCtrlB1_I.ratActSldgModOldOld ThrVlv_PosnCtrlB1_I.ratActSldgModOldOldOld ThrVlv_PosnCtrlB1_I.ratActThd ThrVlv_PosnCtrlB1_I.ratActVCalcnOld ThrVlv_PosnCtrlB1_I.ratDeCtrlr ThrVlv_PosnCtrlB1_I.ratDeCtrlrEndVal ThrVlv_PosnCtrlB1_I.ratDeCtrlrEndValAbslt ThrVlv_PosnCtrlB1_I.ratDeCtrlrOld ThrVlv_PosnCtrlB1_I.ratDeCtrlrSdlg ThrVlv_PosnCtrlB1_I.ratDes ThrVlv_PosnCtrlB1_I.ratDesFil ThrVlv_PosnCtrlB1_I.ratDesFilLowrLim ThrVlv_PosnCtrlB1_I.ratDesFilUpprLim ThrVlv_PosnCtrlB1_I.ratDesHldClsdAndOpen ThrVlv_PosnCtrlB1_I.ratDesLim ThrVlv_PosnCtrlB1_I.ratDesOpngAftLongHldClsd ThrVlv_PosnCtrlB1_I.ratDesPreCtrl ThrVlv_PosnCtrlB1_I.ratDesPreCtrlDftl ThrVlv_PosnCtrlB1_I.ratDesPreCtrlDftl2 ThrVlv_PosnCtrlB1_I.ratDesPreCtrlDftl2Old ThrVlv_PosnCtrlB1_I.ratDesPreCtrlDftlOld ThrVlv_PosnCtrlB1_I.ratDesPreCtrlOld ThrVlv_PosnCtrlB1_I.ratDesPreCtrlRad ThrVlv_PosnCtrlB1_I.ratDesPreCtrlRadOld ThrVlv_PosnCtrlB1_I.ratDesRad ThrVlv_PosnCtrlB1_I.ratDesRampDwn ThrVlv_PosnCtrlB1_I.ratDesRampMem ThrVlv_PosnCtrlB1_I.ratDesSwt ThrVlv_PosnCtrlB1_I.ratDesSwtDeltaAbslt ThrVlv_PosnCtrlB1_I.ratDesSwtOld ThrVlv_PosnCtrlB1_I.ratDesSwtUnlimSpOld ThrVlv_PosnCtrlB1_I.ratDesValFromHeal ThrVlv_PosnCtrlB1_I.ratDutyCycCompProtMax ThrVlv_PosnCtrlB1_I.ratDutyCycCompProtMin ThrVlv_PosnCtrlB1_I.ratDutyCycCtrl ThrVlv_PosnCtrlB1_I.ratDutyCycFailSafeOlc ThrVlv_PosnCtrlB1_I.ratDutyCycGpfProtn ThrVlv_PosnCtrlB1_I.ratDutyCycHldClsd ThrVlv_PosnCtrlB1_I.ratDutyCycHldClsdCompProt ThrVlv_PosnCtrlB1_I.ratDutyCycHldClsdDynPeak ThrVlv_PosnCtrlB1_I.ratDutyCycHldClsdMap ThrVlv_PosnCtrlB1_I.ratDutyCycHldOpen ThrVlv_PosnCtrlB1_I.ratDutyCycLmsClsng ThrVlv_PosnCtrlB1_I.ratDutyCycMax ThrVlv_PosnCtrlB1_I.ratDutyCycMin ThrVlv_PosnCtrlB1_I.ratDutyCycOffsLrnLimNeg ThrVlv_PosnCtrlB1_I.ratDutyCycOpenLoopOpng ThrVlv_PosnCtrlB1_I.ratDutyCycOpenLoopOpngCntr ThrVlv_PosnCtrlB1_I.ratDutyCycOpenLoopOpngWoBattCmp ThrVlv_PosnCtrlB1_I.ratDutyCycPreCtrl ThrVlv_PosnCtrlB1_I.ratDutyCycRampDwnMin ThrVlv_PosnCtrlB1_I.ratFilDlyOld ThrVlv_PosnCtrlB1_I.ratHldClsdAbortThd ThrVlv_PosnCtrlB1_I.ratHldClsdPosn ThrVlv_PosnCtrlB1_I.ratLimpAirPosnBand ThrVlv_PosnCtrlB1_I.ratOffsClsdPosn ThrVlv_PosnCtrlB1_I.ratPPT1 ThrVlv_PosnCtrlB1_I.ratRampDwnStrt ThrVlv_PosnCtrlB1_I.ratSldgSfc ThrVlv_PosnCtrlB1_I.ratSldgSfcCubic ThrVlv_PosnCtrlB1_I.ratSldgSfcDer ThrVlv_PosnCtrlB1_I.ratSldgSfcOld ThrVlv_PosnCtrlB1_I.ratSldgSfcSqrt ThrVlv_PosnCtrlB1_I.ratSoftLdgDecel ThrVlv_PosnCtrlB1_I.ratSoftLdgStrt ThrVlv_PosnCtrlB1_I.ratStuck ThrVlv_PosnCtrlB1_I.ratStuckPosnOpenThd ThrVlv_PosnCtrlB1_I.stMonPosnCtrl ThrVlv_PosnCtrlB1_I.stMonTSnsrAdpn ThrVlv_PosnCtrlB1_I.tElecMotEstimd ThrVlv_PosnCtrlB1_I.tOffsElecMotSelfHeatg ThrVlv_PosnCtrlB1_I.tOffsSample ThrVlv_PosnCtrlB1_I.tSnsrCorrd ThrVlv_PosnCtrlB1_I.tSnsrCorrdFild ThrVlv_PosnCtrlB1_I.tSnsrOffsAdpd ThrVlv_PosnCtrlB1_I.tSnsrOffsAdpd_a ThrVlv_PosnCtrlB1_I.tiCtrlDe ThrVlv_PosnCtrlB1_I.tiCtrlDeCsers ThrVlv_PosnCtrlB1_I.tiCtrlDeMaxCsers ThrVlv_PosnCtrlB1_I.tiDebLowUBatt ThrVlv_PosnCtrlB1_I.tiDutyCycExcd ThrVlv_PosnCtrlB1_I.tiFilSwtSpdLimSoftLdg ThrVlv_PosnCtrlB1_I.tiHldClsdActv ThrVlv_PosnCtrlB1_I.tiHldClsdDynPeak ThrVlv_PosnCtrlB1_I.tiOpng ThrVlv_PosnCtrlB1_I.tiPreCtrlFildOld ThrVlv_PosnCtrlB1_I.tiPreCtrlSlow ThrVlv_PosnCtrlB1_I.tiPsRdy ThrVlv_PosnCtrlB1_I.tiReaDesPosn ThrVlv_PosnCtrlB1_I.tiReaDesPosnFailSafe ThrVlv_PosnCtrlB1_I.tiVvtEndPosn ThrVlv_PosnCtrlB1_I.tqFric ThrVlv_PosnCtrlB1_I.tqFricOld ThrVlv_PosnCtrlB1_I.uBalStrmInfl ThrVlv_PosnCtrlB1_I.uBattLimNeg ThrVlv_PosnCtrlB1_I.uBattLimPos ThrVlv_PosnCtrlB1_I.uCtrl ThrVlv_PosnCtrlB1_I.uCtrlDer ThrVlv_PosnCtrlB1_I.uCtrlDerFild ThrVlv_PosnCtrlB1_I.uCtrlIntgl ThrVlv_PosnCtrlB1_I.uCtrlIntglOld ThrVlv_PosnCtrlB1_I.uCtrlIntglRstAftLmsClsng ThrVlv_PosnCtrlB1_I.uCtrlProp ThrVlv_PosnCtrlB1_I.uCtrlSldgMod ThrVlv_PosnCtrlB1_I.uDesPreCtrl ThrVlv_PosnCtrlB1_I.uDifOpngSprg ThrVlv_PosnCtrlB1_I.uElecMotIndt ThrVlv_PosnCtrlB1_I.uElecMotIndtCmp ThrVlv_PosnCtrlB1_I.uElecMotIndtCmpFild ThrVlv_PosnCtrlB1_I.uElecMotTerminal ThrVlv_PosnCtrlB1_I.uFbCtrlUnlim ThrVlv_PosnCtrlB1_I.uFric ThrVlv_PosnCtrlB1_I.uLnrPreCtrl ThrVlv_PosnCtrlB1_I.uMinOpngSprg ThrVlv_PosnCtrlB1_I.uOffsTranLineOpngSprg ThrVlv_PosnCtrlB1_I.uOhmR ThrVlv_PosnCtrlB1_I.uOpngSprgComp ThrVlv_PosnCtrlB1_I.uSlopLowrLineOpngSprg ThrVlv_PosnCtrlB1_I.uSlopTranLineOpngSprg ThrVlv_PosnCtrlB1_I.uSprgCmp ThrVlv_PosnCtrlB1_I.wghtSignIntglSldgMod /end LOC_MEASUREMENT
 FUNCTION_VERSION "1.34.0" /end FUNCTION
/begin FUNCTION ThrVlv_PsIf "1.12.0    Interface to Powerstage"
 /begin DEF_CHARACTERISTIC ThrVlv_stPsIfCfgB1_C ThrVlv_stPwrStgEnaCdnMask_C ThrVlv_tiClrSc_C ThrVlv_tiSetOutPerdB1_C /end DEF_CHARACTERISTIC
 /begin IN_MEASUREMENT DevLib_stPwrStgEnaCond MoCSOP_stActvMsg SyC_stSub ThrVlv_flgActPosnVldB1 ThrVlv_flgOffsLrnPsOffB1 ThrVlv_flgPosnCtrlPsOffB1 ThrVlv_flgReqFuCutOffB1 ThrVlv_ratDutyCycB1 /end IN_MEASUREMENT
 /begin OUT_MEASUREMENT ThrVlv_flgActrOnB1 ThrVlv_flgOpenLoadDiagFinshdB1 ThrVlv_flgReqPsOffB1 ThrVlv_stMonPsIfB1 /end OUT_MEASUREMENT
 /begin LOC_MEASUREMENT ThrVlv_flgSwtOffDiagStrtB1 ThrVlv_ratDutyCycB1_mp ThrVlv_stHbrdgB1 ThrVlv_stPsErrB1_mp /end LOC_MEASUREMENT
 FUNCTION_VERSION "1.12.0" /end FUNCTION
/begin FUNCTION ThrVlv_Sens "1.19.0    Position Sensor Evaluation"
 /begin DEF_CHARACTERISTIC ThrVlv_IfLimpHomeSubB1_I.stMask_C ThrVlv_IfMainFillgCompB1_I.nMinForChrgComp_C ThrVlv_IfMainFillgCompB1_I.ratSens1ChrgMaxDe_C ThrVlv_IfMainFillgCompB1_I.ratSens2ChrgMaxDe_C ThrVlv_IfMainFillgCompB1_I.tiDebMaiChrgSensErr_C ThrVlv_IfMainFillgCompB1_I.tiDebSens1ChrgSyncErr_C ThrVlv_IfMainFillgCompB1_I.tiDebSens2ChrgSyncErr_C ThrVlv_IfMainFillgCompB1_I.tiDlySensSel_C ThrVlv_IfMainFillgCompB1_I.tiFildCompChrg_CUR ThrVlv_IfSens2B1_I.ratMaxSensDe_CUR ThrVlv_IfSens2B1_I.tiDebSens1Sens2SyncErr_C ThrVlv_IfSens2B1_I.tiDebSens2Err_C ThrVlv_IfSens2B1_I.uSens2Max_C ThrVlv_IfSens2B1_I.uSens2Min_C ThrVlv_IfSens2B1_I.uVltgOffs_C ThrVlv_IfSens2B1_I.uVltgSlop_C ThrVlv_IfSens2B1_I.uVltgThd_C ThrVlv_Sens_B1_I.ratActCharThdMax_C ThrVlv_Sens_B1_I.ratActCharThdMin_C ThrVlv_Sens_B1_I.ratLimpHomePosn_C ThrVlv_Sens_B1_I.swtNrmActrChar_C ThrVlv_Sens_B1_I.tiDebCycFlg_C ThrVlv_Sens_B1_I.tiDebSens1Err_C ThrVlv_Sens_B1_I.uSens1Max_C ThrVlv_Sens_B1_I.uSens1Min_C ThrVlv_stActrCfg_C /end DEF_CHARACTERISTIC
 /begin IN_MEASUREMENT AirMod_flgMaiChrgSensErr ChrCtl_flgUnthrAgMaiSens ChrCtl_rActPosMnChrgSensB1 Epm_nEng SyC_stSub T15_st ThrVlv_dRatPrVB1 ThrVlv_flgReqFuCutOffB1 ThrVlv_ratLimpAirPosnB1 ThrVlv_uElStopClsdSens1FrstB1 ThrVlv_uElStopClsdSens2FrstB1 /end IN_MEASUREMENT
 /begin OUT_MEASUREMENT ThrVlv_flgActPosnVldB1 ThrVlv_flgAvrgSens1Sens2SelB1 ThrVlv_flgDblSensErrB1 ThrVlv_flgDblSensErrSuspcB1 ThrVlv_flgSens1ErrB1 ThrVlv_flgSens1ErrSuspcB1 ThrVlv_flgSens1SelB1 ThrVlv_flgSens2ErrSuspcB1 ThrVlv_flgSens2SelB1 ThrVlv_flgSensCompActvdB1 ThrVlv_flgSngSensErrB1 ThrVlv_flgSngSensErrSuspcB1 ThrVlv_ratActIntB1 ThrVlv_ratActPosnB1 ThrVlv_ratActPosnMaxB1 ThrVlv_ratActPosnMinB1 ThrVlv_ratActSens1AbsltB1_u8 ThrVlv_ratActSens1RelB1_u8 ThrVlv_ratActSens2AbsltB1_u8 ThrVlv_stMonSensB1 ThrVlv_uRawSens1B1 ThrVlv_uRawSens2B1 ThrVlv_uSens1B1 ThrVlv_uSens2B1 /end OUT_MEASUREMENT
 /begin LOC_MEASUREMENT ThrVlv_cntrSens1SelB1 ThrVlv_cntrSens2SelB1 ThrVlv_flgChrgSens1SyncErrSuspcB1 ThrVlv_flgChrgSens2SyncErrSuspcB1 ThrVlv_flgLstUnthrSensSelB1 ThrVlv_flgSens1Sens2SyncErrSuspcB1 ThrVlv_flgSens1SigRngSuspcB1 ThrVlv_flgSens2CharPosnMaxExcddB1 ThrVlv_flgSens2CharPosnMinExcddB1 ThrVlv_flgSens2ErrB1 ThrVlv_flgSens2SigRngSuspcB1 ThrVlv_flgSensCompDmdDurgUnthrB1 ThrVlv_ratActAvrgB1 ThrVlv_ratActMnChrgSensFildB1 ThrVlv_ratActSens1B1 ThrVlv_ratActSens1FildB1 ThrVlv_ratActSens2B1 ThrVlv_ratActSens2FildB1 ThrVlv_Sens_B1_I.Snsr1DiagPrms ThrVlv_Sens_B1_I.cntComErr ThrVlv_Sens_B1_I.cntNoVldDataFast ThrVlv_Sens_B1_I.cntSnsrErrFast ThrVlv_Sens_B1_I.flgSens1CharPosnMaxExcdd ThrVlv_Sens_B1_I.flgSens1CharPosnMinExcdd ThrVlv_Sens_B1_I.flgSentComErrFast ThrVlv_Sens_B1_I.flgSentNoVldDataFast ThrVlv_Sens_B1_I.flgSnsrErrFast ThrVlv_Sens_B1_I.idxActrTyp ThrVlv_Sens_B1_I.ratActIntSnsr /end LOC_MEASUREMENT
 FUNCTION_VERSION "1.19.0" /end FUNCTION
/begin FUNCTION ThS_AdpLcy "6.0.0     Supply of Interfaces from the Thermal System" /begin IN_MEASUREMENT AirC_stSwt CoVeh_trqMaxAC Fan2_r Fan_r2 /end IN_MEASUREMENT /begin OUT_MEASUREMENT CoCTM_trqMaxAC TS_stMnSwtAC /end OUT_MEASUREMENT FUNCTION_VERSION "6.0.0" /end FUNCTION
/begin FUNCTION TiEngOn_EngRtMngt "1.0.0     Engine Runtime Management for AECD-Counters"
 /begin DEF_CHARACTERISTIC TiEngOn_cfgRtId.RtId_TotIdleRt_C TiEngOn_cfgRtId.RtId_TotPtoRt_C TiEngOn_cfgRtId.RtId_TotRtObd_C /end DEF_CHARACTERISTIC
 /begin IN_MEASUREMENT CB_flgFlsProgmEveSts CoEng_stMai PthSet_stOvrRunCoord /end IN_MEASUREMENT
 /begin OUT_MEASUREMENT TiEngOn_stRtId.RtId_TotIdleRt TiEngOn_stRtId.RtId_TotPtoRt TiEngOn_stRtId.RtId_TotRtObd TiEngOn_tiRtId.RtId_TotIdleRt TiEngOn_tiRtId.RtId_TotPtoRt TiEngOn_tiRtId.RtId_TotRtObd /end OUT_MEASUREMENT
 /begin LOC_MEASUREMENT TiEngOn_flgProgmEve /end LOC_MEASUREMENT
 FUNCTION_VERSION "1.0.0" /end FUNCTION
/begin FUNCTION TiEngOn_PrmId7F "1.0.0     Parameter Id 0x7F: Engine Runtimes" /begin DEF_CHARACTERISTIC TiEngOn_nIdleSpdPrmId7F_C TiEngOn_swtCfgPrmId7F_C /end DEF_CHARACTERISTIC /begin IN_MEASUREMENT APP_r Epm_nEng VehV_v VehV_vSens /end IN_MEASUREMENT
 /begin LOC_MEASUREMENT TiEngOn_flgEngRunTiPid7F TiEngOn_flgEngRunTiPtoPrmId7F TiEngOn_flgIdleEngRunTiPrmId7F /end LOC_MEASUREMENT
 FUNCTION_VERSION "1.0.0" /end FUNCTION
/begin FUNCTION TiEngOn_TotEngRt "1.0.1     Total Engine Runtime" /begin IN_MEASUREMENT CoEng_stMai T15_st /end IN_MEASUREMENT /begin OUT_MEASUREMENT TiEngOn_tiTotEngRt TiEngOn_tiTotIgnOn /end OUT_MEASUREMENT
 /begin LOC_MEASUREMENT TiEngOn_AvsCntr TiEngOn_AvsCntrLst TiEngOn_tiTotEngRtAux TiEngOn_tiTotEngRtAvs TiEngOn_tiTotEngRtNV TiEngOn_tiTotIgnOnAux TiEngOn_tiTotIgnOnNv /end LOC_MEASUREMENT
 FUNCTION_VERSION "1.0.1" /end FUNCTION
/begin FUNCTION TiOff_VdClk "5.7.0     Clockinformation for OffTimes-calculation"
 /begin DEF_CHARACTERISTIC TiOff_stClkIntCfg_CW TiOff_stTestClk_CW TiOff_tiBTiHwClkRst_C TiOff_tiClkStopTst_C TiOff_tiClkTst_C TiOff_tiEcuOffIntMax_C TiOff_tiEcuOffTst_C TiOff_tiHwClkAddWakeup_C TiOff_tiHwClkMax_C /end DEF_CHARACTERISTIC
 /begin IN_MEASUREMENT Eep_EnvRamHist Eep_EnvRamInvld /end IN_MEASUREMENT
 /begin OUT_MEASUREMENT TiOff_bIniGap TiOff_bTiHwClk TiOff_bTiHwClkRst TiOff_tiHwClk TiOff_tiHwClkLstGap TiOff_tiHwClkStop /end OUT_MEASUREMENT
 /begin LOC_MEASUREMENT TiOff_bIniGapLoc TiOff_bTiHwClkRstDiagDisbl TiOff_bTiHwClkRstLoc TiOff_stVdClkEcuOnIndcn TiOff_tiHwClkLoc TiOff_tiHwClkStopLoc TiOff_tiHwClkWakeupLoc TiOff_tiSwClkAux /end LOC_MEASUREMENT
 FUNCTION_VERSION "5.7.0" /end FUNCTION
/begin FUNCTION TiOff_VdDiag "2.1.1     Diagnosis of the Off-time"
 /begin DEF_CHARACTERISTIC TiOff_ratCoolDwnTBasdChkFastMax_C TiOff_ratCoolDwnTBasdChkFastMin_C TiOff_ratCoolDwnTBasdChkSlowMax_C TiOff_ratCoolDwnTBasdChkSlowMin_C TiOff_stCfgTBasdChk_C TiOff_tCEngDsTT15StopTBasdChkFastMin_C TiOff_tCEngDsTT15StopTBasdChkSlowMin_C TiOff_tDiffCEngDsTPsblTBasdChkFastMin_C TiOff_tDiffCEngDsTPsblTBasdChkSlowMin_C TiOff_tDiffCEngDsTTBasdChkFastMax_C TiOff_tDiffCEngDsTTBasdChkSlowMin_C TiOff_tiT15OffEcuOnTBasdChkFastMax_T TiOff_tiT15OffEcuOnTBasdChkSlowMax_T TiOff_tiT15OffTBasdChkFastRef_T TiOff_tiT15OffTBasdChkSlowRef_T TiOff_tiTBasdChkDly_C TiOff_tiTBasdChkLst_C /end DEF_CHARACTERISTIC
 /begin IN_MEASUREMENT CEngDsT_flgSnsrElecVld CEngDsT_tSnsrFild Eep_EnvRamHist Eep_EnvRamInvld EnvT_stTSens EnvT_tSens T15_st /end IN_MEASUREMENT
 /begin LOC_MEASUREMENT TiOff_cntrDsmClearTBasdChk TiOff_cntrDsmClearTBasdChkLst TiOff_flgEcuNotOffTBasdChkProt TiOff_flgTBasdChkFastPhyEna TiOff_flgTBasdChkSlowPhyEna TiOff_ratCoolDwnTBasdChk TiOff_stTBasdChk TiOff_tCEngDsTT15StopTBasdChk TiOff_tCEngDsTT15StrtTBasdChk TiOff_tDiffCEngDsTPsblTBasdChk TiOff_tDiffCEngDsTTBasdChk TiOff_tEnvTSensT15StrtTBasdChk TiOff_tiCumEcuOffTBasdChk TiOff_tiT15OffEcuOnTBasdChk TiOff_tiT15OffMinsTBasdChk TiOff_tiT15OffSecTrigTBasdChk TiOff_tiT15OffTBasdChkFastRef TiOff_tiT15OffTBasdChkSlowRef TiOff_tiTBasdChkTrig /end LOC_MEASUREMENT
 FUNCTION_VERSION "2.1.1" /end FUNCTION
/begin FUNCTION TiOff_VdTiEngOff "2.3.0_1.1.0Off-Time based on Engine Rotation"
 /begin DEF_CHARACTERISTIC TiEngOffBasc_CW TiEngOff_tiBEngTmrRstDeb_C TiEngOff_tiEngRotDeb_C TiOff_stTiEngOffDef_C TiOff_stTiEngOffHwOvf_C TiOff_stTiEngOff_CW TiOff_tiEngOffDef_C /end DEF_CHARACTERISTIC
 /begin IN_MEASUREMENT Eep_EnvRamHist Eep_EnvRamInvld EngStrt_stRstrtRsn Epm_stSpd SyC_ctPostDrvLeave TiOff_bTiHwClk TiOff_bTiHwClkRst TiOff_tiHwClk TiOff_tiHwClkLstGap TiOff_tiHwClkStop /end IN_MEASUREMENT
 /begin OUT_MEASUREMENT TiEngOff_bEngRot TiEngOff_bRst TiEngOff_bTiEngOffEcuActv TiEngOff_stTi TiEngOff_stTiFirstStrt TiEngOff_ti TiEngOff_tiFirstStrt TiOff_cntrEngOffRst /end OUT_MEASUREMENT
 /begin LOC_MEASUREMENT TiEngOff_stTiFirstStrtLoc TiEngOff_tiFirstStrtLoc TiOff_bEngOffFirstStrtFinLoc TiOff_bEngOffSwLoc TiOff_bEngRotLoc TiOff_bEngRstDeb TiOff_bEngRstLoc TiOff_bTiEngOffEcuActvLoc TiOff_bTiEngOffRstReIni TiOff_bTiEngOffRstRstrt TiOff_bXPostDrvTiEngOff TiOff_cntrEngOffRstLoc TiOff_cntrEngOffRstOld TiOff_ctEngOffReIni TiOff_stTiEngOffHw TiOff_stTiEngOffHwEnd TiOff_stTiEngOffHwStart TiOff_stTiEngOffLoc TiOff_stVdTiEngOffEcuOnIndcn TiOff_tiEngOffHw TiOff_tiEngOffHwEnd TiOff_tiEngOffHwStart TiOff_tiEngOffLoc TiOff_tiEngOffSwAux TiOff_tiEngOffSwLoc /end LOC_MEASUREMENT
 FUNCTION_VERSION "2.3.0_1.1.0" /end FUNCTION
/begin FUNCTION TiOff_VdTiStrtEndOff "3.2.0_1.1.0Off time of start-end recognition"
 /begin DEF_CHARACTERISTIC TiOff_bStrtEndOffRstDeb_C TiOff_stTiStrtEndOffDef_C TiOff_stTiStrtEndOffHwOvf_C TiOff_stTiStrtEndOff_CW TiOff_tiStrtEndOffDef_C /end DEF_CHARACTERISTIC
 /begin IN_MEASUREMENT Eep_EnvRamHist Eep_EnvRamInvld EngStrt_bStrtEnd SyC_ctPostDrvLeave SyC_stSub TiOff_bTiHwClk TiOff_bTiHwClkRst TiOff_tiHwClk TiOff_tiHwClkLstGap TiOff_tiHwClkStop /end IN_MEASUREMENT
 /begin OUT_MEASUREMENT TiOff_bStrtEndOffActive TiOff_bStrtEndOffRst TiOff_cntrStrtEndOffRst TiOff_stTiStrtEndOff TiOff_stTiStrtEndOffFirstStrt TiOff_tiStrtEndOff TiOff_tiStrtEndOffFirstStrt /end OUT_MEASUREMENT
 /begin LOC_MEASUREMENT TiOff_bStrtEndOffActiveFall TiOff_bStrtEndOffActiveLoc TiOff_bStrtEndOffFirstStrtFinLoc TiOff_bStrtEndOffRstDeb TiOff_bStrtEndOffRstLoc TiOff_bStrtEndOffRstReIni TiOff_bStrtEndOffRstRstrt TiOff_bStrtEndOffSwLoc TiOff_bTiStrtEndActOld TiOff_bXPostDrvTiStrtEndOff TiOff_cntrStrtEndOffRstLoc TiOff_cntrStrtEndOffRstOld TiOff_ctStrtEndOffReIni TiOff_stTiStrtEndActn TiOff_stTiStrtEndOffFirstStrtLoc TiOff_stTiStrtEndOffHw TiOff_stTiStrtEndOffHwEnd TiOff_stTiStrtEndOffHwStart TiOff_stTiStrtEndOffLoc TiOff_stTiStrtEndOffMdlEnd TiOff_stTiStrtEndOffMdlStart TiOff_stVdTiStrtEndOffEcuOnIndcn TiOff_tiStrtEndOffFirstStrtLoc TiOff_tiStrtEndOffHw TiOff_tiStrtEndOffHwEnd TiOff_tiStrtEndOffHwStart TiOff_tiStrtEndOffLoc TiOff_tiStrtEndOffMdlEnd TiOff_tiStrtEndOffSwAux TiOff_tiStrtEndOffSwLoc /end LOC_MEASUREMENT
 FUNCTION_VERSION "3.2.0_1.1.0" /end FUNCTION
/begin FUNCTION TME_AdpLcyIa "1.0.0     SW Adapter Torque Model Engine: Mapping Legacy to Valid Interface Elements and Vice Versa - Ignition angle"
 /begin IN_MEASUREMENT dzwo2ka_w_msg dzwohsp_w_msg dzwolb_w_msg dzwol_w_msg dzworriref_w_msg dzworri_w_msg dzwotm_w_msg zwopt_w_msg zwsol_w_msg /end IN_MEASUREMENT
 /begin OUT_MEASUREMENT dzwo2ka_msg dzwohsp_msg dzwolb_msg dzwol_msg dzworriref_msg dzworri_msg dzwotm_msg zwopt_msg zwsol_msg /end OUT_MEASUREMENT
 FUNCTION_VERSION "1.0.0" /end FUNCTION
/begin COMPU_METHOD B_TRUE "" TAB_VERB "%6.3" "" COMPU_TAB_REF B_TRUE /end COMPU_METHOD
/begin COMPU_VTAB B_TRUE "" TAB_VERB 2 0 "FALSE" 1 "TRUE" /end COMPU_VTAB
/begin COMPU_METHOD EngN "" RAT_FUNC "%6.3" "rpm" COEFFS 0 2 0 0 0 1 /end COMPU_METHOD
/begin COMPU_METHOD Fact1000 "" RAT_FUNC "%6.5" "-" COEFFS 0 1000 0 0 0 1 /end COMPU_METHOD
/begin COMPU_METHOD fak_q0p000488 "" RAT_FUNC "%6.5" "-" COEFFS 0 65536 0 0 0 32 /end COMPU_METHOD
/begin COMPU_METHOD fak_q0p0009766 "" RAT_FUNC "%6.5" "-" COEFFS 0 65536 0 0 0 64 /end COMPU_METHOD
/begin COMPU_METHOD fak_q0p00195 "" RAT_FUNC "%6.4" "-" COEFFS 0 65536 0 0 0 128 /end COMPU_METHOD
/begin COMPU_METHOD fak_q0p01 "" RAT_FUNC "%6.4" "" COEFFS 0 100 0 0 0 1 /end COMPU_METHOD
/begin COMPU_METHOD fak_q1p526Em5 "" RAT_FUNC "%7.6" "-" COEFFS 0 65536 0 0 0 1 /end COMPU_METHOD
/begin COMPU_METHOD fak_q3p0518Em5 "" RAT_FUNC "%7.6" "" COEFFS 0 32768 0 0 0 1 /end COMPU_METHOD
/begin COMPU_METHOD fak_q6p1035Em5 "" RAT_FUNC "%7.6" "-" COEFFS 0 65536 0 0 0 4 /end COMPU_METHOD
/begin COMPU_METHOD fak_sw_b0p03125 "" RAT_FUNC "%9.8" "-" COEFFS 0 65536 0 0 0 0.0625 /end COMPU_METHOD
/begin COMPU_METHOD i_q0p001_A "" RAT_FUNC "%6.5" "A" COEFFS 0 1 0 0 0 0.001 /end COMPU_METHOD
/begin COMPU_METHOD kw_q0p75 "" RAT_FUNC "%6.3" "Grad KW" COEFFS 0 4 0 0 0 3 /end COMPU_METHOD
/begin COMPU_METHOD leist_q0p015625 "" RAT_FUNC "%6.4" "W" COEFFS 0 64 0 0 0 1 /end COMPU_METHOD
/begin COMPU_METHOD OneToOne "" RAT_FUNC "%6.2" "-" COEFFS 0 1 0 0 0 1 /end COMPU_METHOD
/begin COMPU_METHOD Per_Dur "" RAT_FUNC "%6.2" "usec" COEFFS 0 1 0 0 0 1 /end COMPU_METHOD
/begin COMPU_METHOD q0p0001_Perc "" RAT_FUNC "%7.6" "%" COEFFS 0 10000 0 0 0 1 /end COMPU_METHOD
/begin COMPU_METHOD q0p01562_rad_DIV_s "" RAT_FUNC "%6.4" "rad/s" COEFFS 0 1000000 0 0 0 15625 /end COMPU_METHOD
/begin COMPU_METHOD q0p1_Perc_DIV_s "" RAT_FUNC "%6.3" "%/s" COEFFS 0 10 0 0 0 1 /end COMPU_METHOD
/begin COMPU_METHOD q1Em4_s "" RAT_FUNC "%7.6" "s" COEFFS 0 10000 0 0 0 1 /end COMPU_METHOD
/begin COMPU_METHOD q2p98023Em7_V "" RAT_FUNC "%9.8" "V" COEFFS 0 33554432 0 0 0 10 /end COMPU_METHOD
/begin COMPU_METHOD RBPtCel_du_0p05_1 "" RAT_FUNC "%6.4" "V/s" COEFFS 0 100 0 0 0 5 /end COMPU_METHOD
/begin COMPU_METHOD RBPtCel_fac_0p00001_1 "" RAT_FUNC "%8.7" "-" COEFFS 0 100000 0 0 0 1 /end COMPU_METHOD
/begin COMPU_METHOD RBPtCel_fac_1p0em4_1 "" RAT_FUNC "%7.6" "-" COEFFS 0 10000 0 0 0 1 /end COMPU_METHOD
/begin COMPU_METHOD RBPtCel_ti_5p12em4_1 "" RAT_FUNC "%6.5" "s" COEFFS 0 15625 0 0 0 8 /end COMPU_METHOD
/begin COMPU_METHOD relDK_q0p3922 "" RAT_FUNC "%6.3" "%DK" COEFFS 0 255 0 0 0 100 /end COMPU_METHOD
/begin COMPU_METHOD relgrd_q7p8125 "" RAT_FUNC "%6.2" "%/s" COEFFS 0 128 0 0 0 1000 /end COMPU_METHOD
/begin COMPU_METHOD rel_q0p003052 "" RAT_FUNC "%6.4" "%" COEFFS 0 65536 0 0 0 200 /end COMPU_METHOD
/begin COMPU_METHOD rel_q0p0078125 "" RAT_FUNC "%6.4" "%" COEFFS 0 128 0 0 0 1 /end COMPU_METHOD
/begin COMPU_METHOD r_q0p001_Ohm "" RAT_FUNC "%6.5" "Ohm" COEFFS 0 1000 0 0 0 1 /end COMPU_METHOD
/begin COMPU_METHOD spg_q0p000122 "" RAT_FUNC "%6.5" "V" COEFFS 0 65536 0 0 0 8 /end COMPU_METHOD
/begin COMPU_METHOD spg_q0p00039 "" RAT_FUNC "%6.5" "V" COEFFS 0 1 0 0 0 0.000390625 /end COMPU_METHOD
/begin COMPU_METHOD spg_q0p001 "" RAT_FUNC "%6.5" "V" COEFFS 0 1000 0 0 0 1 /end COMPU_METHOD
/begin COMPU_METHOD spg_q1p221Em3_V "" RAT_FUNC "%6.4" "V" COEFFS 0 65536 0 0 0 80 /end COMPU_METHOD
/begin COMPU_METHOD spg_q1p221_mV "" RAT_FUNC "%6.4" "V" COEFFS 0 65536 0 0 0 80 /end COMPU_METHOD
/begin COMPU_METHOD t10msxs_ub_b2p55 "" RAT_FUNC "%6.4" "s" COEFFS 0 1 0 0 0 0.01 /end COMPU_METHOD
/begin COMPU_METHOD TempDiff_Kelv "" RAT_FUNC "%6.3" "K" COEFFS 0 10 0 0 0 1 /end COMPU_METHOD
/begin COMPU_METHOD Temp_Cels "" RAT_FUNC "%6.1" "deg C" COEFFS 0 10 2731.4 0 0 1 /end COMPU_METHOD
/begin COMPU_METHOD Time_Dt "" RAT_FUNC "%9.8" "s" COEFFS 0 1000000 0 0 0 1 /end COMPU_METHOD
/begin COMPU_METHOD Time_min_q1_COMPU "" RAT_FUNC "%6.2" "min" COEFFS 0 1 0 0 0 1 /end COMPU_METHOD
/begin COMPU_METHOD Time_s "" RAT_FUNC "%6.4" "s" COEFFS 0 100 0 0 0 1 /end COMPU_METHOD
/begin COMPU_METHOD Time_sec_q1_COMPU "" RAT_FUNC "%6.2" "s" COEFFS 0 1 0 0 0 1 /end COMPU_METHOD
/begin COMPU_METHOD TMOSNMVO_SC_Compu "" RAT_FUNC "%6.2" "" COEFFS 0 1 0 0 0 1 /end COMPU_METHOD
/begin COMPU_METHOD TMOSNMZO_SC_Compu "" RAT_FUNC "%6.2" "" COEFFS 0 1 0 0 0 1 /end COMPU_METHOD
/begin COMPU_METHOD TMOSRLVO_SC_Compu "" RAT_FUNC "%6.2" "" COEFFS 0 1 0 0 0 1 /end COMPU_METHOD
/begin COMPU_METHOD TMOSRLZO_SC_Compu "" RAT_FUNC "%6.2" "" COEFFS 0 1 0 0 0 1 /end COMPU_METHOD
/begin COMPU_METHOD TOTENGREV_SC_Compu "" TAB_VERB "%6.3" "" COMPU_TAB_REF TOTENGREV_SC_Compu /end COMPU_METHOD
/begin COMPU_VTAB TOTENGREV_SC_Compu "" TAB_VERB 2 0 "False" 1 "True" /end COMPU_VTAB
/begin COMPU_METHOD TOXDCAT_TYPAVL_SC_Compu "" TAB_VERB "%6.3" "" COMPU_TAB_REF TOXDCAT_TYPAVL_SC_Compu /end COMPU_METHOD
/begin COMPU_VTAB TOXDCAT_TYPAVL_SC_Compu "" TAB_VERB 2 0 "False" 1 "True" /end COMPU_VTAB
/begin COMPU_METHOD TOXICATDS_TYPAVL_SY_Compu "" TAB_VERB "%6.3" "" COMPU_TAB_REF TOXICATDS_TYPAVL_SY_Compu /end COMPU_METHOD
/begin COMPU_VTAB TOXICATDS_TYPAVL_SY_Compu "" TAB_VERB 2 0 "False" 1 "True" /end COMPU_VTAB
/begin COMPU_METHOD TOXICATUS_TYPAVL_SY_Compu "" TAB_VERB "%6.3" "" COMPU_TAB_REF TOXICATUS_TYPAVL_SY_Compu /end COMPU_METHOD
/begin COMPU_VTAB TOXICATUS_TYPAVL_SY_Compu "" TAB_VERB 2 0 "False" 1 "True" /end COMPU_VTAB
/begin COMPU_METHOD TPFLTDS_TYPAVL_SY_Compu "" TAB_VERB "%6.3" "" COMPU_TAB_REF TPFLTDS_TYPAVL_SY_Compu /end COMPU_METHOD
/begin COMPU_VTAB TPFLTDS_TYPAVL_SY_Compu "" TAB_VERB 2 0 "False" 1 "True" /end COMPU_VTAB
/begin COMPU_METHOD TPFLTUS_TYPAVL_SY_Compu "" TAB_VERB "%6.3" "" COMPU_TAB_REF TPFLTUS_TYPAVL_SY_Compu /end COMPU_METHOD
/begin COMPU_VTAB TPFLTUS_TYPAVL_SY_Compu "" TAB_VERB 2 0 "False" 1 "True" /end COMPU_VTAB
/begin COMPU_METHOD TPS65917_SC_Compu "" TAB_VERB "%6.3" "" COMPU_TAB_REF TPS65917_SC_Compu /end COMPU_METHOD
/begin COMPU_VTAB TPS65917_SC_Compu "" TAB_VERB 2 0 "no_device" 1 "one_device" /end COMPU_VTAB
/begin COMPU_METHOD TQCOORDCEN_SC_Compu "" TAB_VERB "%6.3" "" COMPU_TAB_REF TQCOORDCEN_SC_Compu /end COMPU_METHOD
/begin COMPU_VTAB TQCOORDCEN_SC_Compu "" TAB_VERB 2 0 "False" 1 "True" /end COMPU_VTAB
/begin COMPU_METHOD TQCOORD_INHOUSE_SC_Compu "" TAB_VERB "%6.3" "" COMPU_TAB_REF TQCOORD_INHOUSE_SC_Compu /end COMPU_METHOD
/begin COMPU_VTAB TQCOORD_INHOUSE_SC_Compu "" TAB_VERB 2 0 "False" 1 "True" /end COMPU_VTAB
/begin COMPU_METHOD TQFRICADPN_ATS_SC_Compu "" TAB_VERB "%6.3" "" COMPU_TAB_REF TQFRICADPN_ATS_SC_Compu /end COMPU_METHOD
/begin COMPU_VTAB TQFRICADPN_ATS_SC_Compu "" TAB_VERB 2 0 "False" 1 "True" /end COMPU_VTAB
/begin COMPU_METHOD TQLIMNHIBOOSTP_SC_Compu "" TAB_VERB "%6.3" "" COMPU_TAB_REF TQLIMNHIBOOSTP_SC_Compu /end COMPU_METHOD
/begin COMPU_VTAB TQLIMNHIBOOSTP_SC_Compu "" TAB_VERB 2 0 "False" 1 "True" /end COMPU_VTAB
/begin COMPU_METHOD TQLIMNLOCKDTCACTR_SC_Compu "" TAB_VERB "%6.3" "" COMPU_TAB_REF TQLIMNLOCKDTCACTR_SC_Compu /end COMPU_METHOD
/begin COMPU_VTAB TQLIMNLOCKDTCACTR_SC_Compu "" TAB_VERB 2 0 "False" 1 "True" /end COMPU_VTAB
/begin COMPU_METHOD TQRESVLIMNREDNFASTINTV_SC_Compu "" TAB_VERB "%6.3" "" COMPU_TAB_REF TQRESVLIMNREDNFASTINTV_SC_Compu /end COMPU_METHOD
/begin COMPU_VTAB TQRESVLIMNREDNFASTINTV_SC_Compu "" TAB_VERB 2 0 "False" 1 "True" /end COMPU_VTAB
/begin COMPU_METHOD TQSTRUCT2W_SC_Compu "" TAB_VERB "%6.3" "" COMPU_TAB_REF TQSTRUCT2W_SC_Compu /end COMPU_METHOD
/begin COMPU_VTAB TQSTRUCT2W_SC_Compu "" TAB_VERB 2 0 "False" 1 "True" /end COMPU_VTAB
/begin COMPU_METHOD TQSTRUCTTYP_SC_Compu "" TAB_VERB "%6.3" "" COMPU_TAB_REF TQSTRUCTTYP_SC_Compu /end COMPU_METHOD
/begin COMPU_VTAB TQSTRUCTTYP_SC_Compu "" TAB_VERB 4 0 "0" 1 "1" 2 "2" 3 "3" /end COMPU_VTAB
/begin COMPU_METHOD TRANCMPVLVLFT_SC_Compu "" TAB_VERB "%6.3" "" COMPU_TAB_REF TRANCMPVLVLFT_SC_Compu /end COMPU_METHOD
/begin COMPU_VTAB TRANCMPVLVLFT_SC_Compu "" TAB_VERB 2 0 "False" 1 "True" /end COMPU_VTAB
/begin COMPU_METHOD TRANOIPRV_SY_Compu "" TAB_VERB "%6.3" "" COMPU_TAB_REF TRANOIPRV_SY_Compu /end COMPU_METHOD
/begin COMPU_VTAB TRANOIPRV_SY_Compu "" TAB_VERB 2 0 "no anti-rattling available" 1 "anti-rattling available" /end COMPU_VTAB
/begin COMPU_METHOD TRANSPTMODE_SY_Compu "" TAB_VERB "%6.3" "" COMPU_TAB_REF TRANSPTMODE_SY_Compu /end COMPU_METHOD
/begin COMPU_VTAB TRANSPTMODE_SY_Compu "" TAB_VERB 2 0 "False" 1 "True" /end COMPU_VTAB
/begin COMPU_METHOD TRA_AST_SY_Compu "" TAB_VERB "%6.3" "" COMPU_TAB_REF TRA_AST_SY_Compu /end COMPU_METHOD
/begin COMPU_VTAB TRA_AST_SY_Compu "" TAB_VERB 3 0 "NOT_AVL" 1 "CFG" 2 "AVL" /end COMPU_VTAB
/begin COMPU_METHOD TRA_AT_SY_Compu "" TAB_VERB "%6.3" "" COMPU_TAB_REF TRA_AT_SY_Compu /end COMPU_METHOD
/begin COMPU_VTAB TRA_AT_SY_Compu "" TAB_VERB 3 0 "NOT_AVL" 1 "CFG" 2 "AVL" /end COMPU_VTAB
/begin COMPU_METHOD TRA_AUTRKPROTNACTV_SC_Compu "" TAB_VERB "%6.3" "" COMPU_TAB_REF TRA_AUTRKPROTNACTV_SC_Compu /end COMPU_METHOD
/begin COMPU_VTAB TRA_AUTRKPROTNACTV_SC_Compu "" TAB_VERB 2 0 "False" 1 "True" /end COMPU_VTAB
/begin COMPU_METHOD TRA_CVT_SY_Compu "" TAB_VERB "%6.3" "" COMPU_TAB_REF TRA_CVT_SY_Compu /end COMPU_METHOD
/begin COMPU_VTAB TRA_CVT_SY_Compu "" TAB_VERB 3 0 "NOT_AVL" 1 "CFG" 2 "AVL" /end COMPU_VTAB
/begin COMPU_METHOD TRA_DCT_SY_Compu "" TAB_VERB "%6.3" "" COMPU_TAB_REF TRA_DCT_SY_Compu /end COMPU_METHOD
/begin COMPU_VTAB TRA_DCT_SY_Compu "" TAB_VERB 3 0 "NOT_AVL" 1 "CFG" 2 "AVL" /end COMPU_VTAB
/begin COMPU_METHOD TRA_INTERLOCK_SY_Compu "" TAB_VERB "%6.3" "" COMPU_TAB_REF TRA_INTERLOCK_SY_Compu /end COMPU_METHOD
/begin COMPU_VTAB TRA_INTERLOCK_SY_Compu "" TAB_VERB 2 0 "FALSE" 1 "TRUE" /end COMPU_VTAB
/begin COMPU_METHOD TRA_MT_SY_Compu "" TAB_VERB "%6.3" "" COMPU_TAB_REF TRA_MT_SY_Compu /end COMPU_METHOD
/begin COMPU_VTAB TRA_MT_SY_Compu "" TAB_VERB 3 0 "NOT_AVL" 1 "CFG" 2 "AVL" /end COMPU_VTAB
/begin COMPU_METHOD TRA_PDK_SY_Compu "" TAB_VERB "%6.3" "" COMPU_TAB_REF TRA_PDK_SY_Compu /end COMPU_METHOD
/begin COMPU_VTAB TRA_PDK_SY_Compu "" TAB_VERB 2 0 "False" 1 "True" /end COMPU_VTAB
/begin COMPU_METHOD TRBCHAIRACTR_SC_Compu "" TAB_VERB "%6.3" "" COMPU_TAB_REF TRBCHAIRACTR_SC_Compu /end COMPU_METHOD
/begin COMPU_VTAB TRBCHAIRACTR_SC_Compu "" TAB_VERB 2 0 "False" 1 "True" /end COMPU_VTAB
/begin COMPU_METHOD Trq "" RAT_FUNC "%6.3" "Nm" COEFFS 0 10 0 0 0 1 /end COMPU_METHOD
/begin COMPU_METHOD t_q0p001 "" RAT_FUNC "%6.5" "s" COEFFS 0 1000 0 0 0 1 /end COMPU_METHOD
/begin COMPU_METHOD t_q0p01 "" RAT_FUNC "%6.4" "s" COEFFS 0 100 0 0 0 1 /end COMPU_METHOD
/begin COMPU_METHOD t_q0p05 "" RAT_FUNC "%6.4" "s" COEFFS 0 100 0 0 0 5 /end COMPU_METHOD
/begin COMPU_METHOD t_q1 "" RAT_FUNC "%6.2" "s" COEFFS 0 1 0 0 0 1 /end COMPU_METHOD
/begin COMPU_METHOD t_q3p815Em6 "" RAT_FUNC "%8.7" "s" COEFFS 0 262144 0 0 0 1 /end COMPU_METHOD
/begin COMPU_METHOD t_tev0p0005 "" RAT_FUNC "%6.5" "s" COEFFS 0 2048 0 0 0 1 /end COMPU_METHOD
/begin RECORD_LAYOUT Cur_Xs16Ws16 NO_AXIS_PTS_X 1 SWORD AXIS_PTS_X 2 SWORD INDEX_INCR DIRECT FNC_VALUES 3 SWORD COLUMN_DIR DIRECT /end RECORD_LAYOUT
/begin RECORD_LAYOUT Map_Xs16Ys16Ws16 NO_AXIS_PTS_X 1 SWORD NO_AXIS_PTS_Y 2 SWORD AXIS_PTS_X 3 SWORD INDEX_INCR DIRECT AXIS_PTS_Y 4 SWORD INDEX_INCR DIRECT FNC_VALUES 5 SWORD COLUMN_DIR DIRECT /end RECORD_LAYOUT
/begin RECORD_LAYOUT RB_Curve_U16_U16 NO_AXIS_PTS_X 1 UWORD AXIS_PTS_X 2 UWORD INDEX_INCR DIRECT FNC_VALUES 3 UWORD COLUMN_DIR DIRECT /end RECORD_LAYOUT
/begin RECORD_LAYOUT RB_Val_Ws16 FNC_VALUES 1 SWORD COLUMN_DIR DIRECT /end RECORD_LAYOUT
/begin RECORD_LAYOUT RB_Val_Ws32 FNC_VALUES 1 SLONG COLUMN_DIR DIRECT /end RECORD_LAYOUT
/begin RECORD_LAYOUT RB_Val_Wu16 FNC_VALUES 1 UWORD COLUMN_DIR DIRECT /end RECORD_LAYOUT
/begin RECORD_LAYOUT RB_Val_Wu8 FNC_VALUES 1 UBYTE COLUMN_DIR DIRECT /end RECORD_LAYOUT
/begin RECORD_LAYOUT Val_Ws16 FNC_VALUES 1 SWORD COLUMN_DIR DIRECT /end RECORD_LAYOUT
/begin RECORD_LAYOUT Val_Ws32 FNC_VALUES 1 SLONG COLUMN_DIR DIRECT /end RECORD_LAYOUT
/begin RECORD_LAYOUT Val_Wu16 FNC_VALUES 1 UWORD COLUMN_DIR DIRECT /end RECORD_LAYOUT
/begin RECORD_LAYOUT Val_Wu32 FNC_VALUES 1 ULONG COLUMN_DIR DIRECT /end RECORD_LAYOUT
/begin RECORD_LAYOUT Val_Wu8 FNC_VALUES 1 UBYTE COLUMN_DIR DIRECT /end RECORD_LAYOUT
/end MODULE
/end PROJECT
