ASAP2_VERSION 1 60
/begin PROJECT MG1CS022 "MG1CS022"
/begin HEADER "" VERSION "MG1CS022_62XSC_V037_TPROT" PROJECT_NO MG1CS022 /end HEADER
/begin MODULE DIM ""
/begin MOD_COMMON "" BYTE_ORDER MSB_LAST ALIGNMENT_BYTE 1 ALIGNMENT_WORD 2 ALIGNMENT_LONG 4 ALIGNMENT_INT64 4 ALIGNMENT_FLOAT32_IEEE 4 ALIGNMENT_FLOAT64_IEEE 4 DATA_SIZE 32 /end MOD_COMMON
/begin CHARACTERISTIC CstrPurg_ChartcDlyTiCpv_M "Characteristic map for the canister purge valve (CPV) delay time (pressure ratio based)" MAP 0x80544BE0 RB_Map_U8U16_U16 655.3500 t_q0p01_ms 0.00 655.3500 FORMAT "%8.4"
 /begin AXIS_DESCR STD_AXIS BattU_u_ubrsq spg_q0p1 6 0.00 25.50 FORMAT "%5.2" DEPOSIT ABSOLUTE /end AXIS_DESCR
 /begin AXIS_DESCR STD_AXIS pndkpu_w_msg fak_uw_b8 5 0.00 7.999878 FORMAT "%8.6" DEPOSIT ABSOLUTE /end AXIS_DESCR
/end CHARACTERISTIC
/begin CHARACTERISTIC CstrPurg_facCpvDlyTiCorrn_Cur "Factor basic correction of the CPV delay time" CURVE 0x80544C2E RB_Curve_U8_U8 1.992188 fak_ub_b2 0.00 1.992188 FORMAT "%8.6"
 /begin AXIS_DESCR STD_AXIS tCpvModloc temp_ub_q0p75_o48 4 -48.0 143.3 FORMAT "%5.1" DEPOSIT ABSOLUTE /end AXIS_DESCR
/end CHARACTERISTIC
/begin CHARACTERISTIC CstrPurg_flgPwmPerdEdgeActv_C "Enable condition PWM-notification with PERIOD_EDGE functionality" VALUE 0x80544BCC RB_Val_Wboolean 1.00000000000 B_TRUE 0.00 1.00000000000 FORMAT "%13.11" /end CHARACTERISTIC
/begin CHARACTERISTIC CstrPurg_nrTestPls_C "number of test pulses per driving cycle" VALUE 0x80544BD4 RB_Val_Wu32 4294967295.00 dez 0.00 4294967295.00 FORMAT "%13.2" /end CHARACTERISTIC
/begin CHARACTERISTIC CstrPurg_ratMinChgReIni_C "Minimum change in the duty cycle that leads to an immediate adoption of the new duty cycle" VALUE 0x80544C38 RB_Val_Wu16 89.99786 rel_q0p00153 10.00061 99.99847 FORMAT "%8.5" EXTENDED_LIMITS 0.00 99.99847 /end CHARACTERISTIC
/begin CHARACTERISTIC CstrPurg_stTMdl_C "CW to configure the temperature model of the CPV" VALUE 0x80544C3A RB_Val_Wu8 255.0 dez 0.00 255.0 FORMAT "%5.1" /end CHARACTERISTIC
/begin CHARACTERISTIC CstrPurg_tiBtwPlsElecErr_C "time between to test pulses to detect an electrical error of the CPV" VALUE 0x80544BD8 RB_Val_Ws16 655350.0 t_q10_ms -327680.0 327670.0 FORMAT "%8.1" /end CHARACTERISTIC
/begin CHARACTERISTIC CstrPurg_tiBtwPlsOverT_C "time between to test pulses to detect an overtemperature error of the CPV" VALUE 0x80544BDA RB_Val_Ws16 655.3500 t_q0p01 -327.6800 327.6700 FORMAT "%8.4" /end CHARACTERISTIC
/begin CHARACTERISTIC CWESSTT "code word setting variables B_vbemg and B_wks" VALUE 0x80540C78 RB_Val_Wu8 255.0 dez 0.00 255.0 FORMAT "%5.1" /end CHARACTERISTIC
/begin CHARACTERISTIC CWESUK "Code word transient compensation" VALUE 0x80541E94 RB_Val_Wu8 255.0 dez 0.00 255.0 FORMAT "%5.1" /end CHARACTERISTIC
/begin CHARACTERISTIC CWESWE "Codeword %CWESWE configuration" VALUE 0x805422EC RB_Val_Wu8 255.0 dez 0.00 255.0 FORMAT "%5.1" /end CHARACTERISTIC
/begin CHARACTERISTIC CWFPCTVTEV "Codeword choice pressure ratio or absolute pressure" VALUE 0x80544C3B RB_Val_Wu8 255.0 dez 0.00 255.0 FORMAT "%5.1" /end CHARACTERISTIC
/begin CHARACTERISTIC CWINVAAV "Codeword for AAV actuation" VALUE 0x80544BBD RB_Val_Wu8 255.0 dez 0.00 255.0 FORMAT "%5.1" /end CHARACTERISTIC
/begin CHARACTERISTIC CWNSWLMOD "Codeword for afterstart and warm-up dependent on direct injection mode" VALUE 0x8053F45C RB_Val_Wu16 65535.00 dez 0.00 65535.00 FORMAT "%8.2" /end CHARACTERISTIC
/begin CHARACTERISTIC CWPSAAVE "Code word for canister ventilation valve (power stage)" VALUE 0x80544BC0 RB_Val_Wu8 255.0 dez 0.00 255.0 FORMAT "%5.1" /end CHARACTERISTIC
/begin CHARACTERISTIC CWPSTEVE "code word for shutdown of output-stage diagnosis" VALUE 0x80544BDC RB_Val_Wu8 255.0 dez 0.00 255.0 FORMAT "%5.1" /end CHARACTERISTIC
/begin CHARACTERISTIC CWTATETEV "Codewort CWTEATEV" VALUE 0x80544BCD RB_Val_Wu8 255.0 dez 0.00 255.0 FORMAT "%5.1" /end CHARACTERISTIC
/begin CHARACTERISTIC CWTTEV "Codeword choice for canister purge valve (CPV) duty cycle through tester request" VALUE 0x80544C3C RB_Val_Wu8 255.0 dez 0.00 255.0 FORMAT "%5.1" /end CHARACTERISTIC
/begin CHARACTERISTIC DN10BURNT "minimum engine-speed difference for happened combustion" VALUE 0x80540C7A RB_Val_Ws16 32767.50 EngN -16384.00 16383.50 FORMAT "%8.2" /end CHARACTERISTIC
/begin CHARACTERISTIC DRLPT "time constant for delta predicted load for injection time calculation (word)" VALUE 0x80541E96 RB_Val_Wu16 655.3500 t_q0p01 0.00 655.3500 FORMAT "%8.4" /end CHARACTERISTIC
/begin AXIS_PTS EngStrt_agDrctStrtEsstt03_Ax "SST angle direct start" 0x80540C7C wdirst_msg RB_Axis_U8 510.0 kw_q2 3 0.00 510.0 FORMAT "%5.1" DEPOSIT ABSOLUTE /end AXIS_PTS
/begin AXIS_PTS EngStrt_facAlti08_Ax "SST factor altitude" 0x8053F45E PEnv_facCorrAlti RB_Axis_U16 3.999939 fak_uw_b4 8 0.00 3.999939 FORMAT "%8.6" DEPOSIT ABSOLUTE /end AXIS_PTS
/begin CHARACTERISTIC EngStrt_facBadFuCorrnStrt_M "factor bad fuel correction start" MAP 0x80540C80 RB_Map_S16S16_U16 3.984375 fak_ub_b4 0.00 3.984375 FORMAT "%8.6" EXTENDED_LIMITS 0.00 1023.984
 /begin AXIS_DESCR STD_AXIS ESSTT_tCoor Temp_Cels 12 -273.140 3003.560 FORMAT "%8.3" EXTENDED_LIMITS -3549.940 3003.560 DEPOSIT ABSOLUTE /end AXIS_DESCR
 /begin AXIS_DESCR STD_AXIS ESSTT_tStrtCoor Temp_Cels 12 -273.140 3003.560 FORMAT "%8.3" EXTENDED_LIMITS -3549.940 3003.560 DEPOSIT ABSOLUTE /end AXIS_DESCR
/end CHARACTERISTIC
/begin AXIS_PTS EngStrt_facCorrnAlti_AX "Base point distribution over PEnv_facCorrAlti for start factor correction altitude" 0x80540DD4 ESSTT_facCorrnAlti RB_Axis_U16 3.999939 fak_uw_b4 4 0.00 3.999939 FORMAT "%8.6" DEPOSIT ABSOLUTE /end AXIS_PTS
/begin AXIS_PTS EngStrt_facEthEsstt06_Ax "SST ethanol factor correction" 0x80540DDE fethffv RB_Axis_U8 0.9961 fak_ub_b1 6 0.00 0.9961 DEPOSIT ABSOLUTE /end AXIS_PTS
/begin AXIS_PTS EngStrt_facEthStoe09_Ax "SST factor ethanol" 0x8053F470 FfPrm_facEthCurr RB_Axis_U16 1.999969 fak_uw_b2 6 0.00 1.999969 FORMAT "%8.6" DEPOSIT ABSOLUTE /end AXIS_PTS
/begin CHARACTERISTIC EngStrt_facIniFuelMod_T "Curve for additional calibration of the start factor during first Injection for initial fueling mode" CURVE 0x80540DE6 RB_Curve_U16_U16 7.999878 fak_uw_b8 0.00 7.999878 FORMAT "%8.6"
 /begin AXIS_DESCR STD_AXIS anzturst_w OneToOne 2 0.00 65535.00 FORMAT "%8.2" DEPOSIT ABSOLUTE /end AXIS_DESCR
/end CHARACTERISTIC
/begin CHARACTERISTIC EngStrt_facStrtIniFuFillg_T "Curve for initial fuel filing start factor" CURVE 0x80540DF0 RB_Curve_U16_U16 7.999878 fak_uw_b8 0.00 7.999878 FORMAT "%8.6"
 /begin AXIS_DESCR STD_AXIS anzturst_w OneToOne 2 0.00 65535.00 FORMAT "%8.2" DEPOSIT ABSOLUTE /end AXIS_DESCR
/end CHARACTERISTIC
/begin AXIS_PTS EngStrt_mAirModIntegEngStrt06_Ax "SST modelled air mass in start" 0x8053F47E ExhMod_mAirMfIntegEngStrt RB_Axis_U16 23.30133 m_uw_b23p3 6 0.00 23.30133 FORMAT "%8.5" DEPOSIT ABSOLUTE /end AXIS_PTS
/begin CHARACTERISTIC EngStrt_nIniRPMThr_C "Threshold for Engine Speed" VALUE 0x80540DFA RB_Val_Ws16 32767.50 EngN -16384.00 16383.50 FORMAT "%8.2" /end CHARACTERISTIC
/begin AXIS_PTS EngStrt_nrInj12_Ax "SST number of injections" 0x8053F48C anztib1_w_msg RB_Axis_U16 65535.00 dez 12 0.00 65535.00 FORMAT "%8.2" DEPOSIT ABSOLUTE /end AXIS_PTS
/begin AXIS_PTS EngStrt_nrInjEsstt03_Ax "SST number of injection" 0x80540DFC anztib_msg RB_Axis_U8 255.0 dez 3 0.00 255.0 FORMAT "%5.1" DEPOSIT ABSOLUTE /end AXIS_PTS
/begin AXIS_PTS EngStrt_nrInjStrtEsstt14_Ax "SST number of injections" 0x80540E00 anztist RB_Axis_U8 255.0 dez 14 0.00 255.0 FORMAT "%5.1" DEPOSIT ABSOLUTE /end AXIS_PTS
/begin CHARACTERISTIC EngStrt_numAnztiThr_C "Threshold for total amount of injections delivered" VALUE 0x80540E10 RB_Val_Wu16 65535.00 dez 0.00 65535.00 FORMAT "%8.2" /end CHARACTERISTIC
/begin AXIS_PTS EngStrt_pFildRailEsstt02_Ax "SST rail pressure" 0x80540E12 FuPHi_pRail RB_Axis_U16 131.0700 RBPtCel_p_0p002_1 2 0.00 131.0700 FORMAT "%8.4" DEPOSIT ABSOLUTE /end AXIS_PTS
/begin AXIS_PTS EngStrt_ratPrdcAir06_Ax "SST ratio predicted air" 0x8053F4A6 rlp_w_msg RB_Axis_U16 1535.977 rel_uw_q0p0234 6 0.00 1535.977 FORMAT "%8.3" DEPOSIT ABSOLUTE /end AXIS_PTS
/begin AXIS_PTS EngStrt_stActRedStg05_Ax "SST actual reduce stage" 0x8053F4B4 InjSys_stActRedStg RB_Axis_U8 255.0 dez 5 0.00 255.0 FORMAT "%5.1" DEPOSIT ABSOLUTE /end AXIS_PTS
/begin CHARACTERISTIC EngStrt_stCfgShDwnTi "code word to define the used configuration of shut down time" VALUE 0x80540E18 RB_Val_Wu8 255.0 dez 0.00 255.0 FORMAT "%5.1" /end CHARACTERISTIC
/begin CHARACTERISTIC EngStrt_stClassSeln_T "class selection for start enrichment in function ESSTT (Fuel enrichment during start)" CURVE 0x80540E1A RB_Curve_U16_U8_Static 4.000 OneToOne 0.00 4.000 FORMAT "%5.3" EXTENDED_LIMITS 0.00 255.0
 /begin AXIS_DESCR STD_AXIS EngStrt_stStrtReq ENGSTRT_STSTRTREQ_SET_COMPU_VERB 19 0.00 32770.0000000 FORMAT "%13.7" DEPOSIT ABSOLUTE /end AXIS_DESCR
/end CHARACTERISTIC
/begin AXIS_PTS EngStrt_stEomDesReqd_Ax "SST coeng operation mode" 0x8053F4BA ESNSWL_classSelect RB_Axis_U8 255.0 dez 3 0.00 255.0 FORMAT "%5.1" DEPOSIT ABSOLUTE /end AXIS_PTS
/begin CHARACTERISTIC EngStrt_stESNSWLModeAppl_C "calibration interface of function ESNSWL (fuel enrichment afterstart and warm-up) to give a manual target mode" VALUE 0x8053F4BE RB_Val_Wu16 255.0000 dez 0.00 255.0000 FORMAT "%8.4" EXTENDED_LIMITS 0.00 65535.00 /end CHARACTERISTIC
/begin CHARACTERISTIC EngStrt_stESNSWLMode_C "target mode for afterstart and warm-up enrichment" VALUE 0x8053F4C0 RB_Val_Wu8 3.00000000000 ENGSTRT_ESNSWLMODEPOI_SET_COMPU_VERB 0.00 3.00000000000 FORMAT "%13.11" /end CHARACTERISTIC
/begin CHARACTERISTIC EngStrt_stInjCntrRstInhb_T "State Injection counter curve" CURVE 0x80540E56 RB_Curve_U16_U8_Static 255.0 OneToOne 0.00 255.0 FORMAT "%5.1"
 /begin AXIS_DESCR STD_AXIS EngStrt_stStrtReq ENGSTRT_STSTRTREQ_SET_COMPU_VERB 19 0.00 32770.0000000 FORMAT "%13.7" DEPOSIT ABSOLUTE /end AXIS_DESCR
/end CHARACTERISTIC
/begin CHARACTERISTIC EngStrt_stInjMod2Idx_GM "map for assignment of injection mode and start situation to classes in function ESNSWL (fuel enrichment for afterstart and warm-up)" MAP 0x8053F4C2 RB_MapGroup_U16 3.00000000000 ENGSTRT_ESNSWLMODEPOI_SET_COMPU_VERB 0.00 3.00000000000 FORMAT "%13.11"
 /begin AXIS_DESCR COM_AXIS NO_INPUT_QUANTITY InjSys_InjMode_Set_COMPU_VERB 20 0.00 19.0000000000 FORMAT "%13.10" AXIS_PTS_REF InjSys_stInjMod_AX /end AXIS_DESCR
 /begin AXIS_DESCR COM_AXIS ESNSWL_classSelect dez 3 0.00 255.0 FORMAT "%5.1" AXIS_PTS_REF EngStrt_stEomDesReqd_Ax /end AXIS_DESCR
/end CHARACTERISTIC
/begin CHARACTERISTIC EngStrt_stInstSelnAlti_T "instance selection of altitude class" CURVE 0x80540E92 RB_Curve_U16_U8_Static 2.00000000000 ENGSTRT_ESSTTALTI_SET_COMPU_VERB 0.00 2.00000000000 FORMAT "%13.11"
 /begin AXIS_DESCR STD_AXIS ESSTT_stStrtReq ENGSTRT_STSTRTREQ_SET_COMPU_VERB 19 0.00 32770.0000000 FORMAT "%13.7" DEPOSIT ABSOLUTE /end AXIS_DESCR
/end CHARACTERISTIC
/begin CHARACTERISTIC EngStrt_stInstSelnBaseS1_T "selection of direct-start instance for Sync1" CURVE 0x80540ECE RB_Curve_U16_U8_Static 3.00000000000 ENGSTRT_ESSTTBASESYNCS0_SET_COMPU_VERB 0.00 3.00000000000 FORMAT "%13.11"
 /begin AXIS_DESCR STD_AXIS EngStrt_stStrtReq ENGSTRT_STSTRTREQ_SET_COMPU_VERB 19 0.00 32770.0000000 FORMAT "%13.7" DEPOSIT ABSOLUTE /end AXIS_DESCR
/end CHARACTERISTIC
/begin CHARACTERISTIC EngStrt_stInstSelnBase_T "instance selection of base class" CURVE 0x80540F0A RB_Curve_U16_U8_Static 3.00000000000 ENGSTRT_ESSTTBASESYNCS0_SET_COMPU_VERB 0.00 3.00000000000 FORMAT "%13.11"
 /begin AXIS_DESCR STD_AXIS EngStrt_stStrtReq ENGSTRT_STSTRTREQ_SET_COMPU_VERB 19 0.00 32770.0000000 FORMAT "%13.7" DEPOSIT ABSOLUTE /end AXIS_DESCR
/end CHARACTERISTIC
/begin CHARACTERISTIC EngStrt_stInstSelnDirst_T "selection of direct-start instance" CURVE 0x80540F46 RB_Curve_U16_U8_Static 0.00 ENGSTRT_ESSTTDIRSTSYNCS1_SET_COMPU_VERB 0.00 0.00 FORMAT "%13.2"
 /begin AXIS_DESCR STD_AXIS EngStrt_stStrtReq ENGSTRT_STSTRTREQ_SET_COMPU_VERB 19 0.00 32770.0000000 FORMAT "%13.7" DEPOSIT ABSOLUTE /end AXIS_DESCR
/end CHARACTERISTIC
/begin AXIS_PTS EngStrt_stTqResv04_Ax "SST torque reserve" 0x8053F53A dmrmx_w_msg RB_Axis_U16 99.99847 rel_uw_b100 4 0.00 99.99847 FORMAT "%8.5" DEPOSIT ABSOLUTE /end AXIS_PTS
/begin AXIS_PTS EngStrt_tiEngStopEsstt04_Ax "SST time engine has stopped" 0x80540F82 ESSTT_tiEngOff RB_Axis_U16 65535.00 t_q1 6 0.00 65535.00 FORMAT "%8.2" DEPOSIT ABSOLUTE /end AXIS_PTS
/begin AXIS_PTS EngStrt_tiEngStopEssttEth04_Ax "SST time engine has stopped" 0x80540F90 ESSTT_tiEngOff RB_Axis_U16 65535.00 t_q1 4 0.00 65535.00 FORMAT "%8.2" DEPOSIT ABSOLUTE /end AXIS_PTS
/begin AXIS_PTS EngStrt_tIntkAir06_Ax "SST temperature intake air" 0x8053F544 tans_msg RB_Axis_U8 191.3 temp_ub_q0p75_o48 6 -48.0 143.3 FORMAT "%5.1" DEPOSIT ABSOLUTE /end AXIS_PTS
/begin AXIS_PTS EngStrt_tStrtEsstt12_Ax "SST engine start temperature" 0x80540F9A EngStrt_tStrtCoor RB_Axis_S16 3276.700 Temp_Cels 12 -273.140 3003.560 FORMAT "%8.3" EXTENDED_LIMITS -3549.940 3003.560 DEPOSIT ABSOLUTE /end AXIS_PTS
/begin AXIS_PTS EngStrt_tStrtEssttEth12_Ax "SST engine start temperature" 0x80540FB4 EngStrt_tStrtCoor RB_Axis_S16 3276.700 Temp_Cels 12 -273.140 3003.560 FORMAT "%8.3" EXTENDED_LIMITS -3549.940 3003.560 DEPOSIT ABSOLUTE /end AXIS_PTS
/begin CHARACTERISTIC ESNSWL_HOM.FZANSSA1 "base class of function ESNSWL (Fuel enrichment during afterstart and warm-up) / factor for ignition synchronous decreasing of afterstart enrichment at hot start range 1" CURVE 0x8054057C RB_CurveGroup_U8 0.249023438 fak_ub_b0p25 0.00 0.249023438 FORMAT "%11.9"
 /begin AXIS_DESCR COM_AXIS tans_msg temp_ub_q0p75_o48 6 -48.0 143.3 FORMAT "%5.1" AXIS_PTS_REF EngStrt_tIntkAir06_Ax /end AXIS_DESCR
/end CHARACTERISTIC
/begin CHARACTERISTIC ESNSWL_HOM.FZANSSA2 "base class of function ESNSWL (Fuel enrichment during afterstart and warm-up) / factor for ignition synchronous decreasing of afterstart enrichment at hot start range 2" CURVE 0x80540582 RB_CurveGroup_U8 0.249023438 fak_ub_b0p25 0.00 0.249023438 FORMAT "%11.9"
 /begin AXIS_DESCR COM_AXIS tans_msg temp_ub_q0p75_o48 6 -48.0 143.3 FORMAT "%5.1" AXIS_PTS_REF EngStrt_tIntkAir06_Ax /end AXIS_DESCR
/end CHARACTERISTIC
/begin CHARACTERISTIC ESNSWL_HOM.KFFWL "base class of function ESNSWL (Fuel enrichment during afterstart and warm-up) / map warm-up factor" MAP 0x80540588 RB_MapGroup_U8 1.992188 fak_ub_b2 0.00 1.992188 FORMAT "%8.6"
 /begin AXIS_DESCR COM_AXIS tmotesnswl temp_ub_q0p75_o48 12 -48.0 143.3 FORMAT "%5.1" AXIS_PTS_REF STC12ESUB /end AXIS_DESCR
 /begin AXIS_DESCR COM_AXIS tmstesnswl temp_ub_q0p75_o48 12 -48.0 143.3 FORMAT "%5.1" AXIS_PTS_REF STI12ESUB /end AXIS_DESCR
/end CHARACTERISTIC
/begin CHARACTERISTIC ESNSWL_HOM.KFFWLETH "base class of function ESNSWL (Fuel enrichment during afterstart and warm-up) / characteristic map warm up factor for ethanol at HOM" MAP 0x80540618 RB_MapGroup_U8 1.992188 fak_ub_b2 0.00 1.992188 FORMAT "%8.6"
 /begin AXIS_DESCR COM_AXIS tmotesnswl temp_ub_q0p75_o48 12 -48.0 143.3 FORMAT "%5.1" AXIS_PTS_REF STC12ESUB /end AXIS_DESCR
 /begin AXIS_DESCR COM_AXIS tmstesnswl temp_ub_q0p75_o48 12 -48.0 143.3 FORMAT "%5.1" AXIS_PTS_REF STI12ESUB /end AXIS_DESCR
/end CHARACTERISTIC
/begin CHARACTERISTIC ESNSWL_HOM.KFFWLLP "base class of function ESNSWL (Fuel enrichment during afterstart and warm-up) / characteristic map warm up factor for low pressure" MAP 0x805406A8 RB_MapGroup_U8 1.992188 fak_ub_b2 0.00 1.992188 FORMAT "%8.6"
 /begin AXIS_DESCR COM_AXIS tmotesnswl temp_ub_q0p75_o48 12 -48.0 143.3 FORMAT "%5.1" AXIS_PTS_REF STC12ESUB /end AXIS_DESCR
 /begin AXIS_DESCR COM_AXIS tmstesnswl temp_ub_q0p75_o48 12 -48.0 143.3 FORMAT "%5.1" AXIS_PTS_REF STI12ESUB /end AXIS_DESCR
/end CHARACTERISTIC
/begin CHARACTERISTIC ESNSWL_HOM.KFFWLRL "base class of function ESNSWL (Fuel enrichment during afterstart and warm-up) / map warm-up factor load dependent fraction" MAP 0x80540738 RB_MapGroup_U8 1.992188 fak_ub_b2 0.00 1.992188 FORMAT "%8.6"
 /begin AXIS_DESCR COM_AXIS tmstesnswl temp_ub_q0p75_o48 8 -48.0 143.3 FORMAT "%5.1" AXIS_PTS_REF STI08ESUB /end AXIS_DESCR
 /begin AXIS_DESCR COM_AXIS rlp_w_msg rel_uw_q0p0234 6 0.00 1535.977 FORMAT "%8.3" AXIS_PTS_REF EngStrt_ratPrdcAir06_Ax /end AXIS_DESCR
/end CHARACTERISTIC
/begin CHARACTERISTIC ESNSWL_HOM.KFFWLRLETH "base class of function ESNSWL (Fuel enrichment during afterstart and warm-up) / map warm-up factor load dependent fraction at HOM with ethanol" MAP 0x80540768 RB_MapGroup_U8 1.992188 fak_ub_b2 0.00 1.992188 FORMAT "%8.6"
 /begin AXIS_DESCR COM_AXIS tmstesnswl temp_ub_q0p75_o48 8 -48.0 143.3 FORMAT "%5.1" AXIS_PTS_REF STI08ESUB /end AXIS_DESCR
 /begin AXIS_DESCR COM_AXIS rlp_w_msg rel_uw_q0p0234 6 0.00 1535.977 FORMAT "%8.3" AXIS_PTS_REF EngStrt_ratPrdcAir06_Ax /end AXIS_DESCR
/end CHARACTERISTIC
/begin CHARACTERISTIC ESNSWL_HOM.KFNSWRL "base class of function ESNSWL (Fuel enrichment during afterstart and warm-up) / weighting of afterstart enrichment" MAP 0x80540798 RB_MapGroup_U8 1.992188 fak_ub_b2 0.00 1.992188 FORMAT "%8.6"
 /begin AXIS_DESCR COM_AXIS tmstesnswl temp_ub_q0p75_o48 8 -48.0 143.3 FORMAT "%5.1" AXIS_PTS_REF STI08ESUB /end AXIS_DESCR
 /begin AXIS_DESCR COM_AXIS rlp_w_msg rel_uw_q0p0234 6 0.00 1535.977 FORMAT "%8.3" AXIS_PTS_REF EngStrt_ratPrdcAir06_Ax /end AXIS_DESCR
/end CHARACTERISTIC
/begin CHARACTERISTIC ESNSWL_HOM.KFNSWRL2 "base class of function ESNSWL (Fuel enrichment during afterstart and warm-up) / weighting of afterstart enrichment" MAP 0x805407C8 RB_MapGroup_U8 1.992188 fak_ub_b2 0.00 1.992188 FORMAT "%8.6"
 /begin AXIS_DESCR COM_AXIS tmstesnswl temp_ub_q0p75_o48 8 -48.0 143.3 FORMAT "%5.1" AXIS_PTS_REF STI08ESUB /end AXIS_DESCR
 /begin AXIS_DESCR COM_AXIS rlp_w_msg rel_uw_q0p0234 6 0.00 1535.977 FORMAT "%8.3" AXIS_PTS_REF EngStrt_ratPrdcAir06_Ax /end AXIS_DESCR
/end CHARACTERISTIC
/begin CHARACTERISTIC ESNSWL_HOM.KFWWLML "base class of function ESNSWL (Fuel enrichment during afterstart and warm-up) / map weighting warm-up factor" MAP 0x805407F8 RB_MapGroup_U8 1.992188 fak_ub_b2 0.00 1.992188 FORMAT "%8.6"
 /begin AXIS_DESCR COM_AXIS ExhMod_mAirMfIntegEngStrt m_uw_b23p3 6 0.00 23.30133 FORMAT "%8.5" AXIS_PTS_REF EngStrt_mAirModIntegEngStrt06_Ax /end AXIS_DESCR
 /begin AXIS_DESCR COM_AXIS tmstesnswl temp_ub_q0p75_o48 8 -48.0 143.3 FORMAT "%5.1" AXIS_PTS_REF STI08ESUB /end AXIS_DESCR
/end CHARACTERISTIC
/begin CHARACTERISTIC ESNSWL_HOM.KFWWLMLETH "base class of function ESNSWL (Fuel enrichment during afterstart and warm-up) / characteristic map weighting warm-up with ethanol dependence" MAP 0x80540828 RB_MapGroup_U8 1.992188 fak_ub_b2 0.00 1.992188 FORMAT "%8.6"
 /begin AXIS_DESCR COM_AXIS ExhMod_mAirMfIntegEngStrt m_uw_b23p3 6 0.00 23.30133 FORMAT "%8.5" AXIS_PTS_REF EngStrt_mAirModIntegEngStrt06_Ax /end AXIS_DESCR
 /begin AXIS_DESCR COM_AXIS tmstesnswl temp_ub_q0p75_o48 8 -48.0 143.3 FORMAT "%5.1" AXIS_PTS_REF STI08ESUB /end AXIS_DESCR
/end CHARACTERISTIC
/begin CHARACTERISTIC ESNSWL_HOM.KFWWLMTANS "base class of function ESNSWL (Fuel enrichment during afterstart and warm-up) / characteristic map weighting warm-up dependent on integrated air mass and intake air temperature" MAP 0x80540858 RB_MapGroup_U8 1.992188 fak_ub_b2 0.00 1.992188 FORMAT "%8.6"
 /begin AXIS_DESCR COM_AXIS ExhMod_mAirMfIntegEngStrt m_uw_b23p3 6 0.00 23.30133 FORMAT "%8.5" AXIS_PTS_REF EngStrt_mAirModIntegEngStrt06_Ax /end AXIS_DESCR
 /begin AXIS_DESCR COM_AXIS tans_msg temp_ub_q0p75_o48 6 -48.0 143.3 FORMAT "%5.1" AXIS_PTS_REF EngStrt_tIntkAir06_Ax /end AXIS_DESCR
/end CHARACTERISTIC
/begin CHARACTERISTIC ESNSWL_HOM.KLTANS "base class of function ESNSWL (Fuel enrichment during afterstart and warm-up) / characteristic curve dependent on intake air temperature" CURVE 0x8054087C RB_CurveGroup_U8 0.9961 fak_ub_b1 0.00 0.9961
 /begin AXIS_DESCR COM_AXIS tans_msg temp_ub_q0p75_o48 6 -48.0 143.3 FORMAT "%5.1" AXIS_PTS_REF EngStrt_tIntkAir06_Ax /end AXIS_DESCR
/end CHARACTERISTIC
/begin CHARACTERISTIC ESNSWL_HOM.ZDGZA1 "base class of function ESNSWL (Fuel enrichment during afterstart and warm-up) / Number of ignitions for decrease in range 1" VALUE 0x80540882 RB_Val_Wu8 255.0 dez 0.00 255.0 FORMAT "%5.1" /end CHARACTERISTIC
/begin CHARACTERISTIC ESNSWL_HOM.ZDGZA2 "base class of function ESNSWL (Fuel enrichment during afterstart and warm-up) / Number of ignitions for decrease in range 2" VALUE 0x80540883 RB_Val_Wu8 255.0 dez 0.00 255.0 FORMAT "%5.1" /end CHARACTERISTIC
/begin CHARACTERISTIC ESNSWL_HOM.ZDGZA3 "base class of function ESNSWL (Fuel enrichment during afterstart and warm-up) / Number of ignitions for decrease in range 3" VALUE 0x80540884 RB_Val_Wu8 255.0 dez 0.00 255.0 FORMAT "%5.1" /end CHARACTERISTIC
/begin CHARACTERISTIC ESNSWL_HOM.facAftStrtAltiLp_GT "base class of function ESNSWL (Fuel enrichment during afterstart and warm-up) / factor after start altitude lowpass" CURVE 0x80540885 RB_CurveGroup_U8 3.984 fak_ub_b4 0.00 3.984 FORMAT "%5.3"
 /begin AXIS_DESCR COM_AXIS PEnv_facCorrAlti fak_uw_b4 8 0.00 3.999939 FORMAT "%8.6" AXIS_PTS_REF EngStrt_facAlti08_Ax /end AXIS_DESCR
/end CHARACTERISTIC
/begin CHARACTERISTIC ESNSWL_HOM.facAftStrtCatHtg_GT "base class of function ESNSWL (Fuel enrichment during afterstart and warm-up) / factor after start cat heating" CURVE 0x8054088D RB_CurveGroup_U8 3.984 fak_ub_b4 0.00 3.984 FORMAT "%5.3"
 /begin AXIS_DESCR COM_AXIS tmstesnswl temp_ub_q0p75_o48 12 -48.0 143.3 FORMAT "%5.1" AXIS_PTS_REF STI12ESUB /end AXIS_DESCR
/end CHARACTERISTIC
/begin CHARACTERISTIC ESNSWL_HOM.facAftStrtHotStrt_GT "base class of function ESNSWL (Fuel enrichment during afterstart and warm-up) / factor after start hot start" MAP 0x80540899 RB_MapGroup_U8 1.992188 fak_ub_b2 0.00 1.992188 FORMAT "%8.6"
 /begin AXIS_DESCR COM_AXIS tans_msg temp_ub_q0p75_o48 6 -48.0 143.3 FORMAT "%5.1" AXIS_PTS_REF EngStrt_tIntkAir06_Ax /end AXIS_DESCR
 /begin AXIS_DESCR COM_AXIS tmotesnswl temp_ub_q0p75_o48 12 -48.0 143.3 FORMAT "%5.1" AXIS_PTS_REF STC12ESUB /end AXIS_DESCR
/end CHARACTERISTIC
/begin CHARACTERISTIC ESNSWL_HOM.facCurrAftStrtEth_GM "base class of function ESNSWL (Fuel enrichment during afterstart and warm-up) / base class ESNSWL factor after start ethanol" MAP 0x805408E1 RB_MapGroup_U8 3.984 fak_ub_b4 0.00 3.984 FORMAT "%5.3"
 /begin AXIS_DESCR COM_AXIS tmstesnswl temp_ub_q0p75_o48 12 -48.0 143.3 FORMAT "%5.1" AXIS_PTS_REF STI12ESUB /end AXIS_DESCR
 /begin AXIS_DESCR COM_AXIS FfPrm_facEthCurr fak_uw_b2 6 0.00 1.999969 FORMAT "%8.6" AXIS_PTS_REF EngStrt_facEthStoe09_Ax /end AXIS_DESCR
/end CHARACTERISTIC
/begin CHARACTERISTIC ESNSWL_HOM.facCurrDernIgnSyncEth1_GM "base class of function ESNSWL (Fuel enrichment during afterstart and warm-up) / base class ESNSWL factor derating ignition synchronous for ethanol 1" MAP 0x80540929 RB_MapGroup_U8 0.249023438 fak_ub_b0p25 0.00 0.249023438 FORMAT "%11.9"
 /begin AXIS_DESCR COM_AXIS tmstesnswl temp_ub_q0p75_o48 12 -48.0 143.3 FORMAT "%5.1" AXIS_PTS_REF STI12ESUB /end AXIS_DESCR
 /begin AXIS_DESCR COM_AXIS FfPrm_facEthCurr fak_uw_b2 6 0.00 1.999969 FORMAT "%8.6" AXIS_PTS_REF EngStrt_facEthStoe09_Ax /end AXIS_DESCR
/end CHARACTERISTIC
/begin CHARACTERISTIC ESNSWL_HOM.facCurrDernIgnSyncEth2_GM "base class of function ESNSWL (Fuel enrichment during afterstart and warm-up) / base class ESNSWL factor derating ignition synchronous for ethanol 2" MAP 0x80540971 RB_MapGroup_U8 0.249023438 fak_ub_b0p25 0.00 0.249023438 FORMAT "%11.9"
 /begin AXIS_DESCR COM_AXIS tmstesnswl temp_ub_q0p75_o48 12 -48.0 143.3 FORMAT "%5.1" AXIS_PTS_REF STI12ESUB /end AXIS_DESCR
 /begin AXIS_DESCR COM_AXIS FfPrm_facEthCurr fak_uw_b2 6 0.00 1.999969 FORMAT "%8.6" AXIS_PTS_REF EngStrt_facEthStoe09_Ax /end AXIS_DESCR
/end CHARACTERISTIC
/begin CHARACTERISTIC ESNSWL_HOM.facCurrDernIgnSyncEth3_GM "base class of function ESNSWL (Fuel enrichment during afterstart and warm-up) / base class ESNSWL factor derating ignition synchronous for ethanol 3" MAP 0x805409B9 RB_MapGroup_U8 0.249023438 fak_ub_b0p25 0.00 0.249023438 FORMAT "%11.9"
 /begin AXIS_DESCR COM_AXIS tmstesnswl temp_ub_q0p75_o48 12 -48.0 143.3 FORMAT "%5.1" AXIS_PTS_REF STI12ESUB /end AXIS_DESCR
 /begin AXIS_DESCR COM_AXIS FfPrm_facEthCurr fak_uw_b2 6 0.00 1.999969 FORMAT "%8.6" AXIS_PTS_REF EngStrt_facEthStoe09_Ax /end AXIS_DESCR
/end CHARACTERISTIC
/begin CHARACTERISTIC ESNSWL_HOM.facCurrDernSwtThdEth1_GM "base class of function ESNSWL (Fuel enrichment during afterstart and warm-up) / base class ESNSWLfactor derating switch threshold for ethanol1" MAP 0x80540A01 RB_MapGroup_U8 1.992188 fak_ub_b2 0.00 1.992188 FORMAT "%8.6"
 /begin AXIS_DESCR COM_AXIS tmstesnswl temp_ub_q0p75_o48 12 -48.0 143.3 FORMAT "%5.1" AXIS_PTS_REF STI12ESUB /end AXIS_DESCR
 /begin AXIS_DESCR COM_AXIS FfPrm_facEthCurr fak_uw_b2 6 0.00 1.999969 FORMAT "%8.6" AXIS_PTS_REF EngStrt_facEthStoe09_Ax /end AXIS_DESCR
/end CHARACTERISTIC
/begin CHARACTERISTIC ESNSWL_HOM.facCurrDernSwtThdEth2_GM "base class of function ESNSWL (Fuel enrichment during afterstart and warm-up) / base class ESNSWLfactor derating switch threshold for ethanol2" MAP 0x80540A49 RB_MapGroup_U8 1.992188 fak_ub_b2 0.00 1.992188 FORMAT "%8.6"
 /begin AXIS_DESCR COM_AXIS tmstesnswl temp_ub_q0p75_o48 12 -48.0 143.3 FORMAT "%5.1" AXIS_PTS_REF STI12ESUB /end AXIS_DESCR
 /begin AXIS_DESCR COM_AXIS FfPrm_facEthCurr fak_uw_b2 6 0.00 1.999969 FORMAT "%8.6" AXIS_PTS_REF EngStrt_facEthStoe09_Ax /end AXIS_DESCR
/end CHARACTERISTIC
/begin CHARACTERISTIC ESNSWL_HOM_KL.FZANSSA1 " / factor for ignition synchronous decreasing of afterstart enrichment at hot start range 1" CURVE 0x8053F628 RB_CurveGroup_U8 0.249023438 fak_ub_b0p25 0.00 0.249023438 FORMAT "%11.9"
 /begin AXIS_DESCR COM_AXIS tans_msg temp_ub_q0p75_o48 6 -48.0 143.3 FORMAT "%5.1" AXIS_PTS_REF EngStrt_tIntkAir06_Ax /end AXIS_DESCR
/end CHARACTERISTIC
/begin CHARACTERISTIC ESNSWL_HOM_KL.FZANSSA2 " / factor for ignition synchronous decreasing of afterstart enrichment at hot start range 2" CURVE 0x8053F62E RB_CurveGroup_U8 0.249023438 fak_ub_b0p25 0.00 0.249023438 FORMAT "%11.9"
 /begin AXIS_DESCR COM_AXIS tans_msg temp_ub_q0p75_o48 6 -48.0 143.3 FORMAT "%5.1" AXIS_PTS_REF EngStrt_tIntkAir06_Ax /end AXIS_DESCR
/end CHARACTERISTIC
/begin CHARACTERISTIC ESNSWL_HOM_KL.KFFWL " / map warm-up factor" MAP 0x8053F634 RB_MapGroup_U8 1.992188 fak_ub_b2 0.00 1.992188 FORMAT "%8.6"
 /begin AXIS_DESCR COM_AXIS tmotesnswl temp_ub_q0p75_o48 12 -48.0 143.3 FORMAT "%5.1" AXIS_PTS_REF STC12ESUB /end AXIS_DESCR
 /begin AXIS_DESCR COM_AXIS tmstesnswl temp_ub_q0p75_o48 12 -48.0 143.3 FORMAT "%5.1" AXIS_PTS_REF STI12ESUB /end AXIS_DESCR
/end CHARACTERISTIC
/begin CHARACTERISTIC ESNSWL_HOM_KL.KFFWLETH " / characteristic map warm up factor for ethanol at HOM" MAP 0x8053F6C4 RB_MapGroup_U8 1.992188 fak_ub_b2 0.00 1.992188 FORMAT "%8.6"
 /begin AXIS_DESCR COM_AXIS tmotesnswl temp_ub_q0p75_o48 12 -48.0 143.3 FORMAT "%5.1" AXIS_PTS_REF STC12ESUB /end AXIS_DESCR
 /begin AXIS_DESCR COM_AXIS tmstesnswl temp_ub_q0p75_o48 12 -48.0 143.3 FORMAT "%5.1" AXIS_PTS_REF STI12ESUB /end AXIS_DESCR
/end CHARACTERISTIC
/begin CHARACTERISTIC ESNSWL_HOM_KL.KFFWLLP " / characteristic map warm up factor for low pressure" MAP 0x8053F754 RB_MapGroup_U8 1.992188 fak_ub_b2 0.00 1.992188 FORMAT "%8.6"
 /begin AXIS_DESCR COM_AXIS tmotesnswl temp_ub_q0p75_o48 12 -48.0 143.3 FORMAT "%5.1" AXIS_PTS_REF STC12ESUB /end AXIS_DESCR
 /begin AXIS_DESCR COM_AXIS tmstesnswl temp_ub_q0p75_o48 12 -48.0 143.3 FORMAT "%5.1" AXIS_PTS_REF STI12ESUB /end AXIS_DESCR
/end CHARACTERISTIC
/begin CHARACTERISTIC ESNSWL_HOM_KL.KFFWLRL " / map warm-up factor load dependent fraction" MAP 0x8053F7E4 RB_MapGroup_U8 1.992188 fak_ub_b2 0.00 1.992188 FORMAT "%8.6"
 /begin AXIS_DESCR COM_AXIS tmstesnswl temp_ub_q0p75_o48 8 -48.0 143.3 FORMAT "%5.1" AXIS_PTS_REF STI08ESUB /end AXIS_DESCR
 /begin AXIS_DESCR COM_AXIS rlp_w_msg rel_uw_q0p0234 6 0.00 1535.977 FORMAT "%8.3" AXIS_PTS_REF EngStrt_ratPrdcAir06_Ax /end AXIS_DESCR
/end CHARACTERISTIC
/begin CHARACTERISTIC ESNSWL_HOM_KL.KFFWLRLETH " / map warm-up factor load dependent fraction at HOM with ethanol" MAP 0x8053F814 RB_MapGroup_U8 1.992188 fak_ub_b2 0.00 1.992188 FORMAT "%8.6"
 /begin AXIS_DESCR COM_AXIS tmstesnswl temp_ub_q0p75_o48 8 -48.0 143.3 FORMAT "%5.1" AXIS_PTS_REF STI08ESUB /end AXIS_DESCR
 /begin AXIS_DESCR COM_AXIS rlp_w_msg rel_uw_q0p0234 6 0.00 1535.977 FORMAT "%8.3" AXIS_PTS_REF EngStrt_ratPrdcAir06_Ax /end AXIS_DESCR
/end CHARACTERISTIC
/begin CHARACTERISTIC ESNSWL_HOM_KL.KFNSWRL " / weighting of afterstart enrichment" MAP 0x8053F844 RB_MapGroup_U8 1.992188 fak_ub_b2 0.00 1.992188 FORMAT "%8.6"
 /begin AXIS_DESCR COM_AXIS tmstesnswl temp_ub_q0p75_o48 8 -48.0 143.3 FORMAT "%5.1" AXIS_PTS_REF STI08ESUB /end AXIS_DESCR
 /begin AXIS_DESCR COM_AXIS rlp_w_msg rel_uw_q0p0234 6 0.00 1535.977 FORMAT "%8.3" AXIS_PTS_REF EngStrt_ratPrdcAir06_Ax /end AXIS_DESCR
/end CHARACTERISTIC
/begin CHARACTERISTIC ESNSWL_HOM_KL.KFNSWRL2 " / weighting of afterstart enrichment" MAP 0x8053F874 RB_MapGroup_U8 1.992188 fak_ub_b2 0.00 1.992188 FORMAT "%8.6"
 /begin AXIS_DESCR COM_AXIS tmstesnswl temp_ub_q0p75_o48 8 -48.0 143.3 FORMAT "%5.1" AXIS_PTS_REF STI08ESUB /end AXIS_DESCR
 /begin AXIS_DESCR COM_AXIS rlp_w_msg rel_uw_q0p0234 6 0.00 1535.977 FORMAT "%8.3" AXIS_PTS_REF EngStrt_ratPrdcAir06_Ax /end AXIS_DESCR
/end CHARACTERISTIC
/begin CHARACTERISTIC ESNSWL_HOM_KL.KFWWLML " / map weighting warm-up factor" MAP 0x8053F8A4 RB_MapGroup_U8 1.992188 fak_ub_b2 0.00 1.992188 FORMAT "%8.6"
 /begin AXIS_DESCR COM_AXIS ExhMod_mAirMfIntegEngStrt m_uw_b23p3 6 0.00 23.30133 FORMAT "%8.5" AXIS_PTS_REF EngStrt_mAirModIntegEngStrt06_Ax /end AXIS_DESCR
 /begin AXIS_DESCR COM_AXIS tmstesnswl temp_ub_q0p75_o48 8 -48.0 143.3 FORMAT "%5.1" AXIS_PTS_REF STI08ESUB /end AXIS_DESCR
/end CHARACTERISTIC
/begin CHARACTERISTIC ESNSWL_HOM_KL.KFWWLMLETH " / characteristic map weighting warm-up with ethanol dependence" MAP 0x8053F8D4 RB_MapGroup_U8 1.992188 fak_ub_b2 0.00 1.992188 FORMAT "%8.6"
 /begin AXIS_DESCR COM_AXIS ExhMod_mAirMfIntegEngStrt m_uw_b23p3 6 0.00 23.30133 FORMAT "%8.5" AXIS_PTS_REF EngStrt_mAirModIntegEngStrt06_Ax /end AXIS_DESCR
 /begin AXIS_DESCR COM_AXIS tmstesnswl temp_ub_q0p75_o48 8 -48.0 143.3 FORMAT "%5.1" AXIS_PTS_REF STI08ESUB /end AXIS_DESCR
/end CHARACTERISTIC
/begin CHARACTERISTIC ESNSWL_HOM_KL.KFWWLMTANS " / characteristic map weighting warm-up dependent on integrated air mass and intake air temperature" MAP 0x8053F904 RB_MapGroup_U8 1.992188 fak_ub_b2 0.00 1.992188 FORMAT "%8.6"
 /begin AXIS_DESCR COM_AXIS ExhMod_mAirMfIntegEngStrt m_uw_b23p3 6 0.00 23.30133 FORMAT "%8.5" AXIS_PTS_REF EngStrt_mAirModIntegEngStrt06_Ax /end AXIS_DESCR
 /begin AXIS_DESCR COM_AXIS tans_msg temp_ub_q0p75_o48 6 -48.0 143.3 FORMAT "%5.1" AXIS_PTS_REF EngStrt_tIntkAir06_Ax /end AXIS_DESCR
/end CHARACTERISTIC
/begin CHARACTERISTIC ESNSWL_HOM_KL.KLTANS " / characteristic curve dependent on intake air temperature" CURVE 0x8053F928 RB_CurveGroup_U8 0.9961 fak_ub_b1 0.00 0.9961
 /begin AXIS_DESCR COM_AXIS tans_msg temp_ub_q0p75_o48 6 -48.0 143.3 FORMAT "%5.1" AXIS_PTS_REF EngStrt_tIntkAir06_Ax /end AXIS_DESCR
/end CHARACTERISTIC
/begin CHARACTERISTIC ESNSWL_HOM_KL.ZDGZA1 " / Number of ignitions for decrease in range 1" VALUE 0x8053F92E RB_Val_Wu8 255.0 dez 0.00 255.0 FORMAT "%5.1" /end CHARACTERISTIC
/begin CHARACTERISTIC ESNSWL_HOM_KL.ZDGZA2 " / Number of ignitions for decrease in range 2" VALUE 0x8053F92F RB_Val_Wu8 255.0 dez 0.00 255.0 FORMAT "%5.1" /end CHARACTERISTIC
/begin CHARACTERISTIC ESNSWL_HOM_KL.ZDGZA3 " / Number of ignitions for decrease in range 3" VALUE 0x8053F930 RB_Val_Wu8 255.0 dez 0.00 255.0 FORMAT "%5.1" /end CHARACTERISTIC
/begin CHARACTERISTIC ESNSWL_HOM_KL.facAftStrtAltiLp_GT " / factor after start altitude lowpass" CURVE 0x8053F931 RB_CurveGroup_U8 3.984 fak_ub_b4 0.00 3.984 FORMAT "%5.3"
 /begin AXIS_DESCR COM_AXIS PEnv_facCorrAlti fak_uw_b4 8 0.00 3.999939 FORMAT "%8.6" AXIS_PTS_REF EngStrt_facAlti08_Ax /end AXIS_DESCR
/end CHARACTERISTIC
/begin CHARACTERISTIC ESNSWL_HOM_KL.facAftStrtCatHtg_GT " / factor after start cat heating" CURVE 0x8053F939 RB_CurveGroup_U8 3.984 fak_ub_b4 0.00 3.984 FORMAT "%5.3"
 /begin AXIS_DESCR COM_AXIS tmstesnswl temp_ub_q0p75_o48 12 -48.0 143.3 FORMAT "%5.1" AXIS_PTS_REF STI12ESUB /end AXIS_DESCR
/end CHARACTERISTIC
/begin CHARACTERISTIC ESNSWL_HOM_KL.facAftStrtHotStrt_GT " / factor after start hot start" MAP 0x8053F945 RB_MapGroup_U8 1.992188 fak_ub_b2 0.00 1.992188 FORMAT "%8.6"
 /begin AXIS_DESCR COM_AXIS tans_msg temp_ub_q0p75_o48 6 -48.0 143.3 FORMAT "%5.1" AXIS_PTS_REF EngStrt_tIntkAir06_Ax /end AXIS_DESCR
 /begin AXIS_DESCR COM_AXIS tmotesnswl temp_ub_q0p75_o48 12 -48.0 143.3 FORMAT "%5.1" AXIS_PTS_REF STC12ESUB /end AXIS_DESCR
/end CHARACTERISTIC
/begin CHARACTERISTIC ESNSWL_HOM_KL.facCurrAftStrtEth_GM " / base class ESNSWL factor after start ethanol" MAP 0x8053F98D RB_MapGroup_U8 3.984 fak_ub_b4 0.00 3.984 FORMAT "%5.3"
 /begin AXIS_DESCR COM_AXIS tmstesnswl temp_ub_q0p75_o48 12 -48.0 143.3 FORMAT "%5.1" AXIS_PTS_REF STI12ESUB /end AXIS_DESCR
 /begin AXIS_DESCR COM_AXIS FfPrm_facEthCurr fak_uw_b2 6 0.00 1.999969 FORMAT "%8.6" AXIS_PTS_REF EngStrt_facEthStoe09_Ax /end AXIS_DESCR
/end CHARACTERISTIC
/begin CHARACTERISTIC ESNSWL_HOM_KL.facCurrDernIgnSyncEth1_GM " / base class ESNSWL factor derating ignition synchronous for ethanol 1" MAP 0x8053F9D5 RB_MapGroup_U8 0.249023438 fak_ub_b0p25 0.00 0.249023438 FORMAT "%11.9"
 /begin AXIS_DESCR COM_AXIS tmstesnswl temp_ub_q0p75_o48 12 -48.0 143.3 FORMAT "%5.1" AXIS_PTS_REF STI12ESUB /end AXIS_DESCR
 /begin AXIS_DESCR COM_AXIS FfPrm_facEthCurr fak_uw_b2 6 0.00 1.999969 FORMAT "%8.6" AXIS_PTS_REF EngStrt_facEthStoe09_Ax /end AXIS_DESCR
/end CHARACTERISTIC
/begin CHARACTERISTIC ESNSWL_HOM_KL.facCurrDernIgnSyncEth2_GM " / base class ESNSWL factor derating ignition synchronous for ethanol 2" MAP 0x8053FA1D RB_MapGroup_U8 0.249023438 fak_ub_b0p25 0.00 0.249023438 FORMAT "%11.9"
 /begin AXIS_DESCR COM_AXIS tmstesnswl temp_ub_q0p75_o48 12 -48.0 143.3 FORMAT "%5.1" AXIS_PTS_REF STI12ESUB /end AXIS_DESCR
 /begin AXIS_DESCR COM_AXIS FfPrm_facEthCurr fak_uw_b2 6 0.00 1.999969 FORMAT "%8.6" AXIS_PTS_REF EngStrt_facEthStoe09_Ax /end AXIS_DESCR
/end CHARACTERISTIC
/begin CHARACTERISTIC ESNSWL_HOM_KL.facCurrDernIgnSyncEth3_GM " / base class ESNSWL factor derating ignition synchronous for ethanol 3" MAP 0x8053FA65 RB_MapGroup_U8 0.249023438 fak_ub_b0p25 0.00 0.249023438 FORMAT "%11.9"
 /begin AXIS_DESCR COM_AXIS tmstesnswl temp_ub_q0p75_o48 12 -48.0 143.3 FORMAT "%5.1" AXIS_PTS_REF STI12ESUB /end AXIS_DESCR
 /begin AXIS_DESCR COM_AXIS FfPrm_facEthCurr fak_uw_b2 6 0.00 1.999969 FORMAT "%8.6" AXIS_PTS_REF EngStrt_facEthStoe09_Ax /end AXIS_DESCR
/end CHARACTERISTIC
/begin CHARACTERISTIC ESNSWL_HOM_KL.facCurrDernSwtThdEth1_GM " / base class ESNSWLfactor derating switch threshold for ethanol1" MAP 0x8053FAAD RB_MapGroup_U8 1.992188 fak_ub_b2 0.00 1.992188 FORMAT "%8.6"
 /begin AXIS_DESCR COM_AXIS tmstesnswl temp_ub_q0p75_o48 12 -48.0 143.3 FORMAT "%5.1" AXIS_PTS_REF STI12ESUB /end AXIS_DESCR
 /begin AXIS_DESCR COM_AXIS FfPrm_facEthCurr fak_uw_b2 6 0.00 1.999969 FORMAT "%8.6" AXIS_PTS_REF EngStrt_facEthStoe09_Ax /end AXIS_DESCR
/end CHARACTERISTIC
/begin CHARACTERISTIC ESNSWL_HOM_KL.facCurrDernSwtThdEth2_GM " / base class ESNSWLfactor derating switch threshold for ethanol2" MAP 0x8053FAF5 RB_MapGroup_U8 1.992188 fak_ub_b2 0.00 1.992188 FORMAT "%8.6"
 /begin AXIS_DESCR COM_AXIS tmstesnswl temp_ub_q0p75_o48 12 -48.0 143.3 FORMAT "%5.1" AXIS_PTS_REF STI12ESUB /end AXIS_DESCR
 /begin AXIS_DESCR COM_AXIS FfPrm_facEthCurr fak_uw_b2 6 0.00 1.999969 FORMAT "%8.6" AXIS_PTS_REF EngStrt_facEthStoe09_Ax /end AXIS_DESCR
/end CHARACTERISTIC
/begin CHARACTERISTIC ESNSWL_HSP.FZANSSA1 " / factor for ignition synchronous decreasing of afterstart enrichment at hot start range 1" CURVE 0x8053FB44 RB_CurveGroup_U8 0.249023438 fak_ub_b0p25 0.00 0.249023438 FORMAT "%11.9"
 /begin AXIS_DESCR COM_AXIS tans_msg temp_ub_q0p75_o48 6 -48.0 143.3 FORMAT "%5.1" AXIS_PTS_REF EngStrt_tIntkAir06_Ax /end AXIS_DESCR
/end CHARACTERISTIC
/begin CHARACTERISTIC ESNSWL_HSP.FZANSSA2 " / factor for ignition synchronous decreasing of afterstart enrichment at hot start range 2" CURVE 0x8053FB4A RB_CurveGroup_U8 0.249023438 fak_ub_b0p25 0.00 0.249023438 FORMAT "%11.9"
 /begin AXIS_DESCR COM_AXIS tans_msg temp_ub_q0p75_o48 6 -48.0 143.3 FORMAT "%5.1" AXIS_PTS_REF EngStrt_tIntkAir06_Ax /end AXIS_DESCR
/end CHARACTERISTIC
/begin CHARACTERISTIC ESNSWL_HSP.KFFWL " / map warm-up factor" MAP 0x8053FB50 RB_MapGroup_U8 1.992188 fak_ub_b2 0.00 1.992188 FORMAT "%8.6"
 /begin AXIS_DESCR COM_AXIS tmotesnswl temp_ub_q0p75_o48 12 -48.0 143.3 FORMAT "%5.1" AXIS_PTS_REF STC12ESUB /end AXIS_DESCR
 /begin AXIS_DESCR COM_AXIS tmstesnswl temp_ub_q0p75_o48 12 -48.0 143.3 FORMAT "%5.1" AXIS_PTS_REF STI12ESUB /end AXIS_DESCR
/end CHARACTERISTIC
/begin CHARACTERISTIC ESNSWL_HSP.KFFWLETH " / characteristic map warm up factor for ethanol at HOM" MAP 0x8053FBE0 RB_MapGroup_U8 1.992188 fak_ub_b2 0.00 1.992188 FORMAT "%8.6"
 /begin AXIS_DESCR COM_AXIS tmotesnswl temp_ub_q0p75_o48 12 -48.0 143.3 FORMAT "%5.1" AXIS_PTS_REF STC12ESUB /end AXIS_DESCR
 /begin AXIS_DESCR COM_AXIS tmstesnswl temp_ub_q0p75_o48 12 -48.0 143.3 FORMAT "%5.1" AXIS_PTS_REF STI12ESUB /end AXIS_DESCR
/end CHARACTERISTIC
/begin CHARACTERISTIC ESNSWL_HSP.KFFWLLP " / characteristic map warm up factor for low pressure" MAP 0x8053FC70 RB_MapGroup_U8 1.992188 fak_ub_b2 0.00 1.992188 FORMAT "%8.6"
 /begin AXIS_DESCR COM_AXIS tmotesnswl temp_ub_q0p75_o48 12 -48.0 143.3 FORMAT "%5.1" AXIS_PTS_REF STC12ESUB /end AXIS_DESCR
 /begin AXIS_DESCR COM_AXIS tmstesnswl temp_ub_q0p75_o48 12 -48.0 143.3 FORMAT "%5.1" AXIS_PTS_REF STI12ESUB /end AXIS_DESCR
/end CHARACTERISTIC
/begin CHARACTERISTIC ESNSWL_HSP.KFFWLRL " / map warm-up factor load dependent fraction" MAP 0x8053FD00 RB_MapGroup_U8 1.992188 fak_ub_b2 0.00 1.992188 FORMAT "%8.6"
 /begin AXIS_DESCR COM_AXIS tmstesnswl temp_ub_q0p75_o48 8 -48.0 143.3 FORMAT "%5.1" AXIS_PTS_REF STI08ESUB /end AXIS_DESCR
 /begin AXIS_DESCR COM_AXIS rlp_w_msg rel_uw_q0p0234 6 0.00 1535.977 FORMAT "%8.3" AXIS_PTS_REF EngStrt_ratPrdcAir06_Ax /end AXIS_DESCR
/end CHARACTERISTIC
/begin CHARACTERISTIC ESNSWL_HSP.KFFWLRLETH " / map warm-up factor load dependent fraction at HOM with ethanol" MAP 0x8053FD30 RB_MapGroup_U8 1.992188 fak_ub_b2 0.00 1.992188 FORMAT "%8.6"
 /begin AXIS_DESCR COM_AXIS tmstesnswl temp_ub_q0p75_o48 8 -48.0 143.3 FORMAT "%5.1" AXIS_PTS_REF STI08ESUB /end AXIS_DESCR
 /begin AXIS_DESCR COM_AXIS rlp_w_msg rel_uw_q0p0234 6 0.00 1535.977 FORMAT "%8.3" AXIS_PTS_REF EngStrt_ratPrdcAir06_Ax /end AXIS_DESCR
/end CHARACTERISTIC
/begin CHARACTERISTIC ESNSWL_HSP.KFNSWRL " / weighting of afterstart enrichment" MAP 0x8053FD60 RB_MapGroup_U8 1.992188 fak_ub_b2 0.00 1.992188 FORMAT "%8.6"
 /begin AXIS_DESCR COM_AXIS tmstesnswl temp_ub_q0p75_o48 8 -48.0 143.3 FORMAT "%5.1" AXIS_PTS_REF STI08ESUB /end AXIS_DESCR
 /begin AXIS_DESCR COM_AXIS rlp_w_msg rel_uw_q0p0234 6 0.00 1535.977 FORMAT "%8.3" AXIS_PTS_REF EngStrt_ratPrdcAir06_Ax /end AXIS_DESCR
/end CHARACTERISTIC
/begin CHARACTERISTIC ESNSWL_HSP.KFNSWRL2 " / weighting of afterstart enrichment" MAP 0x8053FD90 RB_MapGroup_U8 1.992188 fak_ub_b2 0.00 1.992188 FORMAT "%8.6"
 /begin AXIS_DESCR COM_AXIS tmstesnswl temp_ub_q0p75_o48 8 -48.0 143.3 FORMAT "%5.1" AXIS_PTS_REF STI08ESUB /end AXIS_DESCR
 /begin AXIS_DESCR COM_AXIS rlp_w_msg rel_uw_q0p0234 6 0.00 1535.977 FORMAT "%8.3" AXIS_PTS_REF EngStrt_ratPrdcAir06_Ax /end AXIS_DESCR
/end CHARACTERISTIC
/begin CHARACTERISTIC ESNSWL_HSP.KFWWLML " / map weighting warm-up factor" MAP 0x8053FDC0 RB_MapGroup_U8 1.992188 fak_ub_b2 0.00 1.992188 FORMAT "%8.6"
 /begin AXIS_DESCR COM_AXIS ExhMod_mAirMfIntegEngStrt m_uw_b23p3 6 0.00 23.30133 FORMAT "%8.5" AXIS_PTS_REF EngStrt_mAirModIntegEngStrt06_Ax /end AXIS_DESCR
 /begin AXIS_DESCR COM_AXIS tmstesnswl temp_ub_q0p75_o48 8 -48.0 143.3 FORMAT "%5.1" AXIS_PTS_REF STI08ESUB /end AXIS_DESCR
/end CHARACTERISTIC
/begin CHARACTERISTIC ESNSWL_HSP.KFWWLMLETH " / characteristic map weighting warm-up with ethanol dependence" MAP 0x8053FDF0 RB_MapGroup_U8 1.992188 fak_ub_b2 0.00 1.992188 FORMAT "%8.6"
 /begin AXIS_DESCR COM_AXIS ExhMod_mAirMfIntegEngStrt m_uw_b23p3 6 0.00 23.30133 FORMAT "%8.5" AXIS_PTS_REF EngStrt_mAirModIntegEngStrt06_Ax /end AXIS_DESCR
 /begin AXIS_DESCR COM_AXIS tmstesnswl temp_ub_q0p75_o48 8 -48.0 143.3 FORMAT "%5.1" AXIS_PTS_REF STI08ESUB /end AXIS_DESCR
/end CHARACTERISTIC
/begin CHARACTERISTIC ESNSWL_HSP.KFWWLMTANS " / characteristic map weighting warm-up dependent on integrated air mass and intake air temperature" MAP 0x8053FE20 RB_MapGroup_U8 1.992188 fak_ub_b2 0.00 1.992188 FORMAT "%8.6"
 /begin AXIS_DESCR COM_AXIS ExhMod_mAirMfIntegEngStrt m_uw_b23p3 6 0.00 23.30133 FORMAT "%8.5" AXIS_PTS_REF EngStrt_mAirModIntegEngStrt06_Ax /end AXIS_DESCR
 /begin AXIS_DESCR COM_AXIS tans_msg temp_ub_q0p75_o48 6 -48.0 143.3 FORMAT "%5.1" AXIS_PTS_REF EngStrt_tIntkAir06_Ax /end AXIS_DESCR
/end CHARACTERISTIC
/begin CHARACTERISTIC ESNSWL_HSP.KLTANS " / characteristic curve dependent on intake air temperature" CURVE 0x8053FE44 RB_CurveGroup_U8 0.9961 fak_ub_b1 0.00 0.9961
 /begin AXIS_DESCR COM_AXIS tans_msg temp_ub_q0p75_o48 6 -48.0 143.3 FORMAT "%5.1" AXIS_PTS_REF EngStrt_tIntkAir06_Ax /end AXIS_DESCR
/end CHARACTERISTIC
/begin CHARACTERISTIC ESNSWL_HSP.ZDGZA1 " / Number of ignitions for decrease in range 1" VALUE 0x8053FE4A RB_Val_Wu8 255.0 dez 0.00 255.0 FORMAT "%5.1" /end CHARACTERISTIC
/begin CHARACTERISTIC ESNSWL_HSP.ZDGZA2 " / Number of ignitions for decrease in range 2" VALUE 0x8053FE4B RB_Val_Wu8 255.0 dez 0.00 255.0 FORMAT "%5.1" /end CHARACTERISTIC
/begin CHARACTERISTIC ESNSWL_HSP.ZDGZA3 " / Number of ignitions for decrease in range 3" VALUE 0x8053FE4C RB_Val_Wu8 255.0 dez 0.00 255.0 FORMAT "%5.1" /end CHARACTERISTIC
/begin CHARACTERISTIC ESNSWL_HSP.facAftStrtAltiLp_GT " / factor after start altitude lowpass" CURVE 0x8053FE4D RB_CurveGroup_U8 3.984 fak_ub_b4 0.00 3.984 FORMAT "%5.3"
 /begin AXIS_DESCR COM_AXIS PEnv_facCorrAlti fak_uw_b4 8 0.00 3.999939 FORMAT "%8.6" AXIS_PTS_REF EngStrt_facAlti08_Ax /end AXIS_DESCR
/end CHARACTERISTIC
/begin CHARACTERISTIC ESNSWL_HSP.facAftStrtCatHtg_GT " / factor after start cat heating" CURVE 0x8053FE55 RB_CurveGroup_U8 3.984 fak_ub_b4 0.00 3.984 FORMAT "%5.3"
 /begin AXIS_DESCR COM_AXIS tmstesnswl temp_ub_q0p75_o48 12 -48.0 143.3 FORMAT "%5.1" AXIS_PTS_REF STI12ESUB /end AXIS_DESCR
/end CHARACTERISTIC
/begin CHARACTERISTIC ESNSWL_HSP.facAftStrtHotStrt_GT " / factor after start hot start" MAP 0x8053FE61 RB_MapGroup_U8 1.992188 fak_ub_b2 0.00 1.992188 FORMAT "%8.6"
 /begin AXIS_DESCR COM_AXIS tans_msg temp_ub_q0p75_o48 6 -48.0 143.3 FORMAT "%5.1" AXIS_PTS_REF EngStrt_tIntkAir06_Ax /end AXIS_DESCR
 /begin AXIS_DESCR COM_AXIS tmotesnswl temp_ub_q0p75_o48 12 -48.0 143.3 FORMAT "%5.1" AXIS_PTS_REF STC12ESUB /end AXIS_DESCR
/end CHARACTERISTIC
/begin CHARACTERISTIC ESNSWL_HSP.facCurrAftStrtEth_GM " / base class ESNSWL factor after start ethanol" MAP 0x8053FEA9 RB_MapGroup_U8 3.984 fak_ub_b4 0.00 3.984 FORMAT "%5.3"
 /begin AXIS_DESCR COM_AXIS tmstesnswl temp_ub_q0p75_o48 12 -48.0 143.3 FORMAT "%5.1" AXIS_PTS_REF STI12ESUB /end AXIS_DESCR
 /begin AXIS_DESCR COM_AXIS FfPrm_facEthCurr fak_uw_b2 6 0.00 1.999969 FORMAT "%8.6" AXIS_PTS_REF EngStrt_facEthStoe09_Ax /end AXIS_DESCR
/end CHARACTERISTIC
/begin CHARACTERISTIC ESNSWL_HSP.facCurrDernIgnSyncEth1_GM " / base class ESNSWL factor derating ignition synchronous for ethanol 1" MAP 0x8053FEF1 RB_MapGroup_U8 0.249023438 fak_ub_b0p25 0.00 0.249023438 FORMAT "%11.9"
 /begin AXIS_DESCR COM_AXIS tmstesnswl temp_ub_q0p75_o48 12 -48.0 143.3 FORMAT "%5.1" AXIS_PTS_REF STI12ESUB /end AXIS_DESCR
 /begin AXIS_DESCR COM_AXIS FfPrm_facEthCurr fak_uw_b2 6 0.00 1.999969 FORMAT "%8.6" AXIS_PTS_REF EngStrt_facEthStoe09_Ax /end AXIS_DESCR
/end CHARACTERISTIC
/begin CHARACTERISTIC ESNSWL_HSP.facCurrDernIgnSyncEth2_GM " / base class ESNSWL factor derating ignition synchronous for ethanol 2" MAP 0x8053FF39 RB_MapGroup_U8 0.249023438 fak_ub_b0p25 0.00 0.249023438 FORMAT "%11.9"
 /begin AXIS_DESCR COM_AXIS tmstesnswl temp_ub_q0p75_o48 12 -48.0 143.3 FORMAT "%5.1" AXIS_PTS_REF STI12ESUB /end AXIS_DESCR
 /begin AXIS_DESCR COM_AXIS FfPrm_facEthCurr fak_uw_b2 6 0.00 1.999969 FORMAT "%8.6" AXIS_PTS_REF EngStrt_facEthStoe09_Ax /end AXIS_DESCR
/end CHARACTERISTIC
/begin CHARACTERISTIC ESNSWL_HSP.facCurrDernIgnSyncEth3_GM " / base class ESNSWL factor derating ignition synchronous for ethanol 3" MAP 0x8053FF81 RB_MapGroup_U8 0.249023438 fak_ub_b0p25 0.00 0.249023438 FORMAT "%11.9"
 /begin AXIS_DESCR COM_AXIS tmstesnswl temp_ub_q0p75_o48 12 -48.0 143.3 FORMAT "%5.1" AXIS_PTS_REF STI12ESUB /end AXIS_DESCR
 /begin AXIS_DESCR COM_AXIS FfPrm_facEthCurr fak_uw_b2 6 0.00 1.999969 FORMAT "%8.6" AXIS_PTS_REF EngStrt_facEthStoe09_Ax /end AXIS_DESCR
/end CHARACTERISTIC
/begin CHARACTERISTIC ESNSWL_HSP.facCurrDernSwtThdEth1_GM " / base class ESNSWLfactor derating switch threshold for ethanol1" MAP 0x8053FFC9 RB_MapGroup_U8 1.992188 fak_ub_b2 0.00 1.992188 FORMAT "%8.6"
 /begin AXIS_DESCR COM_AXIS tmstesnswl temp_ub_q0p75_o48 12 -48.0 143.3 FORMAT "%5.1" AXIS_PTS_REF STI12ESUB /end AXIS_DESCR
 /begin AXIS_DESCR COM_AXIS FfPrm_facEthCurr fak_uw_b2 6 0.00 1.999969 FORMAT "%8.6" AXIS_PTS_REF EngStrt_facEthStoe09_Ax /end AXIS_DESCR
/end CHARACTERISTIC
/begin CHARACTERISTIC ESNSWL_HSP.facCurrDernSwtThdEth2_GM " / base class ESNSWLfactor derating switch threshold for ethanol2" MAP 0x80540011 RB_MapGroup_U8 1.992188 fak_ub_b2 0.00 1.992188 FORMAT "%8.6"
 /begin AXIS_DESCR COM_AXIS tmstesnswl temp_ub_q0p75_o48 12 -48.0 143.3 FORMAT "%5.1" AXIS_PTS_REF STI12ESUB /end AXIS_DESCR
 /begin AXIS_DESCR COM_AXIS FfPrm_facEthCurr fak_uw_b2 6 0.00 1.999969 FORMAT "%8.6" AXIS_PTS_REF EngStrt_facEthStoe09_Ax /end AXIS_DESCR
/end CHARACTERISTIC
/begin CHARACTERISTIC ESNSWL_HSP_KL.FZANSSA1 " / factor for ignition synchronous decreasing of afterstart enrichment at hot start range 1" CURVE 0x80540060 RB_CurveGroup_U8 0.249023438 fak_ub_b0p25 0.00 0.249023438 FORMAT "%11.9"
 /begin AXIS_DESCR COM_AXIS tans_msg temp_ub_q0p75_o48 6 -48.0 143.3 FORMAT "%5.1" AXIS_PTS_REF EngStrt_tIntkAir06_Ax /end AXIS_DESCR
/end CHARACTERISTIC
/begin CHARACTERISTIC ESNSWL_HSP_KL.FZANSSA2 " / factor for ignition synchronous decreasing of afterstart enrichment at hot start range 2" CURVE 0x80540066 RB_CurveGroup_U8 0.249023438 fak_ub_b0p25 0.00 0.249023438 FORMAT "%11.9"
 /begin AXIS_DESCR COM_AXIS tans_msg temp_ub_q0p75_o48 6 -48.0 143.3 FORMAT "%5.1" AXIS_PTS_REF EngStrt_tIntkAir06_Ax /end AXIS_DESCR
/end CHARACTERISTIC
/begin CHARACTERISTIC ESNSWL_HSP_KL.KFFWL " / map warm-up factor" MAP 0x8054006C RB_MapGroup_U8 1.992188 fak_ub_b2 0.00 1.992188 FORMAT "%8.6"
 /begin AXIS_DESCR COM_AXIS tmotesnswl temp_ub_q0p75_o48 12 -48.0 143.3 FORMAT "%5.1" AXIS_PTS_REF STC12ESUB /end AXIS_DESCR
 /begin AXIS_DESCR COM_AXIS tmstesnswl temp_ub_q0p75_o48 12 -48.0 143.3 FORMAT "%5.1" AXIS_PTS_REF STI12ESUB /end AXIS_DESCR
/end CHARACTERISTIC
/begin CHARACTERISTIC ESNSWL_HSP_KL.KFFWLETH " / characteristic map warm up factor for ethanol at HOM" MAP 0x805400FC RB_MapGroup_U8 1.992188 fak_ub_b2 0.00 1.992188 FORMAT "%8.6"
 /begin AXIS_DESCR COM_AXIS tmotesnswl temp_ub_q0p75_o48 12 -48.0 143.3 FORMAT "%5.1" AXIS_PTS_REF STC12ESUB /end AXIS_DESCR
 /begin AXIS_DESCR COM_AXIS tmstesnswl temp_ub_q0p75_o48 12 -48.0 143.3 FORMAT "%5.1" AXIS_PTS_REF STI12ESUB /end AXIS_DESCR
/end CHARACTERISTIC
/begin CHARACTERISTIC ESNSWL_HSP_KL.KFFWLLP " / characteristic map warm up factor for low pressure" MAP 0x8054018C RB_MapGroup_U8 1.992188 fak_ub_b2 0.00 1.992188 FORMAT "%8.6"
 /begin AXIS_DESCR COM_AXIS tmotesnswl temp_ub_q0p75_o48 12 -48.0 143.3 FORMAT "%5.1" AXIS_PTS_REF STC12ESUB /end AXIS_DESCR
 /begin AXIS_DESCR COM_AXIS tmstesnswl temp_ub_q0p75_o48 12 -48.0 143.3 FORMAT "%5.1" AXIS_PTS_REF STI12ESUB /end AXIS_DESCR
/end CHARACTERISTIC
/begin CHARACTERISTIC ESNSWL_HSP_KL.KFFWLRL " / map warm-up factor load dependent fraction" MAP 0x8054021C RB_MapGroup_U8 1.992188 fak_ub_b2 0.00 1.992188 FORMAT "%8.6"
 /begin AXIS_DESCR COM_AXIS tmstesnswl temp_ub_q0p75_o48 8 -48.0 143.3 FORMAT "%5.1" AXIS_PTS_REF STI08ESUB /end AXIS_DESCR
 /begin AXIS_DESCR COM_AXIS rlp_w_msg rel_uw_q0p0234 6 0.00 1535.977 FORMAT "%8.3" AXIS_PTS_REF EngStrt_ratPrdcAir06_Ax /end AXIS_DESCR
/end CHARACTERISTIC
/begin CHARACTERISTIC ESNSWL_HSP_KL.KFFWLRLETH " / map warm-up factor load dependent fraction at HOM with ethanol" MAP 0x8054024C RB_MapGroup_U8 1.992188 fak_ub_b2 0.00 1.992188 FORMAT "%8.6"
 /begin AXIS_DESCR COM_AXIS tmstesnswl temp_ub_q0p75_o48 8 -48.0 143.3 FORMAT "%5.1" AXIS_PTS_REF STI08ESUB /end AXIS_DESCR
 /begin AXIS_DESCR COM_AXIS rlp_w_msg rel_uw_q0p0234 6 0.00 1535.977 FORMAT "%8.3" AXIS_PTS_REF EngStrt_ratPrdcAir06_Ax /end AXIS_DESCR
/end CHARACTERISTIC
/begin CHARACTERISTIC ESNSWL_HSP_KL.KFNSWRL " / weighting of afterstart enrichment" MAP 0x8054027C RB_MapGroup_U8 1.992188 fak_ub_b2 0.00 1.992188 FORMAT "%8.6"
 /begin AXIS_DESCR COM_AXIS tmstesnswl temp_ub_q0p75_o48 8 -48.0 143.3 FORMAT "%5.1" AXIS_PTS_REF STI08ESUB /end AXIS_DESCR
 /begin AXIS_DESCR COM_AXIS rlp_w_msg rel_uw_q0p0234 6 0.00 1535.977 FORMAT "%8.3" AXIS_PTS_REF EngStrt_ratPrdcAir06_Ax /end AXIS_DESCR
/end CHARACTERISTIC
/begin CHARACTERISTIC ESNSWL_HSP_KL.KFNSWRL2 " / weighting of afterstart enrichment" MAP 0x805402AC RB_MapGroup_U8 1.992188 fak_ub_b2 0.00 1.992188 FORMAT "%8.6"
 /begin AXIS_DESCR COM_AXIS tmstesnswl temp_ub_q0p75_o48 8 -48.0 143.3 FORMAT "%5.1" AXIS_PTS_REF STI08ESUB /end AXIS_DESCR
 /begin AXIS_DESCR COM_AXIS rlp_w_msg rel_uw_q0p0234 6 0.00 1535.977 FORMAT "%8.3" AXIS_PTS_REF EngStrt_ratPrdcAir06_Ax /end AXIS_DESCR
/end CHARACTERISTIC
/begin CHARACTERISTIC ESNSWL_HSP_KL.KFWWLML " / map weighting warm-up factor" MAP 0x805402DC RB_MapGroup_U8 1.992188 fak_ub_b2 0.00 1.992188 FORMAT "%8.6"
 /begin AXIS_DESCR COM_AXIS ExhMod_mAirMfIntegEngStrt m_uw_b23p3 6 0.00 23.30133 FORMAT "%8.5" AXIS_PTS_REF EngStrt_mAirModIntegEngStrt06_Ax /end AXIS_DESCR
 /begin AXIS_DESCR COM_AXIS tmstesnswl temp_ub_q0p75_o48 8 -48.0 143.3 FORMAT "%5.1" AXIS_PTS_REF STI08ESUB /end AXIS_DESCR
/end CHARACTERISTIC
/begin CHARACTERISTIC ESNSWL_HSP_KL.KFWWLMLETH " / characteristic map weighting warm-up with ethanol dependence" MAP 0x8054030C RB_MapGroup_U8 1.992188 fak_ub_b2 0.00 1.992188 FORMAT "%8.6"
 /begin AXIS_DESCR COM_AXIS ExhMod_mAirMfIntegEngStrt m_uw_b23p3 6 0.00 23.30133 FORMAT "%8.5" AXIS_PTS_REF EngStrt_mAirModIntegEngStrt06_Ax /end AXIS_DESCR
 /begin AXIS_DESCR COM_AXIS tmstesnswl temp_ub_q0p75_o48 8 -48.0 143.3 FORMAT "%5.1" AXIS_PTS_REF STI08ESUB /end AXIS_DESCR
/end CHARACTERISTIC
/begin CHARACTERISTIC ESNSWL_HSP_KL.KFWWLMTANS " / characteristic map weighting warm-up dependent on integrated air mass and intake air temperature" MAP 0x8054033C RB_MapGroup_U8 1.992188 fak_ub_b2 0.00 1.992188 FORMAT "%8.6"
 /begin AXIS_DESCR COM_AXIS ExhMod_mAirMfIntegEngStrt m_uw_b23p3 6 0.00 23.30133 FORMAT "%8.5" AXIS_PTS_REF EngStrt_mAirModIntegEngStrt06_Ax /end AXIS_DESCR
 /begin AXIS_DESCR COM_AXIS tans_msg temp_ub_q0p75_o48 6 -48.0 143.3 FORMAT "%5.1" AXIS_PTS_REF EngStrt_tIntkAir06_Ax /end AXIS_DESCR
/end CHARACTERISTIC
/begin CHARACTERISTIC ESNSWL_HSP_KL.KLTANS " / characteristic curve dependent on intake air temperature" CURVE 0x80540360 RB_CurveGroup_U8 0.9961 fak_ub_b1 0.00 0.9961
 /begin AXIS_DESCR COM_AXIS tans_msg temp_ub_q0p75_o48 6 -48.0 143.3 FORMAT "%5.1" AXIS_PTS_REF EngStrt_tIntkAir06_Ax /end AXIS_DESCR
/end CHARACTERISTIC
/begin CHARACTERISTIC ESNSWL_HSP_KL.ZDGZA1 " / Number of ignitions for decrease in range 1" VALUE 0x80540366 RB_Val_Wu8 255.0 dez 0.00 255.0 FORMAT "%5.1" /end CHARACTERISTIC
/begin CHARACTERISTIC ESNSWL_HSP_KL.ZDGZA2 " / Number of ignitions for decrease in range 2" VALUE 0x80540367 RB_Val_Wu8 255.0 dez 0.00 255.0 FORMAT "%5.1" /end CHARACTERISTIC
/begin CHARACTERISTIC ESNSWL_HSP_KL.ZDGZA3 " / Number of ignitions for decrease in range 3" VALUE 0x80540368 RB_Val_Wu8 255.0 dez 0.00 255.0 FORMAT "%5.1" /end CHARACTERISTIC
/begin CHARACTERISTIC ESNSWL_HSP_KL.facAftStrtAltiLp_GT " / factor after start altitude lowpass" CURVE 0x80540369 RB_CurveGroup_U8 3.984 fak_ub_b4 0.00 3.984 FORMAT "%5.3"
 /begin AXIS_DESCR COM_AXIS PEnv_facCorrAlti fak_uw_b4 8 0.00 3.999939 FORMAT "%8.6" AXIS_PTS_REF EngStrt_facAlti08_Ax /end AXIS_DESCR
/end CHARACTERISTIC
/begin CHARACTERISTIC ESNSWL_HSP_KL.facAftStrtCatHtg_GT " / factor after start cat heating" CURVE 0x80540371 RB_CurveGroup_U8 3.984 fak_ub_b4 0.00 3.984 FORMAT "%5.3"
 /begin AXIS_DESCR COM_AXIS tmstesnswl temp_ub_q0p75_o48 12 -48.0 143.3 FORMAT "%5.1" AXIS_PTS_REF STI12ESUB /end AXIS_DESCR
/end CHARACTERISTIC
/begin CHARACTERISTIC ESNSWL_HSP_KL.facAftStrtHotStrt_GT " / factor after start hot start" MAP 0x8054037D RB_MapGroup_U8 1.992188 fak_ub_b2 0.00 1.992188 FORMAT "%8.6"
 /begin AXIS_DESCR COM_AXIS tans_msg temp_ub_q0p75_o48 6 -48.0 143.3 FORMAT "%5.1" AXIS_PTS_REF EngStrt_tIntkAir06_Ax /end AXIS_DESCR
 /begin AXIS_DESCR COM_AXIS tmotesnswl temp_ub_q0p75_o48 12 -48.0 143.3 FORMAT "%5.1" AXIS_PTS_REF STC12ESUB /end AXIS_DESCR
/end CHARACTERISTIC
/begin CHARACTERISTIC ESNSWL_HSP_KL.facCurrAftStrtEth_GM " / base class ESNSWL factor after start ethanol" MAP 0x805403C5 RB_MapGroup_U8 3.984 fak_ub_b4 0.00 3.984 FORMAT "%5.3"
 /begin AXIS_DESCR COM_AXIS tmstesnswl temp_ub_q0p75_o48 12 -48.0 143.3 FORMAT "%5.1" AXIS_PTS_REF STI12ESUB /end AXIS_DESCR
 /begin AXIS_DESCR COM_AXIS FfPrm_facEthCurr fak_uw_b2 6 0.00 1.999969 FORMAT "%8.6" AXIS_PTS_REF EngStrt_facEthStoe09_Ax /end AXIS_DESCR
/end CHARACTERISTIC
/begin CHARACTERISTIC ESNSWL_HSP_KL.facCurrDernIgnSyncEth1_GM " / base class ESNSWL factor derating ignition synchronous for ethanol 1" MAP 0x8054040D RB_MapGroup_U8 0.249023438 fak_ub_b0p25 0.00 0.249023438 FORMAT "%11.9"
 /begin AXIS_DESCR COM_AXIS tmstesnswl temp_ub_q0p75_o48 12 -48.0 143.3 FORMAT "%5.1" AXIS_PTS_REF STI12ESUB /end AXIS_DESCR
 /begin AXIS_DESCR COM_AXIS FfPrm_facEthCurr fak_uw_b2 6 0.00 1.999969 FORMAT "%8.6" AXIS_PTS_REF EngStrt_facEthStoe09_Ax /end AXIS_DESCR
/end CHARACTERISTIC
/begin CHARACTERISTIC ESNSWL_HSP_KL.facCurrDernIgnSyncEth2_GM " / base class ESNSWL factor derating ignition synchronous for ethanol 2" MAP 0x80540455 RB_MapGroup_U8 0.249023438 fak_ub_b0p25 0.00 0.249023438 FORMAT "%11.9"
 /begin AXIS_DESCR COM_AXIS tmstesnswl temp_ub_q0p75_o48 12 -48.0 143.3 FORMAT "%5.1" AXIS_PTS_REF STI12ESUB /end AXIS_DESCR
 /begin AXIS_DESCR COM_AXIS FfPrm_facEthCurr fak_uw_b2 6 0.00 1.999969 FORMAT "%8.6" AXIS_PTS_REF EngStrt_facEthStoe09_Ax /end AXIS_DESCR
/end CHARACTERISTIC
/begin CHARACTERISTIC ESNSWL_HSP_KL.facCurrDernIgnSyncEth3_GM " / base class ESNSWL factor derating ignition synchronous for ethanol 3" MAP 0x8054049D RB_MapGroup_U8 0.249023438 fak_ub_b0p25 0.00 0.249023438 FORMAT "%11.9"
 /begin AXIS_DESCR COM_AXIS tmstesnswl temp_ub_q0p75_o48 12 -48.0 143.3 FORMAT "%5.1" AXIS_PTS_REF STI12ESUB /end AXIS_DESCR
 /begin AXIS_DESCR COM_AXIS FfPrm_facEthCurr fak_uw_b2 6 0.00 1.999969 FORMAT "%8.6" AXIS_PTS_REF EngStrt_facEthStoe09_Ax /end AXIS_DESCR
/end CHARACTERISTIC
/begin CHARACTERISTIC ESNSWL_HSP_KL.facCurrDernSwtThdEth1_GM " / base class ESNSWLfactor derating switch threshold for ethanol1" MAP 0x805404E5 RB_MapGroup_U8 1.992188 fak_ub_b2 0.00 1.992188 FORMAT "%8.6"
 /begin AXIS_DESCR COM_AXIS tmstesnswl temp_ub_q0p75_o48 12 -48.0 143.3 FORMAT "%5.1" AXIS_PTS_REF STI12ESUB /end AXIS_DESCR
 /begin AXIS_DESCR COM_AXIS FfPrm_facEthCurr fak_uw_b2 6 0.00 1.999969 FORMAT "%8.6" AXIS_PTS_REF EngStrt_facEthStoe09_Ax /end AXIS_DESCR
/end CHARACTERISTIC
/begin CHARACTERISTIC ESNSWL_HSP_KL.facCurrDernSwtThdEth2_GM " / base class ESNSWLfactor derating switch threshold for ethanol2" MAP 0x8054052D RB_MapGroup_U8 1.992188 fak_ub_b2 0.00 1.992188 FORMAT "%8.6"
 /begin AXIS_DESCR COM_AXIS tmstesnswl temp_ub_q0p75_o48 12 -48.0 143.3 FORMAT "%5.1" AXIS_PTS_REF STI12ESUB /end AXIS_DESCR
 /begin AXIS_DESCR COM_AXIS FfPrm_facEthCurr fak_uw_b2 6 0.00 1.999969 FORMAT "%8.6" AXIS_PTS_REF EngStrt_facEthStoe09_Ax /end AXIS_DESCR
/end CHARACTERISTIC
/begin CHARACTERISTIC ESSTT_ALTI.facEnchmtCorrnAltiFlexFu_GM "Altitude Class of function ESSTT (Fuel enrichment during start) / weighting of engine start-factor depending on altitude" MAP 0x80541908 RB_MapGroup_U8 1.992188 fak_ub_b2 0.00 1.992188 FORMAT "%8.6"
 /begin AXIS_DESCR COM_AXIS EngStrt_tStrtCoor Temp_Cels 12 -273.140 3003.560 FORMAT "%8.3" EXTENDED_LIMITS -3549.940 3003.560 AXIS_PTS_REF EngStrt_tStrtEsstt12_Ax /end AXIS_DESCR
 /begin AXIS_DESCR COM_AXIS ESSTT_facCorrnAlti fak_uw_b4 4 0.00 3.999939 FORMAT "%8.6" AXIS_PTS_REF EngStrt_facCorrnAlti_AX /end AXIS_DESCR
/end CHARACTERISTIC
/begin CHARACTERISTIC ESSTT_ALTI.facEnchmtCorrnAlti_GM "Altitude Class of function ESSTT (Fuel enrichment during start) / weighting of engine start-factor depending on altitude" MAP 0x80541938 RB_MapGroup_U8 1.992188 fak_ub_b2 0.00 1.992188 FORMAT "%8.6"
 /begin AXIS_DESCR COM_AXIS EngStrt_tStrtCoor Temp_Cels 12 -273.140 3003.560 FORMAT "%8.3" EXTENDED_LIMITS -3549.940 3003.560 AXIS_PTS_REF EngStrt_tStrtEsstt12_Ax /end AXIS_DESCR
 /begin AXIS_DESCR COM_AXIS ESSTT_facCorrnAlti fak_uw_b4 4 0.00 3.999939 FORMAT "%8.6" AXIS_PTS_REF EngStrt_facCorrnAlti_AX /end AXIS_DESCR
/end CHARACTERISTIC
/begin CHARACTERISTIC ESSTT_ALTI_2.facEnchmtCorrnAltiFlexFu_GM "ESSTT altitude class / weighting of engine start-factor depending on altitude" MAP 0x8054109C RB_MapGroup_U8 1.992188 fak_ub_b2 0.00 1.992188 FORMAT "%8.6"
 /begin AXIS_DESCR COM_AXIS EngStrt_tStrtCoor Temp_Cels 12 -273.140 3003.560 FORMAT "%8.3" EXTENDED_LIMITS -3549.940 3003.560 AXIS_PTS_REF EngStrt_tStrtEsstt12_Ax /end AXIS_DESCR
 /begin AXIS_DESCR COM_AXIS ESSTT_facCorrnAlti fak_uw_b4 4 0.00 3.999939 FORMAT "%8.6" AXIS_PTS_REF EngStrt_facCorrnAlti_AX /end AXIS_DESCR
/end CHARACTERISTIC
/begin CHARACTERISTIC ESSTT_ALTI_2.facEnchmtCorrnAlti_GM "ESSTT altitude class / weighting of engine start-factor depending on altitude" MAP 0x805410CC RB_MapGroup_U8 1.992188 fak_ub_b2 0.00 1.992188 FORMAT "%8.6"
 /begin AXIS_DESCR COM_AXIS EngStrt_tStrtCoor Temp_Cels 12 -273.140 3003.560 FORMAT "%8.3" EXTENDED_LIMITS -3549.940 3003.560 AXIS_PTS_REF EngStrt_tStrtEsstt12_Ax /end AXIS_DESCR
 /begin AXIS_DESCR COM_AXIS ESSTT_facCorrnAlti fak_uw_b4 4 0.00 3.999939 FORMAT "%8.6" AXIS_PTS_REF EngStrt_facCorrnAlti_AX /end AXIS_DESCR
/end CHARACTERISTIC
/begin CHARACTERISTIC ESSTT_ALTI_3.facEnchmtCorrnAltiFlexFu_GM "ESSTT altitude class / weighting of engine start-factor depending on altitude" MAP 0x80541100 RB_MapGroup_U8 1.992188 fak_ub_b2 0.00 1.992188 FORMAT "%8.6"
 /begin AXIS_DESCR COM_AXIS EngStrt_tStrtCoor Temp_Cels 12 -273.140 3003.560 FORMAT "%8.3" EXTENDED_LIMITS -3549.940 3003.560 AXIS_PTS_REF EngStrt_tStrtEsstt12_Ax /end AXIS_DESCR
 /begin AXIS_DESCR COM_AXIS ESSTT_facCorrnAlti fak_uw_b4 4 0.00 3.999939 FORMAT "%8.6" AXIS_PTS_REF EngStrt_facCorrnAlti_AX /end AXIS_DESCR
/end CHARACTERISTIC
/begin CHARACTERISTIC ESSTT_ALTI_3.facEnchmtCorrnAlti_GM "ESSTT altitude class / weighting of engine start-factor depending on altitude" MAP 0x80541130 RB_MapGroup_U8 1.992188 fak_ub_b2 0.00 1.992188 FORMAT "%8.6"
 /begin AXIS_DESCR COM_AXIS EngStrt_tStrtCoor Temp_Cels 12 -273.140 3003.560 FORMAT "%8.3" EXTENDED_LIMITS -3549.940 3003.560 AXIS_PTS_REF EngStrt_tStrtEsstt12_Ax /end AXIS_DESCR
 /begin AXIS_DESCR COM_AXIS ESSTT_facCorrnAlti fak_uw_b4 4 0.00 3.999939 FORMAT "%8.6" AXIS_PTS_REF EngStrt_facCorrnAlti_AX /end AXIS_DESCR
/end CHARACTERISTIC
/begin CHARACTERISTIC ESSTT_DIRST.facStrtCorrNrInjAgDrctStrtEth_GM "class direct start / Map factor start correction number injection start angle for Ethanol" MAP 0x8054196C RB_MapGroup_U8 1.992188 fak_ub_b2 0.00 1.992188 FORMAT "%8.6"
 /begin AXIS_DESCR COM_AXIS anztib_msg dez 3 0.00 255.0 FORMAT "%5.1" AXIS_PTS_REF EngStrt_nrInjEsstt03_Ax /end AXIS_DESCR
 /begin AXIS_DESCR COM_AXIS wdirst_msg kw_q2 3 0.00 510.0 FORMAT "%5.1" AXIS_PTS_REF EngStrt_agDrctStrtEsstt03_Ax /end AXIS_DESCR
/end CHARACTERISTIC
/begin CHARACTERISTIC ESSTT_DIRST.facStrtCorrNrInjAgDrctStrt_GM "class direct start / factor start correction number injection angle start" MAP 0x80541975 RB_MapGroup_U8 1.992188 fak_ub_b2 0.00 1.992188 FORMAT "%8.6"
 /begin AXIS_DESCR COM_AXIS anztib_msg dez 3 0.00 255.0 FORMAT "%5.1" AXIS_PTS_REF EngStrt_nrInjEsstt03_Ax /end AXIS_DESCR
 /begin AXIS_DESCR COM_AXIS wdirst_msg kw_q2 3 0.00 510.0 FORMAT "%5.1" AXIS_PTS_REF EngStrt_agDrctStrtEsstt03_Ax /end AXIS_DESCR
/end CHARACTERISTIC
/begin CHARACTERISTIC ESSTT_DIRST.facStrtCorrRstrtTStrtEth_GM "class direct start / Map correction restart for Ethanol" MAP 0x8054197E RB_MapGroup_U8 1.992188 fak_ub_b2 0.00 1.992188 FORMAT "%8.6"
 /begin AXIS_DESCR COM_AXIS ESSTT_tiEngOff t_q1 4 0.00 65535.00 FORMAT "%8.2" AXIS_PTS_REF EngStrt_tiEngStopEssttEth04_Ax /end AXIS_DESCR
 /begin AXIS_DESCR COM_AXIS EngStrt_tStrtCoor Temp_Cels 12 -273.140 3003.560 FORMAT "%8.3" EXTENDED_LIMITS -3549.940 3003.560 AXIS_PTS_REF EngStrt_tStrtEssttEth12_Ax /end AXIS_DESCR
/end CHARACTERISTIC
/begin CHARACTERISTIC ESSTT_DIRST.facStrtCorrRstrtTStrt_GM "class direct start / correction restart" MAP 0x805419AE RB_MapGroup_U8 1.992188 fak_ub_b2 0.00 1.992188 FORMAT "%8.6"
 /begin AXIS_DESCR COM_AXIS ESSTT_tiEngOff t_q1 6 0.00 65535.00 FORMAT "%8.2" AXIS_PTS_REF EngStrt_tiEngStopEsstt04_Ax /end AXIS_DESCR
 /begin AXIS_DESCR COM_AXIS EngStrt_tStrtCoor Temp_Cels 12 -273.140 3003.560 FORMAT "%8.3" EXTENDED_LIMITS -3549.940 3003.560 AXIS_PTS_REF EngStrt_tStrtEsstt12_Ax /end AXIS_DESCR
/end CHARACTERISTIC
/begin CHARACTERISTIC ESSTT_DIRST.facStrtTStrtFacEth_GM "class direct start / correction ethanol" MAP 0x805419F6 RB_MapGroup_U16 63.99902 fak_uw_b64 0.00 63.99902 FORMAT "%8.5"
 /begin AXIS_DESCR COM_AXIS EngStrt_tStrtCoor Temp_Cels 12 -273.140 3003.560 FORMAT "%8.3" EXTENDED_LIMITS -3549.940 3003.560 AXIS_PTS_REF EngStrt_tStrtEssttEth12_Ax /end AXIS_DESCR
 /begin AXIS_DESCR COM_AXIS fethffv fak_ub_b1 6 0.00 0.9961 AXIS_PTS_REF EngStrt_facEthEsstt06_Ax /end AXIS_DESCR
/end CHARACTERISTIC
/begin CHARACTERISTIC ESSTT_DIRST.facStrtTStrtNrInjStrtEth_GM "class direct start / factor start ethanol correction number injections start temp" MAP 0x80541A86 RB_MapGroup_U8 3.984 fak_ub_b4 0.00 3.984 FORMAT "%5.3"
 /begin AXIS_DESCR COM_AXIS EngStrt_tStrtCoor Temp_Cels 12 -273.140 3003.560 FORMAT "%8.3" EXTENDED_LIMITS -3549.940 3003.560 AXIS_PTS_REF EngStrt_tStrtEssttEth12_Ax /end AXIS_DESCR
 /begin AXIS_DESCR COM_AXIS anztist dez 14 0.00 255.0 FORMAT "%5.1" AXIS_PTS_REF EngStrt_nrInjStrtEsstt14_Ax /end AXIS_DESCR
/end CHARACTERISTIC
/begin CHARACTERISTIC ESSTT_DIRST.facStrtTStrtNrInjStrt_GM "class direct start / factor start correction number injections start temperature" MAP 0x80541B2E RB_MapGroup_U8 1.992188 fak_ub_b2 0.00 1.992188 FORMAT "%8.6"
 /begin AXIS_DESCR COM_AXIS EngStrt_tStrtCoor Temp_Cels 12 -273.140 3003.560 FORMAT "%8.3" EXTENDED_LIMITS -3549.940 3003.560 AXIS_PTS_REF EngStrt_tStrtEsstt12_Ax /end AXIS_DESCR
 /begin AXIS_DESCR COM_AXIS anztist dez 14 0.00 255.0 FORMAT "%5.1" AXIS_PTS_REF EngStrt_nrInjStrtEsstt14_Ax /end AXIS_DESCR
/end CHARACTERISTIC
/begin CHARACTERISTIC ESSTT_DIRST.facStrtTStrtPFildRail_GM "class direct start / Group map factor for rail pressure" MAP 0x80541BD6 RB_MapGroup_U16 63.99902 fak_uw_b64 0.00 63.99902 FORMAT "%8.5"
 /begin AXIS_DESCR COM_AXIS EngStrt_tStrtCoor Temp_Cels 12 -273.140 3003.560 FORMAT "%8.3" EXTENDED_LIMITS -3549.940 3003.560 AXIS_PTS_REF EngStrt_tStrtEsstt12_Ax /end AXIS_DESCR
 /begin AXIS_DESCR COM_AXIS FuPHi_pRail RBPtCel_p_0p002_1 2 0.00 131.0700 FORMAT "%8.4" AXIS_PTS_REF EngStrt_pFildRailEsstt02_Ax /end AXIS_DESCR
/end CHARACTERISTIC
/begin CHARACTERISTIC ESSTT_HDST.facStrtCorrRstrtTStrtEth_GM "base class of function ESSTT (Fuel enrichment during start) / correction restart for ethanol" MAP 0x80541C0C RB_MapGroup_U8 1.992188 fak_ub_b2 0.00 1.992188 FORMAT "%8.6"
 /begin AXIS_DESCR COM_AXIS ESSTT_tiEngOff t_q1 4 0.00 65535.00 FORMAT "%8.2" AXIS_PTS_REF EngStrt_tiEngStopEssttEth04_Ax /end AXIS_DESCR
 /begin AXIS_DESCR COM_AXIS EngStrt_tStrtCoor Temp_Cels 12 -273.140 3003.560 FORMAT "%8.3" EXTENDED_LIMITS -3549.940 3003.560 AXIS_PTS_REF EngStrt_tStrtEssttEth12_Ax /end AXIS_DESCR
/end CHARACTERISTIC
/begin CHARACTERISTIC ESSTT_HDST.facStrtCorrRstrtTStrt_GM "base class of function ESSTT (Fuel enrichment during start) / correction restart" MAP 0x80541C3C RB_MapGroup_U8 1.992188 fak_ub_b2 0.00 1.992188 FORMAT "%8.6"
 /begin AXIS_DESCR COM_AXIS ESSTT_tiEngOff t_q1 6 0.00 65535.00 FORMAT "%8.2" AXIS_PTS_REF EngStrt_tiEngStopEsstt04_Ax /end AXIS_DESCR
 /begin AXIS_DESCR COM_AXIS EngStrt_tStrtCoor Temp_Cels 12 -273.140 3003.560 FORMAT "%8.3" EXTENDED_LIMITS -3549.940 3003.560 AXIS_PTS_REF EngStrt_tStrtEsstt12_Ax /end AXIS_DESCR
/end CHARACTERISTIC
/begin CHARACTERISTIC ESSTT_HDST.facStrtTStrtFacEth_GM "base class of function ESSTT (Fuel enrichment during start) / correction ethanol" MAP 0x80541C84 RB_MapGroup_U16 63.99902 fak_uw_b64 0.00 63.99902 FORMAT "%8.5"
 /begin AXIS_DESCR COM_AXIS EngStrt_tStrtCoor Temp_Cels 12 -273.140 3003.560 FORMAT "%8.3" EXTENDED_LIMITS -3549.940 3003.560 AXIS_PTS_REF EngStrt_tStrtEssttEth12_Ax /end AXIS_DESCR
 /begin AXIS_DESCR COM_AXIS fethffv fak_ub_b1 6 0.00 0.9961 AXIS_PTS_REF EngStrt_facEthEsstt06_Ax /end AXIS_DESCR
/end CHARACTERISTIC
/begin CHARACTERISTIC ESSTT_HDST.facStrtTStrtNrInjStrtEth_GM "base class of function ESSTT (Fuel enrichment during start) / factor start ethanol correction number injections start temp" MAP 0x80541D14 RB_MapGroup_U8 3.984 fak_ub_b4 0.00 3.984 FORMAT "%5.3"
 /begin AXIS_DESCR COM_AXIS EngStrt_tStrtCoor Temp_Cels 12 -273.140 3003.560 FORMAT "%8.3" EXTENDED_LIMITS -3549.940 3003.560 AXIS_PTS_REF EngStrt_tStrtEssttEth12_Ax /end AXIS_DESCR
 /begin AXIS_DESCR COM_AXIS anztist dez 14 0.00 255.0 FORMAT "%5.1" AXIS_PTS_REF EngStrt_nrInjStrtEsstt14_Ax /end AXIS_DESCR
/end CHARACTERISTIC
/begin CHARACTERISTIC ESSTT_HDST.facStrtTStrtNrInjStrt_GM "base class of function ESSTT (Fuel enrichment during start) / factor start correction number injections start temperature" MAP 0x80541DBC RB_MapGroup_U8 1.992188 fak_ub_b2 0.00 1.992188 FORMAT "%8.6"
 /begin AXIS_DESCR COM_AXIS EngStrt_tStrtCoor Temp_Cels 12 -273.140 3003.560 FORMAT "%8.3" EXTENDED_LIMITS -3549.940 3003.560 AXIS_PTS_REF EngStrt_tStrtEsstt12_Ax /end AXIS_DESCR
 /begin AXIS_DESCR COM_AXIS anztist dez 14 0.00 255.0 FORMAT "%5.1" AXIS_PTS_REF EngStrt_nrInjStrtEsstt14_Ax /end AXIS_DESCR
/end CHARACTERISTIC
/begin CHARACTERISTIC ESSTT_HDST.facStrtTStrtPFildRail_GM "base class of function ESSTT (Fuel enrichment during start) / group map factor for rail pressure" MAP 0x80541E64 RB_MapGroup_U16 63.99902 fak_uw_b64 0.00 63.99902 FORMAT "%8.5"
 /begin AXIS_DESCR COM_AXIS EngStrt_tStrtCoor Temp_Cels 12 -273.140 3003.560 FORMAT "%8.3" EXTENDED_LIMITS -3549.940 3003.560 AXIS_PTS_REF EngStrt_tStrtEsstt12_Ax /end AXIS_DESCR
 /begin AXIS_DESCR COM_AXIS FuPHi_pRail RBPtCel_p_0p002_1 2 0.00 131.0700 FORMAT "%8.4" AXIS_PTS_REF EngStrt_pFildRailEsstt02_Ax /end AXIS_DESCR
/end CHARACTERISTIC
/begin CHARACTERISTIC ESSTT_HDST_EOL.facStrtCorrRstrtTStrtEth_GM "ESSTT base class / correction restart for ethanol" MAP 0x80541164 RB_MapGroup_U8 1.992188 fak_ub_b2 0.00 1.992188 FORMAT "%8.6"
 /begin AXIS_DESCR COM_AXIS ESSTT_tiEngOff t_q1 4 0.00 65535.00 FORMAT "%8.2" AXIS_PTS_REF EngStrt_tiEngStopEssttEth04_Ax /end AXIS_DESCR
 /begin AXIS_DESCR COM_AXIS EngStrt_tStrtCoor Temp_Cels 12 -273.140 3003.560 FORMAT "%8.3" EXTENDED_LIMITS -3549.940 3003.560 AXIS_PTS_REF EngStrt_tStrtEssttEth12_Ax /end AXIS_DESCR
/end CHARACTERISTIC
/begin CHARACTERISTIC ESSTT_HDST_EOL.facStrtCorrRstrtTStrt_GM "ESSTT base class / correction restart" MAP 0x80541194 RB_MapGroup_U8 1.992188 fak_ub_b2 0.00 1.992188 FORMAT "%8.6"
 /begin AXIS_DESCR COM_AXIS ESSTT_tiEngOff t_q1 6 0.00 65535.00 FORMAT "%8.2" AXIS_PTS_REF EngStrt_tiEngStopEsstt04_Ax /end AXIS_DESCR
 /begin AXIS_DESCR COM_AXIS EngStrt_tStrtCoor Temp_Cels 12 -273.140 3003.560 FORMAT "%8.3" EXTENDED_LIMITS -3549.940 3003.560 AXIS_PTS_REF EngStrt_tStrtEsstt12_Ax /end AXIS_DESCR
/end CHARACTERISTIC
/begin CHARACTERISTIC ESSTT_HDST_EOL.facStrtTStrtFacEth_GM "ESSTT base class / correction ethanol" MAP 0x805411DC RB_MapGroup_U16 63.99902 fak_uw_b64 0.00 63.99902 FORMAT "%8.5"
 /begin AXIS_DESCR COM_AXIS EngStrt_tStrtCoor Temp_Cels 12 -273.140 3003.560 FORMAT "%8.3" EXTENDED_LIMITS -3549.940 3003.560 AXIS_PTS_REF EngStrt_tStrtEssttEth12_Ax /end AXIS_DESCR
 /begin AXIS_DESCR COM_AXIS fethffv fak_ub_b1 6 0.00 0.9961 AXIS_PTS_REF EngStrt_facEthEsstt06_Ax /end AXIS_DESCR
/end CHARACTERISTIC
/begin CHARACTERISTIC ESSTT_HDST_EOL.facStrtTStrtNrInjStrtEth_GM "ESSTT base class / factor start ethanol correction number injections start temp" MAP 0x8054126C RB_MapGroup_U8 3.984 fak_ub_b4 0.00 3.984 FORMAT "%5.3"
 /begin AXIS_DESCR COM_AXIS EngStrt_tStrtCoor Temp_Cels 12 -273.140 3003.560 FORMAT "%8.3" EXTENDED_LIMITS -3549.940 3003.560 AXIS_PTS_REF EngStrt_tStrtEssttEth12_Ax /end AXIS_DESCR
 /begin AXIS_DESCR COM_AXIS anztist dez 14 0.00 255.0 FORMAT "%5.1" AXIS_PTS_REF EngStrt_nrInjStrtEsstt14_Ax /end AXIS_DESCR
/end CHARACTERISTIC
/begin CHARACTERISTIC ESSTT_HDST_EOL.facStrtTStrtNrInjStrt_GM "ESSTT base class / factor start correction number injections start temperature" MAP 0x80541314 RB_MapGroup_U8 1.992188 fak_ub_b2 0.00 1.992188 FORMAT "%8.6"
 /begin AXIS_DESCR COM_AXIS EngStrt_tStrtCoor Temp_Cels 12 -273.140 3003.560 FORMAT "%8.3" EXTENDED_LIMITS -3549.940 3003.560 AXIS_PTS_REF EngStrt_tStrtEsstt12_Ax /end AXIS_DESCR
 /begin AXIS_DESCR COM_AXIS anztist dez 14 0.00 255.0 FORMAT "%5.1" AXIS_PTS_REF EngStrt_nrInjStrtEsstt14_Ax /end AXIS_DESCR
/end CHARACTERISTIC
/begin CHARACTERISTIC ESSTT_HDST_EOL.facStrtTStrtPFildRail_GM "ESSTT base class / group map factor for rail pressure" MAP 0x805413BC RB_MapGroup_U16 63.99902 fak_uw_b64 0.00 63.99902 FORMAT "%8.5"
 /begin AXIS_DESCR COM_AXIS EngStrt_tStrtCoor Temp_Cels 12 -273.140 3003.560 FORMAT "%8.3" EXTENDED_LIMITS -3549.940 3003.560 AXIS_PTS_REF EngStrt_tStrtEsstt12_Ax /end AXIS_DESCR
 /begin AXIS_DESCR COM_AXIS FuPHi_pRail RBPtCel_p_0p002_1 2 0.00 131.0700 FORMAT "%8.4" AXIS_PTS_REF EngStrt_pFildRailEsstt02_Ax /end AXIS_DESCR
/end CHARACTERISTIC
/begin CHARACTERISTIC ESSTT_NDST.facStrtCorrRstrtTStrtEth_GM "ESSTT base class / correction restart for ethanol" MAP 0x805413F0 RB_MapGroup_U8 1.992188 fak_ub_b2 0.00 1.992188 FORMAT "%8.6"
 /begin AXIS_DESCR COM_AXIS ESSTT_tiEngOff t_q1 4 0.00 65535.00 FORMAT "%8.2" AXIS_PTS_REF EngStrt_tiEngStopEssttEth04_Ax /end AXIS_DESCR
 /begin AXIS_DESCR COM_AXIS EngStrt_tStrtCoor Temp_Cels 12 -273.140 3003.560 FORMAT "%8.3" EXTENDED_LIMITS -3549.940 3003.560 AXIS_PTS_REF EngStrt_tStrtEssttEth12_Ax /end AXIS_DESCR
/end CHARACTERISTIC
/begin CHARACTERISTIC ESSTT_NDST.facStrtCorrRstrtTStrt_GM "ESSTT base class / correction restart" MAP 0x80541420 RB_MapGroup_U8 1.992188 fak_ub_b2 0.00 1.992188 FORMAT "%8.6"
 /begin AXIS_DESCR COM_AXIS ESSTT_tiEngOff t_q1 6 0.00 65535.00 FORMAT "%8.2" AXIS_PTS_REF EngStrt_tiEngStopEsstt04_Ax /end AXIS_DESCR
 /begin AXIS_DESCR COM_AXIS EngStrt_tStrtCoor Temp_Cels 12 -273.140 3003.560 FORMAT "%8.3" EXTENDED_LIMITS -3549.940 3003.560 AXIS_PTS_REF EngStrt_tStrtEsstt12_Ax /end AXIS_DESCR
/end CHARACTERISTIC
/begin CHARACTERISTIC ESSTT_NDST.facStrtTStrtFacEth_GM "ESSTT base class / correction ethanol" MAP 0x80541468 RB_MapGroup_U16 63.99902 fak_uw_b64 0.00 63.99902 FORMAT "%8.5"
 /begin AXIS_DESCR COM_AXIS EngStrt_tStrtCoor Temp_Cels 12 -273.140 3003.560 FORMAT "%8.3" EXTENDED_LIMITS -3549.940 3003.560 AXIS_PTS_REF EngStrt_tStrtEssttEth12_Ax /end AXIS_DESCR
 /begin AXIS_DESCR COM_AXIS fethffv fak_ub_b1 6 0.00 0.9961 AXIS_PTS_REF EngStrt_facEthEsstt06_Ax /end AXIS_DESCR
/end CHARACTERISTIC
/begin CHARACTERISTIC ESSTT_NDST.facStrtTStrtNrInjStrtEth_GM "ESSTT base class / factor start ethanol correction number injections start temp" MAP 0x805414F8 RB_MapGroup_U8 3.984 fak_ub_b4 0.00 3.984 FORMAT "%5.3"
 /begin AXIS_DESCR COM_AXIS EngStrt_tStrtCoor Temp_Cels 12 -273.140 3003.560 FORMAT "%8.3" EXTENDED_LIMITS -3549.940 3003.560 AXIS_PTS_REF EngStrt_tStrtEssttEth12_Ax /end AXIS_DESCR
 /begin AXIS_DESCR COM_AXIS anztist dez 14 0.00 255.0 FORMAT "%5.1" AXIS_PTS_REF EngStrt_nrInjStrtEsstt14_Ax /end AXIS_DESCR
/end CHARACTERISTIC
/begin CHARACTERISTIC ESSTT_NDST.facStrtTStrtNrInjStrt_GM "ESSTT base class / factor start correction number injections start temperature" MAP 0x805415A0 RB_MapGroup_U8 1.992188 fak_ub_b2 0.00 1.992188 FORMAT "%8.6"
 /begin AXIS_DESCR COM_AXIS EngStrt_tStrtCoor Temp_Cels 12 -273.140 3003.560 FORMAT "%8.3" EXTENDED_LIMITS -3549.940 3003.560 AXIS_PTS_REF EngStrt_tStrtEsstt12_Ax /end AXIS_DESCR
 /begin AXIS_DESCR COM_AXIS anztist dez 14 0.00 255.0 FORMAT "%5.1" AXIS_PTS_REF EngStrt_nrInjStrtEsstt14_Ax /end AXIS_DESCR
/end CHARACTERISTIC
/begin CHARACTERISTIC ESSTT_NDST.facStrtTStrtPFildRail_GM "ESSTT base class / group map factor for rail pressure" MAP 0x80541648 RB_MapGroup_U16 63.99902 fak_uw_b64 0.00 63.99902 FORMAT "%8.5"
 /begin AXIS_DESCR COM_AXIS EngStrt_tStrtCoor Temp_Cels 12 -273.140 3003.560 FORMAT "%8.3" EXTENDED_LIMITS -3549.940 3003.560 AXIS_PTS_REF EngStrt_tStrtEsstt12_Ax /end AXIS_DESCR
 /begin AXIS_DESCR COM_AXIS FuPHi_pRail RBPtCel_p_0p002_1 2 0.00 131.0700 FORMAT "%8.4" AXIS_PTS_REF EngStrt_pFildRailEsstt02_Ax /end AXIS_DESCR
/end CHARACTERISTIC
/begin CHARACTERISTIC ESSTT_NDST_EOL.facStrtCorrRstrtTStrtEth_GM "ESSTT base class / correction restart for ethanol" MAP 0x8054167C RB_MapGroup_U8 1.992188 fak_ub_b2 0.00 1.992188 FORMAT "%8.6"
 /begin AXIS_DESCR COM_AXIS ESSTT_tiEngOff t_q1 4 0.00 65535.00 FORMAT "%8.2" AXIS_PTS_REF EngStrt_tiEngStopEssttEth04_Ax /end AXIS_DESCR
 /begin AXIS_DESCR COM_AXIS EngStrt_tStrtCoor Temp_Cels 12 -273.140 3003.560 FORMAT "%8.3" EXTENDED_LIMITS -3549.940 3003.560 AXIS_PTS_REF EngStrt_tStrtEssttEth12_Ax /end AXIS_DESCR
/end CHARACTERISTIC
/begin CHARACTERISTIC ESSTT_NDST_EOL.facStrtCorrRstrtTStrt_GM "ESSTT base class / correction restart" MAP 0x805416AC RB_MapGroup_U8 1.992188 fak_ub_b2 0.00 1.992188 FORMAT "%8.6"
 /begin AXIS_DESCR COM_AXIS ESSTT_tiEngOff t_q1 6 0.00 65535.00 FORMAT "%8.2" AXIS_PTS_REF EngStrt_tiEngStopEsstt04_Ax /end AXIS_DESCR
 /begin AXIS_DESCR COM_AXIS EngStrt_tStrtCoor Temp_Cels 12 -273.140 3003.560 FORMAT "%8.3" EXTENDED_LIMITS -3549.940 3003.560 AXIS_PTS_REF EngStrt_tStrtEsstt12_Ax /end AXIS_DESCR
/end CHARACTERISTIC
/begin CHARACTERISTIC ESSTT_NDST_EOL.facStrtTStrtFacEth_GM "ESSTT base class / correction ethanol" MAP 0x805416F4 RB_MapGroup_U16 63.99902 fak_uw_b64 0.00 63.99902 FORMAT "%8.5"
 /begin AXIS_DESCR COM_AXIS EngStrt_tStrtCoor Temp_Cels 12 -273.140 3003.560 FORMAT "%8.3" EXTENDED_LIMITS -3549.940 3003.560 AXIS_PTS_REF EngStrt_tStrtEssttEth12_Ax /end AXIS_DESCR
 /begin AXIS_DESCR COM_AXIS fethffv fak_ub_b1 6 0.00 0.9961 AXIS_PTS_REF EngStrt_facEthEsstt06_Ax /end AXIS_DESCR
/end CHARACTERISTIC
/begin CHARACTERISTIC ESSTT_NDST_EOL.facStrtTStrtNrInjStrtEth_GM "ESSTT base class / factor start ethanol correction number injections start temp" MAP 0x80541784 RB_MapGroup_U8 3.984 fak_ub_b4 0.00 3.984 FORMAT "%5.3"
 /begin AXIS_DESCR COM_AXIS EngStrt_tStrtCoor Temp_Cels 12 -273.140 3003.560 FORMAT "%8.3" EXTENDED_LIMITS -3549.940 3003.560 AXIS_PTS_REF EngStrt_tStrtEssttEth12_Ax /end AXIS_DESCR
 /begin AXIS_DESCR COM_AXIS anztist dez 14 0.00 255.0 FORMAT "%5.1" AXIS_PTS_REF EngStrt_nrInjStrtEsstt14_Ax /end AXIS_DESCR
/end CHARACTERISTIC
/begin CHARACTERISTIC ESSTT_NDST_EOL.facStrtTStrtNrInjStrt_GM "ESSTT base class / factor start correction number injections start temperature" MAP 0x8054182C RB_MapGroup_U8 1.992188 fak_ub_b2 0.00 1.992188 FORMAT "%8.6"
 /begin AXIS_DESCR COM_AXIS EngStrt_tStrtCoor Temp_Cels 12 -273.140 3003.560 FORMAT "%8.3" EXTENDED_LIMITS -3549.940 3003.560 AXIS_PTS_REF EngStrt_tStrtEsstt12_Ax /end AXIS_DESCR
 /begin AXIS_DESCR COM_AXIS anztist dez 14 0.00 255.0 FORMAT "%5.1" AXIS_PTS_REF EngStrt_nrInjStrtEsstt14_Ax /end AXIS_DESCR
/end CHARACTERISTIC
/begin CHARACTERISTIC ESSTT_NDST_EOL.facStrtTStrtPFildRail_GM "ESSTT base class / group map factor for rail pressure" MAP 0x805418D4 RB_MapGroup_U16 63.99902 fak_uw_b64 0.00 63.99902 FORMAT "%8.5"
 /begin AXIS_DESCR COM_AXIS EngStrt_tStrtCoor Temp_Cels 12 -273.140 3003.560 FORMAT "%8.3" EXTENDED_LIMITS -3549.940 3003.560 AXIS_PTS_REF EngStrt_tStrtEsstt12_Ax /end AXIS_DESCR
 /begin AXIS_DESCR COM_AXIS FuPHi_pRail RBPtCel_p_0p002_1 2 0.00 131.0700 FORMAT "%8.4" AXIS_PTS_REF EngStrt_pFildRailEsstt02_Ax /end AXIS_DESCR
/end CHARACTERISTIC
/begin CHARACTERISTIC Etc_MaxReqTO_C "Maximum time between 2 engine test requests. Value is applicated on 10ms time base (Value of 500 means 5s), but the smallest possible resolution is 100ms. Active tests will be stopped if this times has run out." VALUE 0x80590CAA Val_Wu16 65535.00 OneToOne 0.00 65535.00 FORMAT "%8.2" /end CHARACTERISTIC
/begin CHARACTERISTIC EvapActrCcv_flgSwtPsSubRlyActv_C "Flag for powerstage diagnosis when SUBRELAY is active" VALUE 0x80544BC1 RB_Val_Wboolean 1.00000000000 B_TRUE 0.00 1.00000000000 FORMAT "%13.11" /end CHARACTERISTIC
/begin CHARACTERISTIC EvapActrCcv_tiPsHeatrRlyActv_C "Delay time for power stage diagnosis when Heater relay is active" VALUE 0x80544BC2 RB_Val_Wu8 25.50 t_q0p1 0.00 25.50 FORMAT "%5.2" /end CHARACTERISTIC
/begin CHARACTERISTIC EvapActrCpv_ratCpvOpen_C "Output duty cycle CPV for pressure reduction in PostDrive ECU sub-state" VALUE 0x80544C3E RB_Val_Wu16 99.99847 rel_uw_b100 0.00 99.99847 FORMAT "%8.5" /end CHARACTERISTIC
/begin CHARACTERISTIC EvapActrCpv_stCpvActvnPostDrv_C "Code word for CPV activation in PostDrive ECU sub-state" VALUE 0x80544C40 RB_Val_Wu8 255.0 dez 0.00 255.0 FORMAT "%5.1" /end CHARACTERISTIC
/begin CHARACTERISTIC EvapActrCpv_tiDlyCpvHiResl_C "Delay time until CPV opening in PostDrive ECU sub-state" VALUE 0x80544C42 RB_Val_Wu16 1310.700 t_q0p02 0.00 1310.700 FORMAT "%8.3" /end CHARACTERISTIC
/begin CHARACTERISTIC EvapActrCpv_tiDlyElecDiag_C "Delay time to enable CPV electrical diagnosis" VALUE 0x80544BDD RB_Val_Wu8 25.50 t_q0p1 0.00 25.50 FORMAT "%5.2" /end CHARACTERISTIC
/begin CHARACTERISTIC EvapActrCpv_tiOpenCpvHiResl_C "Opening time of CPV for pressure reduction in PostDrive ECU sub-state" VALUE 0x80544C44 RB_Val_Wu16 1310.700 t_q0p02 0.00 1310.700 FORMAT "%8.3" /end CHARACTERISTIC
/begin CHARACTERISTIC FELDTESK_nrTestPlsCcv_C "Number of test pulses per driving cycle for electrical diagnosis of CCV valve" VALUE 0x80544BC4 RB_Val_Wu32 4294967295.00 dez 0.00 4294967295.00 FORMAT "%13.2" /end CHARACTERISTIC
/begin CHARACTERISTIC FELDTESK_tiBtwPlsElecErrCcv_C "Time between test pulses in case of fault detected for electrical diagnosis of CCV valve" VALUE 0x80544BC8 RB_Val_Ws16 655350.0 t_q10_ms -327680.0 327670.0 FORMAT "%8.1" /end CHARACTERISTIC
/begin CHARACTERISTIC FELDTESK_tiBtwPlsOverTCcv_C "Time between test pulses in case of over temperature detected for electrical diagnosis of CCV valve" VALUE 0x80544BCA RB_Val_Ws16 655.3500 t_q0p01 -327.6800 327.6700 FORMAT "%8.4" /end CHARACTERISTIC
/begin CHARACTERISTIC FPCtl_stCpvDiPs_C "state of CPV Disable Powerstage" VALUE 0x80544BCE RB_Val_Wu16 65535.00 OneToOne 0.00 65535.00 FORMAT "%8.2" /end CHARACTERISTIC
/begin CHARACTERISTIC FSTTHDPRE "factor high pressure start pre-injection" CURVE 0x80540FCE RB_Curve_S16_U16_Static 63.99902 fak_uw_b64 0.00 63.99902 FORMAT "%8.5"
 /begin AXIS_DESCR STD_AXIS EngStrt_tStrtCoor Temp_Cels 4 -273.140 3003.560 FORMAT "%8.3" EXTENDED_LIMITS -3549.940 3003.560 DEPOSIT ABSOLUTE /end AXIS_DESCR
/end CHARACTERISTIC
/begin CHARACTERISTIC FTVTEVTANS "Factor delay time correction by temperature of the sucked in air" CURVE 0x80544C46 RB_Curve_U8_U8 1.992188 fak_ub_b2 0.00 1.992188 FORMAT "%8.6"
 /begin AXIS_DESCR STD_AXIS tansloc temp_ub_q0p75_o48 4 -48.0 143.3 FORMAT "%5.1" DEPOSIT ABSOLUTE /end AXIS_DESCR
/end CHARACTERISTIC
/begin CHARACTERISTIC FUKDE "Factor transient control direct injection" VALUE 0x80541E98 RB_Val_Wu16 7.999878 fak_uw_b8 0.00 7.999878 FORMAT "%8.6" /end CHARACTERISTIC
/begin CHARACTERISTIC FUKDEETH "Factor transient control direct injection with E85 (or E100)" VALUE 0x80541E9A RB_Val_Wu16 7.999878 fak_uw_b8 0.00 7.999878 FORMAT "%8.6" /end CHARACTERISTIC
/begin CHARACTERISTIC FUKDESP "Factor transient control direct injection for split injections" VALUE 0x80541E9C RB_Val_Wu16 7.999878 fak_uw_b8 0.00 7.999878 FORMAT "%8.6" /end CHARACTERISTIC
/begin CHARACTERISTIC FUKDESPETH "Factor transient control direct injection at splitted injections with E85 (or E100)" VALUE 0x80541E9E RB_Val_Wu16 7.999878 fak_uw_b8 0.00 7.999878 FORMAT "%8.6" /end CHARACTERISTIC
/begin CHARACTERISTIC FUKNSTM "initial value of transient control post-start factor" CURVE 0x80541EA0 RB_Curve_U8_U8 3.984 fak_ub_b4 0.00 3.984 FORMAT "%5.3"
 /begin AXIS_DESCR STD_AXIS tmsesuk temp_ub_q0p75_o48 9 -48.0 143.3 FORMAT "%5.1" DEPOSIT ABSOLUTE /end AXIS_DESCR
/end CHARACTERISTIC
/begin CHARACTERISTIC FUKNSTMETH "initial value of transient control post-start factor with E85 (or E100)" CURVE 0x80541EB3 RB_Curve_U8_U8 15.94 fak_ub_b16 0.00 15.94 FORMAT "%5.2"
 /begin AXIS_DESCR STD_AXIS tmsesuk temp_ub_q0p75_o48 9 -48.0 143.3 FORMAT "%5.1" DEPOSIT ABSOLUTE /end AXIS_DESCR
/end CHARACTERISTIC
/begin CHARACTERISTIC FVANST "weighting factor of deceleration during post-cranking" VALUE 0x80541EC6 RB_Val_Wu8 1.992188 fak_ub_b2 0.00 1.992188 FORMAT "%8.6" /end CHARACTERISTIC
/begin CHARACTERISTIC FWEHT "Factor: restart quantity, temperature-dependent (hard restart)" CURVE 0x805422ED RB_Curve_U8_U8 1.992188 fak_ub_b2 0.00 1.992188 FORMAT "%8.6"
 /begin AXIS_DESCR STD_AXIS tmeswe temp_ub_q0p75_o48 9 -48.0 143.3 FORMAT "%5.1" DEPOSIT ABSOLUTE /end AXIS_DESCR
/end CHARACTERISTIC
/begin CHARACTERISTIC FWEHTETH "Factor: restart quantity, temperature-dependent (hard restart) for ethanol" CURVE 0x80542300 RB_Curve_U8_U8 1.992188 fak_ub_b2 0.00 1.992188 FORMAT "%8.6"
 /begin AXIS_DESCR STD_AXIS tmeswe temp_ub_q0p75_o48 9 -48.0 143.3 FORMAT "%5.1" DEPOSIT ABSOLUTE /end AXIS_DESCR
/end CHARACTERISTIC
/begin CHARACTERISTIC FWEMRFA "factor restart fuel mass dependent of desired torque" CURVE 0x80542314 RB_Curve_U16_U8_Static 1.992188 fak_ub_b2 0.00 1.992188 FORMAT "%8.6"
 /begin AXIS_DESCR STD_AXIS InjSys_relDrvrReqTq rel_uw_b200 6 0.00 199.9969 FORMAT "%8.4" DEPOSIT ABSOLUTE /end AXIS_DESCR
/end CHARACTERISTIC
/begin CHARACTERISTIC FWEMRFAETH "factor restart fuel mass dependent of desired torque for ethanol" CURVE 0x80542328 RB_Curve_U16_U8_Static 1.992188 fak_ub_b2 0.00 1.992188 FORMAT "%8.6"
 /begin AXIS_DESCR STD_AXIS InjSys_relDrvrReqTq rel_uw_b200 6 0.00 199.9969 FORMAT "%8.4" DEPOSIT ABSOLUTE /end AXIS_DESCR
/end CHARACTERISTIC
/begin CHARACTERISTIC FWET "factor temperature restart fuel mass" CURVE 0x8054233C RB_Curve_U8_U8 1.992188 fak_ub_b2 0.00 1.992188 FORMAT "%8.6"
 /begin AXIS_DESCR STD_AXIS tmeswe temp_ub_q0p75_o48 9 -48.0 143.3 FORMAT "%5.1" DEPOSIT ABSOLUTE /end AXIS_DESCR
/end CHARACTERISTIC
/begin CHARACTERISTIC FWETETH "factor temperature restart fuel mass for ethanol" CURVE 0x8054234F RB_Curve_U8_U8 1.992188 fak_ub_b2 0.00 1.992188 FORMAT "%8.6"
 /begin AXIS_DESCR STD_AXIS tmeswe temp_ub_q0p75_o48 9 -48.0 143.3 FORMAT "%5.1" DEPOSIT ABSOLUTE /end AXIS_DESCR
/end CHARACTERISTIC
/begin CHARACTERISTIC IMLHS "integrated flow of air-mass at hot start" VALUE 0x80540FE0 RB_Val_Wu8 23.21 m_ub_b23p3 0.00 23.21 FORMAT "%5.2" /end CHARACTERISTIC
/begin CHARACTERISTIC InjSyG_facTCorrnTraCmpVvt_M "Temperature dependent correction factor for relative fuel mass from transient compensation VVT(Variable Valve Timing)" MAP 0x80541EC7 RB_MapGroup_U8 1.992188 fak_ub_b2 0.00 1.992188 FORMAT "%8.6"
 /begin AXIS_DESCR COM_AXIS tmesuk temp_ub_q0p75_o48 9 -48.0 143.3 FORMAT "%5.1" AXIS_PTS_REF STM09ESUB /end AXIS_DESCR
 /begin AXIS_DESCR COM_AXIS InjSys_nEngLResTraCmp10ms nmot_ub_q40 7 0.00 10200. FORMAT "%5.0" AXIS_PTS_REF SNM07ESUB /end AXIS_DESCR
/end CHARACTERISTIC
/begin CHARACTERISTIC InjSys_facCorrnDecelPostStrt_T "characteristic curve VA(deceleration enleanment) depending on the time after end of start" CURVE 0x80541F06 RB_Curve_U16_U8_Static 1.992188 fak_ub_b2 0.00 1.992188 FORMAT "%8.6"
 /begin AXIS_DESCR STD_AXIS tnse_w_msg t_q0p1 4 0.00 6553.500 FORMAT "%8.3" DEPOSIT ABSOLUTE /end AXIS_DESCR
/end CHARACTERISTIC
/begin CHARACTERISTIC InjSys_facCorrnTraCmpVvt_M "Correction factor for relative fuel mass from transient compensation VVT(Variable Valve Timing)" MAP 0x80541F14 RB_Map_S16U16_S16 15.99976 fak_sw_b8 -8.000000 7.999756 FORMAT "%8.6"
 /begin AXIS_DESCR STD_AXIS GEVlv_agIntkB1 kw_q0p0156 5 -512.0000 511.9844 FORMAT "%8.4" DEPOSIT ABSOLUTE /end AXIS_DESCR
 /begin AXIS_DESCR STD_AXIS rlp_w_msg rel_uw_q0p0234 5 0.00 1535.977 FORMAT "%8.3" DEPOSIT ABSOLUTE /end AXIS_DESCR
/end CHARACTERISTIC
/begin CHARACTERISTIC InjSys_facHardRstrtTEthnlStrtStopFuCut_T "Weighting of the hard factor re-injection enrichment depending of temperature by FlexFuel for SSFC" CURVE 0x80542362 RB_Curve_U8_U8 1.992188 fak_ub_b2 0.00 1.992188 FORMAT "%8.6"
 /begin AXIS_DESCR STD_AXIS tmeswe temp_ub_q0p75_o48 9 -48.0 143.3 FORMAT "%5.1" DEPOSIT ABSOLUTE /end AXIS_DESCR
/end CHARACTERISTIC
/begin CHARACTERISTIC InjSys_facHardRstrtTStrtStopFuCut_T "Weighting of the factor re-injection enrichment depending of temperature for SSFC" CURVE 0x80542375 RB_Curve_U8_U8 1.992188 fak_ub_b2 0.00 1.992188 FORMAT "%8.6"
 /begin AXIS_DESCR STD_AXIS tmeswe temp_ub_q0p75_o48 9 -48.0 143.3 FORMAT "%5.1" DEPOSIT ABSOLUTE /end AXIS_DESCR
/end CHARACTERISTIC
/begin CHARACTERISTIC InjSys_facRstrtTEthnlStrtStopFuCut_T "Weighting of the factor re-injection enrichment depending of temperature by FlexFuel for SSFC" CURVE 0x80542388 RB_Curve_U8_U8 1.992188 fak_ub_b2 0.00 1.992188 FORMAT "%8.6"
 /begin AXIS_DESCR STD_AXIS tmeswe temp_ub_q0p75_o48 9 -48.0 143.3 FORMAT "%5.1" DEPOSIT ABSOLUTE /end AXIS_DESCR
/end CHARACTERISTIC
/begin CHARACTERISTIC InjSys_facRstrtTStrtStopFuCut_T "Weighting of the factor re-injection enrichment depending of temperature for SSFC" CURVE 0x8054239B RB_Curve_U8_U8 1.992188 fak_ub_b2 0.00 1.992188 FORMAT "%8.6"
 /begin AXIS_DESCR STD_AXIS tmeswe temp_ub_q0p75_o48 9 -48.0 143.3 FORMAT "%5.1" DEPOSIT ABSOLUTE /end AXIS_DESCR
/end CHARACTERISTIC
/begin CHARACTERISTIC InjSys_flgCdnEndStrt_C "Condition :Flag end of start" VALUE 0x805423AE RB_Val_Wboolean 1.00000000000 B_TRUE 0.00 1.00000000000 FORMAT "%13.11" /end CHARACTERISTIC
/begin AXIS_PTS InjSys_mfAirM05_AX "base point distribution for Air Mass Flow with 5 base points" 0x80541F5E ml_w_msg RB_Axis_U16 6553.500 m_q0p1 5 0.00 6553.500 FORMAT "%8.3" DEPOSIT ABSOLUTE /end AXIS_PTS
/begin CHARACTERISTIC InjSys_OffsStrtStopFuCut_T "Characteristic curve for offset in pointer on cut-in factors curve for StartStop Fuel cutoff for SSFC" CURVE 0x805423AF RB_FixCurve_U8_U8 255.0 dez 0.00 255.0 FORMAT "%5.1"
 /begin AXIS_DESCR FIX_AXIS anzzyksa_msg dez 5 0.00 4.000 FORMAT "%5.3" FIX_AXIS_PAR 0 0 5 /end AXIS_DESCR
/end CHARACTERISTIC
/begin CHARACTERISTIC InjSys_ratATraCmpThd_GM "Transient Compensation threshold for Acceleration Enrichment." MAP 0x80541F6A RB_MapGroup_S16 1535.977 rel_sw_q0p0234 -768.0000 767.9766 FORMAT "%8.4"
 /begin AXIS_DESCR COM_AXIS tmesuk temp_ub_q0p75_o48 9 -48.0 143.3 FORMAT "%5.1" AXIS_PTS_REF STM09ESUB /end AXIS_DESCR
 /begin AXIS_DESCR COM_AXIS ml_w_msg m_q0p1 5 0.00 6553.500 FORMAT "%8.3" AXIS_PTS_REF InjSys_mfAirM05_AX /end AXIS_DESCR
/end CHARACTERISTIC
/begin CHARACTERISTIC InjSys_ratDecelTraCmpThd_GM "Transient Compensation threshold for Deceleration Enleanment." MAP 0x80541FC4 RB_MapGroup_S16 1535.977 rel_sw_q0p0234 -768.0000 767.9766 FORMAT "%8.4"
 /begin AXIS_DESCR COM_AXIS tmesuk temp_ub_q0p75_o48 9 -48.0 143.3 FORMAT "%5.1" AXIS_PTS_REF STM09ESUB /end AXIS_DESCR
 /begin AXIS_DESCR COM_AXIS ml_w_msg m_q0p1 5 0.00 6553.500 FORMAT "%8.3" AXIS_PTS_REF InjSys_mfAirM05_AX /end AXIS_DESCR
/end CHARACTERISTIC
/begin AXIS_PTS InjSys_stInjMod_AX "base point distribution current injection mode" 0x8055908E NO_INPUT_QUANTITY RB_Axis_U8 19.0000000000 InjSys_InjMode_Set_COMPU_VERB 20 0.00 19.0000000000 FORMAT "%13.10" DEPOSIT ABSOLUTE /end AXIS_PTS
/begin CHARACTERISTIC InjSys_tiCEngDstEthnl_M "Map to select Timer based on coolant temperature and ethanol factor" MAP 0x805423B4 RB_Map_S16U16_U16 15.00000 t_q0p01 0.00 15.00000 FORMAT "%8.5" EXTENDED_LIMITS 0.00 655.3500
 /begin AXIS_DESCR STD_AXIS CEngDsT_t Temp_Cels 6 -3549.940 3003.560 FORMAT "%8.3" DEPOSIT ABSOLUTE /end AXIS_DESCR
 /begin AXIS_DESCR STD_AXIS FfPrm_facEth fak_uw_b2 6 0.00 1.999969 FORMAT "%8.6" DEPOSIT ABSOLUTE /end AXIS_DESCR
/end CHARACTERISTIC
/begin CHARACTERISTIC InjSys_tiDlyFuMCmp_C "filter time constant for relative fuel mass transition compensation" VALUE 0x8054201E RB_Val_Wu16 655.3500 t_q0p01 0.00 655.3500 FORMAT "%8.4" /end CHARACTERISTIC
/begin CHARACTERISTIC InjSys_tiTnFilAgCamsftIntk_M "filter time constant for variable valve timing" MAP 0x80542020 RB_Map_U8S16_U16 655.3400 t_q0p01 0.0100 655.3500 FORMAT "%8.4" EXTENDED_LIMITS 0.00 655.3500
 /begin AXIS_DESCR STD_AXIS tmesuk temp_ub_q0p75_o48 9 -48.0 143.3 FORMAT "%5.1" DEPOSIT ABSOLUTE /end AXIS_DESCR
 /begin AXIS_DESCR STD_AXIS InjSys_agSpIntkGrad kw_q0p0156 9 -512.0000 511.9844 FORMAT "%8.4" DEPOSIT ABSOLUTE /end AXIS_DESCR
/end CHARACTERISTIC
/begin CHARACTERISTIC KFBADE "factor acceleration enrichment direct injection" MAP 0x805420E0 RB_MapGroup_U8 1.992188 fak_ub_b2 0.00 1.992188 FORMAT "%8.6"
 /begin AXIS_DESCR COM_AXIS tmesuk temp_ub_q0p75_o48 9 -48.0 143.3 FORMAT "%5.1" AXIS_PTS_REF STM09ESUB /end AXIS_DESCR
 /begin AXIS_DESCR COM_AXIS InjSys_nEngLResTraCmp10ms nmot_ub_q40 7 0.00 10200. FORMAT "%5.0" AXIS_PTS_REF SNM07ESUB /end AXIS_DESCR
/end CHARACTERISTIC
/begin CHARACTERISTIC KFBADEETH "factor accel. enrichment direct injection for ethanol" MAP 0x8054211F RB_MapGroup_U8 1.992188 fak_ub_b2 0.00 1.992188 FORMAT "%8.6"
 /begin AXIS_DESCR COM_AXIS tmesuk temp_ub_q0p75_o48 9 -48.0 143.3 FORMAT "%5.1" AXIS_PTS_REF STM09ESUB /end AXIS_DESCR
 /begin AXIS_DESCR COM_AXIS InjSys_nEngLResTraCmp10ms nmot_ub_q40 7 0.00 10200. FORMAT "%5.0" AXIS_PTS_REF SNM07ESUB /end AXIS_DESCR
/end CHARACTERISTIC
/begin CHARACTERISTIC KFFNSHO "weighting of afterstart enrichment" MAP 0x8053F54C RB_Map_U8U16_U8 1.992188 fak_ub_b2 0.00 1.992188 FORMAT "%8.6"
 /begin AXIS_DESCR STD_AXIS tmstesnswl temp_ub_q0p75_o48 6 -48.0 143.3 FORMAT "%5.1" DEPOSIT ABSOLUTE /end AXIS_DESCR
 /begin AXIS_DESCR STD_AXIS PEnv_facCorrAlti fak_uw_b4 4 0.00 3.999939 FORMAT "%8.6" DEPOSIT ABSOLUTE /end AXIS_DESCR
/end CHARACTERISTIC
/begin CHARACTERISTIC KFFWET "Factor temperature restart fuel mass considering ethanol concentration" MAP 0x80542418 RB_Map_U8U8_U8 1.992188 fak_ub_b2 0.00 1.992188 FORMAT "%8.6"
 /begin AXIS_DESCR STD_AXIS anzwe dez 16 0.00 255.0 FORMAT "%5.1" DEPOSIT ABSOLUTE /end AXIS_DESCR
 /begin AXIS_DESCR STD_AXIS tmeswe temp_ub_q0p75_o48 8 -48.0 143.3 FORMAT "%5.1" DEPOSIT ABSOLUTE /end AXIS_DESCR
/end CHARACTERISTIC
/begin CHARACTERISTIC KFKNSTWST "Caracteristical map weighting for the factor after start by restart" MAP 0x8053F574 RB_Map_U8U16_U8 1.992188 fak_ub_b2 0.00 1.992188 FORMAT "%8.6"
 /begin AXIS_DESCR STD_AXIS tmstesnswl temp_ub_q0p75_o48 8 -48.0 143.3 FORMAT "%5.1" DEPOSIT ABSOLUTE /end AXIS_DESCR
 /begin AXIS_DESCR STD_AXIS EngStrt_tiEngOffESNSWL dez 10 0.00 65535.00 FORMAT "%8.2" DEPOSIT ABSOLUTE /end AXIS_DESCR
/end CHARACTERISTIC
/begin CHARACTERISTIC KFLRST "Map Time Delay" MAP 0x80540A94 RB_MapGroup_U16 327.67499992 zk5msxs_uw_b327p68 0.00500008 327.68000000 FORMAT "%12.8" EXTENDED_LIMITS 0.0050000762951 327.68000000
 /begin AXIS_DESCR COM_AXIS LamCtrl_nEngESPLANT nmot_uw_q0p25 7 0.00 16383.75 FORMAT "%8.2" AXIS_PTS_REF SNM07LSUW /end AXIS_DESCR
 /begin AXIS_DESCR COM_AXIS LamCtrl_ratFillgPlaPrm rel_uw_q0p0234 8 0.00 1535.977 FORMAT "%8.3" AXIS_PTS_REF SRL08LSUW /end AXIS_DESCR
/end CHARACTERISTIC
/begin CHARACTERISTIC KFLRSTV "Map Time Delay (for small valve lift)" MAP 0x80540B04 RB_MapGroup_U16 327.67499992 zk5msxs_uw_b327p68 0.00500008 327.68000000 FORMAT "%12.8" EXTENDED_LIMITS 0.0050000762951 327.68000000
 /begin AXIS_DESCR COM_AXIS LamCtrl_nEngESPLANT nmot_uw_q0p25 7 0.00 16383.75 FORMAT "%8.2" AXIS_PTS_REF SNM07LSUW /end AXIS_DESCR
 /begin AXIS_DESCR COM_AXIS LamCtrl_ratFillgPlaPrm rel_uw_q0p0234 8 0.00 1535.977 FORMAT "%8.3" AXIS_PTS_REF SRL08LSUW /end AXIS_DESCR
/end CHARACTERISTIC
/begin CHARACTERISTIC KFLRSZ "Characteristic map time constant of the LRS, 16-bit" MAP 0x80540B74 RB_MapGroup_U16 655.34999985 zk10msxs_uw_b655p36 0.01000015 655.36000000 FORMAT "%12.8" EXTENDED_LIMITS 0.010000152590 655.36000000
 /begin AXIS_DESCR COM_AXIS LamCtrl_nEngESPLANT nmot_uw_q0p25 7 0.00 16383.75 FORMAT "%8.2" AXIS_PTS_REF SNM07LSUW /end AXIS_DESCR
 /begin AXIS_DESCR COM_AXIS LamCtrl_ratFillgPlaPrm rel_uw_q0p0234 8 0.00 1535.977 FORMAT "%8.3" AXIS_PTS_REF SRL08LSUW /end AXIS_DESCR
/end CHARACTERISTIC
/begin CHARACTERISTIC KFLRSZV "Characteristic map time constant (for small valve lift)" MAP 0x80540BE4 RB_MapGroup_U16 655.34999985 zk10msxs_uw_b655p36 0.01000015 655.36000000 FORMAT "%12.8" EXTENDED_LIMITS 0.010000152590 655.36000000
 /begin AXIS_DESCR COM_AXIS LamCtrl_nEngESPLANT nmot_uw_q0p25 7 0.00 16383.75 FORMAT "%8.2" AXIS_PTS_REF SNM07LSUW /end AXIS_DESCR
 /begin AXIS_DESCR COM_AXIS LamCtrl_ratFillgPlaPrm rel_uw_q0p0234 8 0.00 1535.977 FORMAT "%8.3" AXIS_PTS_REF SRL08LSUW /end AXIS_DESCR
/end CHARACTERISTIC
/begin CHARACTERISTIC KFRKUMTOH2 "Correction map for switch to double injection (homogeneous)" MAP 0x8054215E RB_Map_U8U16_S16 79.96875 rel_sw_b1536 -39.98438 39.98438 FORMAT "%8.5" EXTENDED_LIMITS -1536.000 1535.953
 /begin AXIS_DESCR STD_AXIS tmsesuk temp_ub_q0p75_o48 4 -48.0 143.3 FORMAT "%5.1" DEPOSIT ABSOLUTE /end AXIS_DESCR
 /begin AXIS_DESCR STD_AXIS anztib_w_msg dez 4 0.00 65535.00 FORMAT "%8.2" DEPOSIT ABSOLUTE /end AXIS_DESCR
/end CHARACTERISTIC
/begin CHARACTERISTIC KFRKUMTOHO "Correction map for double injection (Homogeneous)" MAP 0x8054218C RB_Map_U8U16_S16 79.96875 rel_sw_b1536 -39.98438 39.98438 FORMAT "%8.5" EXTENDED_LIMITS -1536.000 1535.953
 /begin AXIS_DESCR STD_AXIS tmsesuk temp_ub_q0p75_o48 4 -48.0 143.3 FORMAT "%5.1" DEPOSIT ABSOLUTE /end AXIS_DESCR
 /begin AXIS_DESCR STD_AXIS anztib_w_msg dez 4 0.00 65535.00 FORMAT "%8.2" DEPOSIT ABSOLUTE /end AXIS_DESCR
/end CHARACTERISTIC
/begin CHARACTERISTIC KFTEVP "Characteristic map for time period of the Canister purge valve" MAP 0x80544C4F RB_Map_U8U8_U8 127.0 t500usxms_ub_q0p5 0.5 127.5 FORMAT "%5.1" EXTENDED_LIMITS 0.00 127.5
 /begin AXIS_DESCR STD_AXIS Epm_nEngLRes_nmot nmot_ub_q40 5 0.00 10200. FORMAT "%5.0" DEPOSIT ABSOLUTE /end AXIS_DESCR
 /begin AXIS_DESCR STD_AXIS tatesoll1 rel_ub_b99p6 9 0.00 99.61 FORMAT "%5.2" DEPOSIT ABSOLUTE /end AXIS_DESCR
/end CHARACTERISTIC
/begin CHARACTERISTIC KFTVPHTEV "Characteristic map for the canister purge valve (CPV) delay time (absolute pressure based)" MAP 0x80544C8C RB_Map_U8U16_U16 655.3500 t_q0p01_ms 0.00 655.3500 FORMAT "%8.4"
 /begin AXIS_DESCR STD_AXIS BattU_u_ubrsq spg_q0p1 4 0.00 25.50 FORMAT "%5.2" DEPOSIT ABSOLUTE /end AXIS_DESCR
 /begin AXIS_DESCR STD_AXIS phtev_w p_q0p0195 6 0.00 1279.980 FORMAT "%8.3" DEPOSIT ABSOLUTE /end AXIS_DESCR
/end CHARACTERISTIC
/begin CHARACTERISTIC KFVADE "factor deceleration enleanment direct injection" MAP 0x805421BA RB_MapGroup_U8 1.992188 fak_ub_b2 0.00 1.992188 FORMAT "%8.6"
 /begin AXIS_DESCR COM_AXIS tmesuk temp_ub_q0p75_o48 9 -48.0 143.3 FORMAT "%5.1" AXIS_PTS_REF STM09ESUB /end AXIS_DESCR
 /begin AXIS_DESCR COM_AXIS InjSys_nEngLResTraCmp10ms nmot_ub_q40 7 0.00 10200. FORMAT "%5.0" AXIS_PTS_REF SNM07ESUB /end AXIS_DESCR
/end CHARACTERISTIC
/begin CHARACTERISTIC KFVADEETH "factor decel. enleanment direct injection for FlexFuel" MAP 0x805421F9 RB_MapGroup_U8 1.992188 fak_ub_b2 0.00 1.992188 FORMAT "%8.6"
 /begin AXIS_DESCR COM_AXIS tmesuk temp_ub_q0p75_o48 9 -48.0 143.3 FORMAT "%5.1" AXIS_PTS_REF STM09ESUB /end AXIS_DESCR
 /begin AXIS_DESCR COM_AXIS InjSys_nEngLResTraCmp10ms nmot_ub_q40 7 0.00 10200. FORMAT "%5.0" AXIS_PTS_REF SNM07ESUB /end AXIS_DESCR
/end CHARACTERISTIC
/begin CHARACTERISTIC KFWKSTNTM "map weighting of factor cold start" MAP 0x80540FE2 RB_Map_S16S16_U8 0.9961 fak_ub_b1 0.00 0.9961
 /begin AXIS_DESCR STD_AXIS EngStrt_tStrtCoor Temp_Cels 6 -3549.940 3003.560 FORMAT "%8.3" DEPOSIT ABSOLUTE /end AXIS_DESCR
 /begin AXIS_DESCR STD_AXIS Epm_nEng EngN 6 -16384.00 16383.50 FORMAT "%8.2" DEPOSIT ABSOLUTE /end AXIS_DESCR
/end CHARACTERISTIC
/begin CHARACTERISTIC KLANZRKUM "Curve duration in working cycles of transient compensation during injection mode change" CURVE 0x80542238 RB_CurveGroup_U8 255.0 dez 0.00 255.0 FORMAT "%5.1"
 /begin AXIS_DESCR COM_AXIS tmesuk temp_ub_q0p75_o48 9 -48.0 143.3 FORMAT "%5.1" AXIS_PTS_REF STM09ESUB /end AXIS_DESCR
/end CHARACTERISTIC
/begin CHARACTERISTIC KLFIMHU "Factor pulse abrupt" CURVE 0x805424B2 RB_Curve_U8_U8 1.992188 fak_ub_b2 0.00 1.992188 FORMAT "%8.6"
 /begin AXIS_DESCR STD_AXIS anzwe dez 16 0.00 255.0 FORMAT "%5.1" DEPOSIT ABSOLUTE /end AXIS_DESCR
/end CHARACTERISTIC
/begin CHARACTERISTIC KLFIMHUETH "Factor pulse abrupt for ethanol" CURVE 0x805424D3 RB_Curve_U8_U8 1.992188 fak_ub_b2 0.00 1.992188 FORMAT "%8.6"
 /begin AXIS_DESCR STD_AXIS anzwe dez 16 0.00 255.0 FORMAT "%5.1" DEPOSIT ABSOLUTE /end AXIS_DESCR
/end CHARACTERISTIC
/begin CHARACTERISTIC KLFIMWU "Factor pulse smooth" CURVE 0x805424F4 RB_Curve_U8_U8 1.992188 fak_ub_b2 0.00 1.992188 FORMAT "%8.6"
 /begin AXIS_DESCR STD_AXIS anzwe dez 16 0.00 255.0 FORMAT "%5.1" DEPOSIT ABSOLUTE /end AXIS_DESCR
/end CHARACTERISTIC
/begin CHARACTERISTIC KLFIMWUETH "Factor pulse smooth for ethanol" CURVE 0x80542515 RB_Curve_U8_U8 1.992188 fak_ub_b2 0.00 1.992188 FORMAT "%8.6"
 /begin AXIS_DESCR STD_AXIS anzwe dez 16 0.00 255.0 FORMAT "%5.1" DEPOSIT ABSOLUTE /end AXIS_DESCR
/end CHARACTERISTIC
/begin CHARACTERISTIC KLFWENM "factor temperature restart fuel mass depending of engine speed" CURVE 0x80542536 RB_Curve_S16_U8_Static 1.992188 fak_ub_b2 0.00 1.992188 FORMAT "%8.6"
 /begin AXIS_DESCR STD_AXIS Epm_nEng EngN 10 -16384.00 16383.50 FORMAT "%8.2" DEPOSIT ABSOLUTE /end AXIS_DESCR
/end CHARACTERISTIC
/begin CHARACTERISTIC KLFWLN "characteristic line weighting warm-up factor" CURVE 0x8053F5E2 RB_Curve_U8_U8 1.992188 fak_ub_b2 0.00 1.992188 FORMAT "%8.6"
 /begin AXIS_DESCR STD_AXIS Epm_nEngLRes EngN_LRes 6 0.00 10200. FORMAT "%5.0" DEPOSIT ABSOLUTE /end AXIS_DESCR
/end CHARACTERISTIC
/begin CHARACTERISTIC KLKSEBFNS "Correction curve for the factor after start by first fuel filling" CURVE 0x8053F5F0 RB_Curve_U16_U8_Static 1.992188 fak_ub_b2 0.00 1.992188 FORMAT "%8.6"
 /begin AXIS_DESCR STD_AXIS tnse_w_msg t100msxs_uw_b6553p5 4 0.00 6553.500 FORMAT "%8.3" DEPOSIT ABSOLUTE /end AXIS_DESCR
/end CHARACTERISTIC
/begin CHARACTERISTIC KLRERKUM "Curve decay-factor of transient compensation during injection mode change" CURVE 0x80542241 RB_CurveGroup_U8 0.9961 fak_ub_b1 0.00 0.9961
 /begin AXIS_DESCR COM_AXIS tmesuk temp_ub_q0p75_o48 9 -48.0 143.3 FORMAT "%5.1" AXIS_PTS_REF STM09ESUB /end AXIS_DESCR
/end CHARACTERISTIC
/begin CHARACTERISTIC KLRKUMRL "Curve load dependent correction of compensation for operation mode switch" CURVE 0x8054224A RB_Curve_U16_U8_Static 1.992188 fak_ub_b2 0.00 1.992188 FORMAT "%8.6"
 /begin AXIS_DESCR STD_AXIS rlp_w_msg rel_uw_q0p0234 6 0.00 1535.977 FORMAT "%8.3" DEPOSIT ABSOLUTE /end AXIS_DESCR
/end CHARACTERISTIC
/begin CHARACTERISTIC KLTMCHDIFF "Difference of engine temperature during ecu-afterrun for condition hot start" CURVE 0x80541022 RB_Curve_S16_S16 6553.500 temp_q0p1 -3276.800 3276.700 FORMAT "%8.3"
 /begin AXIS_DESCR STD_AXIS EngStrt_tStopCoor Temp_Cels 6 -3549.940 3003.560 FORMAT "%8.3" DEPOSIT ABSOLUTE /end AXIS_DESCR
/end CHARACTERISTIC
/begin CHARACTERISTIC KLTMODT "Threshold difference engine temperature for hot start" CURVE 0x8054103C RB_Curve_S16_S16 6553.500 temp_q0p1 -3276.800 3276.700 FORMAT "%8.3"
 /begin AXIS_DESCR STD_AXIS EngStrt_tStopCoor Temp_Cels 3 -3549.940 3003.560 FORMAT "%8.3" DEPOSIT ABSOLUTE /end AXIS_DESCR
/end CHARACTERISTIC
/begin CHARACTERISTIC KLTNSUUK "Disabling time of transient control during post-cranking" CURVE 0x8054225E RB_Curve_U8_U16_Static 655.3500 t10msxs_uw_b655p35 0.00 655.3500 FORMAT "%8.4"
 /begin AXIS_DESCR STD_AXIS InjSys_tStrtTraCmp temp_ub_q0p75_o48 4 -48.0 143.3 FORMAT "%5.1" DEPOSIT ABSOLUTE /end AXIS_DESCR
/end CHARACTERISTIC
/begin CHARACTERISTIC KLTWSTT "threshold soak time for re-start" CURVE 0x8054104A RB_Curve_S16_U16_Static 65535.00 t1sxs_uw_q1 0.00 65535.00 FORMAT "%8.2"
 /begin AXIS_DESCR STD_AXIS EngStrt_tStopCoor Temp_Cels 12 -3549.940 3003.560 FORMAT "%8.3" DEPOSIT ABSOLUTE /end AXIS_DESCR
/end CHARACTERISTIC
/begin CHARACTERISTIC KLZYKSA "Characteristic curve for offset in pointer on cut-in factors curve" CURVE 0x80542556 RB_FixCurve_U8_U8 255.0 dez 0.00 255.0 FORMAT "%5.1"
 /begin AXIS_DESCR FIX_AXIS anzzyksa_msg dez 5 0.00 4.000 FORMAT "%5.3" FIX_AXIS_PAR 0 0 5 /end AXIS_DESCR
/end CHARACTERISTIC
/begin CHARACTERISTIC KWTMH "engine-temperature - threshold warm" VALUE 0x8054107C RB_Val_Ws16 6553.500 Temp_Cels -3549.940 3003.560 FORMAT "%8.3" /end CHARACTERISTIC
/begin CHARACTERISTIC KWTMHSG "engine temperature hot-start limit" VALUE 0x8054107E RB_Val_Ws16 6553.500 Temp_Cels -3549.940 3003.560 FORMAT "%8.3" /end CHARACTERISTIC
/begin CHARACTERISTIC KWTMK "engine-temperature - threshold cold" VALUE 0x80541080 RB_Val_Ws16 6553.500 Temp_Cels -3549.940 3003.560 FORMAT "%8.3" /end CHARACTERISTIC
/begin CHARACTERISTIC MSNTEVO "Standardized mass flow through the complete open canister purge valve (CPV) (8 Bit)" VALUE 0x80544CCE RB_Val_Wu16 25.59961 m_uw_b25p6 0.00 25.59961 FORMAT "%8.5" /end CHARACTERISTIC
/begin CHARACTERISTIC RKBAUM "rk-threshold for acceleration enrichment display" CURVE 0x8054226C RB_CurveGroup_S16 1535.977 rel_sw_q0p0234 -768.0000 767.9766 FORMAT "%8.4"
 /begin AXIS_DESCR COM_AXIS tmesuk temp_ub_q0p75_o48 9 -48.0 143.3 FORMAT "%5.1" AXIS_PTS_REF STM09ESUB /end AXIS_DESCR
/end CHARACTERISTIC
/begin CHARACTERISTIC RKVAUM "rk-threshold for deceleration enleanment display" CURVE 0x8054227E RB_CurveGroup_S16 1535.977 rel_sw_q0p0234 -768.0000 767.9766 FORMAT "%8.4"
 /begin AXIS_DESCR COM_AXIS tmesuk temp_ub_q0p75_o48 9 -48.0 143.3 FORMAT "%5.1" AXIS_PTS_REF STM09ESUB /end AXIS_DESCR
/end CHARACTERISTIC
/begin AXIS_PTS SNM07ESUB "Base point distribution of engine speed, 14 base pts." 0x80542290 InjSys_nEngLResTraCmp10ms RB_Axis_U8 10200. nmot_ub_q40 7 0.00 10200. FORMAT "%5.0" DEPOSIT ABSOLUTE /end AXIS_PTS
/begin AXIS_PTS SNM07LSUW "Base point distribution for LRS controller parameters" 0x80540C54 LamCtrl_nEngESPLANT RB_Axis_U16 16383.75 nmot_uw_q0p25 7 0.00 16383.75 FORMAT "%8.2" DEPOSIT ABSOLUTE /end AXIS_PTS
/begin AXIS_PTS SRL08LSUW "air charge set points for the controller parameters" 0x80540C64 LamCtrl_ratFillgPlaPrm RB_Axis_U16 1535.977 rel_uw_q0p0234 8 0.00 1535.977 FORMAT "%8.3" DEPOSIT ABSOLUTE /end AXIS_PTS
/begin AXIS_PTS STC12ESUB "Distribution for the engine coolant temperature tmotesnswl for ESNSWL" 0x8053F5FE tmotesnswl RB_Axis_U8 191.3 temp_ub_q0p75_o48 12 -48.0 143.3 FORMAT "%5.1" DEPOSIT ABSOLUTE /end AXIS_PTS
/begin AXIS_PTS STI08ESUB "Distribution for engine coolant temperature at start for ESNSWL" 0x8053F60B tmstesnswl RB_Axis_U8 191.3 temp_ub_q0p75_o48 8 -48.0 143.3 FORMAT "%5.1" DEPOSIT ABSOLUTE /end AXIS_PTS
/begin AXIS_PTS STI12ESUB "Distribution for engine coolant temperature at start for ESNSWL" 0x8053F614 tmstesnswl RB_Axis_U8 191.3 temp_ub_q0p75_o48 12 -48.0 143.3 FORMAT "%5.1" DEPOSIT ABSOLUTE /end AXIS_PTS
/begin AXIS_PTS STM09ESUB "Base point distribution of engine temperature, 9 base pts." 0x80542298 tmesuk RB_Axis_U8 191.3 temp_ub_q0p75_o48 9 -48.0 143.3 FORMAT "%5.1" DEPOSIT ABSOLUTE /end AXIS_PTS
/begin CHARACTERISTIC TANDT "threshold difference intake air temperature for hot start" CURVE 0x80541082 RB_Curve_U8_U8 191.3 temp_ub_b191p25 0.00 191.3 FORMAT "%5.1"
 /begin AXIS_DESCR STD_AXIS tansab_msg temp_ub_q0p75_o48 8 -48.0 143.3 FORMAT "%5.1" DEPOSIT ABSOLUTE /end AXIS_DESCR
/end CHARACTERISTIC
/begin CHARACTERISTIC TANH "intake air temperature - threshold warm" VALUE 0x80541093 RB_Val_Wu8 191.3 temp_ub_q0p75_o48 -48.0 143.3 FORMAT "%5.1" /end CHARACTERISTIC
/begin CHARACTERISTIC TATEGMX "Maximum canister purge valve (CPV) duty cycle for pulsed CPV activation" VALUE 0x80544CD0 RB_Val_Wu16 99.99847 rel_q0p00153 0.00 99.99847 FORMAT "%8.5" /end CHARACTERISTIC
/begin CHARACTERISTIC TATEMSN "Characteristic curve for the duty cycle of the canister purge valve (CPV) depending on the massflow" CURVE 0x80544CD2 RB_Curve_U16_U16 99.99847 rel_q0p00153 0.00 99.99847 FORMAT "%8.5"
 /begin AXIS_DESCR STD_AXIS msntesol_w_msg m_uw_b25p6 15 0.00 25.59961 FORMAT "%8.5" DEPOSIT ABSOLUTE /end AXIS_DESCR
/end CHARACTERISTIC
/begin CHARACTERISTIC TATEOUT1 "calibration output duty cycle for canister purge valve 1 (only for test)" VALUE 0x80544BD0 RB_Val_Wu16 99.99847 rel_uw_b100 0.00 99.99847 FORMAT "%8.5" /end CHARACTERISTIC
/begin CHARACTERISTIC TFUELHST0 "threshold for fuel temperature for hot start" VALUE 0x80541094 RB_Val_Ws16 6553.500 Temp_Cels -3549.940 3003.560 FORMAT "%8.3" /end CHARACTERISTIC
/begin CHARACTERISTIC TNSUKUM "disabling time of injection mode switch compensation during post-cranking" VALUE 0x805422A2 RB_Val_Wu16 655.3500 t_q0p01 0.00 655.3500 FORMAT "%8.4" /end CHARACTERISTIC
/begin CHARACTERISTIC ZBURNLIM "threshold detected combustions for re-start" VALUE 0x80541096 RB_Val_Wu8 255.0 dez 0.00 255.0 FORMAT "%5.1" /end CHARACTERISTIC
/begin CHARACTERISTIC ZUKDEM "Time constant transient control direct injection, tmot dependent" CURVE 0x805422A4 RB_CurveGroup_U16 655.3400 t_q0p01 0.0100 655.3500 FORMAT "%8.4" EXTENDED_LIMITS 0.00 655.3500
 /begin AXIS_DESCR COM_AXIS tmesuk temp_ub_q0p75_o48 9 -48.0 143.3 FORMAT "%5.1" AXIS_PTS_REF STM09ESUB /end AXIS_DESCR
/end CHARACTERISTIC
/begin CHARACTERISTIC ZUKDEMETH "Time constant transient control direct injection, tmot dependent with E85 (or E100)" CURVE 0x805422B6 RB_CurveGroup_U16 655.3400 t_q0p01 0.0100 655.3500 FORMAT "%8.4" EXTENDED_LIMITS 0.00 655.3500
 /begin AXIS_DESCR COM_AXIS tmesuk temp_ub_q0p75_o48 9 -48.0 143.3 FORMAT "%5.1" AXIS_PTS_REF STM09ESUB /end AXIS_DESCR
/end CHARACTERISTIC
/begin CHARACTERISTIC ZUKNSTM "time constant of transient control post cranking factor dependent on engine temperature" CURVE 0x805422C8 RB_CurveGroup_U16 6553.400 t_q0p1 0.100 6553.500 FORMAT "%8.3" EXTENDED_LIMITS 0.00 6553.500
 /begin AXIS_DESCR COM_AXIS tmesuk temp_ub_q0p75_o48 9 -48.0 143.3 FORMAT "%5.1" AXIS_PTS_REF STM09ESUB /end AXIS_DESCR
/end CHARACTERISTIC
/begin CHARACTERISTIC ZUKNSTMETH "time constant of transient control post cranking factor dependent on tmot with E85 (or E100)" CURVE 0x805422DA RB_CurveGroup_U16 6553.400 t_q0p1 0.100 6553.500 FORMAT "%8.3" EXTENDED_LIMITS 0.00 6553.500
 /begin AXIS_DESCR COM_AXIS tmesuk temp_ub_q0p75_o48 9 -48.0 143.3 FORMAT "%5.1" AXIS_PTS_REF STM09ESUB /end AXIS_DESCR
/end CHARACTERISTIC
/begin MEASUREMENT anzrkum "Duration in working cycles of transient compensation during injection mode change" UBYTE dez 1 100 0.00 255.0 FORMAT "%5.1" ECU_ADDRESS 0x70002EF9 /end MEASUREMENT
/begin MEASUREMENT anztist "ti-counter at start" UBYTE OneToOne 1 100 0.00 255.0 FORMAT "%5.1" ECU_ADDRESS 0x60000915 /end MEASUREMENT
/begin MEASUREMENT anztistoffs "injection counter for change in injection-timing" UBYTE OneToOne 1 100 0.00 255.0 FORMAT "%5.1" ECU_ADDRESS 0x70002F67 /end MEASUREMENT
/begin MEASUREMENT anztistreprio "ti-counter at repriorisation of start" UBYTE OneToOne 1 100 0.00 255.0 FORMAT "%5.1" ECU_ADDRESS 0x70002F66 /end MEASUREMENT
/begin MEASUREMENT anztuini_w "Amount of delivered injections during initial fuel filling, notice" UWORD OneToOne 1 100 0.00 65535.00 FORMAT "%8.2" ECU_ADDRESS 0x70002F64 /end MEASUREMENT
/begin MEASUREMENT anzturst_w "Total amount of delivered injections during initial fuel filling" UWORD OneToOne 1 100 0.00 65535.00 FORMAT "%8.2" ECU_ADDRESS 0x60039096 /end MEASUREMENT
/begin MEASUREMENT anzwe "Number of processed cut-in factor after compensation" UBYTE dez 1 100 0.00 255.0 FORMAT "%5.1" ECU_ADDRESS 0x60000916 /end MEASUREMENT
/begin MEASUREMENT anzwefim "number of processed fuel cut-in factors" UBYTE dez 1 100 0.00 255.0 FORMAT "%5.1" ECU_ADDRESS 0x70002EEF /end MEASUREMENT
/begin MEASUREMENT anzzyksa_msg "Number of working cycles with full cut-off" UBYTE dez 1 100 0.00 255.0 FORMAT "%5.1" ECU_ADDRESS 0x70003668 /end MEASUREMENT
/begin MEASUREMENT azylwe "number of processed cut-in cylinders" UBYTE dez 1 100 0.00 255.0 FORMAT "%5.1" ECU_ADDRESS 0x60000918 /end MEASUREMENT
/begin MEASUREMENT BattU_u_ubrsq "Temporary Battery voltage x-input for characteristic map calculating delay time for Canister purge" UBYTE spg_q0p1 1 100 0.00 25.50 FORMAT "%5.2" ECU_ADDRESS 0x6000B0F3 /end MEASUREMENT
/begin MEASUREMENT B_afwe "flag number of restart fuel feed factors" UBYTE B_TRUE 1 100 0.00 1.00000000000 BIT_MASK 0x1 FORMAT "%13.11" ECU_ADDRESS 0x70002EEE /end MEASUREMENT
/begin MEASUREMENT B_bag_msg "Condition large acceleration enrichment" UBYTE B_TRUE 1 100 0.00 1.00000000000 BIT_MASK 0x1 FORMAT "%13.11" ECU_ADDRESS 0x70000C36 /end MEASUREMENT
/begin MEASUREMENT B_eepesstt "Condition Powerfail EEPROM %ESSTT" UBYTE B_TRUE 1 100 0.00 1.00000000000 BIT_MASK 0x1 FORMAT "%13.11" ECU_ADDRESS 0x60039094 /end MEASUREMENT
/begin MEASUREMENT B_fnsoff_msg "Condition switch off calculation of afterstart" UBYTE B_TRUE 1 100 0.00 1.00000000000 BIT_MASK 0x1 FORMAT "%13.11" ECU_ADDRESS 0x70003645 /end MEASUREMENT
/begin MEASUREMENT B_fwe_msg "Condition factor fuel cut-in" UBYTE B_TRUE 1 100 0.00 1.00000000000 BIT_MASK 0x1 FORMAT "%13.11" ECU_ADDRESS 0x70003644 /end MEASUREMENT
/begin MEASUREMENT B_fwloff_msg "Condition switch off calculation of warm-up" UBYTE B_TRUE 1 100 0.00 1.00000000000 BIT_MASK 0x1 FORMAT "%13.11" ECU_ADDRESS 0x70003643 /end MEASUREMENT
/begin MEASUREMENT B_hst "condition hot start" UBYTE B_TRUE 1 100 0.00 1.00000000000 BIT_MASK 0x1 FORMAT "%13.11" ECU_ADDRESS 0x6003908E /end MEASUREMENT
/begin MEASUREMENT B_hstnl "condition hot start caused by engine temperature during ecu-afterrun" UBYTE B_TRUE 1 100 0.00 1.00000000000 BIT_MASK 0x1 FORMAT "%13.11" ECU_ADDRESS 0x6000B104 /end MEASUREMENT
/begin MEASUREMENT B_hstverd_msg "condition suspect of hot start" UBYTE B_TRUE 1 100 0.00 1.00000000000 BIT_MASK 0x1 FORMAT "%13.11" ECU_ADDRESS 0x6000EE98 /end MEASUREMENT
/begin MEASUREMENT B_hst_msg "condition hot start" UBYTE B_TRUE 1 100 0.00 1.00000000000 BIT_MASK 0x1 FORMAT "%13.11" ECU_ADDRESS 0x60039553 /end MEASUREMENT
/begin MEASUREMENT B_mdein_msg "Condition actions on the torque are active" UBYTE B_TRUE 1 100 0.00 1.00000000000 BIT_MASK 0x1 FORMAT "%13.11" ECU_ADDRESS 0x70000B6E /end MEASUREMENT
/begin MEASUREMENT B_mibeg_msg "condition torque limit active" UBYTE B_TRUE 1 100 0.00 1.00000000000 BIT_MASK 0x1 FORMAT "%13.11" ECU_ADDRESS 0x70000B6B /end MEASUREMENT
/begin MEASUREMENT B_nswlmod "Condition mode afterstart and warm-up" UBYTE B_TRUE 1 100 0.00 1.00000000000 BIT_MASK 0x1 FORMAT "%13.11" ECU_ADDRESS 0x70003026 /end MEASUREMENT
/begin MEASUREMENT B_qmismeus_msg "Acknowledge for turning on correction of driver demanded torque" UBYTE B_TRUE 1 100 0.00 1.00000000000 BIT_MASK 0x1 FORMAT "%13.11" ECU_ADDRESS 0x70000B36 /end MEASUREMENT
/begin MEASUREMENT B_rkum "Condition correction value for injection mode switch active" UBYTE B_TRUE 1 100 0.00 1.00000000000 BIT_MASK 0x1 FORMAT "%13.11" ECU_ADDRESS 0x700002B3 /end MEASUREMENT
/begin MEASUREMENT B_sa_msg "Fuel cut-off" UBYTE B_TRUE 1 100 0.00 1.00000000000 BIT_MASK 0x1 FORMAT "%13.11" ECU_ADDRESS 0x70000B31 /end MEASUREMENT
/begin MEASUREMENT B_tatewi_msg "condition immediate ouput of the duty cycle" UBYTE B_TRUE 1 100 0.00 1.00000000000 BIT_MASK 0x1 FORMAT "%13.11" ECU_ADDRESS 0x6000F217 /end MEASUREMENT
/begin MEASUREMENT B_tevtini_msg "TEV timer re-initialized" UBYTE B_TRUE 1 100 0.00 1.00000000000 BIT_MASK 0x1 FORMAT "%13.11" ECU_ADDRESS 0x6000F214 /end MEASUREMENT
/begin MEASUREMENT B_tldcvs_msg "Vent solenoid of carbon canister close for tank leak diagnosis" UBYTE B_TRUE 1 100 0.00 1.00000000000 BIT_MASK 0x1 FORMAT "%13.11" ECU_ADDRESS 0x600001C3 /end MEASUREMENT
/begin MEASUREMENT B_uk1 "Enable condition for transient control" UBYTE B_TRUE 1 100 0.00 1.00000000000 BIT_MASK 0x1 FORMAT "%13.11" ECU_ADDRESS 0x700002B2 /end MEASUREMENT
/begin MEASUREMENT B_ukns "Enable condition transient contr. after cranking" UBYTE B_TRUE 1 100 0.00 1.00000000000 BIT_MASK 0x1 FORMAT "%13.11" ECU_ADDRESS 0x700002B1 /end MEASUREMENT
/begin MEASUREMENT B_uknsll "Enable condition transient contr. after cranking depending on state of axles coordinator and catalyst heating active" UBYTE B_TRUE 1 100 0.00 1.00000000000 BIT_MASK 0x1 FORMAT "%13.11" ECU_ADDRESS 0x700002B0 /end MEASUREMENT
/begin MEASUREMENT B_ukum "Condition: Enable condtion for the injection mode switch compensation" UBYTE B_TRUE 1 100 0.00 1.00000000000 BIT_MASK 0x1 FORMAT "%13.11" ECU_ADDRESS 0x700002AF /end MEASUREMENT
/begin MEASUREMENT B_vag_msg "Condition large deceleration enleanment" UBYTE B_TRUE 1 100 0.00 1.00000000000 BIT_MASK 0x1 FORMAT "%13.11" ECU_ADDRESS 0x70000AF3 /end MEASUREMENT
/begin MEASUREMENT B_vbmg_msg "condition combustion possible" UBYTE B_TRUE 1 100 0.00 1.00000000000 BIT_MASK 0x1 FORMAT "%13.11" ECU_ADDRESS 0x70003636 /end MEASUREMENT
/begin MEASUREMENT B_wks_msg "Condition cold restart" UBYTE B_TRUE 1 100 0.00 1.00000000000 BIT_MASK 0x1 FORMAT "%13.11" ECU_ADDRESS 0x6000EE84 /end MEASUREMENT
/begin MEASUREMENT B_wst0 "Condition restart (part 1: combustions detected)" UBYTE B_TRUE 1 100 0.00 1.00000000000 BIT_MASK 0x1 FORMAT "%13.11" ECU_ADDRESS 0x60039093 /end MEASUREMENT
/begin MEASUREMENT B_wst1 "Condition restart (part 2: soak time)" UBYTE B_TRUE 1 100 0.00 1.00000000000 BIT_MASK 0x1 FORMAT "%13.11" ECU_ADDRESS 0x70002F62 /end MEASUREMENT
/begin MEASUREMENT B_wst2 "Condition restart (part1: combustions detected in last cycle)" UBYTE B_TRUE 1 100 0.00 1.00000000000 BIT_MASK 0x1 FORMAT "%13.11" ECU_ADDRESS 0x70002F61 /end MEASUREMENT
/begin MEASUREMENT B_wst_msg "condition for restart" UBYTE B_TRUE 1 100 0.00 1.00000000000 BIT_MASK 0x1 FORMAT "%13.11" ECU_ADDRESS 0x6000EE83 /end MEASUREMENT
/begin MEASUREMENT B_zwsol_msg "Condition for computation of desired ignition angle" UBYTE B_TRUE 1 100 0.00 1.00000000000 BIT_MASK 0x1 FORMAT "%13.11" ECU_ADDRESS 0x70000AE0 /end MEASUREMENT
/begin MEASUREMENT CstrPurg_ratPercCpv "output duty cycle of CPV" SWORD rel_sw_b100 1 100 -100.0000 99.9969 FORMAT "%8.4" ECU_ADDRESS 0x600091F4 /end MEASUREMENT
/begin MEASUREMENT CstrPurg_ratSp "desired duty cycle of the first PCV" UWORD rel_q0p00153 1 100 0.00 99.99847 FORMAT "%8.5" ECU_ADDRESS 0x60008CB2 /end MEASUREMENT
/begin MEASUREMENT CstrPurg_ratSpCorrn "correction desired duty cycle of the first PCV" SWORD rel_sw_b100 1 100 -100.0000 99.9969 FORMAT "%8.4" ECU_ADDRESS 0x60007080 /end MEASUREMENT
/begin MEASUREMENT danzwefim_msg "offset on the number of processed fuel cut-in factors" UBYTE dez 1 100 0.00 255.0 FORMAT "%5.1" ECU_ADDRESS 0x70003664 /end MEASUREMENT
/begin MEASUREMENT dmrmx_w_msg "delta torque for charge by torque reserve" UWORD rel_uw_b100 1 100 0.00 99.99847 FORMAT "%8.5" ECU_ADDRESS 0x60014000 /end MEASUREMENT
/begin MEASUREMENT drkuk_w "delta relative fuel mass flow transient control" UWORD rel_uw_q0p0234 1 100 0.00 1535.977 FORMAT "%8.3" ECU_ADDRESS 0x600070A6 /end MEASUREMENT
/begin MEASUREMENT drlpLT_w "delta predicted load for injection time calculation (filtered value)" SWORD rel_sw_q0p0234 1 100 -768.0000 767.9766 FORMAT "%8.4" ECU_ADDRESS 0x600070A4 /end MEASUREMENT
/begin MEASUREMENT EngStrt_bCdnCmbPsbl "condition combustion possible" UBYTE B_TRUE 1 100 0.00 1.00000000000 BIT_MASK 0x1 FORMAT "%13.11" ECU_ADDRESS 0x70002F60 /end MEASUREMENT
/begin MEASUREMENT EngStrt_bIniFuelMod "Condition first Injection for initial fueling mode accomplished" UBYTE B_TRUE 1 100 0.00 1.00000000000 BIT_MASK 0x1 FORMAT "%13.11" ECU_ADDRESS 0x60039092 /end MEASUREMENT
/begin MEASUREMENT EngStrt_ctEsnswlReIniSyncS0 "Local variable to store the global post-drive leave counter(SyC_ctPostDrvLeave)" UBYTE OneToOne 1 100 0.00 255.0 FORMAT "%5.1" ECU_ADDRESS 0x70003025 /end MEASUREMENT
/begin MEASUREMENT EngStrt_facAftStrtWrmUp "Factor afterstart and warm-up" UWORD fak_uw_b16 1 100 0.00 15.99976 FORMAT "%8.5" ECU_ADDRESS 0x70003982 /end MEASUREMENT
/begin MEASUREMENT EngStrt_facBascValAftStrt "base value for after start correction" UBYTE fak_ub_b4 1 100 0.00 3.984 FORMAT "%5.3" ARRAY_SIZE 4 ECU_ADDRESS 0x70003021 /end MEASUREMENT
/begin MEASUREMENT EngStrt_facStrtCorrn "Correction factor for injection factor at start" UWORD fak_uw_b64 1 100 0.00 63.99902 FORMAT "%8.5" ECU_ADDRESS 0x70002F5E /end MEASUREMENT
/begin MEASUREMENT EngStrt_facStrtCorrnBasc "Correction factor for injection factor at start (basic value)" UWORD fak_uw_b64 1 100 0.00 63.99902 FORMAT "%8.5" ECU_ADDRESS 0x70002F5C /end MEASUREMENT
/begin MEASUREMENT EngStrt_facWrmUpLd "base value for warm up correction" UBYTE fak_ub_b2 1 100 0.00 1.992188 FORMAT "%8.6" ARRAY_SIZE 4 ECU_ADDRESS 0x7000301D /end MEASUREMENT
/begin MEASUREMENT EngStrt_flgInjTmngErly "condition early injection" UBYTE B_TRUE 1 100 0.00 1.00000000000 BIT_MASK 0x1 FORMAT "%13.11" ECU_ADDRESS 0x70002F5B /end MEASUREMENT
/begin MEASUREMENT EngStrt_flgRePrioLocFuStrt "Start repriorisation" UBYTE B_TRUE 1 100 0.00 1.00000000000 BIT_MASK 0x1 FORMAT "%13.11" ECU_ADDRESS 0x70002F5A /end MEASUREMENT
/begin MEASUREMENT EngStrt_flgShDwnTiVld "shut-down time valid" UBYTE B_TRUE 1 100 0.00 1.00000000000 BIT_MASK 0x1 FORMAT "%13.11" ECU_ADDRESS 0x6000EE57 /end MEASUREMENT
/begin MEASUREMENT EngStrt_idxClassSeldFuStrt "selected ESSTT class" UBYTE OneToOne 1 100 0.00 4.000 FORMAT "%5.3" ECU_ADDRESS 0x70002F59 /end MEASUREMENT
/begin MEASUREMENT EngStrt_idxInstSeldAlti "instance selection of altitude class" UBYTE ENGSTRT_ESSTTALTI_SET_COMPU_VERB 1 100 0.00 2.00000000000 FORMAT "%13.11" ECU_ADDRESS 0x70002F58 /end MEASUREMENT
/begin MEASUREMENT EngStrt_idxInstSeldBaseFuStrt "selected instance of ESSTT base class" UBYTE ENGSTRT_ESSTTBASESYNCS0_SET_COMPU_VERB 1 100 0.00 3.00000000000 FORMAT "%13.11" ECU_ADDRESS 0x70002F57 /end MEASUREMENT
/begin MEASUREMENT EngStrt_idxInstSeldDirstFuStrt "selected instance of ESSTT direct start class" UBYTE ENGSTRT_ESSTTDIRSTSYNCS1_SET_COMPU_VERB 1 100 0.00 0.00 FORMAT "%13.2" ECU_ADDRESS 0x70002F56 /end MEASUREMENT
/begin MEASUREMENT EngStrt_stAftStrtDeactvn "base value for the downward regulation of the afterstart factor" UBYTE fak_ub_b2 1 100 0.00 1.992188 FORMAT "%8.6" ARRAY_SIZE 4 ECU_ADDRESS 0x70003019 /end MEASUREMENT
/begin MEASUREMENT EngStrt_stInjESNSWLMode "Class selection for function ESNSWL (fuel enrichment during afterstart and warm-up) based on injection mode" UBYTE ENGSTRT_ESNSWLMODEPOI_SET_COMPU_VERB 1 100 0.00 3.00000000000 FORMAT "%13.11" ECU_ADDRESS 0x7000370B /end MEASUREMENT
/begin MEASUREMENT EngStrt_tiEngOffESNSWL "local engine off time ESNSWL" UWORD t_q1 1 100 0.00 65535.00 FORMAT "%8.2" ECU_ADDRESS 0x70003980 /end MEASUREMENT
/begin MEASUREMENT EngStrt_tInkMnfldESSTT "Intake manifold temperature in ESSTT" UBYTE temp_ub_q0p75_o48 1 100 -48.0 143.3 FORMAT "%5.1" ECU_ADDRESS 0x6000B103 /end MEASUREMENT
/begin MEASUREMENT EngT_tDiffEssttLoc "difference engine temperature in ECU post drive" SWORD temp_q0p1 1 100 -3276.800 3276.700 FORMAT "%8.3" ECU_ADDRESS 0x600070AA /end MEASUREMENT
/begin MEASUREMENT EngT_tMxEssttLoc "local copy max. value engine temp. (eng. coolant or cyl. head)" SWORD Temp_Cels 1 100 -3549.940 3003.560 FORMAT "%8.3" ECU_ADDRESS 0x60039090 /end MEASUREMENT
/begin MEASUREMENT Epm_nEngLRes_nmot "Temporary engine speed x-input for characteristic map for time period of canister purge." UBYTE nmot_ub_q40 1 100 0.00 10200. FORMAT "%5.0" ECU_ADDRESS 0x6000B0F2 /end MEASUREMENT
/begin MEASUREMENT ESNSWL_classSelect "A Local variable for class select in ESNSWL" UBYTE dez 1 100 0.00 255.0 FORMAT "%5.1" ECU_ADDRESS 0x70003018 /end MEASUREMENT
/begin MEASUREMENT ESNSWL_HOM.B_fnsb1 "base class of function ESNSWL (Fuel enrichment during afterstart and warm-up) / Condition afterstart decrease range 1 active during afterstart enrichment" UBYTE B_TRUE 1 100 0.00 1.00000000000 BIT_MASK 0x1 FORMAT "%13.11" ECU_ADDRESS 0x70002F6C /end MEASUREMENT
/begin MEASUREMENT ESNSWL_HOM.B_fnsb2 "base class of function ESNSWL (Fuel enrichment during afterstart and warm-up) / Condition afterstart decrease range 2 active during afterstart enrichment" UBYTE B_TRUE 1 100 0.00 1.00000000000 BIT_MASK 0x1 FORMAT "%13.11" ECU_ADDRESS 0x70002F6D /end MEASUREMENT
/begin MEASUREMENT ESNSWL_HOM.B_fnsb3 "base class of function ESNSWL (Fuel enrichment during afterstart and warm-up) / Condition afterstart decrease range 3 active during afterstart enrichment" UBYTE B_TRUE 1 100 0.00 1.00000000000 BIT_MASK 0x1 FORMAT "%13.11" ECU_ADDRESS 0x70002F6E /end MEASUREMENT
/begin MEASUREMENT ESNSWL_HOM.abr1_count "base class of function ESNSWL (Fuel enrichment during afterstart and warm-up) / Counter of ignitions for downward regulation of afterstart and warmup enrichment" UBYTE dez 1 100 0.00 255.0 FORMAT "%5.1" ECU_ADDRESS 0x70002F6F /end MEASUREMENT
/begin MEASUREMENT ESNSWL_HOM.fipoleth "base class of function ESNSWL (Fuel enrichment during afterstart and warm-up) / Factor interpolation betwenn E85 (or E100) and E0 for injection functions" UBYTE fak_ub_b1 1 100 0.00 0.9961 ECU_ADDRESS 0x70002F70 /end MEASUREMENT
/begin MEASUREMENT ESNSWL_HOM.fwllr "base class of function ESNSWL (Fuel enrichment during afterstart and warm-up) / base warm up enrichment factor" UBYTE fak_ub_b2 1 100 0.00 1.992188 FORMAT "%8.6" ECU_ADDRESS 0x70002F71 /end MEASUREMENT
/begin MEASUREMENT ESNSWL_HOM.fwllrl "base class of function ESNSWL (Fuel enrichment during afterstart and warm-up) / base value for warm up enrichment correction" UBYTE fak_ub_b2 1 100 0.00 1.992188 FORMAT "%8.6" ECU_ADDRESS 0x70002F72 /end MEASUREMENT
/begin MEASUREMENT ESNSWL_HOM.fwlrl "base class of function ESNSWL (Fuel enrichment during afterstart and warm-up) / base warm-up enrichment factor load dependent fraction" UBYTE fak_ub_b2 1 100 0.00 1.992188 FORMAT "%8.6" ECU_ADDRESS 0x70002F73 /end MEASUREMENT
/begin MEASUREMENT ESNSWL_HOM.fwlrlml "base class of function ESNSWL (Fuel enrichment during afterstart and warm-up) / Base warm-up enrichment factor load dependent after weighting" UBYTE fak_ub_b2 1 100 0.00 1.992188 FORMAT "%8.6" ECU_ADDRESS 0x70002F74 /end MEASUREMENT
/begin MEASUREMENT ESNSWL_HOM.gkfkfwwlml "base class of function ESNSWL (Fuel enrichment during afterstart and warm-up) / Weighting of the warm-up ramp-down factor for load dependency" UBYTE fak_ub_b2 1 100 0.00 1.992188 FORMAT "%8.6" ECU_ADDRESS 0x70002F76 /end MEASUREMENT
/begin MEASUREMENT ESNSWL_HOM.gkfns "base class of function ESNSWL (Fuel enrichment during afterstart and warm-up) / base value for after start enrichment correction after weithing and downward regulation" UBYTE fak_ub_b4 1 100 0.00 3.984 FORMAT "%5.3" ECU_ADDRESS 0x70002F77 /end MEASUREMENT
/begin MEASUREMENT ESNSWL_HOM.gklfns "base class of function ESNSWL (Fuel enrichment during afterstart and warm-up) / base value for after start enrichment correction" UBYTE fak_ub_b4 1 100 0.00 3.984 FORMAT "%5.3" ECU_ADDRESS 0x70002F78 /end MEASUREMENT
/begin MEASUREMENT ESNSWL_HOM.gklfzansh1 "base class of function ESNSWL (Fuel enrichment during afterstart and warm-up) / Factor for ign. sync. decreasing of afterstart enrichment in range 1 for homogen" UBYTE fak_ub_b0p25 1 100 0.00 0.249023438 FORMAT "%11.9" ECU_ADDRESS 0x70002F79 /end MEASUREMENT
/begin MEASUREMENT ESNSWL_HOM.gklfzansh2 "base class of function ESNSWL (Fuel enrichment during afterstart and warm-up) / Factor for ign. sync. decreasing of afterstart enrichment in range 2 for homogen" UBYTE fak_ub_b0p25 1 100 0.00 0.249023438 FORMAT "%11.9" ECU_ADDRESS 0x70002F7A /end MEASUREMENT
/begin MEASUREMENT ESNSWL_HOM.gklfzansh3 "base class of function ESNSWL (Fuel enrichment during afterstart and warm-up) / Factor for ign. sync. decreasing of afterstart enrichment in range 3 for homogen" UBYTE fak_ub_b0p25 1 100 0.00 0.249023438 FORMAT "%11.9" ECU_ADDRESS 0x70002F7B /end MEASUREMENT
/begin MEASUREMENT ESNSWL_HOM.gklszansh1 "base class of function ESNSWL (Fuel enrichment during afterstart and warm-up) / Switching range 1 of afterstart enrichment for homogenous mode" UBYTE fak_ub_b2 1 100 0.00 1.000000 FORMAT "%8.6" ECU_ADDRESS 0x70002F7E /end MEASUREMENT
/begin MEASUREMENT ESNSWL_HOM.gklszansh2 "base class of function ESNSWL (Fuel enrichment during afterstart and warm-up) / Switching range 2 of afterstart enrichment for homogenous mode" UBYTE fak_ub_b2 1 100 0.00 1.000000 FORMAT "%8.6" ECU_ADDRESS 0x70002F7F /end MEASUREMENT
/begin MEASUREMENT ESNSWL_HOM.nsactr "base class of function ESNSWL (Fuel enrichment during afterstart and warm-up) / base value for the downward regulation of the afterstart enrichment factor" UBYTE fak_ub_b2 1 100 0.00 1.992188 FORMAT "%8.6" ECU_ADDRESS 0x70002F81 /end MEASUREMENT
/begin MEASUREMENT ESNSWL_HOM.nsactrout "base class of function ESNSWL (Fuel enrichment during afterstart and warm-up) / base value for the downward regulation of the afterstart enrichment factor" UBYTE fak_ub_b2 1 100 0.00 1.992188 FORMAT "%8.6" ECU_ADDRESS 0x70002F82 /end MEASUREMENT
/begin MEASUREMENT ESNSWL_HOM_KL.B_fnsb1 " / Condition afterstart decrease range 1 active during afterstart enrichment" UBYTE B_TRUE 1 100 0.00 1.00000000000 BIT_MASK 0x1 FORMAT "%13.11" ECU_ADDRESS 0x70002FC0 /end MEASUREMENT
/begin MEASUREMENT ESNSWL_HOM_KL.B_fnsb2 " / Condition afterstart decrease range 2 active during afterstart enrichment" UBYTE B_TRUE 1 100 0.00 1.00000000000 BIT_MASK 0x1 FORMAT "%13.11" ECU_ADDRESS 0x70002FC1 /end MEASUREMENT
/begin MEASUREMENT ESNSWL_HOM_KL.B_fnsb3 " / Condition afterstart decrease range 3 active during afterstart enrichment" UBYTE B_TRUE 1 100 0.00 1.00000000000 BIT_MASK 0x1 FORMAT "%13.11" ECU_ADDRESS 0x70002FC2 /end MEASUREMENT
/begin MEASUREMENT ESNSWL_HOM_KL.abr1_count " / Counter of ignitions for downward regulation of afterstart and warmup enrichment" UBYTE dez 1 100 0.00 255.0 FORMAT "%5.1" ECU_ADDRESS 0x70002FC3 /end MEASUREMENT
/begin MEASUREMENT ESNSWL_HOM_KL.fipoleth " / Factor interpolation betwenn E85 (or E100) and E0 for injection functions" UBYTE fak_ub_b1 1 100 0.00 0.9961 ECU_ADDRESS 0x70002FC4 /end MEASUREMENT
/begin MEASUREMENT ESNSWL_HOM_KL.fwllr " / base warm up enrichment factor" UBYTE fak_ub_b2 1 100 0.00 1.992188 FORMAT "%8.6" ECU_ADDRESS 0x70002FC5 /end MEASUREMENT
/begin MEASUREMENT ESNSWL_HOM_KL.fwllrl " / base value for warm up enrichment correction" UBYTE fak_ub_b2 1 100 0.00 1.992188 FORMAT "%8.6" ECU_ADDRESS 0x70002FC6 /end MEASUREMENT
/begin MEASUREMENT ESNSWL_HOM_KL.fwlrl " / base warm-up enrichment factor load dependent fraction" UBYTE fak_ub_b2 1 100 0.00 1.992188 FORMAT "%8.6" ECU_ADDRESS 0x70002FC7 /end MEASUREMENT
/begin MEASUREMENT ESNSWL_HOM_KL.fwlrlml " / Base warm-up enrichment factor load dependent after weighting" UBYTE fak_ub_b2 1 100 0.00 1.992188 FORMAT "%8.6" ECU_ADDRESS 0x70002FC8 /end MEASUREMENT
/begin MEASUREMENT ESNSWL_HOM_KL.gkfkfwwlml " / Weighting of the warm-up ramp-down factor for load dependency" UBYTE fak_ub_b2 1 100 0.00 1.992188 FORMAT "%8.6" ECU_ADDRESS 0x70002FCA /end MEASUREMENT
/begin MEASUREMENT ESNSWL_HOM_KL.gkfns " / base value for after start enrichment correction after weithing and downward regulation" UBYTE fak_ub_b4 1 100 0.00 3.984 FORMAT "%5.3" ECU_ADDRESS 0x70002FCB /end MEASUREMENT
/begin MEASUREMENT ESNSWL_HOM_KL.gklfns " / base value for after start enrichment correction" UBYTE fak_ub_b4 1 100 0.00 3.984 FORMAT "%5.3" ECU_ADDRESS 0x70002FCC /end MEASUREMENT
/begin MEASUREMENT ESNSWL_HOM_KL.gklfzansh1 " / Factor for ign. sync. decreasing of afterstart enrichment in range 1 for homogen" UBYTE fak_ub_b0p25 1 100 0.00 0.249023438 FORMAT "%11.9" ECU_ADDRESS 0x70002FCD /end MEASUREMENT
/begin MEASUREMENT ESNSWL_HOM_KL.gklfzansh2 " / Factor for ign. sync. decreasing of afterstart enrichment in range 2 for homogen" UBYTE fak_ub_b0p25 1 100 0.00 0.249023438 FORMAT "%11.9" ECU_ADDRESS 0x70002FCE /end MEASUREMENT
/begin MEASUREMENT ESNSWL_HOM_KL.gklfzansh3 " / Factor for ign. sync. decreasing of afterstart enrichment in range 3 for homogen" UBYTE fak_ub_b0p25 1 100 0.00 0.249023438 FORMAT "%11.9" ECU_ADDRESS 0x70002FCF /end MEASUREMENT
/begin MEASUREMENT ESNSWL_HOM_KL.gklszansh1 " / Switching range 1 of afterstart enrichment for homogenous mode" UBYTE fak_ub_b2 1 100 0.00 1.000000 FORMAT "%8.6" ECU_ADDRESS 0x70002FD2 /end MEASUREMENT
/begin MEASUREMENT ESNSWL_HOM_KL.gklszansh2 " / Switching range 2 of afterstart enrichment for homogenous mode" UBYTE fak_ub_b2 1 100 0.00 1.000000 FORMAT "%8.6" ECU_ADDRESS 0x70002FD3 /end MEASUREMENT
/begin MEASUREMENT ESNSWL_HOM_KL.nsactr " / base value for the downward regulation of the afterstart enrichment factor" UBYTE fak_ub_b2 1 100 0.00 1.992188 FORMAT "%8.6" ECU_ADDRESS 0x70002FD5 /end MEASUREMENT
/begin MEASUREMENT ESNSWL_HOM_KL.nsactrout " / base value for the downward regulation of the afterstart enrichment factor" UBYTE fak_ub_b2 1 100 0.00 1.992188 FORMAT "%8.6" ECU_ADDRESS 0x70002FD6 /end MEASUREMENT
/begin MEASUREMENT ESNSWL_HSP.B_fnsb1 " / Condition afterstart decrease range 1 active during afterstart enrichment" UBYTE B_TRUE 1 100 0.00 1.00000000000 BIT_MASK 0x1 FORMAT "%13.11" ECU_ADDRESS 0x70002FA4 /end MEASUREMENT
/begin MEASUREMENT ESNSWL_HSP.B_fnsb2 " / Condition afterstart decrease range 2 active during afterstart enrichment" UBYTE B_TRUE 1 100 0.00 1.00000000000 BIT_MASK 0x1 FORMAT "%13.11" ECU_ADDRESS 0x70002FA5 /end MEASUREMENT
/begin MEASUREMENT ESNSWL_HSP.B_fnsb3 " / Condition afterstart decrease range 3 active during afterstart enrichment" UBYTE B_TRUE 1 100 0.00 1.00000000000 BIT_MASK 0x1 FORMAT "%13.11" ECU_ADDRESS 0x70002FA6 /end MEASUREMENT
/begin MEASUREMENT ESNSWL_HSP.abr1_count " / Counter of ignitions for downward regulation of afterstart and warmup enrichment" UBYTE dez 1 100 0.00 255.0 FORMAT "%5.1" ECU_ADDRESS 0x70002FA7 /end MEASUREMENT
/begin MEASUREMENT ESNSWL_HSP.fipoleth " / Factor interpolation betwenn E85 (or E100) and E0 for injection functions" UBYTE fak_ub_b1 1 100 0.00 0.9961 ECU_ADDRESS 0x70002FA8 /end MEASUREMENT
/begin MEASUREMENT ESNSWL_HSP.fwllr " / base warm up enrichment factor" UBYTE fak_ub_b2 1 100 0.00 1.992188 FORMAT "%8.6" ECU_ADDRESS 0x70002FA9 /end MEASUREMENT
/begin MEASUREMENT ESNSWL_HSP.fwllrl " / base value for warm up enrichment correction" UBYTE fak_ub_b2 1 100 0.00 1.992188 FORMAT "%8.6" ECU_ADDRESS 0x70002FAA /end MEASUREMENT
/begin MEASUREMENT ESNSWL_HSP.fwlrl " / base warm-up enrichment factor load dependent fraction" UBYTE fak_ub_b2 1 100 0.00 1.992188 FORMAT "%8.6" ECU_ADDRESS 0x70002FAB /end MEASUREMENT
/begin MEASUREMENT ESNSWL_HSP.fwlrlml " / Base warm-up enrichment factor load dependent after weighting" UBYTE fak_ub_b2 1 100 0.00 1.992188 FORMAT "%8.6" ECU_ADDRESS 0x70002FAC /end MEASUREMENT
/begin MEASUREMENT ESNSWL_HSP.gkfkfwwlml " / Weighting of the warm-up ramp-down factor for load dependency" UBYTE fak_ub_b2 1 100 0.00 1.992188 FORMAT "%8.6" ECU_ADDRESS 0x70002FAE /end MEASUREMENT
/begin MEASUREMENT ESNSWL_HSP.gkfns " / base value for after start enrichment correction after weithing and downward regulation" UBYTE fak_ub_b4 1 100 0.00 3.984 FORMAT "%5.3" ECU_ADDRESS 0x70002FAF /end MEASUREMENT
/begin MEASUREMENT ESNSWL_HSP.gklfns " / base value for after start enrichment correction" UBYTE fak_ub_b4 1 100 0.00 3.984 FORMAT "%5.3" ECU_ADDRESS 0x70002FB0 /end MEASUREMENT
/begin MEASUREMENT ESNSWL_HSP.gklfzansh1 " / Factor for ign. sync. decreasing of afterstart enrichment in range 1 for homogen" UBYTE fak_ub_b0p25 1 100 0.00 0.249023438 FORMAT "%11.9" ECU_ADDRESS 0x70002FB1 /end MEASUREMENT
/begin MEASUREMENT ESNSWL_HSP.gklfzansh2 " / Factor for ign. sync. decreasing of afterstart enrichment in range 2 for homogen" UBYTE fak_ub_b0p25 1 100 0.00 0.249023438 FORMAT "%11.9" ECU_ADDRESS 0x70002FB2 /end MEASUREMENT
/begin MEASUREMENT ESNSWL_HSP.gklfzansh3 " / Factor for ign. sync. decreasing of afterstart enrichment in range 3 for homogen" UBYTE fak_ub_b0p25 1 100 0.00 0.249023438 FORMAT "%11.9" ECU_ADDRESS 0x70002FB3 /end MEASUREMENT
/begin MEASUREMENT ESNSWL_HSP.gklszansh1 " / Switching range 1 of afterstart enrichment for homogenous mode" UBYTE fak_ub_b2 1 100 0.00 1.000000 FORMAT "%8.6" ECU_ADDRESS 0x70002FB6 /end MEASUREMENT
/begin MEASUREMENT ESNSWL_HSP.gklszansh2 " / Switching range 2 of afterstart enrichment for homogenous mode" UBYTE fak_ub_b2 1 100 0.00 1.000000 FORMAT "%8.6" ECU_ADDRESS 0x70002FB7 /end MEASUREMENT
/begin MEASUREMENT ESNSWL_HSP.nsactr " / base value for the downward regulation of the afterstart enrichment factor" UBYTE fak_ub_b2 1 100 0.00 1.992188 FORMAT "%8.6" ECU_ADDRESS 0x70002FB9 /end MEASUREMENT
/begin MEASUREMENT ESNSWL_HSP.nsactrout " / base value for the downward regulation of the afterstart enrichment factor" UBYTE fak_ub_b2 1 100 0.00 1.992188 FORMAT "%8.6" ECU_ADDRESS 0x70002FBA /end MEASUREMENT
/begin MEASUREMENT ESNSWL_HSP_KL.B_fnsb1 " / Condition afterstart decrease range 1 active during afterstart enrichment" UBYTE B_TRUE 1 100 0.00 1.00000000000 BIT_MASK 0x1 FORMAT "%13.11" ECU_ADDRESS 0x70002F88 /end MEASUREMENT
/begin MEASUREMENT ESNSWL_HSP_KL.B_fnsb2 " / Condition afterstart decrease range 2 active during afterstart enrichment" UBYTE B_TRUE 1 100 0.00 1.00000000000 BIT_MASK 0x1 FORMAT "%13.11" ECU_ADDRESS 0x70002F89 /end MEASUREMENT
/begin MEASUREMENT ESNSWL_HSP_KL.B_fnsb3 " / Condition afterstart decrease range 3 active during afterstart enrichment" UBYTE B_TRUE 1 100 0.00 1.00000000000 BIT_MASK 0x1 FORMAT "%13.11" ECU_ADDRESS 0x70002F8A /end MEASUREMENT
/begin MEASUREMENT ESNSWL_HSP_KL.abr1_count " / Counter of ignitions for downward regulation of afterstart and warmup enrichment" UBYTE dez 1 100 0.00 255.0 FORMAT "%5.1" ECU_ADDRESS 0x70002F8B /end MEASUREMENT
/begin MEASUREMENT ESNSWL_HSP_KL.fipoleth " / Factor interpolation betwenn E85 (or E100) and E0 for injection functions" UBYTE fak_ub_b1 1 100 0.00 0.9961 ECU_ADDRESS 0x70002F8C /end MEASUREMENT
/begin MEASUREMENT ESNSWL_HSP_KL.fwllr " / base warm up enrichment factor" UBYTE fak_ub_b2 1 100 0.00 1.992188 FORMAT "%8.6" ECU_ADDRESS 0x70002F8D /end MEASUREMENT
/begin MEASUREMENT ESNSWL_HSP_KL.fwllrl " / base value for warm up enrichment correction" UBYTE fak_ub_b2 1 100 0.00 1.992188 FORMAT "%8.6" ECU_ADDRESS 0x70002F8E /end MEASUREMENT
/begin MEASUREMENT ESNSWL_HSP_KL.fwlrl " / base warm-up enrichment factor load dependent fraction" UBYTE fak_ub_b2 1 100 0.00 1.992188 FORMAT "%8.6" ECU_ADDRESS 0x70002F8F /end MEASUREMENT
/begin MEASUREMENT ESNSWL_HSP_KL.fwlrlml " / Base warm-up enrichment factor load dependent after weighting" UBYTE fak_ub_b2 1 100 0.00 1.992188 FORMAT "%8.6" ECU_ADDRESS 0x70002F90 /end MEASUREMENT
/begin MEASUREMENT ESNSWL_HSP_KL.gkfkfwwlml " / Weighting of the warm-up ramp-down factor for load dependency" UBYTE fak_ub_b2 1 100 0.00 1.992188 FORMAT "%8.6" ECU_ADDRESS 0x70002F92 /end MEASUREMENT
/begin MEASUREMENT ESNSWL_HSP_KL.gkfns " / base value for after start enrichment correction after weithing and downward regulation" UBYTE fak_ub_b4 1 100 0.00 3.984 FORMAT "%5.3" ECU_ADDRESS 0x70002F93 /end MEASUREMENT
/begin MEASUREMENT ESNSWL_HSP_KL.gklfns " / base value for after start enrichment correction" UBYTE fak_ub_b4 1 100 0.00 3.984 FORMAT "%5.3" ECU_ADDRESS 0x70002F94 /end MEASUREMENT
/begin MEASUREMENT ESNSWL_HSP_KL.gklfzansh1 " / Factor for ign. sync. decreasing of afterstart enrichment in range 1 for homogen" UBYTE fak_ub_b0p25 1 100 0.00 0.249023438 FORMAT "%11.9" ECU_ADDRESS 0x70002F95 /end MEASUREMENT
/begin MEASUREMENT ESNSWL_HSP_KL.gklfzansh2 " / Factor for ign. sync. decreasing of afterstart enrichment in range 2 for homogen" UBYTE fak_ub_b0p25 1 100 0.00 0.249023438 FORMAT "%11.9" ECU_ADDRESS 0x70002F96 /end MEASUREMENT
/begin MEASUREMENT ESNSWL_HSP_KL.gklfzansh3 " / Factor for ign. sync. decreasing of afterstart enrichment in range 3 for homogen" UBYTE fak_ub_b0p25 1 100 0.00 0.249023438 FORMAT "%11.9" ECU_ADDRESS 0x70002F97 /end MEASUREMENT
/begin MEASUREMENT ESNSWL_HSP_KL.gklszansh1 " / Switching range 1 of afterstart enrichment for homogenous mode" UBYTE fak_ub_b2 1 100 0.00 1.000000 FORMAT "%8.6" ECU_ADDRESS 0x70002F9A /end MEASUREMENT
/begin MEASUREMENT ESNSWL_HSP_KL.gklszansh2 " / Switching range 2 of afterstart enrichment for homogenous mode" UBYTE fak_ub_b2 1 100 0.00 1.000000 FORMAT "%8.6" ECU_ADDRESS 0x70002F9B /end MEASUREMENT
/begin MEASUREMENT ESNSWL_HSP_KL.nsactr " / base value for the downward regulation of the afterstart enrichment factor" UBYTE fak_ub_b2 1 100 0.00 1.992188 FORMAT "%8.6" ECU_ADDRESS 0x70002F9D /end MEASUREMENT
/begin MEASUREMENT ESNSWL_HSP_KL.nsactrout " / base value for the downward regulation of the afterstart enrichment factor" UBYTE fak_ub_b2 1 100 0.00 1.992188 FORMAT "%8.6" ECU_ADDRESS 0x70002F9E /end MEASUREMENT
/begin MEASUREMENT ESSTT_ALTI.facEnchmtCorrnAlti "Altitude Class of function ESSTT (Fuel enrichment during start) / start-factor depending on altitude" UBYTE fak_ub_b2 1 100 0.00 1.992188 FORMAT "%8.6" ECU_ADDRESS 0x70002F06 /end MEASUREMENT
/begin MEASUREMENT ESSTT_ALTI.facEnchmtCorrnAltiFlexFu "Altitude Class of function ESSTT (Fuel enrichment during start) / start-factor depending on altitude for Ethanol" UBYTE fak_ub_b2 1 100 0.00 1.992188 FORMAT "%8.6" ECU_ADDRESS 0x70002F07 /end MEASUREMENT
/begin MEASUREMENT ESSTT_ALTI_2.facEnchmtCorrnAlti " / start-factor depending on altitude" UBYTE fak_ub_b2 1 100 0.00 1.992188 FORMAT "%8.6" ECU_ADDRESS 0x70002F1C /end MEASUREMENT
/begin MEASUREMENT ESSTT_ALTI_2.facEnchmtCorrnAltiFlexFu " / start-factor depending on altitude for Ethanol" UBYTE fak_ub_b2 1 100 0.00 1.992188 FORMAT "%8.6" ECU_ADDRESS 0x70002F1D /end MEASUREMENT
/begin MEASUREMENT ESSTT_ALTI_3.facEnchmtCorrnAlti " / start-factor depending on altitude" UBYTE fak_ub_b2 1 100 0.00 1.992188 FORMAT "%8.6" ECU_ADDRESS 0x70002F1A /end MEASUREMENT
/begin MEASUREMENT ESSTT_ALTI_3.facEnchmtCorrnAltiFlexFu " / start-factor depending on altitude for Ethanol" UBYTE fak_ub_b2 1 100 0.00 1.992188 FORMAT "%8.6" ECU_ADDRESS 0x70002F1B /end MEASUREMENT
/begin MEASUREMENT ESSTT_bColdRstrt "Condition cold restart" UBYTE B_TRUE 1 100 0.00 1.00000000000 BIT_MASK 0x1 FORMAT "%13.11" ECU_ADDRESS 0x6000B102 /end MEASUREMENT
/begin MEASUREMENT ESSTT_bEngRstrt "Condition Engine Restart" UBYTE B_TRUE 1 100 0.00 1.00000000000 BIT_MASK 0x1 FORMAT "%13.11" ECU_ADDRESS 0x6000EE62 /end MEASUREMENT
/begin MEASUREMENT ESSTT_bHotStrt "Condition hot restart" UBYTE B_TRUE 1 100 0.00 1.00000000000 BIT_MASK 0x1 FORMAT "%13.11" ECU_ADDRESS 0x6000B101 /end MEASUREMENT
/begin MEASUREMENT ESSTT_bHotStrtSuspc "Condition hot restart suspicion" UBYTE B_TRUE 1 100 0.00 1.00000000000 BIT_MASK 0x1 FORMAT "%13.11" ECU_ADDRESS 0x6000B100 /end MEASUREMENT
/begin MEASUREMENT ESSTT_DIRST.facStrt "class direct start / Injection factor at start" UWORD fak_uw_b64 1 100 0.00 63.99902 FORMAT "%8.5" ECU_ADDRESS 0x70002F00 /end MEASUREMENT
/begin MEASUREMENT ESSTT_DIRST.facStrtBasc "class direct start / Injection factor at start (basic value)" UWORD fak_uw_b64 1 100 0.00 63.99902 FORMAT "%8.5" ECU_ADDRESS 0x70002F02 /end MEASUREMENT
/begin MEASUREMENT ESSTT_DIRST.facStrtCoornDrctStrt "class direct start / Correction factor for injection factor at direct start" UBYTE fak_ub_b2 1 100 0.00 1.992188 FORMAT "%8.6" ECU_ADDRESS 0x70002F04 /end MEASUREMENT
/begin MEASUREMENT ESSTT_DIRST.facStrtCorrnRstrt "class direct start / Correction factor for injection factor at restart" UBYTE fak_ub_b2 1 100 0.00 1.992188 FORMAT "%8.6" ECU_ADDRESS 0x70002F05 /end MEASUREMENT
/begin MEASUREMENT ESSTT_facCorrnAlti "Altitude correction factor" UWORD fak_uw_b4 1 100 0.00 3.999939 FORMAT "%8.6" ECU_ADDRESS 0x70002F54 /end MEASUREMENT
/begin MEASUREMENT ESSTT_facEthPerc "Ethanol percentage factor when SY_FFV0, 0 when SY_FFV=0 for ESSTT" UBYTE fak_ub_b1 1 100 0.00 0.9961 ECU_ADDRESS 0x70002F52 /end MEASUREMENT
/begin MEASUREMENT ESSTT_facStrtInj "start-injection factor" UWORD fak_uw_b64 1 100 0.00 63.99902 FORMAT "%8.5" ECU_ADDRESS 0x70002F50 /end MEASUREMENT
/begin MEASUREMENT ESSTT_facStrtInjCorrn "Local variable for factor start Injection correction" UWORD fak_uw_b64 1 100 0.00 63.99902 FORMAT "%8.5" ECU_ADDRESS 0x70002F4E /end MEASUREMENT
/begin MEASUREMENT ESSTT_HDST.facStrt "base class of function ESSTT (Fuel enrichment during start) / Injection factor at start" UWORD fak_uw_b64 1 100 0.00 63.99902 FORMAT "%8.5" ECU_ADDRESS 0x70002EFA /end MEASUREMENT
/begin MEASUREMENT ESSTT_HDST.facStrtBasc "base class of function ESSTT (Fuel enrichment during start) / Injection factor at start (basic value)" UWORD fak_uw_b64 1 100 0.00 63.99902 FORMAT "%8.5" ECU_ADDRESS 0x70002EFC /end MEASUREMENT
/begin MEASUREMENT ESSTT_HDST.facStrtCorrnRstrt "base class of function ESSTT (Fuel enrichment during start) / Correction factor for injection factor at restart" UBYTE fak_ub_b2 1 100 0.00 1.992188 FORMAT "%8.6" ECU_ADDRESS 0x70002EFE /end MEASUREMENT
/begin MEASUREMENT ESSTT_HDST_EOL.facStrt " / Injection factor at start" UWORD fak_uw_b64 1 100 0.00 63.99902 FORMAT "%8.5" ECU_ADDRESS 0x70002F14 /end MEASUREMENT
/begin MEASUREMENT ESSTT_HDST_EOL.facStrtBasc " / Injection factor at start (basic value)" UWORD fak_uw_b64 1 100 0.00 63.99902 FORMAT "%8.5" ECU_ADDRESS 0x70002F16 /end MEASUREMENT
/begin MEASUREMENT ESSTT_HDST_EOL.facStrtCorrnRstrt " / Correction factor for injection factor at restart" UBYTE fak_ub_b2 1 100 0.00 1.992188 FORMAT "%8.6" ECU_ADDRESS 0x70002F18 /end MEASUREMENT
/begin MEASUREMENT ESSTT_NDST.facStrt " / Injection factor at start" UWORD fak_uw_b64 1 100 0.00 63.99902 FORMAT "%8.5" ECU_ADDRESS 0x70002F0E /end MEASUREMENT
/begin MEASUREMENT ESSTT_NDST.facStrtBasc " / Injection factor at start (basic value)" UWORD fak_uw_b64 1 100 0.00 63.99902 FORMAT "%8.5" ECU_ADDRESS 0x70002F10 /end MEASUREMENT
/begin MEASUREMENT ESSTT_NDST.facStrtCorrnRstrt " / Correction factor for injection factor at restart" UBYTE fak_ub_b2 1 100 0.00 1.992188 FORMAT "%8.6" ECU_ADDRESS 0x70002F12 /end MEASUREMENT
/begin MEASUREMENT ESSTT_NDST_EOL.facStrt " / Injection factor at start" UWORD fak_uw_b64 1 100 0.00 63.99902 FORMAT "%8.5" ECU_ADDRESS 0x70002F08 /end MEASUREMENT
/begin MEASUREMENT ESSTT_NDST_EOL.facStrtBasc " / Injection factor at start (basic value)" UWORD fak_uw_b64 1 100 0.00 63.99902 FORMAT "%8.5" ECU_ADDRESS 0x70002F0A /end MEASUREMENT
/begin MEASUREMENT ESSTT_NDST_EOL.facStrtCorrnRstrt " / Correction factor for injection factor at restart" UBYTE fak_ub_b2 1 100 0.00 1.992188 FORMAT "%8.6" ECU_ADDRESS 0x70002F0C /end MEASUREMENT
/begin MEASUREMENT ESSTT_stStrtReq "Start type from the start coordinator (local)" UWORD ENGSTRT_STSTRTREQ_SET_COMPU_VERB 1 100 0.00 32770.0000000 FORMAT "%13.7" ECU_ADDRESS 0x70002F4C /end MEASUREMENT
/begin MEASUREMENT ESSTT_tCoor "Engine temperature for the start coordinator" SWORD Temp_Cels 1 100 -273.140 3003.560 FORMAT "%8.3" ECU_ADDRESS 0x70002F4A /end MEASUREMENT
/begin MEASUREMENT ESSTT_tiEngOff "Engine time off" UWORD t_q1 1 100 0.00 65535.00 FORMAT "%8.2" ECU_ADDRESS 0x70002F48 /end MEASUREMENT
/begin MEASUREMENT ESSTT_tStrtCoor "Start temperature for the start coordinator" SWORD Temp_Cels 1 100 -273.140 3003.560 FORMAT "%8.3" ECU_ADDRESS 0x70002F46 /end MEASUREMENT
/begin MEASUREMENT Etc_ctCurRunTst "Stores the number of actual running engine tests" UBYTE OneToOne 1 100 0.00 255.0 FORMAT "%5.1" ECU_ADDRESS 0x6000F843 /end MEASUREMENT
/begin MEASUREMENT EvapActrCcv_flgElecDiagEnad "Condition to enable CCV electrical diagnosis" UBYTE B_TRUE 1 100 0.00 1.00000000000 BIT_MASK 0x1 FORMAT "%13.11" ECU_ADDRESS 0x6000B0F8 /end MEASUREMENT
/begin MEASUREMENT EvapActrCpv_flgElecDiagEnad "Condition to enable CPV electrical diagnosis" UBYTE B_TRUE 1 100 0.00 1.00000000000 BIT_MASK 0x1 FORMAT "%13.11" ECU_ADDRESS 0x6000B0F5 /end MEASUREMENT
/begin MEASUREMENT fbade_w "factor of trans.control during acceleration direct injection" UWORD fak_uw_b16 1 100 0.00 15.99976 FORMAT "%8.5" ECU_ADDRESS 0x600070A2 /end MEASUREMENT
/begin MEASUREMENT febfmodns "Weighting of the factor after start by first fuel filling" UBYTE fak_ub_b2 1 100 0.00 1.992188 FORMAT "%8.6" ECU_ADDRESS 0x60000919 /end MEASUREMENT
/begin MEASUREMENT febfmod_w "Additional weighting for the start factor by initial fuel filling" UWORD fak_uw_b8 1 100 0.00 7.999878 FORMAT "%8.6" ECU_ADDRESS 0x600005FA /end MEASUREMENT
/begin MEASUREMENT fethffv "Ethanol percentage factor when SY_FFV>0, 0 when SY_FFV=0" UBYTE fak_ub_b1 1 100 0.00 0.9961 ECU_ADDRESS 0x6000B0FF /end MEASUREMENT
/begin MEASUREMENT fktns_w_msg "after start enrichment" UWORD fak_uw_b16 1 100 0.00 15.99976 FORMAT "%8.5" ECU_ADDRESS 0x600007A2 /end MEASUREMENT
/begin MEASUREMENT fnsba_w "post cranking factor of transient control during acceleration" UWORD fak_uw_b16 1 100 0.00 15.99976 FORMAT "%8.5" ECU_ADDRESS 0x60007088 /end MEASUREMENT
/begin MEASUREMENT fnsva_w "post cranking factor of transient control during deceleration" UWORD fak_uw_b16 1 100 0.00 15.99976 FORMAT "%8.5" ECU_ADDRESS 0x60007086 /end MEASUREMENT
/begin MEASUREMENT fnswkstaa "factor post-start weighting over start-adaptation factor" UBYTE fak_ub_b4 1 100 0.00 3.984 FORMAT "%5.3" ECU_ADDRESS 0x6000B105 /end MEASUREMENT
/begin MEASUREMENT fnswlspltkor_w "Correction factor for afterstart and warm up factor in Split mode" UWORD fak_uw_b16 1 100 0.00 15.99976 FORMAT "%8.5" ECU_ADDRESS 0x70003016 /end MEASUREMENT
/begin MEASUREMENT fnswlst_w_msg "Factor afterstart and warm-up for max. selection at start" UWORD fak_uw_b16 1 100 0.00 15.99976 FORMAT "%8.5" ECU_ADDRESS 0x70003014 /end MEASUREMENT
/begin MEASUREMENT fnswl_w_msg "Factor afterstart and warm-up" UWORD fak_uw_b16 1 100 0.00 15.99976 FORMAT "%8.5" ECU_ADDRESS 0x600007A6 /end MEASUREMENT
/begin MEASUREMENT fns_w_msg "after start factor" UWORD fak_uw_b16 1 100 0.00 15.99976 FORMAT "%8.5" ECU_ADDRESS 0x500008CC /end MEASUREMENT
/begin MEASUREMENT FPCtl_ctReIniDTEVE100ms "Local variable to store the global drive cycle counter(SyC_ctPostDrvLeave)" UBYTE OneToOne 1 100 0.00 255.0 FORMAT "%5.1" ECU_ADDRESS 0x6000B0F6 /end MEASUREMENT
/begin MEASUREMENT FPCtl_flgIniTEATEV20ms "Initialisation necessary for TEATEV 20ms" UBYTE B_TRUE 1 100 0.00 1.00000000000 BIT_MASK 0x1 FORMAT "%13.11" ECU_ADDRESS 0x6000B0F1 /end MEASUREMENT
/begin MEASUREMENT FPCtl_flgReIniDTEVE100ms "Re-Initialisation necessary for DTEVE 100ms" UBYTE B_TRUE 1 100 0.00 1.00000000000 BIT_MASK 0x1 FORMAT "%13.11" ECU_ADDRESS 0x6000B0F4 /end MEASUREMENT
/begin MEASUREMENT FPCtl_flgReIniHT2KTTEV20ms "Flag: Re-Initialization necessary for HT2KTTEV 20ms" UBYTE B_TRUE 1 100 0.00 1.00000000000 BIT_MASK 0x1 FORMAT "%13.11" ECU_ADDRESS 0x6000B0F7 /end MEASUREMENT
/begin MEASUREMENT FPCtl_flgReIniTEATEV20ms "Re-Initialisation necessary for TEATEV 20ms" UBYTE B_TRUE 1 100 0.00 1.00000000000 BIT_MASK 0x1 FORMAT "%13.11" ECU_ADDRESS 0x6000B0F0 /end MEASUREMENT
/begin MEASUREMENT fst_w_msg "start-injection factor" UWORD fak_uw_b64 1 100 0.00 63.99902 FORMAT "%8.5" ECU_ADDRESS 0x600007AE /end MEASUREMENT
/begin MEASUREMENT fukdesp_w "Transient compensation conversion factor for HSP injection" UWORD fak_uw_b8 1 100 0.00 7.999878 FORMAT "%8.6" ECU_ADDRESS 0x600070A0 /end MEASUREMENT
/begin MEASUREMENT fukde_w "Transient compensation conversion factor for HOM injection" UWORD fak_uw_b8 1 100 0.00 7.999878 FORMAT "%8.6" ECU_ADDRESS 0x6000709E /end MEASUREMENT
/begin MEASUREMENT fuknstm_w "Factor transient compensation for post-start/warm-up correction" UWORD fak_uw_b16 1 100 0.00 15.99976 FORMAT "%8.5" ECU_ADDRESS 0x60007084 /end MEASUREMENT
/begin MEASUREMENT fvade_w "factor of trans.control at deceleration direct injection" UWORD fak_uw_b16 1 100 0.00 15.99976 FORMAT "%8.5" ECU_ADDRESS 0x6000709C /end MEASUREMENT
/begin MEASUREMENT fwehtm_msg "Interpoled Value from curve FWEHTETH and FWEHT" UBYTE fak_ub_b2 1 100 0.00 1.992188 FORMAT "%8.6" ECU_ADDRESS 0x6000EEE7 /end MEASUREMENT
/begin MEASUREMENT fwe_msg "reinjection factor" UBYTE fak_ub_b2 1 100 0.00 1.992188 FORMAT "%8.6" ECU_ADDRESS 0x500009BE /end MEASUREMENT
/begin MEASUREMENT fwlwkstaa "factor weighting warm-up via fuel adaption" UBYTE fak_ub_b2 1 100 0.00 1.992188 FORMAT "%8.6" ECU_ADDRESS 0x70003012 /end MEASUREMENT
/begin MEASUREMENT fwl_msg "Warm up factor" UBYTE fak_ub_b2 1 100 0.00 1.992188 FORMAT "%8.6" ECU_ADDRESS 0x7000365C /end MEASUREMENT
/begin MEASUREMENT fwnsnaus_w "Precontrolled after-start and warm-up factor 16 bit" UWORD fak_uw_b16 1 100 0.00 15.99976 FORMAT "%8.5" ECU_ADDRESS 0x70003010 /end MEASUREMENT
/begin MEASUREMENT GEVCtl_stCamPhaActrIntk_AbrtReasonMsg "Abort reason of tester demand phaseshifting intake camshaft" UWORD OneToOne 1 100 0.00 65535.00 FORMAT "%8.2" ECU_ADDRESS 0x600094C0 /end MEASUREMENT
/begin MEASUREMENT GEVCtl_stCamPhaActrIntk_StMsg "Status of tester demand phaseshifting intake camshaft" UWORD OneToOne 1 100 0.00 65535.00 FORMAT "%8.2" ECU_ADDRESS 0x600094BE /end MEASUREMENT
/begin MEASUREMENT GEVCtl_stCamPhaActrIntk_StrtPermMsg "Start permission of tester demand phaseshifting intake camshaft" UWORD OneToOne 1 100 0.00 32767.00 FORMAT "%8.2" ECU_ADDRESS 0x600094BC /end MEASUREMENT
/begin MEASUREMENT GEVCtl_stCamsftFineAdpnIntk_AbrtReasonMsg "Abort reason of tester demand fine adaptation intake camshaft" UWORD OneToOne 1 100 0.00 65535.00 FORMAT "%8.2" ECU_ADDRESS 0x600094BA /end MEASUREMENT
/begin MEASUREMENT GEVCtl_stCamsftFineAdpnIntk_StMsg "Status of tester demand fine adaptation intake camshaft" UWORD OneToOne 1 100 0.00 65535.00 FORMAT "%8.2" ECU_ADDRESS 0x600094B8 /end MEASUREMENT
/begin MEASUREMENT GEVCtl_stCamsftFineAdpnIntk_StrtPermMsg "Start permission of tester demand fine adaptation intake camshaft" UWORD OneToOne 1 100 0.00 65535.00 FORMAT "%8.2" ECU_ADDRESS 0x600094B6 /end MEASUREMENT
/begin MEASUREMENT GEVCtl_stCamsftRefAdpn_AbrtReasonMsg "Abort reason of tester demand reference adaptation camshafts" UWORD OneToOne 1 100 0.00 65535.00 FORMAT "%8.2" ECU_ADDRESS 0x600094B4 /end MEASUREMENT
/begin MEASUREMENT GEVCtl_stCamsftRefAdpn_StMsg "Status of tester demand reference adaptation camshafts" UWORD OneToOne 1 100 0.00 65535.00 FORMAT "%8.2" ECU_ADDRESS 0x600094B2 /end MEASUREMENT
/begin MEASUREMENT GEVCtl_stCamsftRefAdpn_StrtPermMsg "Start permission of tester demand reference adaptation camshafts" UWORD OneToOne 1 100 0.00 65535.00 FORMAT "%8.2" ECU_ADDRESS 0x600094B0 /end MEASUREMENT
/begin MEASUREMENT gkfkffwlrlml "Output KFFWLRL" UBYTE fak_ub_b2 1 100 0.00 1.992188 FORMAT "%8.6" ECU_ADDRESS 0x7000300E /end MEASUREMENT
/begin MEASUREMENT gklfwstab "correction of afterstart deactivation" UBYTE fak_ub_b2 1 100 0.00 1.992188 FORMAT "%8.6" ECU_ADDRESS 0x7000300D /end MEASUREMENT
/begin MEASUREMENT glbfwllr "local variable to store the maximum value" UBYTE fak_ub_b2 1 100 0.00 1.992188 FORMAT "%8.6" ECU_ADDRESS 0x7000300C /end MEASUREMENT
/begin MEASUREMENT glbnsactr "local variable to store the maximum value" UBYTE fak_ub_b2 1 100 0.00 1.992188 FORMAT "%8.6" ECU_ADDRESS 0x7000300B /end MEASUREMENT
/begin MEASUREMENT InjSys_agCamsftIntkFild "angle Camshaft intake filtered" SWORD kw_q0p0156 1 100 -512.0000 511.9844 FORMAT "%8.4" ECU_ADDRESS 0x6000709A /end MEASUREMENT
/begin MEASUREMENT InjSys_agSpIntkGrad "Delta Inlet Valve Setpoint angle" SWORD kw_q0p0156 1 100 -512.0000 511.9844 FORMAT "%8.4" ECU_ADDRESS 0x60007098 /end MEASUREMENT
/begin MEASUREMENT InjSys_agSpIntkLoc "Local desired position phase actuator intake camshaft bank1" SWORD kw_q0p0156 1 100 -512.0000 511.9844 FORMAT "%8.4" ECU_ADDRESS 0x60007096 /end MEASUREMENT
/begin MEASUREMENT InjSys_cntrCycOvrn "Number of working cycles with full cut-off 16bit" UWORD OneToOne 1 100 0.00 65535.00 FORMAT "%8.2" ECU_ADDRESS 0x7000395C /end MEASUREMENT
/begin MEASUREMENT InjSys_facCorrnDecelPostStrt "reduction of VA for the time after end of start" UBYTE fak_ub_b2 1 100 0.00 1.992188 FORMAT "%8.6" ECU_ADDRESS 0x6000B0FE /end MEASUREMENT
/begin MEASUREMENT InjSys_flgAftEngStrtFuCutActv "Flag indicates SS fuel cut is being activated" UBYTE B_TRUE 1 100 0.00 1.00000000000 BIT_MASK 0x1 FORMAT "%13.11" ECU_ADDRESS 0x70003609 /end MEASUREMENT
/begin MEASUREMENT InjSys_flgInitCdnESUK "Init condition for esuk" UBYTE B_TRUE 1 100 0.00 1.00000000000 BIT_MASK 0x1 FORMAT "%13.11" ECU_ADDRESS 0x700002AE /end MEASUREMENT
/begin MEASUREMENT InjSys_nEngLResTraCmp10ms "engine speed with low resolution for injection transient compensation at 100 ms" UBYTE nmot_ub_q40 1 100 0.00 10200. FORMAT "%5.0" ECU_ADDRESS 0x6000B0FD /end MEASUREMENT
/begin MEASUREMENT InjSys_nEngLResTraCmpS1 "engine speed with low resolution for injection transient compensation at synchro S1" UBYTE nmot_ub_q40 1 100 0.00 10200. FORMAT "%5.0" ECU_ADDRESS 0x70002EF8 /end MEASUREMENT
/begin MEASUREMENT InjSys_ratInjMTraCmpVvt "relative fuel mass transient compensation VVT" SWORD rel_sw_q0p0468 1 100 -1536.000 1535.953 FORMAT "%8.3" ECU_ADDRESS 0x60007094 /end MEASUREMENT
/begin MEASUREMENT InjSys_relDrvrReqTq "relative driver request torque" UWORD rel_uw_b200 1 100 0.00 199.9969 FORMAT "%8.4" ECU_ADDRESS 0x70002EEC /end MEASUREMENT
/begin MEASUREMENT InjSys_tStrtTraCmp "Starting value of downstream engine coolant temperature for injection transient compensation" UBYTE temp_ub_q0p75_o48 1 100 -48.0 143.3 FORMAT "%5.1" ECU_ADDRESS 0x6000B0FC /end MEASUREMENT
/begin MEASUREMENT kffnsfho "weighting of afterstart enrichment" UBYTE fak_ub_b2 1 100 0.00 1.992188 FORMAT "%8.6" ECU_ADDRESS 0x7000300A /end MEASUREMENT
/begin MEASUREMENT kfkfwwns "output of map KFWWNS (decrease of afterstart enrichment in case of cold restart)" UBYTE fak_ub_b2 1 100 0.00 1.992188 FORMAT "%8.6" ECU_ADDRESS 0x70003009 /end MEASUREMENT
/begin MEASUREMENT kl_twstt_w "output characteristic line TWSTT" UWORD t1sxs_uw_q1 1 100 0.00 65535.00 FORMAT "%8.2" ECU_ADDRESS 0x600070A8 /end MEASUREMENT
/begin MEASUREMENT LamCtrl_nEngESPLANT "Engine speed (in FC ESPLANT)" UWORD nmot_uw_q0p25 1 100 0.00 16383.75 FORMAT "%8.2" ECU_ADDRESS 0x60008BCE /end MEASUREMENT
/begin MEASUREMENT LamCtrl_ratFillgPlaPrm "Relative air charge (in FC ESPLANT)" UWORD rel_uw_q0p0234 1 100 0.00 1535.977 FORMAT "%8.3" ECU_ADDRESS 0x60008BCC /end MEASUREMENT
/begin MEASUREMENT mifab_w_msg "limited desired indicated engine torque" UWORD rel_uw_b100 1 100 0.00 99.99847 FORMAT "%8.5" ECU_ADDRESS 0x700053FC /end MEASUREMENT
/begin MEASUREMENT mifal_w_msg "Indicated drivers wish torque for torque coordination cylinder filling" UWORD rel_uw_b100 1 100 0.00 99.99847 FORMAT "%8.5" ECU_ADDRESS 0x700053FE /end MEASUREMENT
/begin MEASUREMENT mifa_msg "desired indicated engine torque" UBYTE rel_ub_b100 1 100 0.00 99.61 FORMAT "%5.2" ECU_ADDRESS 0x700054BC /end MEASUREMENT
/begin MEASUREMENT mifa_w_msg "desired indicated engine torque" UWORD rel_uw_b100 1 100 0.00 99.99847 FORMAT "%8.5" ECU_ADDRESS 0x60008AEE /end MEASUREMENT
/begin MEASUREMENT miglsol_w_msg "coordinated, unscaled torque request for charge" UWORD rel_uw_b100 1 100 0.00 99.99847 FORMAT "%8.5" ECU_ADDRESS 0x70005400 /end MEASUREMENT
/begin MEASUREMENT milsol_w_msg "coordinated torque request for charge" UWORD rel_uw_b100 1 100 0.00 99.99847 FORMAT "%8.5" ECU_ADDRESS 0x60008AEA /end MEASUREMENT
/begin MEASUREMENT misolv_w_msg "indicated resultant nominal torque before torque limitation" UWORD rel_uw_b100 1 100 0.00 99.99847 FORMAT "%8.5" ECU_ADDRESS 0x70005404 /end MEASUREMENT
/begin MEASUREMENT misol_msg "indexed resultant nominal torque" UBYTE rel_ub_b100 1 100 0.00 99.61 FORMAT "%5.2" ECU_ADDRESS 0x700054BD /end MEASUREMENT
/begin MEASUREMENT misol_w_msg "indexed resultant nominal torque" UWORD rel_uw_b100 1 100 0.00 99.99847 FORMAT "%8.5" ECU_ADDRESS 0x70005402 /end MEASUREMENT
/begin MEASUREMENT msntetev1_w_msg "normalized mass flow PCV1 (16 bit)" UWORD m_uw_b25p6 1 100 0.00 25.59961 FORMAT "%8.5" ECU_ADDRESS 0x60008ACA /end MEASUREMENT
/begin MEASUREMENT msntetev2_w_msg "normalized mass flow 2nd PCV (16 bit)" UWORD m_uw_b25p6 1 100 0.00 25.59961 FORMAT "%8.5" ECU_ADDRESS 0x60008AC8 /end MEASUREMENT
/begin MEASUREMENT msntetev_w_msg "normalized mass flow PCV (16 bit)" UWORD m_uw_b25p6 1 100 0.00 25.59961 FORMAT "%8.5" ECU_ADDRESS 0x50005EA2 /end MEASUREMENT
/begin MEASUREMENT msntevo_w_msg "normalized mass flow through the complete open PCV" UWORD m_uw_b25p6 1 100 0.00 25.59961 FORMAT "%8.5" ECU_ADDRESS 0x60008AC6 /end MEASUREMENT
/begin MEASUREMENT nsactr "afterstart counter/filter" UBYTE fak_ub_b2 1 100 0.00 1.992188 FORMAT "%8.6" ECU_ADDRESS 0x70003008 /end MEASUREMENT
/begin MEASUREMENT phtev_w "pressure behind CPV" UWORD p_q0p0195 1 100 0.00 1279.980 FORMAT "%8.3" ECU_ADDRESS 0x6000707E /end MEASUREMENT
/begin MEASUREMENT pndkpu_w_msg "quotient: pressure downstream throttle valve ambient pressure" UWORD fak_uw_b8 1 100 0.00 7.999878 FORMAT "%8.6" ECU_ADDRESS 0x60008AAE /end MEASUREMENT
/begin MEASUREMENT rkukf_w "filtered relative fuel mass transition compensation without adjustment" SWORD rel_sw_q0p0234 1 100 -768.0000 767.9766 FORMAT "%8.4" ECU_ADDRESS 0x60007092 /end MEASUREMENT
/begin MEASUREMENT rkukgbs_w "relative fuel mass transition compensation, base value for operation mode switch" SWORD rel_sw_b1536 1 100 -1536.000 1535.953 FORMAT "%8.3" ECU_ADDRESS 0x60007090 /end MEASUREMENT
/begin MEASUREMENT rkukg_w_msg "relative fuel mass transition compensation" SWORD rel_sw_b1536 1 100 -1536.000 1535.953 FORMAT "%8.3" ECU_ADDRESS 0x5000091C /end MEASUREMENT
/begin MEASUREMENT rkukkvvt_w "relative fuel mass short term part of transient control VVT" SWORD rel_sw_b1536 1 100 -1536.000 1535.953 FORMAT "%8.3" ECU_ADDRESS 0x6000708E /end MEASUREMENT
/begin MEASUREMENT rkukumbs_w "Base correction value on rk for injection mode switch" SWORD rel_sw_b1536 1 100 -1536.000 1535.953 FORMAT "%8.3" ECU_ADDRESS 0x70002EF6 /end MEASUREMENT
/begin MEASUREMENT rkukum_w "Correction value on rk for injection mode switch (homogeneous)" SWORD rel_sw_b1536 1 100 -1536.000 1535.953 FORMAT "%8.3" ECU_ADDRESS 0x70002EF4 /end MEASUREMENT
/begin MEASUREMENT rkuk_w "relative fuel mass transition compensation without adjustment" SWORD rel_sw_q0p0234 1 100 -768.0000 767.9766 FORMAT "%8.4" ECU_ADDRESS 0x6000708C /end MEASUREMENT
/begin MEASUREMENT rlinterp_w_msg "Unified interface for either rl_w or rl_w multiplied by secondary air correction" UWORD rel_uw_q0p0234 1 100 0.00 1535.977 FORMAT "%8.3" ECU_ADDRESS 0x60014038 /end MEASUREMENT
/begin MEASUREMENT tansloc "intake air temperature local copy" UBYTE temp_ub_q0p75_o48 1 100 -48.0 143.3 FORMAT "%5.1" ECU_ADDRESS 0x6000B0EF /end MEASUREMENT
/begin MEASUREMENT tatekorrin_w "corrected duty cycle for canister purge valve" UWORD rel_uw_b100 1 100 0.00 99.99847 FORMAT "%8.5" ECU_ADDRESS 0x6000707C /end MEASUREMENT
/begin MEASUREMENT tatekorr_w "corrected duty cycle for canister purge valve" UWORD rel_uw_b100 1 100 0.00 99.99847 FORMAT "%8.5" ECU_ADDRESS 0x6000707A /end MEASUREMENT
/begin MEASUREMENT tateout2_w_msg "output duty cycle for canister purge valve 2 (16 bit)" UWORD rel_q0p00153 1 100 0.00 99.99847 FORMAT "%8.5" ECU_ADDRESS 0x60008A70 /end MEASUREMENT
/begin MEASUREMENT tateout_w_msg "output duty cycle for canister purge valve (16 bit)" UWORD rel_q0p00153 1 100 0.00 99.99847 FORMAT "%8.5" ECU_ADDRESS 0x60008A6C /end MEASUREMENT
/begin MEASUREMENT tatesoll1 "desired duty cycle of the first PCV" UBYTE rel_ub_b99p6 1 100 0.00 99.61 FORMAT "%5.2" ECU_ADDRESS 0x6000B0EE /end MEASUREMENT
/begin MEASUREMENT tatesoll1old_w "Old value of desired duty cycle used for calculation the variation of duty cycle between 2 process executions." UWORD rel_q0p00153 1 100 0.00 99.99847 FORMAT "%8.5" ECU_ADDRESS 0x60007078 /end MEASUREMENT
/begin MEASUREMENT tatesoll1_w_msg "desired duty cycle of the first PCV (16 bit)" UWORD rel_q0p00153 1 100 0.00 99.99847 FORMAT "%8.5" ECU_ADDRESS 0x60008A6A /end MEASUREMENT
/begin MEASUREMENT tatesoll2_w_msg "desired duty cycle of the 2nd PCV (16 bit)" UWORD rel_q0p00153 1 100 0.00 99.99847 FORMAT "%8.5" ECU_ADDRESS 0x60008A68 /end MEASUREMENT
/begin MEASUREMENT tCpvModloc "local variable for CstrPurg_tCpv or CstrPurg_tCpvMod switch" UBYTE temp_ub_q0p75_o48 1 100 -48.0 143.3 FORMAT "%5.1" ECU_ADDRESS 0x6000B0ED /end MEASUREMENT
/begin MEASUREMENT tevper_msg "periode time of purge control valve" UBYTE t500usxms_ub_q0p5 1 100 0.00 127.5 FORMAT "%5.1" ECU_ADDRESS 0x6000F2D5 /end MEASUREMENT
/begin MEASUREMENT tlrsb_w_msg "Time delay for lambda-control model, base value" UWORD zk5msxs_uw_b327p68 1 100 0.00500008 327.68000000 FORMAT "%12.8" ECU_ADDRESS 0x60014046 /end MEASUREMENT
/begin MEASUREMENT tlrslb_w_msg "Deadtime of plant for continuous lambda control; base value; linear quantization; bank 1" UWORD t_q0p01 1 100 0.0100 655.3500 FORMAT "%8.4" ECU_ADDRESS 0x60008A5A /end MEASUREMENT
/begin MEASUREMENT tlrsl_w_msg "Deadtime of plant for continuous lambda control; linear quantization" UWORD t_q0p01 1 100 0.0100 655.3500 FORMAT "%8.4" ECU_ADDRESS 0x60008A5C /end MEASUREMENT
/begin MEASUREMENT tlrs_w_msg "Time delay for lambda-control model" UWORD zk5msxs_uw_b327p68 1 100 0.00500008 327.68000000 FORMAT "%12.8" ECU_ADDRESS 0x60014044 /end MEASUREMENT
/begin MEASUREMENT tmesuk "relevant engine temperature used in ESUK" UBYTE temp_ub_q0p75_o48 1 100 -48.0 143.3 FORMAT "%5.1" ECU_ADDRESS 0x6000B0FB /end MEASUREMENT
/begin MEASUREMENT tmeswe "relevant engine temperature used in ESWE" UBYTE temp_ub_q0p75_o48 1 100 -48.0 143.3 FORMAT "%5.1" ECU_ADDRESS 0x6000B0F9 /end MEASUREMENT
/begin MEASUREMENT tmotesnswl "Engine temperature (for ESNSWL)" UBYTE temp_ub_q0p75_o48 1 100 -48.0 143.3 FORMAT "%5.1" ECU_ADDRESS 0x70003651 /end MEASUREMENT
/begin MEASUREMENT tmsesuk "relevant engine start temperature used in ESUK" UBYTE temp_ub_q0p75_o48 1 100 -48.0 143.3 FORMAT "%5.1" ECU_ADDRESS 0x6000B0FA /end MEASUREMENT
/begin MEASUREMENT tmstesnswl "Engine start temperature (for ESNSWL)" UBYTE temp_ub_q0p75_o48 1 100 -48.0 143.3 FORMAT "%5.1" ECU_ADDRESS 0x70003650 /end MEASUREMENT
/begin MEASUREMENT tvtevptu_w "delay time of PCV (pressure, battery voltage, temperature dependent)" UWORD t_q0p01_ms 1 100 0.00 655.3500 FORMAT "%8.4" ECU_ADDRESS 0x60007076 /end MEASUREMENT
/begin MEASUREMENT zburnsum "sum of detected combustions during start" UBYTE dez 1 100 0.00 255.0 FORMAT "%5.1" ECU_ADDRESS 0x5000097C /end MEASUREMENT
/begin MEASUREMENT zlrsb_w_msg "plant time constant of continuous air-fuel control, base value" UWORD zk10msxs_uw_b655p36 1 100 0.01000015 655.36000000 FORMAT "%12.8" ECU_ADDRESS 0x60008A3C /end MEASUREMENT
/begin MEASUREMENT zlrslb_w_msg "Plant time constant of continuous lambda control, base value, linear quantization" UWORD t_q0p01 1 100 0.0100 655.3500 FORMAT "%8.4" ECU_ADDRESS 0x60008A38 /end MEASUREMENT
/begin MEASUREMENT zlrsl_w_msg "Plant time constant of continuous lambda control, linear quantization" UWORD t_q0p01 1 100 0.0100 655.3500 FORMAT "%8.4" ECU_ADDRESS 0x60008A3A /end MEASUREMENT
/begin MEASUREMENT zlrs_w_msg "Time constant for lambda control model, 16 bit" UWORD zk10msxs_uw_b655p36 1 100 0.01000015 655.36000000 FORMAT "%12.8" ECU_ADDRESS 0x60014056 /end MEASUREMENT
/begin MEASUREMENT zukdem_w "Time constant transient control direct injection, tmot dependent" UWORD t_q0p01 1 100 0.00 655.3500 FORMAT "%8.4" ECU_ADDRESS 0x6000708A /end MEASUREMENT
/begin MEASUREMENT zuknstm_w "time constant of transient control post cranking factor dependent on engine temperature" UWORD t_q0p1 1 100 0.00 6553.500 FORMAT "%8.3" ECU_ADDRESS 0x60007082 /end MEASUREMENT
/begin FUNCTION ESNSWL "100.11.0_1.4.0injection during afterstart and warm-up"
 /begin DEF_CHARACTERISTIC CWNSWLMOD EngStrt_facAlti08_Ax EngStrt_facEthStoe09_Ax EngStrt_mAirModIntegEngStrt06_Ax EngStrt_nrInj12_Ax EngStrt_ratPrdcAir06_Ax EngStrt_stActRedStg05_Ax EngStrt_stEomDesReqd_Ax EngStrt_stESNSWLModeAppl_C EngStrt_stESNSWLMode_C EngStrt_stInjMod2Idx_GM EngStrt_stTqResv04_Ax EngStrt_tIntkAir06_Ax ESNSWL_HOM.FZANSSA1 ESNSWL_HOM.FZANSSA2 ESNSWL_HOM.KFFWL ESNSWL_HOM.KFFWLETH ESNSWL_HOM.KFFWLLP ESNSWL_HOM.KFFWLRL ESNSWL_HOM.KFFWLRLETH ESNSWL_HOM.KFNSWRL ESNSWL_HOM.KFNSWRL2 ESNSWL_HOM.KFWWLML ESNSWL_HOM.KFWWLMLETH ESNSWL_HOM.KFWWLMTANS ESNSWL_HOM.KLTANS ESNSWL_HOM.ZDGZA1 ESNSWL_HOM.ZDGZA2 ESNSWL_HOM.ZDGZA3 ESNSWL_HOM.facAftStrtAltiLp_GT ESNSWL_HOM.facAftStrtCatHtg_GT ESNSWL_HOM.facAftStrtHotStrt_GT ESNSWL_HOM.facCurrAftStrtEth_GM ESNSWL_HOM.facCurrDernIgnSyncEth1_GM ESNSWL_HOM.facCurrDernIgnSyncEth2_GM ESNSWL_HOM.facCurrDernIgnSyncEth3_GM ESNSWL_HOM.facCurrDernSwtThdEth1_GM ESNSWL_HOM.facCurrDernSwtThdEth2_GM ESNSWL_HOM_KL.FZANSSA1 ESNSWL_HOM_KL.FZANSSA2 ESNSWL_HOM_KL.KFFWL ESNSWL_HOM_KL.KFFWLETH ESNSWL_HOM_KL.KFFWLLP ESNSWL_HOM_KL.KFFWLRL ESNSWL_HOM_KL.KFFWLRLETH ESNSWL_HOM_KL.KFNSWRL ESNSWL_HOM_KL.KFNSWRL2 ESNSWL_HOM_KL.KFWWLML ESNSWL_HOM_KL.KFWWLMLETH ESNSWL_HOM_KL.KFWWLMTANS ESNSWL_HOM_KL.KLTANS ESNSWL_HOM_KL.ZDGZA1 ESNSWL_HOM_KL.ZDGZA2 ESNSWL_HOM_KL.ZDGZA3 ESNSWL_HOM_KL.facAftStrtAltiLp_GT ESNSWL_HOM_KL.facAftStrtCatHtg_GT ESNSWL_HOM_KL.facAftStrtHotStrt_GT ESNSWL_HOM_KL.facCurrAftStrtEth_GM ESNSWL_HOM_KL.facCurrDernIgnSyncEth1_GM ESNSWL_HOM_KL.facCurrDernIgnSyncEth2_GM ESNSWL_HOM_KL.facCurrDernIgnSyncEth3_GM ESNSWL_HOM_KL.facCurrDernSwtThdEth1_GM ESNSWL_HOM_KL.facCurrDernSwtThdEth2_GM ESNSWL_HSP.FZANSSA1 ESNSWL_HSP.FZANSSA2 ESNSWL_HSP.KFFWL ESNSWL_HSP.KFFWLETH ESNSWL_HSP.KFFWLLP ESNSWL_HSP.KFFWLRL ESNSWL_HSP.KFFWLRLETH ESNSWL_HSP.KFNSWRL ESNSWL_HSP.KFNSWRL2 ESNSWL_HSP.KFWWLML ESNSWL_HSP.KFWWLMLETH ESNSWL_HSP.KFWWLMTANS ESNSWL_HSP.KLTANS ESNSWL_HSP.ZDGZA1 ESNSWL_HSP.ZDGZA2 ESNSWL_HSP.ZDGZA3 ESNSWL_HSP.facAftStrtAltiLp_GT ESNSWL_HSP.facAftStrtCatHtg_GT ESNSWL_HSP.facAftStrtHotStrt_GT ESNSWL_HSP.facCurrAftStrtEth_GM ESNSWL_HSP.facCurrDernIgnSyncEth1_GM ESNSWL_HSP.facCurrDernIgnSyncEth2_GM ESNSWL_HSP.facCurrDernIgnSyncEth3_GM ESNSWL_HSP.facCurrDernSwtThdEth1_GM ESNSWL_HSP.facCurrDernSwtThdEth2_GM ESNSWL_HSP_KL.FZANSSA1 ESNSWL_HSP_KL.FZANSSA2 ESNSWL_HSP_KL.KFFWL ESNSWL_HSP_KL.KFFWLETH ESNSWL_HSP_KL.KFFWLLP ESNSWL_HSP_KL.KFFWLRL ESNSWL_HSP_KL.KFFWLRLETH ESNSWL_HSP_KL.KFNSWRL ESNSWL_HSP_KL.KFNSWRL2 ESNSWL_HSP_KL.KFWWLML ESNSWL_HSP_KL.KFWWLMLETH ESNSWL_HSP_KL.KFWWLMTANS ESNSWL_HSP_KL.KLTANS ESNSWL_HSP_KL.ZDGZA1 ESNSWL_HSP_KL.ZDGZA2 ESNSWL_HSP_KL.ZDGZA3 ESNSWL_HSP_KL.facAftStrtAltiLp_GT ESNSWL_HSP_KL.facAftStrtCatHtg_GT ESNSWL_HSP_KL.facAftStrtHotStrt_GT ESNSWL_HSP_KL.facCurrAftStrtEth_GM ESNSWL_HSP_KL.facCurrDernIgnSyncEth1_GM ESNSWL_HSP_KL.facCurrDernIgnSyncEth2_GM ESNSWL_HSP_KL.facCurrDernIgnSyncEth3_GM ESNSWL_HSP_KL.facCurrDernSwtThdEth1_GM ESNSWL_HSP_KL.facCurrDernSwtThdEth2_GM KFFNSHO KFKNSTWST KLFWLN KLKSEBFNS STC12ESUB STI08ESUB STI12ESUB /end DEF_CHARACTERISTIC
 /begin REF_CHARACTERISTIC InjSys_stInjMod_AX /end REF_CHARACTERISTIC
 /begin IN_MEASUREMENT anztib1_w_msg B_ebfmodns_msg B_hdr_msg B_hst_msg B_kh_msg B_stendes_msg B_vheg_msg B_wst_msg CoEOM_bHOM dmrmx_w_msg EngStrt_flgShDwnTiVld EngStrt_stStrtSit EngStrt_tCoor EngStrt_tStrtCoor Epm_nEngLRes ExhMod_mAirMfIntegEngStrt FfPrm_facEthCurr fipoleth_msg fnsad_w_msg InjSys_stActRedStg PEnv_facCorrAlti rlp_w_msg SyC_ctPostDrvLeave tans_msg TiEngOff_ti tnse_w_msg /end IN_MEASUREMENT
 /begin OUT_MEASUREMENT B_fnsoff_msg B_fwloff_msg EngStrt_facAftStrtWrmUp EngStrt_stInjESNSWLMode fnswl_w_msg fns_w_msg fwl_msg /end OUT_MEASUREMENT
 /begin LOC_MEASUREMENT B_nswlmod EngStrt_ctEsnswlReIniSyncS0 EngStrt_facBascValAftStrt EngStrt_facWrmUpLd EngStrt_stAftStrtDeactvn EngStrt_tiEngOffESNSWL ESNSWL_classSelect ESNSWL_HOM.B_fnsb1 ESNSWL_HOM.B_fnsb2 ESNSWL_HOM.B_fnsb3 ESNSWL_HOM.abr1_count ESNSWL_HOM.fipoleth ESNSWL_HOM.fwllr ESNSWL_HOM.fwllrl ESNSWL_HOM.fwlrl ESNSWL_HOM.fwlrlml ESNSWL_HOM.gkfkfwwlml ESNSWL_HOM.gkfns ESNSWL_HOM.gklfns ESNSWL_HOM.gklfzansh1 ESNSWL_HOM.gklfzansh2 ESNSWL_HOM.gklfzansh3 ESNSWL_HOM.gklszansh1 ESNSWL_HOM.gklszansh2 ESNSWL_HOM.nsactr ESNSWL_HOM.nsactrout ESNSWL_HOM_KL.B_fnsb1 ESNSWL_HOM_KL.B_fnsb2 ESNSWL_HOM_KL.B_fnsb3 ESNSWL_HOM_KL.abr1_count ESNSWL_HOM_KL.fipoleth ESNSWL_HOM_KL.fwllr ESNSWL_HOM_KL.fwllrl ESNSWL_HOM_KL.fwlrl ESNSWL_HOM_KL.fwlrlml ESNSWL_HOM_KL.gkfkfwwlml ESNSWL_HOM_KL.gkfns ESNSWL_HOM_KL.gklfns ESNSWL_HOM_KL.gklfzansh1 ESNSWL_HOM_KL.gklfzansh2 ESNSWL_HOM_KL.gklfzansh3 ESNSWL_HOM_KL.gklszansh1 ESNSWL_HOM_KL.gklszansh2 ESNSWL_HOM_KL.nsactr ESNSWL_HOM_KL.nsactrout ESNSWL_HSP.B_fnsb1 ESNSWL_HSP.B_fnsb2 ESNSWL_HSP.B_fnsb3 ESNSWL_HSP.abr1_count ESNSWL_HSP.fipoleth ESNSWL_HSP.fwllr ESNSWL_HSP.fwllrl ESNSWL_HSP.fwlrl ESNSWL_HSP.fwlrlml ESNSWL_HSP.gkfkfwwlml ESNSWL_HSP.gkfns ESNSWL_HSP.gklfns ESNSWL_HSP.gklfzansh1 ESNSWL_HSP.gklfzansh2 ESNSWL_HSP.gklfzansh3 ESNSWL_HSP.gklszansh1 ESNSWL_HSP.gklszansh2 ESNSWL_HSP.nsactr ESNSWL_HSP.nsactrout ESNSWL_HSP_KL.B_fnsb1 ESNSWL_HSP_KL.B_fnsb2 ESNSWL_HSP_KL.B_fnsb3 ESNSWL_HSP_KL.abr1_count ESNSWL_HSP_KL.fipoleth ESNSWL_HSP_KL.fwllr ESNSWL_HSP_KL.fwllrl ESNSWL_HSP_KL.fwlrl ESNSWL_HSP_KL.fwlrlml ESNSWL_HSP_KL.gkfkfwwlml ESNSWL_HSP_KL.gkfns ESNSWL_HSP_KL.gklfns ESNSWL_HSP_KL.gklfzansh1 ESNSWL_HSP_KL.gklfzansh2 ESNSWL_HSP_KL.gklfzansh3 ESNSWL_HSP_KL.gklszansh1 ESNSWL_HSP_KL.gklszansh2 ESNSWL_HSP_KL.nsactr ESNSWL_HSP_KL.nsactrout febfmodns fktns_w_msg fnswkstaa fnswlspltkor_w fnswlst_w_msg fwlwkstaa fwnsnaus_w gkfkffwlrlml gklfwstab glbfwllr glbnsactr kffnsfho kfkfwwns nsactr tmotesnswl tmstesnswl /end LOC_MEASUREMENT
 FUNCTION_VERSION "100.11.0_1.4.0" /end FUNCTION
/begin FUNCTION ESPLANT "1.28.0    Plant parameters of air/fuel control" /begin DEF_CHARACTERISTIC KFLRST KFLRSTV KFLRSZ KFLRSZV SNM07LSUW SRL08LSUW /end DEF_CHARACTERISTIC
 /begin IN_MEASUREMENT B_vheg_msg EGSDO2_tiDlyAdpnS1B1 EGSDO2_tiTranAdpnS1B1 Epm_nEng rl_w_msg SyC_stSub /end IN_MEASUREMENT
 /begin OUT_MEASUREMENT rlinterp_w_msg tlrsb_w_msg tlrslb_w_msg tlrsl_w_msg tlrs_w_msg zlrsb_w_msg zlrslb_w_msg zlrsl_w_msg zlrs_w_msg /end OUT_MEASUREMENT
 /begin LOC_MEASUREMENT LamCtrl_nEngESPLANT LamCtrl_ratFillgPlaPrm /end LOC_MEASUREMENT
 FUNCTION_VERSION "1.28.0" /end FUNCTION
/begin FUNCTION ESSTT "100.27.0_2.5.0Injection duration at start"
 /begin DEF_CHARACTERISTIC CWESSTT DN10BURNT EngStrt_agDrctStrtEsstt03_Ax EngStrt_facBadFuCorrnStrt_M EngStrt_facCorrnAlti_AX EngStrt_facEthEsstt06_Ax EngStrt_facIniFuelMod_T EngStrt_facStrtIniFuFillg_T EngStrt_nIniRPMThr_C EngStrt_nrInjEsstt03_Ax EngStrt_nrInjStrtEsstt14_Ax EngStrt_numAnztiThr_C EngStrt_pFildRailEsstt02_Ax EngStrt_stCfgShDwnTi EngStrt_stClassSeln_T EngStrt_stInjCntrRstInhb_T EngStrt_stInstSelnAlti_T EngStrt_stInstSelnBaseS1_T EngStrt_stInstSelnBase_T EngStrt_stInstSelnDirst_T EngStrt_tiEngStopEsstt04_Ax EngStrt_tiEngStopEssttEth04_Ax EngStrt_tStrtEsstt12_Ax EngStrt_tStrtEssttEth12_Ax ESSTT_ALTI.facEnchmtCorrnAltiFlexFu_GM ESSTT_ALTI.facEnchmtCorrnAlti_GM ESSTT_ALTI_2.facEnchmtCorrnAltiFlexFu_GM ESSTT_ALTI_2.facEnchmtCorrnAlti_GM ESSTT_ALTI_3.facEnchmtCorrnAltiFlexFu_GM ESSTT_ALTI_3.facEnchmtCorrnAlti_GM ESSTT_DIRST.facStrtCorrNrInjAgDrctStrtEth_GM ESSTT_DIRST.facStrtCorrNrInjAgDrctStrt_GM ESSTT_DIRST.facStrtCorrRstrtTStrtEth_GM ESSTT_DIRST.facStrtCorrRstrtTStrt_GM ESSTT_DIRST.facStrtTStrtFacEth_GM ESSTT_DIRST.facStrtTStrtNrInjStrtEth_GM ESSTT_DIRST.facStrtTStrtNrInjStrt_GM ESSTT_DIRST.facStrtTStrtPFildRail_GM ESSTT_HDST.facStrtCorrRstrtTStrtEth_GM ESSTT_HDST.facStrtCorrRstrtTStrt_GM ESSTT_HDST.facStrtTStrtFacEth_GM ESSTT_HDST.facStrtTStrtNrInjStrtEth_GM ESSTT_HDST.facStrtTStrtNrInjStrt_GM ESSTT_HDST.facStrtTStrtPFildRail_GM ESSTT_HDST_EOL.facStrtCorrRstrtTStrtEth_GM ESSTT_HDST_EOL.facStrtCorrRstrtTStrt_GM ESSTT_HDST_EOL.facStrtTStrtFacEth_GM ESSTT_HDST_EOL.facStrtTStrtNrInjStrtEth_GM ESSTT_HDST_EOL.facStrtTStrtNrInjStrt_GM ESSTT_HDST_EOL.facStrtTStrtPFildRail_GM ESSTT_NDST.facStrtCorrRstrtTStrtEth_GM ESSTT_NDST.facStrtCorrRstrtTStrt_GM ESSTT_NDST.facStrtTStrtFacEth_GM ESSTT_NDST.facStrtTStrtNrInjStrtEth_GM ESSTT_NDST.facStrtTStrtNrInjStrt_GM ESSTT_NDST.facStrtTStrtPFildRail_GM ESSTT_NDST_EOL.facStrtCorrRstrtTStrtEth_GM ESSTT_NDST_EOL.facStrtCorrRstrtTStrt_GM ESSTT_NDST_EOL.facStrtTStrtFacEth_GM ESSTT_NDST_EOL.facStrtTStrtNrInjStrtEth_GM ESSTT_NDST_EOL.facStrtTStrtNrInjStrt_GM ESSTT_NDST_EOL.facStrtTStrtPFildRail_GM FSTTHDPRE IMLHS KFWKSTNTM KLTMCHDIFF KLTMODT KLTWSTT KWTMH KWTMHSG KWTMK TANDT TANH TFUELHST0 ZBURNLIM /end DEF_CHARACTERISTIC
 /begin REF_CHARACTERISTIC CWWL /end REF_CHARACTERISTIC
 /begin IN_MEASUREMENT anztib_msg anztib_w_msg B_ebfmod_msg B_stendes_msg B_stopz_msg B_tfuelg_msg B_urstsprr_msg B_zesync_msg CoEng_stMai Eep_EnvRamHist Eep_EnvRamInvld EngStrt_bFrstStrtEnd EngStrt_flgRePrio EngStrt_stStrtReq EngStrt_tCoor EngStrt_tStopCoor EngStrt_tStrtCoor Epm_nEng Epm_nEngDiff Epm_stSpd ExhMod_mAirMfIntegEngStrt fethstoe_msg FlSys_tFlLPSys FuPHi_pRail InjSys_flgInjTmngErly IntkAirT_tIntkMnfld PEnv_facCorrAlti Strt_stStaActv SyC_stSub tansab_msg TiOff_stTiStrtEndOff TiOff_tiStrtEndOff wdirst_msg /end IN_MEASUREMENT
 /begin OUT_MEASUREMENT B_hst B_hstverd_msg B_hst_msg B_vbmg_msg B_wks_msg B_wst_msg EngStrt_flgShDwnTiVld fst_w_msg /end OUT_MEASUREMENT
 /begin LOC_MEASUREMENT anztist anztistoffs anztistreprio anztuini_w anzturst_w B_eepesstt B_hstnl B_wst0 B_wst1 B_wst2 EngStrt_bCdnCmbPsbl EngStrt_bIniFuelMod EngStrt_facStrtCorrn EngStrt_facStrtCorrnBasc EngStrt_flgInjTmngErly EngStrt_flgRePrioLocFuStrt EngStrt_idxClassSeldFuStrt EngStrt_idxInstSeldAlti EngStrt_idxInstSeldBaseFuStrt EngStrt_idxInstSeldDirstFuStrt EngStrt_tInkMnfldESSTT EngT_tDiffEssttLoc EngT_tMxEssttLoc ESSTT_ALTI.facEnchmtCorrnAlti ESSTT_ALTI.facEnchmtCorrnAltiFlexFu ESSTT_ALTI_2.facEnchmtCorrnAlti ESSTT_ALTI_2.facEnchmtCorrnAltiFlexFu ESSTT_ALTI_3.facEnchmtCorrnAlti ESSTT_ALTI_3.facEnchmtCorrnAltiFlexFu ESSTT_bColdRstrt ESSTT_bEngRstrt ESSTT_bHotStrt ESSTT_bHotStrtSuspc ESSTT_DIRST.facStrt ESSTT_DIRST.facStrtBasc ESSTT_DIRST.facStrtCoornDrctStrt ESSTT_DIRST.facStrtCorrnRstrt ESSTT_facCorrnAlti ESSTT_facEthPerc ESSTT_facStrtInj ESSTT_facStrtInjCorrn ESSTT_HDST.facStrt ESSTT_HDST.facStrtBasc ESSTT_HDST.facStrtCorrnRstrt ESSTT_HDST_EOL.facStrt ESSTT_HDST_EOL.facStrtBasc ESSTT_HDST_EOL.facStrtCorrnRstrt ESSTT_NDST.facStrt ESSTT_NDST.facStrtBasc ESSTT_NDST.facStrtCorrnRstrt ESSTT_NDST_EOL.facStrt ESSTT_NDST_EOL.facStrtBasc ESSTT_NDST_EOL.facStrtCorrnRstrt ESSTT_stStrtReq ESSTT_tCoor ESSTT_tiEngOff ESSTT_tStrtCoor febfmod_w fethffv kl_twstt_w zburnsum /end LOC_MEASUREMENT
 FUNCTION_VERSION "100.27.0_2.5.0" /end FUNCTION
/begin FUNCTION ESUK "18.18.0   Injection: transient compensation"
 /begin DEF_CHARACTERISTIC CWESUK DRLPT FUKDE FUKDEETH FUKDESP FUKDESPETH FUKNSTM FUKNSTMETH FVANST InjSyG_facTCorrnTraCmpVvt_M InjSys_facCorrnDecelPostStrt_T InjSys_facCorrnTraCmpVvt_M InjSys_mfAirM05_AX InjSys_ratATraCmpThd_GM InjSys_ratDecelTraCmpThd_GM InjSys_tiDlyFuMCmp_C InjSys_tiTnFilAgCamsftIntk_M KFBADE KFBADEETH KFRKUMTOH2 KFRKUMTOHO KFVADE KFVADEETH KLANZRKUM KLRERKUM KLRKUMRL KLTNSUUK RKBAUM RKVAUM SNM07ESUB STM09ESUB TNSUKUM ZUKDEM ZUKDEMETH ZUKNSTM ZUKNSTMETH /end DEF_CHARACTERISTIC
 /begin IN_MEASUREMENT anztib_w_msg B_koevab_msg B_ll_msg B_nswo2_msg B_sa_msg B_stendes_msg CEngDsT_tStrt CoEOM_bHOM CoEOM_flgHsp drlp_w_msg EngStrt_bStrt EngStrt_bStrtEnd Epm_ctCyl Epm_nEngLRes fipoleth_msg GEVCtl_agSpIntkB1 GEVlv_agIntkB1 GEVlv_agOutlB1 InjSys_ratPrdcAirLamDes InjSys_tEng InjSys_tEngStrt ml_w_msg rlp_w_msg SyC_stSub tnse_w_msg tnst_w_msg wgvum_w_msg /end IN_MEASUREMENT
 /begin OUT_MEASUREMENT B_bag_msg B_vag_msg rkukg_w_msg /end OUT_MEASUREMENT
 /begin LOC_MEASUREMENT anzrkum B_rkum B_uk1 B_ukns B_uknsll B_ukum drkuk_w drlpLT_w fbade_w fnsba_w fnsva_w fukdesp_w fukde_w fuknstm_w fvade_w InjSys_agCamsftIntkFild InjSys_agSpIntkGrad InjSys_agSpIntkLoc InjSys_facCorrnDecelPostStrt InjSys_flgInitCdnESUK InjSys_nEngLResTraCmp10ms InjSys_nEngLResTraCmpS1 InjSys_ratInjMTraCmpVvt InjSys_tStrtTraCmp rkukf_w rkukgbs_w rkukkvvt_w rkukumbs_w rkukum_w rkuk_w tmesuk tmsesuk zukdem_w zuknstm_w /end LOC_MEASUREMENT
 FUNCTION_VERSION "18.18.0" /end FUNCTION
/begin FUNCTION ESWE "159.0.0   Injection, resumption of overrun fuel cut-off"
 /begin DEF_CHARACTERISTIC CWESWE FWEHT FWEHTETH FWEMRFA FWEMRFAETH FWET FWETETH InjSys_facHardRstrtTEthnlStrtStopFuCut_T InjSys_facHardRstrtTStrtStopFuCut_T InjSys_facRstrtTEthnlStrtStopFuCut_T InjSys_facRstrtTStrtStopFuCut_T InjSys_flgCdnEndStrt_C InjSys_OffsStrtStopFuCut_T InjSys_tiCEngDstEthnl_M KFFWET KLFIMHU KLFIMHUETH KLFIMWU KLFIMWUETH KLFWENM KLZYKSA /end DEF_CHARACTERISTIC
 /begin IN_MEASUREMENT anzti_msg B_ll_msg B_stendes_msg CEngDsT_t CoEng_bFrstStrtEnd Epm_nEng evz_austot_msg FfPrm_facEth fipoleth_msg InjSys_tEng mrfa_w_msg ThrVlv_flgLimpModeB1 ThrVlv_flgReqFuCutOffB1 /end IN_MEASUREMENT
 /begin OUT_MEASUREMENT anzzyksa_msg B_fwe_msg danzwefim_msg fwehtm_msg fwe_msg InjSys_cntrCycOvrn InjSys_flgAftEngStrtFuCutActv /end OUT_MEASUREMENT
 /begin LOC_MEASUREMENT anzwe anzwefim azylwe B_afwe InjSys_relDrvrReqTq tmeswe /end LOC_MEASUREMENT
 FUNCTION_VERSION "159.0.0" /end FUNCTION
/begin FUNCTION ETC_Std "30000.17.0Engine Test Coordinator" /begin DEF_CHARACTERISTIC Etc_MaxReqTO_C /end DEF_CHARACTERISTIC
 /begin OUT_MEASUREMENT Etc_ctCurRunTst GEVCtl_stCamPhaActrIntk_AbrtReasonMsg GEVCtl_stCamPhaActrIntk_StMsg GEVCtl_stCamPhaActrIntk_StrtPermMsg GEVCtl_stCamsftFineAdpnIntk_AbrtReasonMsg GEVCtl_stCamsftFineAdpnIntk_StMsg GEVCtl_stCamsftFineAdpnIntk_StrtPermMsg GEVCtl_stCamsftRefAdpn_AbrtReasonMsg GEVCtl_stCamsftRefAdpn_StMsg GEVCtl_stCamsftRefAdpn_StrtPermMsg /end OUT_MEASUREMENT
 FUNCTION_VERSION "30000.17.0" /end FUNCTION
/begin FUNCTION ETSPTH2ME "9.0.0_159.0.0Interface adapter ETSPth to ME"
 /begin IN_MEASUREMENT CoETS_bIntvActvDes CoETS_trqInrSetCo ftrq2mi_w_msg mimax_w_msg PthLead_stActvMonLim PthLead_trqInrLead PthLead_trqResv PthSet_bIAIntv PthSet_bOvrRun PthSet_stActvMonLim PthSet_trqInrCtOff /end IN_MEASUREMENT
 /begin OUT_MEASUREMENT B_mdein_msg B_mibeg_msg B_qmismeus_msg B_sa_msg B_zwsol_msg dmrmx_w_msg mifab_w_msg mifal_w_msg mifa_msg mifa_w_msg miglsol_w_msg milsol_w_msg misolv_w_msg misol_msg misol_w_msg /end OUT_MEASUREMENT
 FUNCTION_VERSION "9.0.0_159.0.0" /end FUNCTION
/begin FUNCTION EvapActrCcv_Dd "30201.0.0 Evaporation Actuator AAV - Device Driver" /begin DEF_CHARACTERISTIC CWINVAAV /end DEF_CHARACTERISTIC /begin REF_CHARACTERISTIC CWTATETEV /end REF_CHARACTERISTIC
 /begin IN_MEASUREMENT B_btaavet_msg B_btaave_msg B_ccveonv_msg B_dteaav_msg SyC_stSub /end IN_MEASUREMENT
 /begin OUT_MEASUREMENT B_tldcvs_msg /end OUT_MEASUREMENT
 FUNCTION_VERSION "30201.0.0" /end FUNCTION
/begin FUNCTION EvapActrCcv_DdDiag "30201.2.0 Evaporation Actuator AAV - Device Driver Diagnosis"
 /begin DEF_CHARACTERISTIC CWPSAAVE EvapActrCcv_flgSwtPsSubRlyActv_C EvapActrCcv_tiPsHeatrRlyActv_C FELDTESK_nrTestPlsCcv_C FELDTESK_tiBtwPlsElecErrCcv_C FELDTESK_tiBtwPlsOverTCcv_C /end DEF_CHARACTERISTIC
 /begin IN_MEASUREMENT B_deseehr_msg SyC_stSub UEGO_flgHeatrRlyActvS1B1 /end IN_MEASUREMENT
 /begin LOC_MEASUREMENT EvapActrCcv_flgElecDiagEnad /end LOC_MEASUREMENT
 FUNCTION_VERSION "30201.2.0" /end FUNCTION
/begin FUNCTION EvapActrCpv_Dd "30301.4.0 Evaporation Actuator CPV - Device Driver"
 /begin DEF_CHARACTERISTIC CstrPurg_flgPwmPerdEdgeActv_C CWTATETEV FPCtl_stCpvDiPs_C TATEOUT1 /end DEF_CHARACTERISTIC
 /begin IN_MEASUREMENT B_tatewi_msg DevLib_stPwrStgEnaCond tateout_w_msg tevper_msg /end IN_MEASUREMENT
 /begin OUT_MEASUREMENT B_tevtini_msg CstrPurg_ratPercCpv /end OUT_MEASUREMENT
 /begin LOC_MEASUREMENT FPCtl_flgReIniHT2KTTEV20ms /end LOC_MEASUREMENT
 FUNCTION_VERSION "30301.4.0" /end FUNCTION
/begin FUNCTION EvapActrCpv_DdDiag "30301.5.0_1.0.0Evaporation Actuator CPV - Device Driver Diagnosis"
 /begin DEF_CHARACTERISTIC CstrPurg_nrTestPls_C CstrPurg_tiBtwPlsElecErr_C CstrPurg_tiBtwPlsOverT_C CWPSTEVE EvapActrCpv_tiDlyElecDiag_C /end DEF_CHARACTERISTIC
 /begin IN_MEASUREMENT CstrPurg_flgUBattOk EngStrt_bStrtEnd SyC_ctPostDrvLeave /end IN_MEASUREMENT
 /begin LOC_MEASUREMENT EvapActrCpv_flgElecDiagEnad FPCtl_ctReIniDTEVE100ms FPCtl_flgReIniDTEVE100ms /end LOC_MEASUREMENT
 FUNCTION_VERSION "30301.5.0_1.0.0" /end FUNCTION
/begin FUNCTION EvapActrCpv_Vd "30301.8.0 Evaporation Actuator CPV - Virtual Device"
 /begin DEF_CHARACTERISTIC CstrPurg_ChartcDlyTiCpv_M CstrPurg_facCpvDlyTiCorrn_Cur CstrPurg_ratMinChgReIni_C CstrPurg_stTMdl_C CWFPCTVTEV CWTTEV EvapActrCpv_ratCpvOpen_C EvapActrCpv_stCpvActvnPostDrv_C EvapActrCpv_tiDlyCpvHiResl_C EvapActrCpv_tiOpenCpvHiResl_C FTVTEVTANS KFTEVP KFTVPHTEV MSNTEVO TATEGMX TATEMSN /end DEF_CHARACTERISTIC
 /begin IN_MEASUREMENT arqttev_w_msg BattU_u B_rqttev_msg B_tevtini_msg CstrPurg_ratPAftCpvToEnv CstrPurg_tCpvMod CstrPurg_tIntkAir Epm_nEng Epm_nEngLRes msntesol_w_msg PEnv_p pndk_w_msg SyC_stSub VehV_v /end IN_MEASUREMENT
 /begin OUT_MEASUREMENT B_tatewi_msg CstrPurg_ratSp msntetev1_w_msg msntetev2_w_msg msntetev_w_msg msntevo_w_msg pndkpu_w_msg tateout2_w_msg tateout_w_msg tatesoll1_w_msg tatesoll2_w_msg tevper_msg /end OUT_MEASUREMENT
 /begin LOC_MEASUREMENT BattU_u_ubrsq CstrPurg_ratSpCorrn Epm_nEngLRes_nmot FPCtl_flgIniTEATEV20ms FPCtl_flgReIniTEATEV20ms phtev_w tansloc tatekorrin_w tatekorr_w tatesoll1 tatesoll1old_w tCpvModloc tvtevptu_w /end LOC_MEASUREMENT
 FUNCTION_VERSION "30301.8.0" /end FUNCTION
/begin COMPU_METHOD B_TRUE "" TAB_VERB "%6.3" "" COMPU_TAB_REF B_TRUE /end COMPU_METHOD
/begin COMPU_VTAB B_TRUE "" TAB_VERB 2 0 "FALSE" 1 "TRUE" /end COMPU_VTAB
/begin COMPU_METHOD dez "" RAT_FUNC "%6.2" "" COEFFS 0 1 0 0 0 1 /end COMPU_METHOD
/begin COMPU_METHOD EngN "" RAT_FUNC "%6.3" "rpm" COEFFS 0 2 0 0 0 1 /end COMPU_METHOD
/begin COMPU_METHOD EngN_LRes "" RAT_FUNC "%6.1" "rpm" COEFFS 0 0.025 0 0 0 1 /end COMPU_METHOD
/begin COMPU_METHOD ENGSTRT_ESNSWLMODEPOI_SET_COMPU_VERB "" TAB_VERB "%6.3" "-" COMPU_TAB_REF ENGSTRT_ESNSWLMODEPOI_SET_COMPU_VERB /end COMPU_METHOD
/begin COMPU_VTAB ENGSTRT_ESNSWLMODEPOI_SET_COMPU_VERB "" TAB_VERB 4 0 "ESNSWL_HOM" 1 "ESNSWL_HOM_KL" 2 "ESNSWL_HSP" 3 "ESNSWL_HSP_KL" /end COMPU_VTAB
/begin COMPU_METHOD ENGSTRT_ESSTTALTI_SET_COMPU_VERB "" TAB_VERB "%6.3" "-" COMPU_TAB_REF ENGSTRT_ESSTTALTI_SET_COMPU_VERB /end COMPU_METHOD
/begin COMPU_VTAB ENGSTRT_ESSTTALTI_SET_COMPU_VERB "" TAB_VERB 3 0 "ESSTT_ALTI" 1 "ESSTT_ALTI_2" 2 "ESSTT_ALTI_3" /end COMPU_VTAB
/begin COMPU_METHOD ENGSTRT_ESSTTBASESYNCS0_SET_COMPU_VERB "" TAB_VERB "%6.3" "-" COMPU_TAB_REF ENGSTRT_ESSTTBASESYNCS0_SET_COMPU_VERB /end COMPU_METHOD
/begin COMPU_VTAB ENGSTRT_ESSTTBASESYNCS0_SET_COMPU_VERB "" TAB_VERB 4 0 "ESSTT_HDST" 1 "ESSTT_NDST" 2 "ESSTT_HDST_EOL" 3 "ESSTT_NDST_EOL" /end COMPU_VTAB
/begin COMPU_METHOD ENGSTRT_ESSTTDIRSTSYNCS1_SET_COMPU_VERB "" TAB_VERB "%6.3" "-" COMPU_TAB_REF ENGSTRT_ESSTTDIRSTSYNCS1_SET_COMPU_VERB /end COMPU_METHOD
/begin COMPU_VTAB ENGSTRT_ESSTTDIRSTSYNCS1_SET_COMPU_VERB "" TAB_VERB 1 0 "ESSTT_DIRST" /end COMPU_VTAB
/begin COMPU_METHOD ENGSTRT_STSTRTREQ_SET_COMPU_VERB "" TAB_VERB "%6.3" "-" COMPU_TAB_REF ENGSTRT_STSTRTREQ_SET_COMPU_VERB /end COMPU_METHOD
/begin COMPU_VTAB ENGSTRT_STSTRTREQ_SET_COMPU_VERB "" TAB_VERB 19 0 "ENGSTRT_NOSTRT" 1024 "ENGSTRT_LOP" 1028 "ENGSTRT_EOL" 1029 "ENGSTRT_PREINJ" 1031 "ENGSTRT_HIPEOL" 8192 "ENGSTRT_COMRUNNG" 8193 "ENGSTRT_COMSTRTG" 8194 "ENGSTRT_COMWAITSTRTR" 16384 "ENGSTRT_FOLW" 16385 "ENGSTRT_STRTR_DRCT" 32768 "ENGSTRT_HIPCOLD" 32769 "ENGSTRT_HIPMID" 32770 "ENGSTRT_HIPWRM" 256 "ENGSTRT_FOLWWRM" 257 "ENGSTRT_FOLWMID" 258 "ENGSTRT_FOLWCOLD" 259 "ENGSTRT_STRTR_DRCTWRM" 260 "ENGSTRT_STRTR_DRCTMID" 261 "ENGSTRT_STRTR_DRCTCOLD" /end COMPU_VTAB
/begin COMPU_METHOD fak_sw_b8 "" RAT_FUNC "%6.5" "-" COEFFS 0 65536 0 0 0 16 /end COMPU_METHOD
/begin COMPU_METHOD fak_ub_b0p25 "" RAT_FUNC "%10.7" "-" COEFFS 0 256 0 0 0 0.25 /end COMPU_METHOD
/begin COMPU_METHOD fak_ub_b1 "" RAT_FUNC "%6.4" "-" COEFFS 0 256 0 0 0 1 /end COMPU_METHOD
/begin COMPU_METHOD fak_ub_b16 "" RAT_FUNC "%6.4" "-" COEFFS 0 256 0 0 0 16 /end COMPU_METHOD
/begin COMPU_METHOD fak_ub_b2 "" RAT_FUNC "%8.5" "-" COEFFS 0 256 0 0 0 2 /end COMPU_METHOD
/begin COMPU_METHOD fak_ub_b4 "" RAT_FUNC "%6.4" "-" COEFFS 0 256 0 0 0 4 /end COMPU_METHOD
/begin COMPU_METHOD fak_uw_b16 "" RAT_FUNC "%6.5" "-" COEFFS 0 65536 0 0 0 16 /end COMPU_METHOD
/begin COMPU_METHOD fak_uw_b2 "" RAT_FUNC "%7.6" "-" COEFFS 0 65536 0 0 0 2 /end COMPU_METHOD
/begin COMPU_METHOD fak_uw_b4 "" RAT_FUNC "%7.6" "-" COEFFS 0 65536 0 0 0 4 /end COMPU_METHOD
/begin COMPU_METHOD fak_uw_b64 "" RAT_FUNC "%6.5" "-" COEFFS 0 65536 0 0 0 64 /end COMPU_METHOD
/begin COMPU_METHOD fak_uw_b8 "" RAT_FUNC "%6.5" "-" COEFFS 0 65536 0 0 0 8 /end COMPU_METHOD
/begin COMPU_METHOD InjSys_InjMode_Set_COMPU_VERB "" TAB_VERB "%6.3" "-" COMPU_TAB_REF InjSys_InjMode_Set_COMPU_VERB /end COMPU_METHOD
/begin COMPU_VTAB InjSys_InjMode_Set_COMPU_VERB "" TAB_VERB 20 0 "GDIOff" 1 "HO1" 2 "HO2" 3 "HO3" 4 "HO1_WU" 5 "HO2_WU" 6 "HO3_WU" 7 "HP2" 8 "HP3" 9 "HP2_CH" 10 "HP3_CH" 11 "HP2Z" 12 "HP3Z" 13 "SHO1" 14 "SHO2" 15 "SHO3" 16 "SHP3" 17 "SH1" 18 "SH2" 19 "SH3" /end COMPU_VTAB
/begin COMPU_METHOD IUMPR_SY_Compu "" TAB_VERB "%6.3" "" COMPU_TAB_REF IUMPR_SY_Compu /end COMPU_METHOD
/begin COMPU_VTAB IUMPR_SY_Compu "" TAB_VERB 2 0 "NO_IUMPR_ACTIVE" 1 "IUMPR_ACTIVE" /end COMPU_VTAB
/begin COMPU_METHOD IUMPR_VERS_SY_Compu "" TAB_VERB "%6.3" "" COMPU_TAB_REF IUMPR_VERS_SY_Compu /end COMPU_METHOD
/begin COMPU_VTAB IUMPR_VERS_SY_Compu "" TAB_VERB 4 0 "IUMPR_2005" 1 "IUMPR_2007" 2 "IUMPR_2009" 3 "IUMPR_2016" /end COMPU_VTAB
/begin COMPU_METHOD IVGdiCtl_CvoAdpn_EEP_TYP_t "" TAB_VERB "%6.3" "" COMPU_TAB_REF IVGdiCtl_CvoAdpn_EEP_TYP_t /end COMPU_METHOD
/begin COMPU_VTAB IVGdiCtl_CvoAdpn_EEP_TYP_t "" TAB_VERB 2 1 "CVOADPN_EEP_TYP_EEPROM" 2 "CVOADPN_EEP_TYP_EEPROM_MEASURABLE" /end COMPU_VTAB
/begin COMPU_METHOD J1939NM_SC_Compu "" TAB_VERB "%6.3" "" COMPU_TAB_REF J1939NM_SC_Compu /end COMPU_METHOD
/begin COMPU_VTAB J1939NM_SC_Compu "" TAB_VERB 2 0 "False" 1 "True" /end COMPU_VTAB
/begin COMPU_METHOD J1939RM_SC_Compu "" TAB_VERB "%6.3" "" COMPU_TAB_REF J1939RM_SC_Compu /end COMPU_METHOD
/begin COMPU_VTAB J1939RM_SC_Compu "" TAB_VERB 2 0 "False" 1 "True" /end COMPU_VTAB
/begin COMPU_METHOD J1939TP_SC_Compu "" TAB_VERB "%6.3" "" COMPU_TAB_REF J1939TP_SC_Compu /end COMPU_METHOD
/begin COMPU_VTAB J1939TP_SC_Compu "" TAB_VERB 2 0 "False" 1 "True" /end COMPU_VTAB
/begin COMPU_METHOD Kd_Lin_16 "" RAT_FUNC "%7.6" "1/1" COEFFS 0 32767 0 0 0 1 /end COMPU_METHOD
/begin COMPU_METHOD Kd_pRail2Q_1 "" RAT_FUNC "%7.6" "mm^3/s/hPa" COEFFS 0 40960 0 0 0 1 /end COMPU_METHOD
/begin COMPU_METHOD Kd_Prc_COMPU "" RAT_FUNC "%6.5" "%" COEFFS 0 8000 0 0 0 1 /end COMPU_METHOD
/begin COMPU_METHOD KHTRIP_SY_Compu "" TAB_VERB "%6.3" "" COMPU_TAB_REF KHTRIP_SY_Compu /end COMPU_METHOD
/begin COMPU_VTAB KHTRIP_SY_Compu "" TAB_VERB 2 0 "False" 1 "True" /end COMPU_VTAB
/begin COMPU_METHOD Ki_pRail2Q_1 "" RAT_FUNC "%7.6" "mm^3/s^2/hPa" COEFFS 0 10737.41824 0 0 0 1 /end COMPU_METHOD
/begin COMPU_METHOD Ki_Temp2EGTFact "" RAT_FUNC "%8.7" "-" COEFFS 0 429496.7296 0 0 0 1 /end COMPU_METHOD
/begin COMPU_METHOD KNKCTLBLK_SC_Compu "" TAB_VERB "%6.3" "" COMPU_TAB_REF KNKCTLBLK_SC_Compu /end COMPU_METHOD
/begin COMPU_VTAB KNKCTLBLK_SC_Compu "" TAB_VERB 2 0 "False" 1 "True" /end COMPU_VTAB
/begin COMPU_METHOD KNKDEACTVNTSTRIF_SC_Compu "" TAB_VERB "%6.3" "" COMPU_TAB_REF KNKDEACTVNTSTRIF_SC_Compu /end COMPU_METHOD
/begin COMPU_VTAB KNKDEACTVNTSTRIF_SC_Compu "" TAB_VERB 2 0 "False" 1 "True" /end COMPU_VTAB
/begin COMPU_METHOD KNKPREIGNCTRLTEST_SC_Compu "" TAB_VERB "%6.3" "" COMPU_TAB_REF KNKPREIGNCTRLTEST_SC_Compu /end COMPU_METHOD
/begin COMPU_VTAB KNKPREIGNCTRLTEST_SC_Compu "" TAB_VERB 2 0 "False" 1 "True" /end COMPU_VTAB
/begin COMPU_METHOD KNKPREVNHITLOLOAD_SC_Compu "" TAB_VERB "%6.3" "" COMPU_TAB_REF KNKPREVNHITLOLOAD_SC_Compu /end COMPU_METHOD
/begin COMPU_VTAB KNKPREVNHITLOLOAD_SC_Compu "" TAB_VERB 2 0 "False" 1 "True" /end COMPU_VTAB
/begin COMPU_METHOD KNKSNSRCONNDIAG_SC_Compu "" TAB_VERB "%6.3" "" COMPU_TAB_REF KNKSNSRCONNDIAG_SC_Compu /end COMPU_METHOD
/begin COMPU_VTAB KNKSNSRCONNDIAG_SC_Compu "" TAB_VERB 2 0 "False" 1 "True" /end COMPU_VTAB
/begin COMPU_METHOD Kp "" RAT_FUNC "%7.6" "1/1" COEFFS 0 32768 0 0 0 1 /end COMPU_METHOD
/begin COMPU_METHOD Kp_LmbdRec2InjMass_1 "" RAT_FUNC "%6.4" "mg/stroke" COEFFS 0 81.92 0 0 0 1 /end COMPU_METHOD
/begin COMPU_METHOD Kp_pRail2Q_1 "" RAT_FUNC "%7.6" "mm^3/s/hPa" COEFFS 0 81920 0 0 0 1 /end COMPU_METHOD
/begin COMPU_METHOD Kp_Temp2EGTFact "" RAT_FUNC "%7.6" "-" COEFFS 0 25600 0 0 0 1 /end COMPU_METHOD
/begin COMPU_METHOD kw_q0p0156 "" RAT_FUNC "%6.4" "Grad KW" COEFFS 0 64 0 0 0 1 /end COMPU_METHOD
/begin COMPU_METHOD kw_q2 "" RAT_FUNC "%6.2" "deg KW" COEFFS 0 1 0 0 0 2 /end COMPU_METHOD
/begin COMPU_METHOD L9779_SC_Compu "" TAB_VERB "%6.3" "" COMPU_TAB_REF L9779_SC_Compu /end COMPU_METHOD
/begin COMPU_VTAB L9779_SC_Compu "" TAB_VERB 2 0 "False" 1 "True" /end COMPU_VTAB
/begin COMPU_METHOD L9959_SC_Compu "" RAT_FUNC "%6.2" "" COEFFS 0 1 0 0 0 1 /end COMPU_METHOD
/begin COMPU_METHOD L9966_SC_Compu "" RAT_FUNC "%6.2" "" COEFFS 0 1 0 0 0 1 /end COMPU_METHOD
/begin COMPU_METHOD lambdaRec "" RAT_FUNC "%7.6" "-" COEFFS 0 10000 0 0 0 1 /end COMPU_METHOD
/begin COMPU_METHOD lambdaRecVal "" RAT_FUNC "%6.5" "-" COEFFS 0 1000 0 0 0 1 /end COMPU_METHOD
/begin COMPU_METHOD Lambda_DiffQuot "" RAT_FUNC "%6.4" "1/s" COEFFS 0 20 0 0 0 1 /end COMPU_METHOD
/begin COMPU_METHOD LAMCL_CTRLRALG_SC_Compu "" TAB_VERB "%6.3" "" COMPU_TAB_REF LAMCL_CTRLRALG_SC_Compu /end COMPU_METHOD
/begin COMPU_VTAB LAMCL_CTRLRALG_SC_Compu "" TAB_VERB 3 0 "IMC" 1 "SmithPred" 255 "Calibratable" /end COMPU_VTAB
/begin COMPU_METHOD LAMCL_SPSHIFTINJ_SC_Compu "" TAB_VERB "%6.3" "" COMPU_TAB_REF LAMCL_SPSHIFTINJ_SC_Compu /end COMPU_METHOD
/begin COMPU_VTAB LAMCL_SPSHIFTINJ_SC_Compu "" TAB_VERB 2 0 "0" 1 "1" /end COMPU_VTAB
/begin COMPU_METHOD LAMCL_VAR_SY_Compu "" TAB_VERB "%6.3" "" COMPU_TAB_REF LAMCL_VAR_SY_Compu /end COMPU_METHOD
/begin COMPU_VTAB LAMCL_VAR_SY_Compu "" TAB_VERB 47 1 "DAI" 3 "VWW" 4 "POR" 5 "AUD" 6 "OPE" 9 "FIA" 11 "BMW" 14 "PSA" 15 "REN" 17 "ALF" 18 "SAB" 19 "VOL" 20 "NIS" 21 "GMU" 22 "FOR" 26 "IMJ" 51 "SEA" 53 "CHR" 54 "JAG" 55 "ROL" 69 "FER" 72 "TOY" 123 "MIT" 147 "HYU" 159 "HON" 160 "MAZ" 183 "CU" 190 "LRG" 204 "VVW" 214 "AVT" 242 "Iveco" 243 "DMC" 248 "SUZ" 267 "SSANGYONG" 270 "KEF" 289 "AMG" 308 "TAT" 319 "MVM" 330 "TVS" 385 "UAES" 386 "Bajaj Auto Indien" 425 "Polaris" 590 "Scania" 828 "RBCD" 999 "ALL" 2887 "Nonox" 9454 "Fuso" /end COMPU_VTAB
/begin COMPU_METHOD m_q0p1 "" RAT_FUNC "%6.3" "kg/h" COEFFS 0 10 0 0 0 1 /end COMPU_METHOD
/begin COMPU_METHOD m_ub_b23p3 "" RAT_FUNC "%6.3" "kg" COEFFS 0 2812.5 0 0 0 256 /end COMPU_METHOD
/begin COMPU_METHOD m_uw_b23p3 "" RAT_FUNC "%6.5" "kg" COEFFS 0 2812.5 0 0 0 1 /end COMPU_METHOD
/begin COMPU_METHOD m_uw_b25p6 "" RAT_FUNC "%6.5" "kg/h" COEFFS 0 65536 0 0 0 25.6 /end COMPU_METHOD
/begin COMPU_METHOD nmot_ub_q40 "" RAT_FUNC "%6.1" "1/min" COEFFS 0 1 0 0 0 40 /end COMPU_METHOD
/begin COMPU_METHOD nmot_uw_q0p25 "" RAT_FUNC "%6.3" "1/min" COEFFS 0 1 0 0 0 0.25 /end COMPU_METHOD
/begin COMPU_METHOD OneToOne "" RAT_FUNC "%6.2" "-" COEFFS 0 1 0 0 0 1 /end COMPU_METHOD
/begin COMPU_METHOD p_q0p0195 "" RAT_FUNC "%6.4" "hPa" COEFFS 0 256 0 0 0 5 /end COMPU_METHOD
/begin COMPU_METHOD RBPtCel_p_0p002_1 "" RAT_FUNC "%6.4" "MPa" COEFFS 0 1000 0 0 0 2 /end COMPU_METHOD
/begin COMPU_METHOD rel_q0p00153 "" RAT_FUNC "%6.4" "%" COEFFS 0 65536 0 0 0 100 /end COMPU_METHOD
/begin COMPU_METHOD rel_sw_b100 "" RAT_FUNC "%6.4" "%" COEFFS 0 32768 0 0 0 100 /end COMPU_METHOD
/begin COMPU_METHOD rel_sw_b1536 "" RAT_FUNC "%6.4" "%" COEFFS 0 65536 0 0 0 3072 /end COMPU_METHOD
/begin COMPU_METHOD rel_sw_q0p0234 "" RAT_FUNC "%6.4" "%/seg" COEFFS 0 32 0 0 0 0.75 /end COMPU_METHOD
/begin COMPU_METHOD rel_sw_q0p0468 "" RAT_FUNC "%6.4" "%" COEFFS 0 65536 0 0 0 3072 /end COMPU_METHOD
/begin COMPU_METHOD rel_ub_b100 "" RAT_FUNC "%6.3" "%" COEFFS 0 256 0 0 0 100 /end COMPU_METHOD
/begin COMPU_METHOD rel_ub_b99p6 "" RAT_FUNC "%6.3" "%" COEFFS 0 256 0 0 0 100 /end COMPU_METHOD
/begin COMPU_METHOD rel_uw_b100 "" RAT_FUNC "%6.4" "%" COEFFS 0 65536 0 0 0 100 /end COMPU_METHOD
/begin COMPU_METHOD rel_uw_b200 "" RAT_FUNC "%6.4" "%" COEFFS 0 65536 0 0 0 200 /end COMPU_METHOD
/begin COMPU_METHOD rel_uw_q0p0234 "" RAT_FUNC "%6.4" "%" COEFFS 0 32 0 0 0 0.75 /end COMPU_METHOD
/begin COMPU_METHOD spg_q0p1 "" RAT_FUNC "%6.3" "V" COEFFS 0 1 0 0 0 0.1 /end COMPU_METHOD
/begin COMPU_METHOD t100msxs_uw_b6553p5 "" RAT_FUNC "%6.3" "s" COEFFS 0 1 0 0 0 0.1 /end COMPU_METHOD
/begin COMPU_METHOD t10msxs_uw_b655p35 "" RAT_FUNC "%6.4" "s" COEFFS 0 1 0 0 0 0.01 /end COMPU_METHOD
/begin COMPU_METHOD t1sxs_uw_q1 "" RAT_FUNC "%6.2" "s" COEFFS 0 1 0 0 0 1 /end COMPU_METHOD
/begin COMPU_METHOD t500usxms_ub_q0p5 "" RAT_FUNC "%6.3" "ms" COEFFS 0 1 0 0 0 0.5 /end COMPU_METHOD
/begin COMPU_METHOD Temp_Cels "" RAT_FUNC "%6.1" "deg C" COEFFS 0 10 2731.4 0 0 1 /end COMPU_METHOD
/begin COMPU_METHOD temp_q0p1 "" RAT_FUNC "%6.3" "Grad C" COEFFS 0 10 0 0 0 1 /end COMPU_METHOD
/begin COMPU_METHOD temp_ub_b191p25 "" RAT_FUNC "%6.3" "Grad C" COEFFS 0 1 0 0 0 0.75 /end COMPU_METHOD
/begin COMPU_METHOD temp_ub_q0p75_o48 "" RAT_FUNC "%6.2" "Grad C" COEFFS 0 1 48 0 0 0.75 /end COMPU_METHOD
/begin COMPU_METHOD t_q0p01 "" RAT_FUNC "%6.4" "s" COEFFS 0 100 0 0 0 1 /end COMPU_METHOD
/begin COMPU_METHOD t_q0p01_ms "" RAT_FUNC "%6.4" "ms" COEFFS 0 1 0 0 0 0.01 /end COMPU_METHOD
/begin COMPU_METHOD t_q0p02 "" RAT_FUNC "%6.4" "s" COEFFS 0 100 0 0 0 2 /end COMPU_METHOD
/begin COMPU_METHOD t_q0p1 "" RAT_FUNC "%6.3" "s" COEFFS 0 10 0 0 0 1 /end COMPU_METHOD
/begin COMPU_METHOD t_q1 "" RAT_FUNC "%6.2" "s" COEFFS 0 1 0 0 0 1 /end COMPU_METHOD
/begin COMPU_METHOD t_q10_ms "" RAT_FUNC "%6.1" "ms" COEFFS 0 1 0 0 0 10 /end COMPU_METHOD
/begin COMPU_METHOD zk10msxs_uw_b655p36 "" RAT_FUNC "%6.2" "s" COEFFS 0 0 65536 0 100 0 /end COMPU_METHOD
/begin COMPU_METHOD zk5msxs_uw_b327p68 "" RAT_FUNC "%6.2" "s" COEFFS 0 0 65536 0 200 0 /end COMPU_METHOD
/begin RECORD_LAYOUT RB_Axis_S16 NO_AXIS_PTS_X 1 SWORD AXIS_PTS_X 2 SWORD INDEX_INCR DIRECT /end RECORD_LAYOUT
/begin RECORD_LAYOUT RB_Axis_U16 NO_AXIS_PTS_X 1 UWORD AXIS_PTS_X 2 UWORD INDEX_INCR DIRECT /end RECORD_LAYOUT
/begin RECORD_LAYOUT RB_Axis_U8 NO_AXIS_PTS_X 1 UBYTE AXIS_PTS_X 2 UBYTE INDEX_INCR DIRECT /end RECORD_LAYOUT
/begin RECORD_LAYOUT RB_CurveGroup_S16 FNC_VALUES 1 SWORD COLUMN_DIR DIRECT /end RECORD_LAYOUT
/begin RECORD_LAYOUT RB_CurveGroup_U16 FNC_VALUES 1 UWORD COLUMN_DIR DIRECT /end RECORD_LAYOUT
/begin RECORD_LAYOUT RB_CurveGroup_U8 FNC_VALUES 1 UBYTE COLUMN_DIR DIRECT /end RECORD_LAYOUT
/begin RECORD_LAYOUT RB_Curve_S16_S16 NO_AXIS_PTS_X 1 SWORD AXIS_PTS_X 2 SWORD INDEX_INCR DIRECT FNC_VALUES 3 SWORD COLUMN_DIR DIRECT /end RECORD_LAYOUT
/begin RECORD_LAYOUT RB_Curve_S16_U16_Static NO_AXIS_PTS_X 1 SWORD AXIS_PTS_X 2 SWORD INDEX_INCR DIRECT FNC_VALUES 3 UWORD COLUMN_DIR DIRECT STATIC_RECORD_LAYOUT /end RECORD_LAYOUT
/begin RECORD_LAYOUT RB_Curve_S16_U8_Static NO_AXIS_PTS_X 1 SWORD AXIS_PTS_X 2 SWORD INDEX_INCR DIRECT FNC_VALUES 3 UBYTE COLUMN_DIR DIRECT STATIC_RECORD_LAYOUT /end RECORD_LAYOUT
/begin RECORD_LAYOUT RB_Curve_U16_U16 NO_AXIS_PTS_X 1 UWORD AXIS_PTS_X 2 UWORD INDEX_INCR DIRECT FNC_VALUES 3 UWORD COLUMN_DIR DIRECT /end RECORD_LAYOUT
/begin RECORD_LAYOUT RB_Curve_U16_U8_Static NO_AXIS_PTS_X 1 UWORD AXIS_PTS_X 2 UWORD INDEX_INCR DIRECT FNC_VALUES 3 UBYTE COLUMN_DIR DIRECT STATIC_RECORD_LAYOUT /end RECORD_LAYOUT
/begin RECORD_LAYOUT RB_Curve_U8_U16_Static NO_AXIS_PTS_X 1 UBYTE AXIS_PTS_X 2 UBYTE INDEX_INCR DIRECT FNC_VALUES 3 UWORD COLUMN_DIR DIRECT STATIC_RECORD_LAYOUT /end RECORD_LAYOUT
/begin RECORD_LAYOUT RB_Curve_U8_U8 NO_AXIS_PTS_X 1 UBYTE AXIS_PTS_X 2 UBYTE INDEX_INCR DIRECT FNC_VALUES 3 UBYTE COLUMN_DIR DIRECT /end RECORD_LAYOUT
/begin RECORD_LAYOUT RB_FixCurve_U8_U8 FNC_VALUES 1 UBYTE COLUMN_DIR DIRECT /end RECORD_LAYOUT
/begin RECORD_LAYOUT RB_MapGroup_S16 FNC_VALUES 1 SWORD COLUMN_DIR DIRECT /end RECORD_LAYOUT
/begin RECORD_LAYOUT RB_MapGroup_U16 FNC_VALUES 1 UWORD COLUMN_DIR DIRECT /end RECORD_LAYOUT
/begin RECORD_LAYOUT RB_MapGroup_U8 FNC_VALUES 1 UBYTE COLUMN_DIR DIRECT /end RECORD_LAYOUT
/begin RECORD_LAYOUT RB_Map_S16S16_U16 NO_AXIS_PTS_X 1 SWORD NO_AXIS_PTS_Y 2 SWORD AXIS_PTS_X 3 SWORD INDEX_INCR DIRECT AXIS_PTS_Y 4 SWORD INDEX_INCR DIRECT FNC_VALUES 5 UWORD COLUMN_DIR DIRECT /end RECORD_LAYOUT
/begin RECORD_LAYOUT RB_Map_S16S16_U8 NO_AXIS_PTS_X 1 SWORD NO_AXIS_PTS_Y 2 SWORD AXIS_PTS_X 3 SWORD INDEX_INCR DIRECT AXIS_PTS_Y 4 SWORD INDEX_INCR DIRECT FNC_VALUES 5 UBYTE COLUMN_DIR DIRECT /end RECORD_LAYOUT
/begin RECORD_LAYOUT RB_Map_S16U16_S16 NO_AXIS_PTS_X 1 SWORD NO_AXIS_PTS_Y 2 SWORD AXIS_PTS_X 3 SWORD INDEX_INCR DIRECT AXIS_PTS_Y 4 UWORD INDEX_INCR DIRECT FNC_VALUES 5 SWORD ROW_DIR DIRECT /end RECORD_LAYOUT
/begin RECORD_LAYOUT RB_Map_S16U16_U16 NO_AXIS_PTS_X 1 SWORD NO_AXIS_PTS_Y 2 SWORD AXIS_PTS_X 3 SWORD INDEX_INCR DIRECT AXIS_PTS_Y 4 UWORD INDEX_INCR DIRECT FNC_VALUES 5 UWORD ROW_DIR DIRECT /end RECORD_LAYOUT
/begin RECORD_LAYOUT RB_Map_U8S16_U16 NO_AXIS_PTS_X 1 UBYTE NO_AXIS_PTS_Y 2 UBYTE AXIS_PTS_X 3 UBYTE INDEX_INCR DIRECT AXIS_PTS_Y 4 SWORD INDEX_INCR DIRECT FNC_VALUES 5 UWORD ROW_DIR DIRECT /end RECORD_LAYOUT
/begin RECORD_LAYOUT RB_Map_U8U16_S16 NO_AXIS_PTS_X 1 UBYTE NO_AXIS_PTS_Y 2 UBYTE AXIS_PTS_X 3 UBYTE INDEX_INCR DIRECT AXIS_PTS_Y 4 UWORD INDEX_INCR DIRECT FNC_VALUES 5 SWORD ROW_DIR DIRECT /end RECORD_LAYOUT
/begin RECORD_LAYOUT RB_Map_U8U16_U16 NO_AXIS_PTS_X 1 UBYTE NO_AXIS_PTS_Y 2 UBYTE AXIS_PTS_X 3 UBYTE INDEX_INCR DIRECT AXIS_PTS_Y 4 UWORD INDEX_INCR DIRECT FNC_VALUES 5 UWORD ROW_DIR DIRECT /end RECORD_LAYOUT
/begin RECORD_LAYOUT RB_Map_U8U16_U8 NO_AXIS_PTS_X 1 UBYTE NO_AXIS_PTS_Y 2 UBYTE AXIS_PTS_X 3 UBYTE INDEX_INCR DIRECT AXIS_PTS_Y 4 UWORD INDEX_INCR DIRECT FNC_VALUES 5 UBYTE ROW_DIR DIRECT /end RECORD_LAYOUT
/begin RECORD_LAYOUT RB_Map_U8U8_U8 NO_AXIS_PTS_X 1 UBYTE NO_AXIS_PTS_Y 2 UBYTE AXIS_PTS_X 3 UBYTE INDEX_INCR DIRECT AXIS_PTS_Y 4 UBYTE INDEX_INCR DIRECT FNC_VALUES 5 UBYTE COLUMN_DIR DIRECT /end RECORD_LAYOUT
/begin RECORD_LAYOUT RB_Val_Wboolean FNC_VALUES 1 UBYTE COLUMN_DIR DIRECT /end RECORD_LAYOUT
/begin RECORD_LAYOUT RB_Val_Ws16 FNC_VALUES 1 SWORD COLUMN_DIR DIRECT /end RECORD_LAYOUT
/begin RECORD_LAYOUT RB_Val_Wu16 FNC_VALUES 1 UWORD COLUMN_DIR DIRECT /end RECORD_LAYOUT
/begin RECORD_LAYOUT RB_Val_Wu32 FNC_VALUES 1 ULONG COLUMN_DIR DIRECT /end RECORD_LAYOUT
/begin RECORD_LAYOUT RB_Val_Wu8 FNC_VALUES 1 UBYTE COLUMN_DIR DIRECT /end RECORD_LAYOUT
/begin RECORD_LAYOUT Val_Wu16 FNC_VALUES 1 UWORD COLUMN_DIR DIRECT /end RECORD_LAYOUT
/end MODULE
/end PROJECT
