ASAP2_VERSION 1 60
/begin PROJECT MG1CS022 "MG1CS022"
/begin HEADER "" VERSION "MG1CS022_62XSC_V037_TPROT" PROJECT_NO MG1CS022 /end HEADER
/begin MODULE DIM ""
/begin MOD_COMMON "" BYTE_ORDER MSB_LAST ALIGNMENT_BYTE 1 ALIGNMENT_WORD 2 ALIGNMENT_LONG 4 ALIGNMENT_INT64 4 ALIGNMENT_FLOAT32_IEEE 4 ALIGNMENT_FLOAT64_IEEE 4 DATA_SIZE 32 /end MOD_COMMON
/begin CHARACTERISTIC CCPVPLAUMX "max number of CPV plausibility-checks" VALUE 0x8053AE36 RB_Val_Wu8 255.0 dez 0.00 255.0 FORMAT "%5.1" /end CHARACTERISTIC
/begin CHARACTERISTIC CstrPurg_stDiagCpvDteskSeln_C "Code word to select which purge line or Bank are using a DTESK based algorithm" VALUE 0x8053AE98 RB_Val_Wu8 255.0 OneToOne 0.00 255.0 FORMAT "%5.1" /end CHARACTERISTIC
/begin CHARACTERISTIC CWCCVCLSD "Codeword to enable DTESK diagnosis counter increment when CCV is closed" VALUE 0x8053AFFC RB_Val_Wu8 255.0 dez 0.00 255.0 FORMAT "%5.1" /end CHARACTERISTIC
/begin CHARACTERISTIC CWDFSTT "codeword diagnostics for fluid level sensor tank" VALUE 0x8053A8DC RB_Val_Wu8 255.0 dez 0.00 255.0 FORMAT "%5.1" /end CHARACTERISTIC
/begin CHARACTERISTIC CWDTESKAPP "codeword for activating a desired tank leakage diagnosis (for calibration purpose)" VALUE 0x8053AFFD RB_Val_Wu8 6.000 dez 0.00 6.000 FORMAT "%5.3" EXTENDED_LIMITS 0.00 255.0 /end CHARACTERISTIC
/begin CHARACTERISTIC CWDTESKEB "code word for switch on tank leak diagnosis" VALUE 0x8053AFFE RB_Val_Wu16 65535.00 dez 0.00 65535.00 FORMAT "%8.2" /end CHARACTERISTIC
/begin CHARACTERISTIC CWDTESKSTC "code word: calculation of request engine running" VALUE 0x8053B000 RB_Val_Wu8 255.0 dez 0.00 255.0 FORMAT "%5.1" /end CHARACTERISTIC
/begin CHARACTERISTIC CWDTESKTEAD "Codeword to select the method for the disable condition because of high canister load" VALUE 0x8053B001 RB_Val_Wu8 255.0 dez 0.00 255.0 FORMAT "%5.1" /end CHARACTERISTIC
/begin CHARACTERISTIC CWSFTEDAFA "Codeword for high canister load detection at tester request" VALUE 0x8053B002 RB_Val_Wu8 255.0 dez 0.00 255.0 FORMAT "%5.1" /end CHARACTERISTIC
/begin CHARACTERISTIC CWTLDDD "code word for enabling distance debounce in DTESK (byte)" VALUE 0x8053AFF2 RB_Val_Wu8 255.0 dez 0.00 255.0 FORMAT "%5.1" /end CHARACTERISTIC
/begin CHARACTERISTIC CWTLDOBD "code word for specification of the OBD-diagnosis" VALUE 0x8053B003 RB_Val_Wu8 255.0 dez 0.00 255.0 FORMAT "%5.1" /end CHARACTERISTIC
/begin CHARACTERISTIC DDPTETA "pressure threshold for detection of refueling process" VALUE 0x8053AFF4 RB_Val_Ws16 79.99878 p_q0p00122 -40.00000 39.99878 FORMAT "%8.5" /end CHARACTERISTIC
/begin CHARACTERISTIC DFES_xAsgnExtdFrzFrSig_CA "Signal selection for extended freeze frame (signal based)" VAL_BLK 0x804D984C ValA_Wu16 1168.00000000 Signals_IntSigNumVerb 0.00 1168.00000000 FORMAT "%13.8" NUMBER 50 /end CHARACTERISTIC
/begin CHARACTERISTIC DFES_xAsgnFrzFrSig_CA "Signal selection for freeze frame (signal based)" VAL_BLK 0x804D98B0 ValA_Wu16 1168.00000000 Signals_IntSigNumVerb 0.00 1168.00000000 FORMAT "%13.8" NUMBER 87 /end CHARACTERISTIC
/begin CHARACTERISTIC DFES_xClsDltTrg_CA "Fault class parameter: Trigger type for OBD delete counter" VAL_BLK 0x804D995E ValA_Wu8 11.0000000000 DSMAUX_DTRGVerb 0.00 11.0000000000 FORMAT "%13.10" NUMBER 31 /end CHARACTERISTIC
/begin CHARACTERISTIC DFES_xClsFaultTrg_CA "Fault class parameter: Trigger type for fault counter" VAL_BLK 0x804D997D ValA_Wu8 11.0000000000 DSMAUX_DTRGVerb 0.00 11.0000000000 FORMAT "%13.10" NUMBER 31 /end CHARACTERISTIC
/begin CHARACTERISTIC DFES_xClsFltMIL_CA "Fault class parameter: MIL control" VAL_BLK 0x804D999C ValA_Wu8 3.00000000000 DFES_LampFltMIL 0.00 3.00000000000 FORMAT "%13.11" NUMBER 31 /end CHARACTERISTIC
/begin CHARACTERISTIC DFES_xClsFltSVS_CA "Fault class parameter: SVS lamp control" VAL_BLK 0x804D99BB ValA_Wu8 8.00000000000 DFES_LampFltSVS 0.00 8.00000000000 FORMAT "%13.11" NUMBER 31 /end CHARACTERISTIC
/begin CHARACTERISTIC DFES_xClsHealTrg_CA "Fault class parameter: Trigger type for healing counter" VAL_BLK 0x804D99DA ValA_Wu8 11.0000000000 DSMAUX_DTRGVerb 0.00 11.0000000000 FORMAT "%13.10" NUMBER 31 /end CHARACTERISTIC
/begin CHARACTERISTIC DFES_xClsPndDltTrg_CA "Fault class parameter: Trigger type for pending delete counter" VAL_BLK 0x804D99F9 ValA_Wu8 11.0000000000 DSMAUX_DTRGVerb 0.00 11.0000000000 FORMAT "%13.10" NUMBER 31 /end CHARACTERISTIC
/begin CHARACTERISTIC DFES_xClsPrio_CA "Fault class parameter: Static priority and tester visibility" VAL_BLK 0x804D9A18 ValA_Wu8 214.000000000 DFES_TstVisAndPrio 3.000000000 217.000000000 FORMAT "%13.9" NUMBER 31 /end CHARACTERISTIC
/begin CHARACTERISTIC DFES_xClsSvcDltTrg_CA "Fault class parameter: Trigger type for delete counter" VAL_BLK 0x804D9A37 ValA_Wu8 11.0000000000 DSMAUX_DTRGVerb 0.00 11.0000000000 FORMAT "%13.10" NUMBER 31 /end CHARACTERISTIC
/begin CHARACTERISTIC DFES_xClsSVSFaultTrg_CA "Fault class parameter: Trigger type for SVS lamp fault counter" VAL_BLK 0x804D9A56 ValA_Wu8 11.0000000000 DSMAUX_DTRGVerb 0.00 11.0000000000 FORMAT "%13.10" NUMBER 31 /end CHARACTERISTIC
/begin CHARACTERISTIC DFES_xClsSVSHealTrg_CA "Fault class parameter: Trigger type for SVS lamp healing counter" VAL_BLK 0x804D9A75 ValA_Wu8 11.0000000000 DSMAUX_DTRGVerb 0.00 11.0000000000 FORMAT "%13.10" NUMBER 31 /end CHARACTERISTIC
/begin CHARACTERISTIC DFSKVMN "lower threshold for fuel-level sensor plausibility error detection" VALUE 0x8053A8DE RB_Val_Ws16 6553.500 vol_q0p1_l -3276.800 3276.700 FORMAT "%8.3" /end CHARACTERISTIC
/begin CHARACTERISTIC DFSKVMX "upper threshold for fuel-level sensor plausibility error detection" VALUE 0x8053A8E0 RB_Val_Ws16 6553.500 vol_q0p1_l -3276.800 3276.700 FORMAT "%8.3" /end CHARACTERISTIC
/begin CHARACTERISTIC DFSTTH "Minimum fuel-volume-change in tank for plausibility check" VALUE 0x8053A8E2 RB_Val_Wu16 6553.500 vol_q0p1_l 0.00 6553.500 FORMAT "%8.3" /end CHARACTERISTIC
/begin CHARACTERISTIC DHDEVE0P "Parameter for detection failure power stage bank 0" VALUE 0x8053A92C RB_Val_Wu8 255.0 dez 0.00 255.0 FORMAT "%5.1" /end CHARACTERISTIC
/begin CHARACTERISTIC DHDEVE1P "Parameter for detection failure power stage bank 0" VALUE 0x8053A92D RB_Val_Wu8 255.0 dez 0.00 255.0 FORMAT "%5.1" /end CHARACTERISTIC
/begin CHARACTERISTIC DiaActr_ElecHBrdgDiag_DbgSigId_C "Select H-Bridge signal to be debugged." VALUE 0x8058AFD0 Val_Wu16 65535.00 OneToOne 0.00 65535.00 FORMAT "%8.2" /end CHARACTERISTIC
/begin CHARACTERISTIC DiaActr_ElecHBrdgDiag_DbgSigType_C "Select the signal type of signal to be debugged." VALUE 0x8058AFD2 Val_Wu8 1.00000000000 DiaActr_ElecHBrdgDiag_DbgSigType_COMPU_VERB 0.00 1.00000000000 FORMAT "%13.11" /end CHARACTERISTIC
/begin CHARACTERISTIC DiaActr_ElecHBrdgDiag_OlEnaSwtOff_C "Enable powerstage switchoff during permanent error and preliminary heal of open load error. [Relevant only if open load is configured in active \ normal drive mode]." VALUE 0x8058AFD3 Val_Wu8 1.00000000000 DiaActr_ElecHBrdgDiag_OlEnaSwtOff_COMPU_VERB 0.00 1.00000000000 FORMAT "%13.11" /end CHARACTERISTIC
/begin CHARACTERISTIC DiaActr_ElecPsDiag_DbgSigId_C "Signal Id to be debugged" VALUE 0x8058AFD4 Val_Wu32 4294967295.00 OneToOne 0.00 4294967295.00 FORMAT "%13.2" /end CHARACTERISTIC
/begin CHARACTERISTIC DiaActr_ElecPsDiag_DbgSigTyp_C "Type of the output signal (PWMOut, DigOut, Pmd) to be debugged." VALUE 0x8058AFD8 Val_Wu8 3.00000000000 DiaActr_ElecPsDiag_DbgSigTyp_COMPU_VERB 0.00 3.00000000000 FORMAT "%13.11" /end CHARACTERISTIC
/begin CHARACTERISTIC DiaActr_ElecPsDiag_SigOutDurgOpenLd_C "Take into account Open-Load-Error for Shut-Off request." VALUE 0x8058AFD9 Val_Wu8 1.000 OneToOne 0.00 1.000 FORMAT "%5.3" EXTENDED_LIMITS 0.00 255.0 /end CHARACTERISTIC
/begin CHARACTERISTIC DiagCpt_mfMinOffsChkPSnsr_C "Minimum integrated mass flow for release of offset check tank pressure sensor to avoid chock canister condition" VALUE 0x8053AE38 RB_Val_Wu16 2909.754 m_ub_q0p0444 0.00 2909.754 FORMAT "%8.3" /end CHARACTERISTIC
/begin CHARACTERISTIC DiagCpt_mfMinOffsEol_C "Minimum integrated mass flow for release of offset check tank pressure sensor to avoid chock canister condition during end of line test" VALUE 0x8053AE3A RB_Val_Wu16 2909.754 m_ub_q0p0444 0.00 2909.754 FORMAT "%8.3" /end CHARACTERISTIC
/begin CHARACTERISTIC DiagCpt_stOffsDiag_C "Codeword for offsetdiagnosis" VALUE 0x8053AE3C RB_Val_Wu8 255.0 dez 0.00 255.0 FORMAT "%5.1" /end CHARACTERISTIC
/begin CHARACTERISTIC DiagCpt_stPSnsrTankDiag_C "Code word to configure diagnosis tank pressure sensor (1 sensor)" VALUE 0x8053AE3D RB_Val_Wu8 255.0 dez 0.00 255.0 FORMAT "%5.1" /end CHARACTERISTIC
/begin CHARACTERISTIC DiagCpt_vMinOffsEol_C "minimum vehicle velocity for the offset diagnosis during end of line test" VALUE 0x8053AE3E RB_Val_Ws16 655.3500 Vel -327.6800 327.6700 FORMAT "%8.4" /end CHARACTERISTIC
/begin CHARACTERISTIC DKVBTH "minimum-volume of fuel-consumed for tank plausibility check" VALUE 0x8053A8E4 RB_Val_Wu16 255.9961 vol_q3p90625Em3_l 0.00 255.9961 FORMAT "%8.4" /end CHARACTERISTIC
/begin CHARACTERISTIC DMSNTEVMN "Minimum PCV differential mass flow for incremental check of tank pressure sensor" VALUE 0x8053AE40 RB_Val_Wu16 25.59961 m_uw_b25p6 0.00 25.59961 FORMAT "%8.5" /end CHARACTERISTIC
/begin CHARACTERISTIC DPCPVPOF "maximum pressure change during cpv active" VALUE 0x8053AE42 RB_Val_Wu16 79.99878 p_q0p00122 0.00 79.99878 FORMAT "%8.5" /end CHARACTERISTIC
/begin CHARACTERISTIC DPDSTNPW "minimum tank pressure difference for plausibility error detection (Word)" VALUE 0x8053AE44 RB_Val_Wu16 79.99878 p_q0p00122 0.00 79.99878 FORMAT "%8.5" /end CHARACTERISTIC
/begin CHARACTERISTIC DPTEKDTHMX "max value delta tank pressure for offset diagnosis tank pressure sensor" VALUE 0x8053AE46 RB_Val_Wu16 79.99878 p_q0p00122 0.00 79.99878 FORMAT "%8.5" /end CHARACTERISTIC
/begin CHARACTERISTIC DPTEKO "limit for identification offet-failure tank pressure" VALUE 0x8053AE48 RB_Val_Wu16 79.99878 p_q0p00122 0.00 79.99878 FORMAT "%8.5" /end CHARACTERISTIC
/begin CHARACTERISTIC ENVTDSTOMN "Minimum ambient temperature for check of tank pressure sensor for offset" VALUE 0x8053AE4A RB_Val_Ws16 6553.500 Temp_Cels -3549.940 3003.560 FORMAT "%8.3" /end CHARACTERISTIC
/begin CHARACTERISTIC ENVTDSTOMX "Maximum ambient temperature for check of tank pressure sensor for offset" VALUE 0x8053AE4C RB_Val_Ws16 6553.500 Temp_Cels -3549.940 3003.560 FORMAT "%8.3" /end CHARACTERISTIC
/begin CHARACTERISTIC ENVTDSTUMN "Minimum ambient temperature for diagnosis of tank pressure sensor" VALUE 0x8053AE4E RB_Val_Ws16 6553.500 Temp_Cels -3549.940 3003.560 FORMAT "%8.3" /end CHARACTERISTIC
/begin CHARACTERISTIC ENVTDSTUMX "Maximum ambient temperature for diagnosis of tank pressure sensor" VALUE 0x8053AE50 RB_Val_Ws16 6553.500 Temp_Cels -3549.940 3003.560 FORMAT "%8.3" /end CHARACTERISTIC
/begin CHARACTERISTIC EvapDi_facEthnlMax_C "Max ethanol concentration factor threshold" VALUE 0x8053AE9A RB_Val_Wu16 1.999969 fak_uw_b2 0.00 1.999969 FORMAT "%8.6" /end CHARACTERISTIC
/begin CHARACTERISTIC EvapDi_facPGradCalcdThdFlexfu_M "pressure gradient calculation threshold for flexfuel" MAP 0x8053AE9C RB_Map_U16U16_U16 1.562476 pgrad_q2p38Em5 0.00 1.562476 FORMAT "%8.6"
 /begin AXIS_DESCR STD_AXIS fstttld_w_msg vol_q0p1_l 10 0.00 6553.500 FORMAT "%8.3" DEPOSIT ABSOLUTE /end AXIS_DESCR
 /begin AXIS_DESCR STD_AXIS TankLeakDiag_facEthnlSensVal fak_uw_b2 6 0.00 1.999969 FORMAT "%8.6" DEPOSIT ABSOLUTE /end AXIS_DESCR
/end CHARACTERISTIC
/begin CHARACTERISTIC EvapDi_flgEthnlSnsrSwt_C "Ethanol sensor switc" VALUE 0x8053B004 RB_Val_Wboolean 1.00000000000 B_TRUE 0.00 1.00000000000 FORMAT "%13.11" /end CHARACTERISTIC
/begin CHARACTERISTIC EvapDi_stObdOpt_C "Fuel level consideration for OBD-Br3" VALUE 0x8053AFF6 RB_Val_Wu8 255.0 OneToOne 0.00 255.0 FORMAT "%5.1" /end CHARACTERISTIC
/begin CHARACTERISTIC FlLvl_ctMacCntRstPlausyChk_C "Maximum calibratable counts to reset dualtank fuel-level plausibility-check since fuel tank full condition is set." VALUE 0x8053A8E6 RB_Val_Wu16 65535.00 OneToOne 0.00 65535.00 FORMAT "%8.2" /end CHARACTERISTIC
/begin CHARACTERISTIC Fllvl_lenPlausDiagFuSnsrMin_C "Minimum Length to release the IUMPR-FID of the plausibility diagnosis for fuel level sensor." VALUE 0x8053A8E8 RB_Val_Ws32 4294967295.00 Length -2147483648.00 2147483647.00 FORMAT "%13.2" /end CHARACTERISTIC
/begin CHARACTERISTIC FlLvl_stPlausyDiagRst_C "Code word to select reseting of plausibility diagnosis in case of tank full or tank empty" VALUE 0x8053A8EC RB_Val_Wu8 255.0 OneToOne 0.00 255.0 FORMAT "%5.1" /end CHARACTERISTIC
/begin CHARACTERISTIC FlLvl_stSlopDetn_C "Enable or disable slope detection for fuel level" VALUE 0x8053A8ED RB_Val_Wu8 255.0 OneToOne 0.00 255.0 FORMAT "%5.1" /end CHARACTERISTIC
/begin CHARACTERISTIC FlLvl_tiLongStandStill_C "Delay time to wait before resetting the plausibility diagnosis in case of fuel in upper or lower dead zone" VALUE 0x8053A8EE RB_Val_Wu8 255.0 t_q1 0.00 255.0 FORMAT "%5.1" /end CHARACTERISTIC
/begin CHARACTERISTIC FlLvl_tiRefuOnDec_C "Check for detection on fuel level decrement in slope" VALUE 0x8053A8EF RB_Val_Wu8 255.0 t_q1 0.00 255.0 FORMAT "%5.1" /end CHARACTERISTIC
/begin CHARACTERISTIC FlLvl_tiRefuOnInc_C "Check for detection on fuel level increment in slope" VALUE 0x8053A8F0 RB_Val_Wu8 255.0 t_q1 0.00 255.0 FORMAT "%5.1" /end CHARACTERISTIC
/begin CHARACTERISTIC FlLvl_vMovingChkThdHi_C "Upper threshold for vehicle speed in case of plausibility diagnosis reset for upper dead zone" VALUE 0x8053A8F2 RB_Val_Ws16 655.3500 Vel -327.6800 327.6700 FORMAT "%8.4" /end CHARACTERISTIC
/begin CHARACTERISTIC FlLvl_vMovingChkThdLo_C "lower threshold for vehicle speed in case of plausibility diagnosis reset for upper dead zone" VALUE 0x8053A8F4 RB_Val_Ws16 655.3500 Vel -327.6800 327.6700 FORMAT "%8.4" /end CHARACTERISTIC
/begin CHARACTERISTIC FlLvl_vVehStopChkThdHi_C "High threshold for vehicle stop check" VALUE 0x8053A8F6 RB_Val_Wu16 511.9922 vfzg_uw_b512 0.00 511.9922 FORMAT "%8.4" /end CHARACTERISTIC
/begin CHARACTERISTIC FlLvl_vVehStopChkThdLo_C "Low threshold for vehicle stop check" VALUE 0x8053A8F8 RB_Val_Wu16 511.9922 vfzg_uw_b512 0.00 511.9922 FORMAT "%8.4" /end CHARACTERISTIC
/begin CHARACTERISTIC FST1SKTH "Primary fuel-tank volume-change threshold for sensor-stuck detection" VALUE 0x8053A8FA RB_Val_Wu16 6553.500 vol_q0p1_l 0.00 6553.500 FORMAT "%8.3" /end CHARACTERISTIC
/begin CHARACTERISTIC FSTDSTOZMX "Maximum fuel tank level for enabling oscillation check" VALUE 0x8053AE52 RB_Val_Wu16 6553.500 vol_q0p1_l 0.00 6553.500 FORMAT "%8.3" /end CHARACTERISTIC
/begin CHARACTERISTIC FSTEADENMN "Lower threshold of the hysteresis for the disable condition because of high canister load" VALUE 0x8053B006 RB_Val_Ws16 127.9980 fak_sw_b64 -64.00000 63.99805 FORMAT "%8.5" /end CHARACTERISTIC
/begin CHARACTERISTIC FSTEADENMX "Upper threshold of the hysteresis for the disable condition because of high canister load" VALUE 0x8053B008 RB_Val_Ws16 127.9980 fak_sw_b64 -64.00000 63.99805 FORMAT "%8.5" /end CHARACTERISTIC
/begin CHARACTERISTIC FTEADSTOMN "max value factor fuel purge adaptation for offset-check tank pressure sensor" VALUE 0x8053AE54 RB_Val_Ws16 127.9980 fak_sw_b64 -64.00000 63.99805 FORMAT "%8.5" /end CHARACTERISTIC
/begin CHARACTERISTIC FuEvapLeak_cwCcvPErrIgr_C "Codeword to define which error bits should be considered to set error" VALUE 0x8053AFF7 RB_Val_Wu8 255.0 OneToOne 0.00 255.0 FORMAT "%5.1" /end CHARACTERISTIC
/begin CHARACTERISTIC HPUTEDU "lower pressure threshold for performing of the 0.5mm tank leak diagnosis" VALUE 0x8053B00A RB_Val_Wu16 2559.961 p_uw_q0p039 0.00 2559.961 FORMAT "%8.3" /end CHARACTERISTIC
/begin CHARACTERISTIC IMSTEMNTLD "min. integral of purge mass flow for TLD" VALUE 0x8053B00C RB_Val_Wu8 11.32 m_ub_q0p0444 0.00 11.32 FORMAT "%5.2" /end CHARACTERISTIC
/begin CHARACTERISTIC KFFUTNKCENGT "Map for correcting pressure removal gradiant using coolant temprature in DTESK" MAP 0x8053AF38 RB_Map_U16S16_U8 1.992188 fak_ub_b2 0.00 1.992188 FORMAT "%8.6"
 /begin AXIS_DESCR STD_AXIS tnse_w_msg t100msxs_uw_b6553p5 6 0.00 6553.500 FORMAT "%8.3" DEPOSIT ABSOLUTE /end AXIS_DESCR
 /begin AXIS_DESCR STD_AXIS CEngDsT_t Temp_Cels 6 -3549.940 3003.560 FORMAT "%8.3" DEPOSIT ABSOLUTE /end AXIS_DESCR
/end CHARACTERISTIC
/begin CHARACTERISTIC KLDFSTVFZG "delay time for release diagnosis dependent on fuel level difference" CURVE 0x8053A8FC RB_Curve_U16_U16 65535.00 t_q1 0.00 65535.00 FORMAT "%8.2"
 /begin AXIS_DESCR STD_AXIS dfstig_w vol_q0p1_l 4 0.00 6553.500 FORMAT "%8.3" DEPOSIT ABSOLUTE /end AXIS_DESCR
/end CHARACTERISTIC
/begin CHARACTERISTIC KLENVT "Curve for correcting pressure removal gradiant using Enviornment temprature in DTESK" CURVE 0x8053AF78 RB_Curve_S16_U8_Static 1.992188 fak_ub_b2 0.00 1.992188 FORMAT "%8.6"
 /begin AXIS_DESCR STD_AXIS EnvT_t Temp_Cels 6 -3549.940 3003.560 FORMAT "%8.3" DEPOSIT ABSOLUTE /end AXIS_DESCR
/end CHARACTERISTIC
/begin CHARACTERISTIC KLFACCORRALTI "Curve for correcting pressure removal gradiant using altitude change in DTESK" CURVE 0x8053AF8C RB_Curve_U16_U8_Static 1.992188 fak_ub_b2 0.00 1.992188 FORMAT "%8.6"
 /begin AXIS_DESCR STD_AXIS PEnv_facCorrAlti fak_uw_b4 6 0.00 3.999939 FORMAT "%8.6" DEPOSIT ABSOLUTE /end AXIS_DESCR
/end CHARACTERISTIC
/begin CHARACTERISTIC KLFTEADDTESK "curve line high canister load disabeled tank leak diagnoisi" CURVE 0x8053B00E RB_Curve_U8_S16_Static 127.9980 fak_sw_b64 -64.00000 63.99805 FORMAT "%8.5"
 /begin AXIS_DESCR STD_AXIS PurgLeakDiag_tAmbAir temp_ub_q0p75_o48 8 -48.0 143.3 FORMAT "%5.1" DEPOSIT ABSOLUTE /end AXIS_DESCR
/end CHARACTERISTIC
/begin CHARACTERISTIC KLTLDSFS05 "Threshold for tank leak diagnosis" CURVE 0x8053AFA0 RB_CurveGroup_U16 1.562476 pgrad_q2p38Em5 0.00 1.562476 FORMAT "%8.6"
 /begin AXIS_DESCR COM_AXIS fstttld_w_msg vol_q0p1_l 10 0.00 6553.500 FORMAT "%8.3" AXIS_PTS_REF STFST10TLD /end AXIS_DESCR
/end CHARACTERISTIC
/begin CHARACTERISTIC KLTLDSFSFA "Threshold for tank leak diagnosis" CURVE 0x8053AFB4 RB_CurveGroup_U16 1.562476 pgrad_q2p38Em5 0.00 1.562476 FORMAT "%8.6"
 /begin AXIS_DESCR COM_AXIS fstttld_w_msg vol_q0p1_l 10 0.00 6553.500 FORMAT "%8.3" AXIS_PTS_REF STFST10TLD /end AXIS_DESCR
/end CHARACTERISTIC
/begin CHARACTERISTIC KLTLDSFSFG "Threshold for tank leak diagnosis in garage" CURVE 0x8053AFC8 RB_CurveGroup_U16 1.562476 pgrad_q2p38Em5 0.00 1.562476 FORMAT "%8.6"
 /begin AXIS_DESCR COM_AXIS fstttld_w_msg vol_q0p1_l 10 0.00 6553.500 FORMAT "%8.3" AXIS_PTS_REF STFST10TLD /end AXIS_DESCR
/end CHARACTERISTIC
/begin CHARACTERISTIC MISFZUL "number of permissible misfire" VALUE 0x8053A92E RB_Val_Wu8 255.0 dez 0.00 255.0 FORMAT "%5.1" /end CHARACTERISTIC
/begin CHARACTERISTIC MSTEDSOMNL "minimum threshold for plausibility check" VALUE 0x8053AE56 RB_Val_Wu16 25.59961 m_uw_b25p6 0.00 25.59961 FORMAT "%8.5" /end CHARACTERISTIC
/begin CHARACTERISTIC MSTEDSTOMN "min purge mass flow for go on of CPV-plausibility-check" VALUE 0x8053AE58 RB_Val_Wu16 25.59961 m_uw_b25p6 0.00 25.59961 FORMAT "%8.5" /end CHARACTERISTIC
/begin CHARACTERISTIC MSTEPOFH "hystere mass flow" VALUE 0x8053AE5A RB_Val_Wu16 25.59961 m_uw_b25p6 0.00 25.59961 FORMAT "%8.5" /end CHARACTERISTIC
/begin CHARACTERISTIC MSTEPTOFMN "mass flow for change thresholds" VALUE 0x8053AE5C RB_Val_Wu16 25.59961 m_uw_b25p6 0.00 25.59961 FORMAT "%8.5" /end CHARACTERISTIC
/begin CHARACTERISTIC MXDTESK05 "max. threshold of active-counter for smallest leak diagnosis (0,5mm)" VALUE 0x8053B028 RB_Val_Wu8 255.0 dez 0.00 255.0 FORMAT "%5.1" /end CHARACTERISTIC
/begin CHARACTERISTIC NFSTPLMN "min. Number of equal plausibility-results for majority-decision" VALUE 0x8053A90E RB_Val_Wu8 126.0 dez 1.0 127.0 FORMAT "%5.1" EXTENDED_LIMITS 0.00 255.0 /end CHARACTERISTIC
/begin CHARACTERISTIC NMNDHDEVO "minimum engine speed for function DHDEVO" VALUE 0x8053A92F RB_Val_Wu8 10200. nmot_ub_q40 0.00 10200. FORMAT "%5.0" /end CHARACTERISTIC
/begin CHARACTERISTIC NMXDHDEVO "maximum engine speed for function DHDEVO" VALUE 0x8053A930 RB_Val_Wu8 10200. nmot_ub_q40 0.00 10200. FORMAT "%5.0" /end CHARACTERISTIC
/begin CHARACTERISTIC PNDKPUEB "enable threshold for the ratio of pndk_w to pu_w" VALUE 0x8053B029 RB_Val_Wu8 1.992188 fak_ub_b2 0.00 1.992188 FORMAT "%8.6" /end CHARACTERISTIC
/begin CHARACTERISTIC PSPUDSTMX "maximum quotient: manifold pressure to ambient pressure for plausibility check offset diagnosis tank pressure sensor" VALUE 0x8053AE5E RB_Val_Wu8 1.992188 fak_ub_b2 0.00 1.992188 FORMAT "%8.6" /end CHARACTERISTIC
/begin CHARACTERISTIC PSPUTH "enable threshold for the ratio of ps_w/pu_w" VALUE 0x8053AE5F RB_Val_Wu8 1.992188 fak_ub_b2 0.00 1.992188 FORMAT "%8.6" /end CHARACTERISTIC
/begin CHARACTERISTIC PTEDOZ "pressure difference for rationality check of pressure sensor" VALUE 0x8053AE60 RB_Val_Wu16 20479.69 p_q0p3125 0.00 20479.69 FORMAT "%8.2" /end CHARACTERISTIC
/begin CHARACTERISTIC PTEINCERMN "Minimum Tank Pressurel for incremental check of Pressure Sensor Diagnosis, enlarged range" VALUE 0x8053AE62 RB_Val_Ws16 159.9976 p_sw_q0p00244 -80.00000 79.99756 FORMAT "%8.5" /end CHARACTERISTIC
/begin CHARACTERISTIC PTEINCERMX "Maximum Tank Pressurel for incremental check of Pressure Sensor Diagnosis, enlarged range" VALUE 0x8053AE64 RB_Val_Ws16 159.9976 p_sw_q0p00244 -80.00000 79.99756 FORMAT "%8.5" /end CHARACTERISTIC
/begin CHARACTERISTIC PTEKORMN "minimum pressure threshold for operating range of the tank leak diagnosis" VALUE 0x8053B02A RB_Val_Ws16 79.99878 p_q0p00122 -40.00000 39.99878 FORMAT "%8.5" /end CHARACTERISTIC
/begin CHARACTERISTIC PTEKORMX "maximum pressure threshold for operating range of the tank leak diagnosis" VALUE 0x8053B02C RB_Val_Ws16 79.99878 p_q0p00122 -40.00000 39.99878 FORMAT "%8.5" /end CHARACTERISTIC
/begin CHARACTERISTIC PTEKREFMN "minimum value for difference reference value and minimum value tank pressure" VALUE 0x8053AE66 RB_Val_Wu16 79.99878 p_q0p00122 0.00 79.99878 FORMAT "%8.5" /end CHARACTERISTIC
/begin CHARACTERISTIC PTEKREFMNL "minimum change for pressure because of CPV open and close" VALUE 0x8053AE68 RB_Val_Wu16 79.99878 p_q0p00122 0.00 79.99878 FORMAT "%8.5" /end CHARACTERISTIC
/begin CHARACTERISTIC PTEKREFMX "max. deviation 1. reference value to 2. reference value tank pressure" VALUE 0x8053AE6A RB_Val_Wu16 79.99878 p_q0p00122 0.00 79.99878 FORMAT "%8.5" /end CHARACTERISTIC
/begin CHARACTERISTIC PUREFDMX "max deviation Ambient pressure to reference pressure" VALUE 0x8053AE6C RB_Val_Wu16 2559.961 p_uw_q0p039 0.00 2559.961 FORMAT "%8.3" /end CHARACTERISTIC
/begin CHARACTERISTIC PurgLeakDiag_tAbortDlyEol_C "Delay tim for next diagnosis after internal abortion, during tester request" VALUE 0x8053B02E RB_Val_Wu16 6553.500 t_q0p1 0.00 6553.500 FORMAT "%8.3" /end CHARACTERISTIC
/begin CHARACTERISTIC PurgLeakDiag_tiColdStrtEngOffMin_C "Minimum engine off time for cold start detection DTESK" VALUE 0x8053B030 RB_Val_Ws32 4294967295.00 Time_sec_q1_COMPU -2147483648.00 2147483647.00 FORMAT "%13.2" /end CHARACTERISTIC
/begin CHARACTERISTIC PurgLeakDiag_vMaxPrio_C "Velocity threshold of the car, under which a stop inhibit is requested" VALUE 0x8053B034 RB_Val_Wu16 511.9922 vfzg_uw_b512 0.00 511.9922 FORMAT "%8.4" /end CHARACTERISTIC
/begin CHARACTERISTIC PUTEDO "maximum threshold for change of the ambient pressure" VALUE 0x8053B036 RB_Val_Wu16 2559.961 p_uw_q0p039 0.00 2559.961 FORMAT "%8.3" /end CHARACTERISTIC
/begin CHARACTERISTIC RDHDEVOCTR "Number of synchros to reset counters" VALUE 0x8053A931 RB_Val_Wu8 255.0 dez 0.00 255.0 FORMAT "%5.1" /end CHARACTERISTIC
/begin CHARACTERISTIC RLMXDHDEVO "load threshold for function DHDEVO" VALUE 0x8053A932 RB_Val_Wu8 191.3 rel_ub_q0p75 0.00 191.3 FORMAT "%5.1" /end CHARACTERISTIC
/begin CHARACTERISTIC SDMGLVU "lower threshold of driving distance from refueling to supposed rough leak" VALUE 0x8053AFF8 RB_Val_Wu16 1820.417 s_q0p02777_m 0.00 1820.417 FORMAT "%8.3" /end CHARACTERISTIC
/begin CHARACTERISTIC SFTEDA05 "max. threshold of HC-charge for allowed leak diagnose (0.5mm check)" VALUE 0x8053B038 RB_Val_Ws16 127.9980 fak_sw_b64 -64.00000 63.99805 FORMAT "%8.5" /end CHARACTERISTIC
/begin CHARACTERISTIC SFTEDA05FA "max. threshold of HC-charge for allowed leak diagnose (0.5mm check) at tester request" VALUE 0x8053B03A RB_Val_Ws16 127.9980 fak_sw_b64 -64.00000 63.99805 FORMAT "%8.5" /end CHARACTERISTIC
/begin CHARACTERISTIC SFTEDAO05 "upper threshold of HC-charge for allowed leak diagnose (0.5mm check)" VALUE 0x8053B03C RB_Val_Ws16 127.9980 fak_sw_b64 -64.00000 63.99805 FORMAT "%8.5" /end CHARACTERISTIC
/begin CHARACTERISTIC SF_FST "Sum Fault Fuel Level" VAL_BLK 0x8053A924 RB_ValA_Wu16 82.0000000000 dfp_verbal 0.00 82.0000000000 FORMAT "%13.10" READ_ONLY NUMBER 4 /end CHARACTERISTIC
/begin AXIS_PTS STFST10TLD "Steps of fuel level for tank leakage diagnosis" 0x8053AFDC fstttld_w_msg RB_Axis_U16 6553.500 vol_q0p1_l 10 0.00 6553.500 FORMAT "%8.3" DEPOSIT ABSOLUTE /end AXIS_PTS
/begin CHARACTERISTIC TABORDELAY "Delay tim for next diagnosis after internal abortion" VALUE 0x8053B03E RB_Val_Wu16 6553.500 t_q0p1 0.00 6553.500 FORMAT "%8.3" /end CHARACTERISTIC
/begin CHARACTERISTIC TANKABN "minimum fuel level decrease for refuelling diagnostic" VALUE 0x8053A910 RB_Val_Ws16 6553.500 vol_q0p1_l -3276.800 3276.700 FORMAT "%8.3" /end CHARACTERISTIC
/begin CHARACTERISTIC TANKMN "minimum fuel in for refuelling diagnostic" VALUE 0x8053A912 RB_Val_Ws16 6553.500 vol_q0p1_l -3276.800 3276.700 FORMAT "%8.3" /end CHARACTERISTIC
/begin CHARACTERISTIC TANKVOL "maximum of possible existent fuel volume in complete tank system" VALUE 0x8053A914 RB_Val_Wu16 255.9961 vol_q3p90625Em3_l 0.00 255.9961 FORMAT "%8.4" /end CHARACTERISTIC
/begin CHARACTERISTIC TANKVOLH "maximum physical possible fuel level in main tank" VALUE 0x8053A916 RB_Val_Wu16 6553.500 vol_q0p1_l 0.00 6553.500 FORMAT "%8.3" /end CHARACTERISTIC
/begin CHARACTERISTIC TDCPVPOF "minimum time after pressure change" VALUE 0x8053AE6E RB_Val_Wu16 6553.500 t_q0p1 0.00 6553.500 FORMAT "%8.3" /end CHARACTERISTIC
/begin CHARACTERISTIC TDDHDEVOER "delay time error detection DHDEVO" VALUE 0x8053A933 RB_Val_Wu8 25.50 t_q0p1 0.00 25.50 FORMAT "%5.2" /end CHARACTERISTIC
/begin CHARACTERISTIC TDDPTETA "time constant for detection of refueling process" VALUE 0x8053AFFA RB_Val_Wu8 25.50 t_q0p1 0.00 25.50 FORMAT "%5.2" /end CHARACTERISTIC
/begin CHARACTERISTIC TDDSTCON "debouncing time for AAV-opening at tank pressure sensor" VALUE 0x8053AE70 RB_Val_Wu8 25.50 t_q0p1 0.00 25.50 FORMAT "%5.2" /end CHARACTERISTIC
/begin CHARACTERISTIC TDDSTCPVA "debounce time for CPV active phase" VALUE 0x8053AE71 RB_Val_Wu8 25.50 t_q0p1 0.00 25.50 FORMAT "%5.2" /end CHARACTERISTIC
/begin CHARACTERISTIC TDDSTCPVIA "debounce time for CPV inactive phase" VALUE 0x8053AE72 RB_Val_Wu8 25.50 t_q0p1 0.00 25.50 FORMAT "%5.2" /end CHARACTERISTIC
/begin CHARACTERISTIC TDDSTD "Debounce time for check of tank pressure sensor for drift" VALUE 0x8053AE73 RB_Val_Wu8 25.50 t_q0p1 0.00 25.50 FORMAT "%5.2" /end CHARACTERISTIC
/begin CHARACTERISTIC TDDSTMSTE "time constant mass flow filtering" VALUE 0x8053AE74 RB_Val_Wu16 6553.4999985 zk100msxs_uw_b6553p6 0.1000015 6553.6000000 FORMAT "%12.7" EXTENDED_LIMITS 0.10000152590 6553.6000000 /end CHARACTERISTIC
/begin CHARACTERISTIC TDDSTPTEK "time constant pressure filtering" VALUE 0x8053AE76 RB_Val_Wu16 655.34999985 zk10msxs_uw_b655p36 0.01000015 655.36000000 FORMAT "%12.8" EXTENDED_LIMITS 0.010000152590 655.36000000 /end CHARACTERISTIC
/begin CHARACTERISTIC TDPTEKH "time constant pressure filtering" VALUE 0x8053AE78 RB_Val_Wu16 655.34999985 zk10msxs_uw_b655p36 0.01000015 655.36000000 FORMAT "%12.8" EXTENDED_LIMITS 0.010000152590 655.36000000 /end CHARACTERISTIC
/begin CHARACTERISTIC TDPURE "reset time during changes of the ambient pressure" VALUE 0x8053B040 RB_Val_Wu16 6553.500 t_q0p1 0.00 6553.500 FORMAT "%8.3" /end CHARACTERISTIC
/begin CHARACTERISTIC TDSTPTEKS "time constant pressure filtering" VALUE 0x8053AE7A RB_Val_Wu16 655.34999985 zk10msxs_uw_b655p36 0.01000015 655.36000000 FORMAT "%12.8" EXTENDED_LIMITS 0.010000152590 655.36000000 /end CHARACTERISTIC
/begin CHARACTERISTIC TDTESKOFF "Turn on delay time for DTESK Off" VALUE 0x8053AE7C RB_Val_Wu8 25.50 t_q0p1 0.00 25.50 FORMAT "%5.2" /end CHARACTERISTIC
/begin CHARACTERISTIC TDTHPTEK "Filterconstant for the filter to calculate the tank pressure difference" VALUE 0x8053AE7E RB_Val_Wu16 655.34999985 zk10msxs_uw_b655p36 0.01000015 655.36000000 FORMAT "%12.8" EXTENDED_LIMITS 0.010000152590 655.36000000 /end CHARACTERISTIC
/begin CHARACTERISTIC TEDSTO "debounce time for direct setting offset-failure tank pressure sensor" VALUE 0x8053AE80 RB_Val_Wu8 25.50 t_q0p1 0.00 25.50 FORMAT "%5.2" /end CHARACTERISTIC
/begin CHARACTERISTIC TMNHTOHTLD "minimum time between two halts for new request of TLD" VALUE 0x8053B042 RB_Val_Wu8 25.50 t_q0p1 0.00 25.50 FORMAT "%5.2" /end CHARACTERISTIC
/begin CHARACTERISTIC TMSTLDHB05 "Engine start temperature for direct disabling of tank leak diagnosis by high evaporation (0.5mm test)" VALUE 0x8053B043 RB_Val_Wu8 191.3 temp_ub_q0p75_o48 -48.0 143.3 FORMAT "%5.1" /end CHARACTERISTIC
/begin CHARACTERISTIC TMSTLDMN05 "Minimum engine start temperature for enabling tank leak diagnosis 0.5mm test" VALUE 0x8053B044 RB_Val_Wu8 191.3 temp_ub_q0p75_o48 -48.0 143.3 FORMAT "%5.1" /end CHARACTERISTIC
/begin CHARACTERISTIC TMSTLDMX05 "Maximum engine start temperature for enabling tank leak diagnosis 0.5mm test" VALUE 0x8053B045 RB_Val_Wu8 191.3 temp_ub_q0p75_o48 -48.0 143.3 FORMAT "%5.1" /end CHARACTERISTIC
/begin CHARACTERISTIC TNODTES "time after engine start prohibition of TE diagnosis" VALUE 0x8053B046 RB_Val_Wu16 6553.500 t_q0p1 0.00 6553.500 FORMAT "%8.3" /end CHARACTERISTIC
/begin CHARACTERISTIC TNSETLD05 "time threshold after start end for enabling 0.5mm tank leak diagnosis" VALUE 0x8053B048 RB_Val_Wu16 6553.500 t_q0p1 0.00 6553.500 FORMAT "%8.3" /end CHARACTERISTIC
/begin CHARACTERISTIC TPTEKSTOMX "time window for calculation ptekref_w" VALUE 0x8053AE81 RB_Val_Wu8 25.50 t_q0p1 0.00 25.50 FORMAT "%5.2" /end CHARACTERISTIC
/begin CHARACTERISTIC TPUREFDSMX "maximum time for pressure change" VALUE 0x8053AE82 RB_Val_Wu16 6553.500 t_q0p1 0.00 6553.500 FORMAT "%8.3" /end CHARACTERISTIC
/begin CHARACTERISTIC TPUTEDSV "timer start value for change of ambient pressure" VALUE 0x8053B04A RB_Val_Wu16 6553.500 t_q0p1 0.00 6553.500 FORMAT "%8.3" /end CHARACTERISTIC
/begin CHARACTERISTIC TRIRVFZG "debounce time reset of idle request either stop disable depending of vehicle speed" VALUE 0x8053B04C RB_Val_Wu8 25.50 t_q0p1 0.00 25.50 FORMAT "%5.2" /end CHARACTERISTIC
/begin CHARACTERISTIC TSTDSTO "debounce time switch on condition offset-diagnosis tank pressure sensor" VALUE 0x8053AE84 RB_Val_Wu8 25.50 t_q0p1 0.00 25.50 FORMAT "%5.2" /end CHARACTERISTIC
/begin CHARACTERISTIC TTDSTDST "Delay time for enable conditions of check of tank pressure sensor for drift" VALUE 0x8053AE85 RB_Val_Wu8 25.50 t_q0p1 0.00 25.50 FORMAT "%5.2" /end CHARACTERISTIC
/begin CHARACTERISTIC TTDSTP "time period for stabilization of low pass" VALUE 0x8053AE86 RB_Val_Wu8 25.50 t_q0p1 0.00 25.50 FORMAT "%5.2" /end CHARACTERISTIC
/begin CHARACTERISTIC TTDTESKSTO "maximum waiting time for request of engine running via DTESK" VALUE 0x8053B04E RB_Val_Wu16 6553.500 t_q0p1 0.00 6553.500 FORMAT "%8.3" /end CHARACTERISTIC
/begin CHARACTERISTIC TTEDFTE05 "canister load is lower a threshold for this time (0.5mm)" VALUE 0x8053B050 RB_Val_Wu16 6553.500 t_q0p1 0.00 6553.500 FORMAT "%8.3" /end CHARACTERISTIC
/begin CHARACTERISTIC TTEDFTEO05 "high canister load is lower a threshold for this time (0.5mm)" VALUE 0x8053B052 RB_Val_Wu16 6553.500 t_q0p1 0.00 6553.500 FORMAT "%8.3" /end CHARACTERISTIC
/begin CHARACTERISTIC TTEDOZ "minimum test time for rationality check of pressure sensor" VALUE 0x8053AE87 RB_Val_Wu8 25.50 t_q0p1 0.00 25.50 FORMAT "%5.2" /end CHARACTERISTIC
/begin CHARACTERISTIC TTEDOZG "overall test time for rationality check of pressure sensor" VALUE 0x8053AE88 RB_Val_Wu8 25.50 t_q0p1 0.00 25.50 FORMAT "%5.2" /end CHARACTERISTIC
/begin CHARACTERISTIC TTENCT05 "delay time for display the purge period (0.5mm check)" VALUE 0x8053B054 RB_Val_Wu16 6553.500 t_q0p1 0.00 6553.500 FORMAT "%8.3" /end CHARACTERISTIC
/begin CHARACTERISTIC TTENOT05 "max. time since last purge period (0.5mm check)" VALUE 0x8053B056 RB_Val_Wu16 6553.500 t_q0p1 0.00 6553.500 FORMAT "%8.3" /end CHARACTERISTIC
/begin CHARACTERISTIC TTFTEADPTF "time constant for filtering of the canister load factor" VALUE 0x8053B058 RB_Val_Wu16 6553.4999985 zk100msxs_uw_b6553p6 0.1000015 6553.6000000 FORMAT "%12.7" EXTENDED_LIMITS 0.10000152590 6553.6000000 /end CHARACTERISTIC
/begin CHARACTERISTIC TUMSRVTLDO "upper thrshold ambient temperatur" VALUE 0x8053B05A RB_Val_Wu8 191.3 temp_ub_q0p75_o48 -48.0 143.3 FORMAT "%5.1" /end CHARACTERISTIC
/begin CHARACTERISTIC TUMSRVTLDU "lower threshold ambient temperature" VALUE 0x8053B05B RB_Val_Wu8 191.3 temp_ub_q0p75_o48 -48.0 143.3 FORMAT "%5.1" /end CHARACTERISTIC
/begin CHARACTERISTIC TUMTHEB "Ambient temperature limit for tank leak diagnosis" VALUE 0x8053B05C RB_Val_Wu8 191.3 temp_ub_q0p75 0.00 191.3 FORMAT "%5.1" /end CHARACTERISTIC
/begin CHARACTERISTIC TUMTLDO "upper TUMG-threshold for evap system monitoring" VALUE 0x8053B05D RB_Val_Wu8 191.3 temp_ub_q0p75_o48 -48.0 143.3 FORMAT "%5.1" /end CHARACTERISTIC
/begin CHARACTERISTIC TUMTLDU "lower TUMG-threshold for evap system monitoring" VALUE 0x8053B05E RB_Val_Wu8 191.3 temp_ub_q0p75_o48 -48.0 143.3 FORMAT "%5.1" /end CHARACTERISTIC
/begin CHARACTERISTIC TVFAHRTT "Delay time vehicle speed for plaus. tank fluid level" VALUE 0x8053A918 RB_Val_Wu8 255.0 t_q1 0.00 255.0 FORMAT "%5.1" /end CHARACTERISTIC
/begin CHARACTERISTIC TVFSTPRC "debounce time for ""physical range check""" VALUE 0x8053A919 RB_Val_Wu8 255.0 t_q1 0.00 255.0 FORMAT "%5.1" /end CHARACTERISTIC
/begin CHARACTERISTIC TVFSTTG "Delay time fuel level tank valid" VALUE 0x8053A91A RB_Val_Wu8 255.0 t_q1 0.00 255.0 FORMAT "%5.1" /end CHARACTERISTIC
/begin CHARACTERISTIC TVHATA "delay time before refuelling - cycle" VALUE 0x8053A91B RB_Val_Wu8 255.0 t_q1 0.00 255.0 FORMAT "%5.1" /end CHARACTERISTIC
/begin CHARACTERISTIC UBTEDO "maximum battery voltage for diagnosis" VALUE 0x8053B060 RB_Val_Wu16 25.59961 spg_q0p00039 0.00 25.59961 FORMAT "%8.5" /end CHARACTERISTIC
/begin CHARACTERISTIC UBTEDU "minimum battery voltage for evap leakage diagnosis" VALUE 0x8053B062 RB_Val_Wu16 25.59961 spg_q0p00039 0.00 25.59961 FORMAT "%8.5" /end CHARACTERISTIC
/begin CHARACTERISTIC VEHDDSTOMN "minimum vehicle acceleration during inactive CPV-phase" VALUE 0x8053AE8A RB_Val_Ws16 655.3500 Vel -327.6800 327.6700 FORMAT "%8.4" /end CHARACTERISTIC
/begin CHARACTERISTIC VEHDDSTOMX "maximum vehicle acceleration during inactive CPV-phase" VALUE 0x8053AE8C RB_Val_Ws16 655.3500 Vel -327.6800 327.6700 FORMAT "%8.4" /end CHARACTERISTIC
/begin CHARACTERISTIC VEHDSTMN "minimum velocity for plausibility check of the tank pressure sensor" VALUE 0x8053AE8E RB_Val_Ws16 655.3500 Vel -327.6800 327.6700 FORMAT "%8.4" /end CHARACTERISTIC
/begin CHARACTERISTIC VEHDSTMX "maximum velocity for plausibility check of the tank pressure sensor" VALUE 0x8053AE90 RB_Val_Ws16 655.3500 Vel -327.6800 327.6700 FORMAT "%8.4" /end CHARACTERISTIC
/begin CHARACTERISTIC VFZGDFSTT "threshold vehicle speed for plaus. tank fluid level" VALUE 0x8053A91C RB_Val_Wu8 318.8 vfzg_ub_q1p25 0.00 318.8 FORMAT "%5.1" /end CHARACTERISTIC
/begin CHARACTERISTIC VFZGGDSOMX "maximum speed change for offset tank pressure diagnosis" VALUE 0x8053AE92 RB_Val_Wu16 1422.201 acc_q0p021701_m_DIV_s2 0.00 1422.201 FORMAT "%8.3" /end CHARACTERISTIC
/begin CHARACTERISTIC VFZGGDSTMX "maximum vehicle acceleration during inactive CPV-phase" VALUE 0x8053AE94 RB_Val_Wu16 1422.201 acc_q0p021701_m_DIV_s2 0.00 1422.201 FORMAT "%8.3" /end CHARACTERISTIC
/begin CHARACTERISTIC VFZGTLDEB "threshold vehicle speed of enable tank leak diagnosis" VALUE 0x8053B064 RB_Val_Wu16 511.9922 vfzg_uw_b512 0.00 511.9922 FORMAT "%8.4" /end CHARACTERISTIC
/begin CHARACTERISTIC VFZGTLDSRO "offset threshold vehicle speed taking back of request for engine running" VALUE 0x8053B066 RB_Val_Ws16 511.9922 vfzg_uw_b512 -256.0000 255.9922 FORMAT "%8.4" /end CHARACTERISTIC
/begin CHARACTERISTIC VOLBMNSL "maximum fuel volume below minimum sensor level" VALUE 0x8053A91E RB_Val_Ws16 6553.500 vol_q0p1_l -3276.800 3276.700 FORMAT "%8.3" /end CHARACTERISTIC
/begin CHARACTERISTIC VOLOMXSL "maximum fuel volume over maximum sensor level" VALUE 0x8053A920 RB_Val_Ws16 6553.500 vol_q0p1_l -3276.800 3276.700 FORMAT "%8.3" /end CHARACTERISTIC
/begin CHARACTERISTIC ZADIAGSTOP "zadiag limit for reset of stop prohibition" VALUE 0x8053B068 RB_Val_Wu8 241.0 dez 14.0 255.0 FORMAT "%5.1" EXTENDED_LIMITS 0.00 255.0 /end CHARACTERISTIC
/begin CHARACTERISTIC ZFSTPLTH "Minimum time threshold for Dualtank plausibility failure detection" VALUE 0x8053A922 RB_Val_Wu8 255.0 t_q1 0.00 255.0 FORMAT "%5.1" /end CHARACTERISTIC
/begin CHARACTERISTIC ZKMSTDST "Time Constant for filtering of CPV-Mass-Flow for diagnosis of tank pressure sensor" VALUE 0x8053AE96 RB_Val_Wu16 6553.4999985 zk100msxs_uw_b6553p6 0.1000015 6553.6000000 FORMAT "%12.7" EXTENDED_LIMITS 0.10000152590 6553.6000000 /end CHARACTERISTIC
/begin MEASUREMENT aktbeg_msg "maximum activated tank leakage diagnoses" UBYTE dez 1 100 0.00 255.0 FORMAT "%5.1" ECU_ADDRESS 0x60001420 /end MEASUREMENT
/begin MEASUREMENT aktdtesk_msg "requested tank leakage diagnoses" UBYTE dez 1 100 0.00 255.0 FORMAT "%5.1" ECU_ADDRESS 0x6000141F /end MEASUREMENT
/begin MEASUREMENT aktlauft "enabled tank leakage diagnoses before priorisation" UBYTE dez 1 100 0.00 255.0 FORMAT "%5.1" ECU_ADDRESS 0x60000FEE /end MEASUREMENT
/begin MEASUREMENT aktlauf_msg "running fuel tank diagnosis" UBYTE dez 1 100 0.00 255.0 FORMAT "%5.1" ECU_ADDRESS 0x6000141D /end MEASUREMENT
/begin MEASUREMENT aktloc "requested tank leakage diagnoses" UBYTE dez 1 100 0.00 255.0 FORMAT "%5.1" ECU_ADDRESS 0x60000FED /end MEASUREMENT
/begin MEASUREMENT aktstopt "stopped tank leakage diagnoses" UBYTE dez 1 100 0.00 255.0 FORMAT "%5.1" ECU_ADDRESS 0x60000FEC /end MEASUREMENT
/begin MEASUREMENT B_abbrtldloc "local variable to store the time bit value of B_abbrtld_msg after the TOFF delay. Introduced for ease of testing" UBYTE B_TRUE 1 100 0.00 1.00000000000 BIT_MASK 0x1 FORMAT "%13.11" ECU_ADDRESS 0x60001402 /end MEASUREMENT
/begin MEASUREMENT B_ambpof "ambient conditions are fullfilled for offset diagnosis" UBYTE B_TRUE 1 100 0.00 1.00000000000 BIT_MASK 0x1 FORMAT "%13.11" ECU_ADDRESS 0x60001037 /end MEASUREMENT
/begin MEASUREMENT B_clrfste_msg "Condition deleting electrical/CAN-signal error from fault memory" UBYTE B_TRUE 1 100 0.00 1.00000000000 BIT_MASK 0x1 FORMAT "%13.11" ECU_ADDRESS 0x600013FD /end MEASUREMENT
/begin MEASUREMENT B_clrfst_msg "Condition fuel level sender error is deleted from fault memory" UBYTE B_TRUE 1 100 0.00 1.00000000000 BIT_MASK 0x1 FORMAT "%13.11" ECU_ADDRESS 0x600013FE /end MEASUREMENT
/begin MEASUREMENT B_cmpltld "Readiness for tank leak diagnosis is with iO complete" UBYTE B_TRUE 1 100 0.00 1.00000000000 BIT_MASK 0x1 FORMAT "%13.11" ECU_ADDRESS 0x60001000 /end MEASUREMENT
/begin MEASUREMENT B_cpvacheck "CPV active for plausibility check" UBYTE B_TRUE 1 100 0.00 1.00000000000 BIT_MASK 0x1 FORMAT "%13.11" ECU_ADDRESS 0x60001036 /end MEASUREMENT
/begin MEASUREMENT B_cpvacof "pressure by open CPV is calculated" UBYTE B_TRUE 1 100 0.00 1.00000000000 BIT_MASK 0x1 FORMAT "%13.11" ECU_ADDRESS 0x60001035 /end MEASUREMENT
/begin MEASUREMENT B_cpvplaus "CPV-plausibility-check successful" UBYTE B_TRUE 1 100 0.00 1.00000000000 BIT_MASK 0x1 FORMAT "%13.11" ECU_ADDRESS 0x60001034 /end MEASUREMENT
/begin MEASUREMENT B_cpvplwth "lower threshold for plausibility because of cpv" UBYTE B_TRUE 1 100 0.00 1.00000000000 BIT_MASK 0x1 FORMAT "%13.11" ECU_ADDRESS 0x60001033 /end MEASUREMENT
/begin MEASUREMENT B_ddstnpo "request pressure sensor offset diagnosis" UBYTE B_TRUE 1 100 0.00 1.00000000000 BIT_MASK 0x1 FORMAT "%13.11" ECU_ADDRESS 0x60001032 /end MEASUREMENT
/begin MEASUREMENT B_ddstnpp "request pressure sensor plausibility" UBYTE B_TRUE 1 100 0.00 1.00000000000 BIT_MASK 0x1 FORMAT "%13.11" ECU_ADDRESS 0x60001031 /end MEASUREMENT
/begin MEASUREMENT B_ddstnp_msg "cpv is not active" UBYTE B_TRUE 1 100 0.00 1.00000000000 BIT_MASK 0x1 FORMAT "%13.11" ECU_ADDRESS 0x600013FC /end MEASUREMENT
/begin MEASUREMENT B_dfsininv "initialization of NV values of %DFSTT is finished" UBYTE B_TRUE 1 100 0.00 1.00000000000 BIT_MASK 0x1 FORMAT "%13.11" ECU_ADDRESS 0x60036DE7 /end MEASUREMENT
/begin MEASUREMENT B_dfstvfzg "Condition: vehicle speed for plausible tank fluid level" UBYTE B_TRUE 1 100 0.00 1.00000000000 BIT_MASK 0x1 FORMAT "%13.11" ECU_ADDRESS 0x60000107 /end MEASUREMENT
/begin MEASUREMENT B_dhdevoe "Condition: electrical failure of high pressure injector (HPIV) power stage bank of diagnosis DHDEVO" UBYTE B_TRUE 1 100 0.00 1.00000000000 BIT_MASK 0x1 FORMAT "%13.11" ECU_ADDRESS 0x70000380 /end MEASUREMENT
/begin MEASUREMENT B_dhdevom "Condition: mechanical failure HPIV" UBYTE B_TRUE 1 100 0.00 1.00000000000 BIT_MASK 0x1 FORMAT "%13.11" ECU_ADDRESS 0x7000037F /end MEASUREMENT
/begin MEASUREMENT B_dstden "Release tank pressure sensor drift check" UBYTE B_TRUE 1 100 0.00 1.00000000000 BIT_MASK 0x1 FORMAT "%13.11" ECU_ADDRESS 0x60039464 /end MEASUREMENT
/begin MEASUREMENT B_dstrerr_msg "Diagnosis of tank pressure sensor inhibited due to errors" UBYTE B_TRUE 1 100 0.00 1.00000000000 BIT_MASK 0x1 FORMAT "%13.11" ECU_ADDRESS 0x600013FA /end MEASUREMENT
/begin MEASUREMENT B_dstrir_msg "Enable condition for incrementation of IUMPR counter for FID_CDSTR" UBYTE B_TRUE 1 100 0.00 1.00000000000 BIT_MASK 0x1 FORMAT "%13.11" ECU_ADDRESS 0x600013F9 /end MEASUREMENT
/begin MEASUREMENT B_dsttesffcl_msg "fault memory path DTESK" UBYTE B_TRUE 1 100 0.00 1.00000000000 BIT_MASK 0x1 FORMAT "%13.11" ECU_ADDRESS 0x6003955B /end MEASUREMENT
/begin MEASUREMENT B_dtankm "condition refuelling possible" UBYTE B_TRUE 1 100 0.00 1.00000000000 BIT_MASK 0x1 FORMAT "%13.11" ECU_ADDRESS 0x60000106 /end MEASUREMENT
/begin MEASUREMENT B_dteaa_msg "Condition diagnosis CPV by opening the CPV active" UBYTE B_TRUE 1 100 0.00 1.00000000000 BIT_MASK 0x1 FORMAT "%13.11" ECU_ADDRESS 0x6000EEB1 /end MEASUREMENT
/begin MEASUREMENT B_dtesk05 "diagnosis request for smallest leak check (0.5mm)" UBYTE B_TRUE 1 100 0.00 1.00000000000 BIT_MASK 0x1 FORMAT "%13.11" ECU_ADDRESS 0x60000FEB /end MEASUREMENT
/begin MEASUREMENT B_dteskddr_msg "Driving distance debounce for DTESK required" UBYTE B_TRUE 1 100 0.00 1.00000000000 BIT_MASK 0x1 FORMAT "%13.11" ECU_ADDRESS 0x6003955A /end MEASUREMENT
/begin MEASUREMENT B_dteskddv "Virtual driving distance debounce for IUMPR-calculation of DTESK required" UBYTE B_TRUE 1 100 0.00 1.00000000000 BIT_MASK 0x1 FORMAT "%13.11" ECU_ADDRESS 0x60039459 /end MEASUREMENT
/begin MEASUREMENT B_dteskfzg_msg "vehicle conditions for enabling diagnosis" UBYTE B_TRUE 1 100 0.00 1.00000000000 BIT_MASK 0x1 FORMAT "%13.11" ECU_ADDRESS 0x600013F5 /end MEASUREMENT
/begin MEASUREMENT B_dteskpid_msg "conditions for tank leakage diagnosis (DTESK) PID41 enabled" UBYTE B_TRUE 1 100 0.00 1.00000000000 BIT_MASK 0x1 FORMAT "%13.11" ECU_ADDRESS 0x600013F4 /end MEASUREMENT
/begin MEASUREMENT B_dtest_msg "condition for start of TEV opening" UBYTE B_TRUE 1 100 0.00 1.00000000000 BIT_MASK 0x1 FORMAT "%13.11" ECU_ADDRESS 0x6000EEAF /end MEASUREMENT
/begin MEASUREMENT B_dtes_msg "Condition for active diagnosis of canister purge system" UBYTE B_TRUE 1 100 0.00 1.00000000000 BIT_MASK 0x1 FORMAT "%13.11" ECU_ADDRESS 0x6000EEB0 /end MEASUREMENT
/begin MEASUREMENT B_dtezamh_msg "DTEV test in homogeneous Lambda=1 mode enabled" UBYTE B_TRUE 1 100 0.00 1.00000000000 BIT_MASK 0x1 FORMAT "%13.11" ECU_ADDRESS 0x6000F26F /end MEASUREMENT
/begin MEASUREMENT B_dte_msg "Condition for active diagnosis of canister purge system" UBYTE B_TRUE 1 100 0.00 1.00000000000 BIT_MASK 0x1 FORMAT "%13.11" ECU_ADDRESS 0x600013F8 /end MEASUREMENT
/begin MEASUREMENT B_eaavp_msg "internal error flag CCV error" UBYTE B_TRUE 1 100 0.00 1.00000000000 BIT_MASK 0x1 FORMAT "%13.11" ECU_ADDRESS 0x600013F1 /end MEASUREMENT
/begin MEASUREMENT B_edstoft "internal offset diagnosis cycle flag" UBYTE B_TRUE 1 100 0.00 1.00000000000 BIT_MASK 0x1 FORMAT "%13.11" ECU_ADDRESS 0x60001030 /end MEASUREMENT
/begin MEASUREMENT B_edstof_msg "failure offset-diagnosis tank-pressure sensor (internal)" UBYTE B_TRUE 1 100 0.00 1.00000000000 BIT_MASK 0x1 FORMAT "%13.11" ECU_ADDRESS 0x600013F0 /end MEASUREMENT
/begin MEASUREMENT B_edstosci "oscillations in the fuel tank pressure signal detected" UBYTE B_TRUE 1 100 0.00 1.00000000000 BIT_MASK 0x1 FORMAT "%13.11" ECU_ADDRESS 0x600013EF /end MEASUREMENT
/begin MEASUREMENT B_efstgth_msg "Condition fuel level sender error ""fuel level greater than main tank"" existent" UBYTE B_TRUE 1 100 0.00 1.00000000000 BIT_MASK 0x1 FORMAT "%13.11" ECU_ADDRESS 0x60000236 /end MEASUREMENT
/begin MEASUREMENT B_efstnpl_msg "Condition fuel level sender error ""fuel level not plausible against fuel consumption"" existent" UBYTE B_TRUE 1 100 0.00 1.00000000000 BIT_MASK 0x1 FORMAT "%13.11" ECU_ADDRESS 0x60000235 /end MEASUREMENT
/begin MEASUREMENT B_efstsk1_msg "Condition fuel level sender error ""fuel level not plausible against fuel consumption, because signal 1 stucks"" existent" UBYTE B_TRUE 1 100 0.00 1.00000000000 BIT_MASK 0x1 FORMAT "%13.11" ECU_ADDRESS 0x60000234 /end MEASUREMENT
/begin MEASUREMENT B_eincch "condition plausibility error (incremental check) in tank pressure sensor" UBYTE B_TRUE 1 100 0.00 1.00000000000 BIT_MASK 0x1 FORMAT "%13.11" ECU_ADDRESS 0x600013EB /end MEASUREMENT
/begin MEASUREMENT B_endtesk_msg "internal condition smallest leak check complete in this trip" UBYTE B_TRUE 1 100 0.00 1.00000000000 BIT_MASK 0x1 FORMAT "%13.11" ECU_ADDRESS 0x600013E9 /end MEASUREMENT
/begin MEASUREMENT B_etesf_msg "internal condition: small leak detected" UBYTE B_TRUE 1 100 0.00 1.00000000000 BIT_MASK 0x1 FORMAT "%13.11" ECU_ADDRESS 0x600013E5 /end MEASUREMENT
/begin MEASUREMENT B_etesgdd_msg "canister purge system diagnosis - rough leak after distance debounce" UBYTE B_TRUE 1 100 0.00 1.00000000000 BIT_MASK 0x1 FORMAT "%13.11" ECU_ADDRESS 0x600013E4 /end MEASUREMENT
/begin MEASUREMENT B_etesggv "internal condition: virtual rough leak gradient error for calculation of IUMPR detected" UBYTE B_TRUE 1 100 0.00 1.00000000000 BIT_MASK 0x1 FORMAT "%13.11" ECU_ADDRESS 0x60000FFF /end MEASUREMENT
/begin MEASUREMENT B_etesgloc_msg "Local copy of the condition of rough leak" UBYTE B_TRUE 1 100 0.00 1.00000000000 BIT_MASK 0x1 FORMAT "%13.11" ECU_ADDRESS 0x60039558 /end MEASUREMENT
/begin MEASUREMENT B_etesk_msg "internal condition: smallest leak detected" UBYTE B_TRUE 1 100 0.00 1.00000000000 BIT_MASK 0x1 FORMAT "%13.11" ECU_ADDRESS 0x600013E2 /end MEASUREMENT
/begin MEASUREMENT B_fatldtev_msg "condition leak detection request by tank leakage detection" UBYTE B_TRUE 1 100 0.00 1.00000000000 BIT_MASK 0x1 FORMAT "%13.11" ECU_ADDRESS 0x6000EEA1 /end MEASUREMENT
/begin MEASUREMENT B_fplreff "interim result of the Condition: Dualtank fuel-level plausibility-check restart if driving" UBYTE B_TRUE 1 100 0.00 1.00000000000 BIT_MASK 0x1 FORMAT "%13.11" ECU_ADDRESS 0x60036DE6 /end MEASUREMENT
/begin MEASUREMENT B_fst1sk_msg "Condition: Primary-tank fuel-sensor may be stuck" UBYTE B_TRUE 1 100 0.00 1.00000000000 BIT_MASK 0x1 FORMAT "%13.11" ECU_ADDRESS 0x60036E2B /end MEASUREMENT
/begin MEASUREMENT B_fstelerr_msg "Condition electrical/CAN-signal error in fault memory existent" UBYTE B_TRUE 1 100 0.00 1.00000000000 BIT_MASK 0x1 FORMAT "%13.11" ECU_ADDRESS 0x60039556 /end MEASUREMENT
/begin MEASUREMENT B_fstneu "condition first fuel level after ignition" UBYTE B_TRUE 1 100 0.00 1.00000000000 BIT_MASK 0x1 FORMAT "%13.11" ECU_ADDRESS 0x60000105 /end MEASUREMENT
/begin MEASUREMENT B_fstofen "Refueling detection" UBYTE B_TRUE 1 100 0.00 1.00000000000 BIT_MASK 0x1 FORMAT "%13.11" ECU_ADDRESS 0x60000104 /end MEASUREMENT
/begin MEASUREMENT B_fstplcfm "condition plaus. error suspicion and new start of partial plaus. check" UBYTE B_TRUE 1 100 0.00 1.00000000000 BIT_MASK 0x1 FORMAT "%13.11" ECU_ADDRESS 0x60000103 /end MEASUREMENT
/begin MEASUREMENT B_fstplen "Condition: Dueltank fuel-level plausibility-check enable" UBYTE B_TRUE 1 100 0.00 1.00000000000 BIT_MASK 0x1 FORMAT "%13.11" ECU_ADDRESS 0x60000102 /end MEASUREMENT
/begin MEASUREMENT B_fstpler_msg "Condition: Dualtank fuel-level plausibility-error is suspected" UBYTE B_TRUE 1 100 0.00 1.00000000000 BIT_MASK 0x1 FORMAT "%13.11" ECU_ADDRESS 0x60000218 /end MEASUREMENT
/begin MEASUREMENT B_fstploki "Condition: internal fuel-level plausibility-check is OK" UBYTE B_TRUE 1 100 0.00 1.00000000000 BIT_MASK 0x1 FORMAT "%13.11" ECU_ADDRESS 0x60000101 /end MEASUREMENT
/begin MEASUREMENT B_fstplok_msg "Condition: fuel-level plausibility-check is OK" UBYTE B_TRUE 1 100 0.00 1.00000000000 BIT_MASK 0x1 FORMAT "%13.11" ECU_ADDRESS 0x60000217 /end MEASUREMENT
/begin MEASUREMENT B_fstplre "Condition: Dualtank fuel-level plausibility-check restart" UBYTE B_TRUE 1 100 0.00 1.00000000000 BIT_MASK 0x1 FORMAT "%13.11" ECU_ADDRESS 0x60000100 /end MEASUREMENT
/begin MEASUREMENT B_fstplref "Condition: Dualtank fuel-level plausibility-check restart if driving" UBYTE B_TRUE 1 100 0.00 1.00000000000 BIT_MASK 0x1 FORMAT "%13.11" ECU_ADDRESS 0x600000FF /end MEASUREMENT
/begin MEASUREMENT B_fstrok_msg "Condition result of physical range check okay" UBYTE B_TRUE 1 100 0.00 1.00000000000 BIT_MASK 0x1 FORMAT "%13.11" ECU_ADDRESS 0x60000216 /end MEASUREMENT
/begin MEASUREMENT B_fsttab "condition fuel level decrease while ignition on" UBYTE B_TRUE 1 100 0.00 1.00000000000 BIT_MASK 0x1 FORMAT "%13.11" ECU_ADDRESS 0x600000FE /end MEASUREMENT
/begin MEASUREMENT B_fsttldv_msg "Condition: Fuel level for Tank leak diagnosis is valid" UBYTE B_TRUE 1 100 0.00 1.00000000000 BIT_MASK 0x1 FORMAT "%13.11" ECU_ADDRESS 0x60039555 /end MEASUREMENT
/begin MEASUREMENT B_fsttnp_msg "Condition: Dualtank fuel-level plausibility-error detected" UBYTE B_TRUE 1 100 0.00 1.00000000000 BIT_MASK 0x1 FORMAT "%13.11" ECU_ADDRESS 0x60000215 /end MEASUREMENT
/begin MEASUREMENT B_fsttzu_msg "condition fuel level increases while ignition on" UBYTE B_TRUE 1 100 0.00 1.00000000000 BIT_MASK 0x1 FORMAT "%13.11" ECU_ADDRESS 0x60000214 /end MEASUREMENT
/begin MEASUREMENT B_hdevo_msg "Condition open clamping HPIV" UBYTE B_TRUE 1 100 0.00 1.00000000000 BIT_MASK 0x1 FORMAT "%13.11" ECU_ADDRESS 0x70000BAC /end MEASUREMENT
/begin MEASUREMENT B_infoTESFmax "Info-Bit of DFC_TESGLmax" UBYTE B_TRUE 1 100 0.00 1.00000000000 BIT_MASK 0x1 FORMAT "%13.11" ECU_ADDRESS 0x60000FFE /end MEASUREMENT
/begin MEASUREMENT B_infoTESGmax "Info-Bit of DFC_TESGmax" UBYTE B_TRUE 1 100 0.00 1.00000000000 BIT_MASK 0x1 FORMAT "%13.11" ECU_ADDRESS 0x60000FFD /end MEASUREMENT
/begin MEASUREMENT B_iok "Condition: interval for plaus.check okay" UBYTE B_TRUE 1 100 0.00 1.00000000000 BIT_MASK 0x1 FORMAT "%13.11" ECU_ADDRESS 0x600000FD /end MEASUREMENT
/begin MEASUREMENT B_mnhdr "Condition: Error rail pressure too low" UBYTE B_TRUE 1 100 0.00 1.00000000000 BIT_MASK 0x1 FORMAT "%13.11" ECU_ADDRESS 0x7000037E /end MEASUREMENT
/begin MEASUREMENT B_nodhdevo "Condition: no diagnosis open HPIV" UBYTE B_TRUE 1 100 0.00 1.00000000000 BIT_MASK 0x1 FORMAT "%13.11" ECU_ADDRESS 0x7000037D /end MEASUREMENT
/begin MEASUREMENT B_nomfcnt "Condition: no misfire counted" UBYTE B_TRUE 1 100 0.00 1.00000000000 BIT_MASK 0x1 FORMAT "%13.11" ECU_ADDRESS 0x7000037C /end MEASUREMENT
/begin MEASUREMENT B_nomfdet "Condion: no misfire detected" UBYTE B_TRUE 1 100 0.00 1.00000000000 BIT_MASK 0x1 FORMAT "%13.11" ECU_ADDRESS 0x7000037B /end MEASUREMENT
/begin MEASUREMENT B_priodesk_msg "priority of requested operating conditions for tank leak diagnosis" UBYTE B_TRUE 1 100 0.00 1.00000000000 BIT_MASK 0x1 FORMAT "%13.11" ECU_ADDRESS 0x600013C9 /end MEASUREMENT
/begin MEASUREMENT B_priodest "priority of requested operating conditions for tank leak diagnosis, temporary" UBYTE B_TRUE 1 100 0.00 1.00000000000 BIT_MASK 0x1 FORMAT "%13.11" ECU_ADDRESS 0x60000FEA /end MEASUREMENT
/begin MEASUREMENT B_ptekstof "tank pressure is stable for offset diagnosis" UBYTE B_TRUE 1 100 0.00 1.00000000000 BIT_MASK 0x1 FORMAT "%13.11" ECU_ADDRESS 0x6000102F /end MEASUREMENT
/begin MEASUREMENT B_punxc_msg "no extreme conditions of ambient pressure" UBYTE B_TRUE 1 100 0.00 1.00000000000 BIT_MASK 0x1 FORMAT "%13.11" ECU_ADDRESS 0x600013C6 /end MEASUREMENT
/begin MEASUREMENT B_pustpof "ambient pressure for offset diagnosis is fullfilled" UBYTE B_TRUE 1 100 0.00 1.00000000000 BIT_MASK 0x1 FORMAT "%13.11" ECU_ADDRESS 0x6000102E /end MEASUREMENT
/begin MEASUREMENT B_refdstd "Refrence value for check of tank pressure sensor for drift stored in this driving cycle" UBYTE B_TRUE 1 100 0.00 1.00000000000 BIT_MASK 0x1 FORMAT "%13.11" ECU_ADDRESS 0x6000102D /end MEASUREMENT
/begin MEASUREMENT B_rirvfzg "reset of idle request either stop disable depending of vehicle speed" UBYTE B_TRUE 1 100 0.00 1.00000000000 BIT_MASK 0x1 FORMAT "%13.11" ECU_ADDRESS 0x60000FE9 /end MEASUREMENT
/begin MEASUREMENT B_rlirn "Condition: Rough leak has been or could have been detected." UBYTE B_TRUE 1 100 0.00 1.00000000000 BIT_MASK 0x1 FORMAT "%13.11" ECU_ADDRESS 0x60000FFC /end MEASUREMENT
/begin MEASUREMENT B_rlirnv "Condition: Rough leak could have been performed." UBYTE B_TRUE 1 100 0.00 1.00000000000 BIT_MASK 0x1 FORMAT "%13.11" ECU_ADDRESS 0x60000FFB /end MEASUREMENT
/begin MEASUREMENT B_rtldio "Condition set readiness due to tank leack diagnosis ok" UBYTE B_TRUE 1 100 0.00 1.00000000000 BIT_MASK 0x1 FORMAT "%13.11" ECU_ADDRESS 0x60039458 /end MEASUREMENT
/begin MEASUREMENT B_scatldo_msg "release by scheduler: tank leak diagnosis, OBD-diagnosis" UBYTE B_TRUE 1 100 0.00 1.00000000000 BIT_MASK 0x1 FORMAT "%13.11" ECU_ADDRESS 0x600013C4 /end MEASUREMENT
/begin MEASUREMENT B_spdtetld_msg "Locking of CPV check from tank leak diagnosis" UBYTE B_TRUE 1 100 0.00 1.00000000000 BIT_MASK 0x1 FORMAT "%13.11" ECU_ADDRESS 0x600013C3 /end MEASUREMENT
/begin MEASUREMENT B_sstp "engine stop phase for DTESK active" UBYTE B_TRUE 1 100 0.00 1.00000000000 BIT_MASK 0x1 FORMAT "%13.11" ECU_ADDRESS 0x60000FE8 /end MEASUREMENT
/begin MEASUREMENT B_stdsto_msg "Condition start check of tank pressure sensor for offset" UBYTE B_TRUE 1 100 0.00 1.00000000000 BIT_MASK 0x1 FORMAT "%13.11" ECU_ADDRESS 0x600013C2 /end MEASUREMENT
/begin MEASUREMENT B_stincche "end condition for max. diagnosis time of inc. plausibility check" UBYTE B_TRUE 1 100 0.00 1.00000000000 BIT_MASK 0x1 FORMAT "%13.11" ECU_ADDRESS 0x6000102C /end MEASUREMENT
/begin MEASUREMENT B_stincch_msg "Condition start increment check of tank pressure sensor" UBYTE B_TRUE 1 100 0.00 1.00000000000 BIT_MASK 0x1 FORMAT "%13.11" ECU_ADDRESS 0x600013C1 /end MEASUREMENT
/begin MEASUREMENT B_stosche "end condition for max. diagnosis time of oscillation check" UBYTE B_TRUE 1 100 0.00 1.00000000000 BIT_MASK 0x1 FORMAT "%13.11" ECU_ADDRESS 0x6000102B /end MEASUREMENT
/begin MEASUREMENT B_stosch_msg "Condition start oscillation check of tank pressure sensor" UBYTE B_TRUE 1 100 0.00 1.00000000000 BIT_MASK 0x1 FORMAT "%13.11" ECU_ADDRESS 0x600013C0 /end MEASUREMENT
/begin MEASUREMENT B_tankab_msg "condition fuel level decrease" UBYTE B_TRUE 1 100 0.00 1.00000000000 BIT_MASK 0x1 FORMAT "%13.11" ECU_ADDRESS 0x600013BC /end MEASUREMENT
/begin MEASUREMENT B_tankdy_msg "condition fuel level dynamic during refuelling" UBYTE B_TRUE 1 100 0.00 1.00000000000 BIT_MASK 0x1 FORMAT "%13.11" ECU_ADDRESS 0x600013BB /end MEASUREMENT
/begin MEASUREMENT B_tankend "condition refuelling end" UBYTE B_TRUE 1 100 0.00 1.00000000000 BIT_MASK 0x1 FORMAT "%13.11" ECU_ADDRESS 0x600000FC /end MEASUREMENT
/begin MEASUREMENT B_tankg_msg "Condition: re-fuelling bit valid" UBYTE B_TRUE 1 100 0.00 1.00000000000 BIT_MASK 0x1 FORMAT "%13.11" ECU_ADDRESS 0x600001CC /end MEASUREMENT
/begin MEASUREMENT B_tankzu_msg "condition fuel level increase" UBYTE B_TRUE 1 100 0.00 1.00000000000 BIT_MASK 0x1 FORMAT "%13.11" ECU_ADDRESS 0x600001CB /end MEASUREMENT
/begin MEASUREMENT B_tank_msg "Condition: re-fuelling" UBYTE B_TRUE 1 100 0.00 1.00000000000 BIT_MASK 0x1 FORMAT "%13.11" ECU_ADDRESS 0x600001CD /end MEASUREMENT
/begin MEASUREMENT B_tesfmilerr_msg "MIL on and error detected because of 0.04 inch leak in DTESK" UBYTE B_TRUE 1 100 0.00 1.00000000000 BIT_MASK 0x1 FORMAT "%13.11" ECU_ADDRESS 0x600013B9 /end MEASUREMENT
/begin MEASUREMENT B_tesfmil_msg "MIL on because of 0.04 inch leak in DTESK" UBYTE B_TRUE 1 100 0.00 1.00000000000 BIT_MASK 0x1 FORMAT "%13.11" ECU_ADDRESS 0x60039552 /end MEASUREMENT
/begin MEASUREMENT B_tesgmilerr_msg "MIL on and error detected because of 0.09 inch leak in DTESK" UBYTE B_TRUE 1 100 0.00 1.00000000000 BIT_MASK 0x1 FORMAT "%13.11" ECU_ADDRESS 0x600013B8 /end MEASUREMENT
/begin MEASUREMENT B_tesgmil_msg "MIL on due to 0.04inch leak" UBYTE B_TRUE 1 100 0.00 1.00000000000 BIT_MASK 0x1 FORMAT "%13.11" ECU_ADDRESS 0x60039551 /end MEASUREMENT
/begin MEASUREMENT B_tldbccon_msg "basic conditions for tank leak diagnosis fulfilled" UBYTE B_TRUE 1 100 0.00 1.00000000000 BIT_MASK 0x1 FORMAT "%13.11" ECU_ADDRESS 0x600013B6 /end MEASUREMENT
/begin MEASUREMENT B_tldbcstp "basic stop conditions for tank leakage diagnosis fulfilled" UBYTE B_TRUE 1 100 0.00 1.00000000000 BIT_MASK 0x1 FORMAT "%13.11" ECU_ADDRESS 0x60000FE7 /end MEASUREMENT
/begin MEASUREMENT B_tlddicon_msg "conditions with no influence to the tank leak diagnosis" UBYTE B_TRUE 1 100 0.00 1.00000000000 BIT_MASK 0x1 FORMAT "%13.11" ECU_ADDRESS 0x600013B5 /end MEASUREMENT
/begin MEASUREMENT B_tldhb05_msg "high canister load detected (0.5mm check)" UBYTE B_TRUE 1 100 0.00 1.00000000000 BIT_MASK 0x1 FORMAT "%13.11" ECU_ADDRESS 0x600013B4 /end MEASUREMENT
/begin MEASUREMENT B_tldinfo_msg "condition tank leak test for information purposes" UBYTE B_TRUE 1 100 0.00 1.00000000000 BIT_MASK 0x1 FORMAT "%13.11" ECU_ADDRESS 0x600013B3 /end MEASUREMENT
/begin MEASUREMENT B_tldklcon_msg "conditions for 0.5mm tank leak diagnosis fulfilled" UBYTE B_TRUE 1 100 0.00 1.00000000000 BIT_MASK 0x1 FORMAT "%13.11" ECU_ADDRESS 0x600013B2 /end MEASUREMENT
/begin MEASUREMENT B_tldklnx_msg "conditions for 0.5mm tank leak diagnosis wo ambient conditions fulfilled" UBYTE B_TRUE 1 100 0.00 1.00000000000 BIT_MASK 0x1 FORMAT "%13.11" ECU_ADDRESS 0x600013B1 /end MEASUREMENT
/begin MEASUREMENT B_tldmderr_msg "error in DTESK-components (AAV, TEV, pressure components)" UBYTE B_TRUE 1 100 0.00 1.00000000000 BIT_MASK 0x1 FORMAT "%13.11" ECU_ADDRESS 0x600013B0 /end MEASUREMENT
/begin MEASUREMENT B_tldobd_msg "condition tank leak test with obd-relevance" UBYTE B_TRUE 1 100 0.00 1.00000000000 BIT_MASK 0x1 FORMAT "%13.11" ECU_ADDRESS 0x600013AF /end MEASUREMENT
/begin MEASUREMENT B_tldres_msg "condition: reset of evopourativ leakage control from external request" UBYTE B_TRUE 1 100 0.00 1.00000000000 BIT_MASK 0x1 FORMAT "%13.11" ECU_ADDRESS 0x600013AD /end MEASUREMENT
/begin MEASUREMENT B_tldrlcv "conditions for virtual rough leak gradient tank leakage diagnosis fulfilled" UBYTE B_TRUE 1 100 0.00 1.00000000000 BIT_MASK 0x1 FORMAT "%13.11" ECU_ADDRESS 0x60000FFA /end MEASUREMENT
/begin MEASUREMENT B_tldrlerr_msg "rough leak error after DTESK-check" UBYTE B_TRUE 1 100 0.00 1.00000000000 BIT_MASK 0x1 FORMAT "%13.11" ECU_ADDRESS 0x600013AC /end MEASUREMENT
/begin MEASUREMENT B_tldstnai_msg "tank leak diagnosis stops because of inactive injection" UBYTE B_TRUE 1 100 0.00 1.00000000000 BIT_MASK 0x1 FORMAT "%13.11" ECU_ADDRESS 0x600013AB /end MEASUREMENT
/begin MEASUREMENT B_tldstpt_msg "tank difference pressure out of range" UBYTE B_TRUE 1 100 0.00 1.00000000000 BIT_MASK 0x1 FORMAT "%13.11" ECU_ADDRESS 0x600013AA /end MEASUREMENT
/begin MEASUREMENT B_tldstub_msg "battery voltage out of range" UBYTE B_TRUE 1 100 0.00 1.00000000000 BIT_MASK 0x1 FORMAT "%13.11" ECU_ADDRESS 0x600013A9 /end MEASUREMENT
/begin MEASUREMENT B_tldtestp "stop of tank leakage diagnosis because CPV can not be opened" UBYTE B_TRUE 1 100 0.00 1.00000000000 BIT_MASK 0x1 FORMAT "%13.11" ECU_ADDRESS 0x60000FE6 /end MEASUREMENT
/begin MEASUREMENT B_tldvfzg "stored condition (RSFF) vehicle speed (km/h)" UBYTE B_TRUE 1 100 0.00 1.00000000000 BIT_MASK 0x1 FORMAT "%13.11" ECU_ADDRESS 0x60000FE5 /end MEASUREMENT
/begin MEASUREMENT B_tldvrlc "timer for virtual rough leaktest running" UBYTE B_TRUE 1 100 0.00 1.00000000000 BIT_MASK 0x1 FORMAT "%13.11" ECU_ADDRESS 0x60000FF9 /end MEASUREMENT
/begin MEASUREMENT B_tldwdcon_msg "conditions with small influence to the tank leak diagnosis" UBYTE B_TRUE 1 100 0.00 1.00000000000 BIT_MASK 0x1 FORMAT "%13.11" ECU_ADDRESS 0x600013A7 /end MEASUREMENT
/begin MEASUREMENT B_tmstkpid "engine start temperature of %DTESK cold start check for PID$41" UBYTE B_TRUE 1 100 0.00 1.00000000000 BIT_MASK 0x1 FORMAT "%13.11" ECU_ADDRESS 0x60000FE4 /end MEASUREMENT
/begin MEASUREMENT B_tumgnxc_msg "no extreme conditions of ambient temperature" UBYTE B_TRUE 1 100 0.00 1.00000000000 BIT_MASK 0x1 FORMAT "%13.11" ECU_ADDRESS 0x600013A6 /end MEASUREMENT
/begin MEASUREMENT B_tumgsrv_msg "ambient temperature for tank leak diagnosis is fullfilled" UBYTE B_TRUE 1 100 0.00 1.00000000000 BIT_MASK 0x1 FORMAT "%13.11" ECU_ADDRESS 0x600013A5 /end MEASUREMENT
/begin MEASUREMENT B_vfzpof "vehicle speed conditions are fullfilled for offset diagnosis" UBYTE B_TRUE 1 100 0.00 1.00000000000 BIT_MASK 0x1 FORMAT "%13.11" ECU_ADDRESS 0x6000102A /end MEASUREMENT
/begin MEASUREMENT B_zaavp_msg "internal cycle flag CCV error" UBYTE B_TRUE 1 100 0.00 1.00000000000 BIT_MASK 0x1 FORMAT "%13.11" ECU_ADDRESS 0x600013A3 /end MEASUREMENT
/begin MEASUREMENT B_zdstoft "internal offset error pressure sensor" UBYTE B_TRUE 1 100 0.00 1.00000000000 BIT_MASK 0x1 FORMAT "%13.11" ECU_ADDRESS 0x60001029 /end MEASUREMENT
/begin MEASUREMENT B_zdstof_msg "cycle-flag offset-diagnosis tank-pressure sensor (internal)" UBYTE B_TRUE 1 100 0.00 1.00000000000 BIT_MASK 0x1 FORMAT "%13.11" ECU_ADDRESS 0x600013A2 /end MEASUREMENT
/begin MEASUREMENT B_zdstosci "Condition: Oscillation test completed" UBYTE B_TRUE 1 100 0.00 1.00000000000 BIT_MASK 0x1 FORMAT "%13.11" ECU_ADDRESS 0x60001028 /end MEASUREMENT
/begin MEASUREMENT B_zincch "condition (incremental check) of tank pressure sensor finished" UBYTE B_TRUE 1 100 0.00 1.00000000000 BIT_MASK 0x1 FORMAT "%13.11" ECU_ADDRESS 0x60001027 /end MEASUREMENT
/begin MEASUREMENT B_ztesf_msg "internal condition small leak check complete" UBYTE B_TRUE 1 100 0.00 1.00000000000 BIT_MASK 0x1 FORMAT "%13.11" ECU_ADDRESS 0x600013A0 /end MEASUREMENT
/begin MEASUREMENT B_ztesgdd_msg "Internal cycle bit of evap system monitoring - rough leak after distance debounce" UBYTE B_TRUE 1 100 0.00 1.00000000000 BIT_MASK 0x1 FORMAT "%13.11" ECU_ADDRESS 0x6000139F /end MEASUREMENT
/begin MEASUREMENT B_ztesgst "stored internal cycle flag for abortion high canister load" UBYTE B_TRUE 1 100 0.00 1.00000000000 BIT_MASK 0x1 FORMAT "%13.11" ECU_ADDRESS 0x60000FE3 /end MEASUREMENT
/begin MEASUREMENT B_ztesk_msg "internal condition smallest leak check complete" UBYTE B_TRUE 1 100 0.00 1.00000000000 BIT_MASK 0x1 FORMAT "%13.11" ECU_ADDRESS 0x6000139D /end MEASUREMENT
/begin MEASUREMENT ccpvplaus "counter CPV-plausibility-checks" UBYTE dez 1 100 0.00 255.0 FORMAT "%5.1" ECU_ADDRESS 0x60001026 /end MEASUREMENT
/begin MEASUREMENT CstrPurg_flgCpvDiagDteskActv "CPV diagnosis via DTESK active" UBYTE B_TRUE 1 100 0.00 1.00000000000 BIT_MASK 0x1 FORMAT "%13.11" ECU_ADDRESS 0x6000EE72 /end MEASUREMENT
/begin MEASUREMENT CstrPurg_flgCpvDiagDteskCpvOpenChk "CPV diagnosis via DTESK by opening the CPV active" UBYTE B_TRUE 1 100 0.00 1.00000000000 BIT_MASK 0x1 FORMAT "%13.11" ECU_ADDRESS 0x6000EE71 /end MEASUREMENT
/begin MEASUREMENT CstrPurg_flgCpvDiagDteskCpvStrtOpen "CPV diagnosis via DTESK start opening CPV" UBYTE B_TRUE 1 100 0.00 1.00000000000 BIT_MASK 0x1 FORMAT "%13.11" ECU_ADDRESS 0x6000EE70 /end MEASUREMENT
/begin MEASUREMENT CstrPurg_flgDiagCpv1DteskLoLoad "Diag CPV Bank1 in the low load purge line using DTESK algorithm (Release via code word)" UBYTE B_TRUE 1 100 0.00 1.00000000000 BIT_MASK 0x1 FORMAT "%13.11" ECU_ADDRESS 0x6000EE6F /end MEASUREMENT
/begin MEASUREMENT CstrPurg_flgTstrReq "general tester request" UBYTE B_TRUE 1 100 0.00 1.00000000000 BIT_MASK 0x1 FORMAT "%13.11" ECU_ADDRESS 0x6000EE6A /end MEASUREMENT
/begin MEASUREMENT CstrPurg_mfDiagCpv1w "CPV Diagnosis requested massflow during diagnosis for the 1st. CPV" UWORD m_uw_b25p6 1 100 0.00 25.59961 FORMAT "%8.5" ECU_ADDRESS 0x60008CB8 /end MEASUREMENT
/begin MEASUREMENT ctdtesk05 "active counter for smallest leak diagnosis (0,5mm)" UBYTE dez 1 100 0.00 255.0 FORMAT "%5.1" ECU_ADDRESS 0x60000FE2 /end MEASUREMENT
/begin MEASUREMENT dfskv_w "difference consumed fuel - fuel level difference" SWORD vol_q0p1_l 1 100 -3276.800 3276.700 FORMAT "%8.3" ECU_ADDRESS 0x60001054 /end MEASUREMENT
/begin MEASUREMENT dfstigof_w_msg "difference fuel levels after restart" SWORD vol_q0p1_l 1 100 -3276.800 3276.700 FORMAT "%8.3" ECU_ADDRESS 0x600014CC /end MEASUREMENT
/begin MEASUREMENT dfstigo_w_msg "difference fuel lvels during vehicle halts" SWORD vol_q0p1_l 1 100 -3276.800 3276.700 FORMAT "%8.3" ECU_ADDRESS 0x600014CE /end MEASUREMENT
/begin MEASUREMENT dfstig_w "differnez fuel level" UWORD vol_q0p1_l 1 100 0.00 6553.500 FORMAT "%8.3" ECU_ADDRESS 0x60001052 /end MEASUREMENT
/begin MEASUREMENT dfstt_w "difference fuel levels" SWORD vol_q0p1_l 1 100 -3276.800 3276.700 FORMAT "%8.3" ECU_ADDRESS 0x60001050 /end MEASUREMENT
/begin MEASUREMENT DHDEVO_flgDsmClr100ms "Flag for DSM clear in 100ms in the function DHDEVO" UBYTE B_TRUE 1 100 0.00 1.00000000000 BIT_MASK 0x1 FORMAT "%13.11" ECU_ADDRESS 0x7000037A /end MEASUREMENT
/begin MEASUREMENT DHDEVO_flgDsmClr50ms "Flag for DSM clear in 50ms in the function DHDEVO" UBYTE B_TRUE 1 100 0.00 1.00000000000 BIT_MASK 0x1 FORMAT "%13.11" ECU_ADDRESS 0x70000379 /end MEASUREMENT
/begin MEASUREMENT DHDEVO_flgDsmClrSyncS0 "Flag for DSM clear in synchro in the function DHDEVO" UBYTE B_TRUE 1 100 0.00 1.00000000000 BIT_MASK 0x1 FORMAT "%13.11" ECU_ADDRESS 0x70000378 /end MEASUREMENT
/begin MEASUREMENT DiaActrElecPsDiag_cntTestPlsTsk_mp "L-1 L=enNumber of testpulses in current driving cycleL-1" UWORD OneToOne 1 100 0.00 65535.00 FORMAT "%8.2" ECU_ADDRESS 0x70009DF2 /end MEASUREMENT
/begin MEASUREMENT DiaActrElecPsDiag_nrDiagErr_mp "Number of supported errors of the diagnosis signal" UBYTE OneToOne 1 100 0.00 255.0 FORMAT "%5.1" ECU_ADDRESS 0x70009FD9 /end MEASUREMENT
/begin MEASUREMENT DiaActrElecPsDiag_nrTestPls_mp "Number of testpulses in current driving cycle" ULONG OneToOne 1 100 0.00 4294967295.00 FORMAT "%13.2" ECU_ADDRESS 0x70009C18 /end MEASUREMENT
/begin MEASUREMENT DiaActrElecPsDiag_stAttribOL_mp "Current DSM attribute (Tested detection) of the open load error when reporting open load error to DSM module" ULONG OneToOne 1 100 0.00 4294967295.00 FORMAT "%13.2" ECU_ADDRESS 0x70009C14 /end MEASUREMENT
/begin MEASUREMENT DiaActrElecPsDiag_stAttribOT_mp "Current DSM attribute (Tested detection) of the overtemperature error when reporting overtemperature error to DSM module" ULONG OneToOne 1 100 0.00 4294967295.00 FORMAT "%13.2" ECU_ADDRESS 0x70009C10 /end MEASUREMENT
/begin MEASUREMENT DiaActrElecPsDiag_stAttribSCB_mp "Current DSM attribute (Tested detection) of the short circuit to battery error when reporting short circuit to battery error to DSM module" ULONG OneToOne 1 100 0.00 4294967295.00 FORMAT "%13.2" ECU_ADDRESS 0x70009C0C /end MEASUREMENT
/begin MEASUREMENT DiaActrElecPsDiag_stAttribSCG_mp "Current DSM attribute (Tested detection) of the short circuit to ground error when reporting short circuit to ground error to DSM module" ULONG OneToOne 1 100 0.00 4294967295.00 FORMAT "%13.2" ECU_ADDRESS 0x70009C08 /end MEASUREMENT
/begin MEASUREMENT DiaActrElecPsDiag_stDsmDebOpenLoad_mp "Debounce status of OL error" ULONG OneToOne 1 100 0.00 4294967295.00 FORMAT "%13.2" ECU_ADDRESS 0x70009C04 /end MEASUREMENT
/begin MEASUREMENT DiaActrElecPsDiag_stDsmDebOverT_mp "Debounce status of OT error" ULONG OneToOne 1 100 0.00 4294967295.00 FORMAT "%13.2" ECU_ADDRESS 0x70009C00 /end MEASUREMENT
/begin MEASUREMENT DiaActrElecPsDiag_stDsmDebScb_mp "Debounce status of SCB error" ULONG OneToOne 1 100 0.00 4294967295.00 FORMAT "%13.2" ECU_ADDRESS 0x70009BFC /end MEASUREMENT
/begin MEASUREMENT DiaActrElecPsDiag_stDsmDebScg_mp "Debounce status of SCG error" ULONG OneToOne 1 100 0.00 4294967295.00 FORMAT "%13.2" ECU_ADDRESS 0x70009BF8 /end MEASUREMENT
/begin MEASUREMENT DiaActrElecPsDiag_stErrCfgOpenLoad_mp "Configuration of behaviour for OL error" UBYTE OneToOne 1 100 0.00 255.0 FORMAT "%5.1" ECU_ADDRESS 0x70009FD8 /end MEASUREMENT
/begin MEASUREMENT DiaActrElecPsDiag_stErrCfgOverT_mp "Configuration of behaviour for OT error" UBYTE OneToOne 1 100 0.00 255.0 FORMAT "%5.1" ECU_ADDRESS 0x70009FD7 /end MEASUREMENT
/begin MEASUREMENT DiaActrElecPsDiag_stErrCfgScb_mp "Configuration of behaviour for SCB error" UBYTE OneToOne 1 100 0.00 255.0 FORMAT "%5.1" ECU_ADDRESS 0x70009FD6 /end MEASUREMENT
/begin MEASUREMENT DiaActrElecPsDiag_stErrCfgScg_mp "Configuration of behaviour for SCG error" UBYTE OneToOne 1 100 0.00 255.0 FORMAT "%5.1" ECU_ADDRESS 0x70009FD5 /end MEASUREMENT
/begin MEASUREMENT DiaActrElecPsDiag_stPrvTstRslt_mp "The latest result of test impulse" ULONG OneToOne 1 100 0.00 4294967295.00 FORMAT "%13.2" ECU_ADDRESS 0x70009BF4 /end MEASUREMENT
/begin MEASUREMENT DiaActrElecPsDiag_stSigCfg_mp "Configuration of the diagnosis signal" UBYTE OneToOne 1 100 0.00 255.0 FORMAT "%5.1" ECU_ADDRESS 0x70009FD4 /end MEASUREMENT
/begin MEASUREMENT DiaActrElecPsDiag_stSigErrInfo_mp "The last error information of HWE read from the chip" ULONG OneToOne 1 100 0.00 4294967295.00 FORMAT "%13.2" ECU_ADDRESS 0x70009BF0 /end MEASUREMENT
/begin MEASUREMENT DiaActrElecPsDiag_stSig_mp "Actual state of the diagnosis signal: INVALID, NOTEST, NOFAULT, FAULT, PREFAULT, HEALFAULT, WAITSTATE" UBYTE DiaActrElecPsDiag_stSig_COMPU_VERB 1 100 0.00 6.00000000000 FORMAT "%13.11" ECU_ADDRESS 0x70009FD3 /end MEASUREMENT
/begin MEASUREMENT DiaActrElecPsDiag_stTestPls_mp "L-1 L=enThe actual state of the testpulse state machine: NO, REQUESTED, RUN, FINISHED, RE-TRIGGEREDL-1" UBYTE DiaActrElecPsDiag_stTestPls_COMPU_VERB 1 100 1.00000000000 5.00000000000 FORMAT "%13.11" ECU_ADDRESS 0x70009FD2 /end MEASUREMENT
/begin MEASUREMENT DiaActrElecPsDiag_stTmngTestPls_mp "The current time to wait between two testpulses" UBYTE DiaActrElecPsDiag_stTmngTestPls_COMPU_VERB 1 100 0.00 3.00000000000 FORMAT "%13.11" ECU_ADDRESS 0x70009FD1 /end MEASUREMENT
/begin MEASUREMENT DiaActrElecPsDiag_tiTstPls_mp "Current status of timer for the time between testpulses during permanent fault" SWORD OneToOne 1 100 -32768.00 32767.00 FORMAT "%8.2" ECU_ADDRESS 0x70009DF0 /end MEASUREMENT
/begin MEASUREMENT DiaActrElecPsDiag_TstPlsCnt_Cfg_mp "Measurement points for test pulse counter setting" UBYTE OneToOne 1 100 0.00 255.0 FORMAT "%5.1" ECU_ADDRESS 0x70009FD0 /end MEASUREMENT
/begin MEASUREMENT DiaActr_ElecHBrdgDiag_HBrDiagInfo_mp "Diagnosis information from HWE - HBr." ULONG OneToOne 1 100 0.00 4294967295.00 FORMAT "%13.2" ECU_ADDRESS 0x70009C2C /end MEASUREMENT
/begin MEASUREMENT DiaActr_ElecHBrdgDiag_HlfBrDiagInfo_mp "Diagnosis information from IoSrv - HlfBr" ULONG OneToOne 1 100 0.00 4294967295.00 FORMAT "%13.2" ARRAY_SIZE 2 ECU_ADDRESS 0x70009C24 /end MEASUREMENT
/begin MEASUREMENT DiaActr_ElecHBrdgDiag_nrDiagErr_mp "Number of diagnostic errors Size of error object array." UBYTE OneToOne 1 100 0.00 255.0 FORMAT "%5.1" ECU_ADDRESS 0x70009FE3 /end MEASUREMENT
/begin MEASUREMENT DiaActr_ElecHBrdgDiag_OLSigErrInfo_mp "Signal error information during open load diagnosis." ULONG OneToOne 1 100 0.00 4294967295.00 FORMAT "%13.2" ECU_ADDRESS 0x70009C20 /end MEASUREMENT
/begin MEASUREMENT DiaActr_ElecHBrdgDiag_ReasOLAbort_mp "Measuring point indicating reason for open load diagnosis abort. [Relevant only if open load is configured in switchoff or disable mode]." UBYTE OneToOne 1 100 0.00 255.0 FORMAT "%5.1" ECU_ADDRESS 0x70009FE2 /end MEASUREMENT
/begin MEASUREMENT DiaActr_ElecHBrdgDiag_SigErrInfo_mp "Signal error information during normal diagnosis." ULONG OneToOne 1 100 0.00 4294967295.00 FORMAT "%13.2" ECU_ADDRESS 0x70009C1C /end MEASUREMENT
/begin MEASUREMENT DiaActr_ElecHBrdgDiag_stAddOLDiag_mp "Additional open load diagnosis status." UBYTE OneToOne 1 100 0.00 255.0 FORMAT "%5.1" ECU_ADDRESS 0x70009FE1 /end MEASUREMENT
/begin MEASUREMENT DiaActr_ElecHBrdgDiag_stDiagCtrl_mp "Status of diagnosis software (DiaActr_ElecHBrdgDiag) controlling H-Bridge output." UBYTE OneToOne 1 100 0.00 255.0 FORMAT "%5.1" ECU_ADDRESS 0x70009FE0 /end MEASUREMENT
/begin MEASUREMENT DiaActr_ElecHBrdgDiag_stDiagDi_mp "Diagnosis disable status." UBYTE OneToOne 1 100 0.00 255.0 FORMAT "%5.1" ECU_ADDRESS 0x70009FDF /end MEASUREMENT
/begin MEASUREMENT DiaActr_ElecHBrdgDiag_stOLAbortReq_mp "Open load abort request status." UBYTE OneToOne 1 100 0.00 255.0 FORMAT "%5.1" ECU_ADDRESS 0x70009FDE /end MEASUREMENT
/begin MEASUREMENT DiaActr_ElecHBrdgDiag_stOLDiagMode_mp "Open load diagnosis mode." UBYTE OneToOne 1 100 0.00 255.0 FORMAT "%5.1" ECU_ADDRESS 0x70009FDD /end MEASUREMENT
/begin MEASUREMENT DiaActr_ElecHBrdgDiag_stOLDiag_mp "Open load diagnosis status." UBYTE OneToOne 1 100 0.00 255.0 FORMAT "%5.1" ECU_ADDRESS 0x70009FDC /end MEASUREMENT
/begin MEASUREMENT DiaActr_ElecHBrdgDiag_stSigQly_mp "Signal quality returned." UBYTE OneToOne 1 100 0.00 255.0 FORMAT "%5.1" ECU_ADDRESS 0x70009FDB /end MEASUREMENT
/begin MEASUREMENT DiaActr_ElecHBrdgDiag_TestPlsReq_mp "Test pulse request status." UBYTE OneToOne 1 100 0.00 255.0 FORMAT "%5.1" ECU_ADDRESS 0x70009FDA /end MEASUREMENT
/begin MEASUREMENT DiagCpt_flgPSnsrTankClr "Flag for checking the DSM_clear in tank pressure sensor module" UBYTE B_TRUE 1 100 0.00 1.00000000000 BIT_MASK 0x1 FORMAT "%13.11" ECU_ADDRESS 0x60001025 /end MEASUREMENT
/begin MEASUREMENT DiagCpt_flgPSnsrTankIUMPRClr "Flag for checking the DSM_clear in tank pressure sensor IUMPR" UBYTE B_TRUE 1 100 0.00 1.00000000000 BIT_MASK 0x1 FORMAT "%13.11" ECU_ADDRESS 0x60001024 /end MEASUREMENT
/begin MEASUREMENT DiagCpv_cntrReIniBasc1 "Local variable to store the global drive cycle counter" UBYTE dez 1 100 0.00 255.0 FORMAT "%5.1" ECU_ADDRESS 0x6000E81C /end MEASUREMENT
/begin MEASUREMENT DiagCpv_flgCpv1TrbCdnFirstActvn "Turbo denominator purge conditions first time active for 2 seconds" UBYTE B_TRUE 1 100 0.00 1.00000000000 BIT_MASK 0x1 FORMAT "%13.11" ECU_ADDRESS 0x6000E81B /end MEASUREMENT
/begin MEASUREMENT DiagCpv_flgCpv1TrbCdnSecActvn "Turbo denominator purge conditions second time active for 2 seconds" UBYTE B_TRUE 1 100 0.00 1.00000000000 BIT_MASK 0x1 FORMAT "%13.11" ECU_ADDRESS 0x6000E81A /end MEASUREMENT
/begin MEASUREMENT DiagCpv_flgCpv2TrbCdnFirstActvn "Turbo denominator purge conditions first time active for 2 seconds- bank 2" UBYTE B_TRUE 1 100 0.00 1.00000000000 BIT_MASK 0x1 FORMAT "%13.11" ECU_ADDRESS 0x6000E819 /end MEASUREMENT
/begin MEASUREMENT DiagCpv_flgCpv2TrbCdnSecActvn "Turbo denominator purge conditions second time active for 2 seconds - bank 2" UBYTE B_TRUE 1 100 0.00 1.00000000000 BIT_MASK 0x1 FORMAT "%13.11" ECU_ADDRESS 0x6000E818 /end MEASUREMENT
/begin MEASUREMENT DiagCpv_flgReIniBasc1 "ReIni flag for Proc_1_20ms (calculation of High Load Purge Denominator)" UBYTE B_TRUE 1 100 0.00 1.00000000000 BIT_MASK 0x1 FORMAT "%13.11" ECU_ADDRESS 0x6000F14C /end MEASUREMENT
/begin MEASUREMENT DiagCpv_tiPrpnSysActv "Denominator high load purge line counter. Elapsed time with propulsion system active and environment temperature 4.4C." UWORD t_q0p02 1 100 0.00 1310.700 FORMAT "%8.3" ECU_ADDRESS 0x60007482 /end MEASUREMENT
/begin MEASUREMENT DiagCpv_tiSumCpv1TrbCond "Denminator high load purge line counter. Accumulative elapsed time with purge conditions available." UWORD t_q0p02 1 100 0.00 1310.700 FORMAT "%8.3" ECU_ADDRESS 0x60007480 /end MEASUREMENT
/begin MEASUREMENT DiagCpv_tiSumCpv2TrbCond "Denminator high load purge line counter. Accumulative elapsed time with purge conditions available - bank 2" UWORD t_q0p02 1 100 0.00 1310.700 FORMAT "%8.3" ECU_ADDRESS 0x6000747E /end MEASUREMENT
/begin MEASUREMENT dkvbigo_w "fuel consumption during vehicle halts" UWORD vol_q3p90625Em3_l 1 100 0.00 255.9961 FORMAT "%8.4" ECU_ADDRESS 0x6000104E /end MEASUREMENT
/begin MEASUREMENT dkvb_w "difference consumed fuel" UWORD vol_q3p90625Em3_l 1 100 0.00 255.9961 FORMAT "%8.4" ECU_ADDRESS 0x60039478 /end MEASUREMENT
/begin MEASUREMENT dmsntev_w_msg "Difference between Max and Min purge mass flow for incremental check of tank pressure sensor" UWORD m_uw_b25p6 1 100 0.00 25.59961 FORMAT "%8.5" ECU_ADDRESS 0x60001498 /end MEASUREMENT
/begin MEASUREMENT dptekdth_w "tank pressure filtered for offset-diagnosis tank pressure sensor highpass absolut" UWORD p_q0p00122 1 100 0.00 79.99878 FORMAT "%8.5" ECU_ADDRESS 0x60001022 /end MEASUREMENT
/begin MEASUREMENT dptekp_w "tank pressure change" UWORD p_q0p00122 1 100 0.00 79.99878 FORMAT "%8.5" ECU_ADDRESS 0x60001496 /end MEASUREMENT
/begin MEASUREMENT dpte_w "tank pressure difference in tank leak diagnosis" UWORD p_q0p3125 1 100 0.00 20479.69 FORMAT "%8.2" ECU_ADDRESS 0x60001020 /end MEASUREMENT
/begin MEASUREMENT DTESK_flgRstDsmDfp "To maintain consistency: DSM reset flag to ensure clear process take places in same process where calc happens." UBYTE B_TRUE 1 100 0.00 1.00000000000 BIT_MASK 0x1 FORMAT "%13.11" ECU_ADDRESS 0x60000FF8 /end MEASUREMENT
/begin MEASUREMENT FlDev_lenTotDstLstRlsDenom "Stored odometer for fuel level diagnosis denominator" SLONG Length 1 100 -2147483648.00 2147483647.00 FORMAT "%13.2" ECU_ADDRESS 0x60039474 /end MEASUREMENT
/begin MEASUREMENT FlLvl_cntrFuLvlErr "number of successive plausibility errors on fuel-level" UBYTE dez 1 100 0.00 255.0 FORMAT "%5.1" ECU_ADDRESS 0x60001422 /end MEASUREMENT
/begin MEASUREMENT FlLvl_ctPlausyRst "FlLvl_ctPlausyRst" UWORD OneToOne 1 100 0.00 65535.00 FORMAT "%8.2" ECU_ADDRESS 0x6000104C /end MEASUREMENT
/begin MEASUREMENT FlLvl_flgFstPlausyOkCfm "Plausibility check ok confirm" UBYTE B_TRUE 1 100 0.00 1.00000000000 BIT_MASK 0x1 FORMAT "%13.11" ECU_ADDRESS 0x600000FB /end MEASUREMENT
/begin MEASUREMENT FlLvl_flgFuSnsrRlsDenom "Flag to signify that the required distance for fuel sensor plusibility diagnosis FID denominator is reached" UBYTE B_TRUE 1 100 0.00 1.00000000000 BIT_MASK 0x1 FORMAT "%13.11" ECU_ADDRESS 0x600000FA /end MEASUREMENT
/begin MEASUREMENT FlLvl_flgLongStandStill "Flag to signify that the vehicle has stopped for a long time when the fuel was in the upper or lower dead zone and hence reset the plausibility diagnosis" UBYTE B_TRUE 1 100 0.00 1.00000000000 BIT_MASK 0x1 FORMAT "%13.11" ECU_ADDRESS 0x6000104A /end MEASUREMENT
/begin MEASUREMENT FlLvl_flgRefuPsbl "Refuelling possible flag" UBYTE B_TRUE 1 100 0.00 1.00000000000 BIT_MASK 0x1 FORMAT "%13.11" ECU_ADDRESS 0x60001397 /end MEASUREMENT
/begin MEASUREMENT FlLvl_flgTankEmptyResv "Tank empty or reserve" UBYTE B_TRUE 1 100 0.00 1.00000000000 BIT_MASK 0x1 FORMAT "%13.11" ECU_ADDRESS 0x60036DE5 /end MEASUREMENT
/begin MEASUREMENT FlLvl_flgTankFull "Tank full" UBYTE B_TRUE 1 100 0.00 1.00000000000 BIT_MASK 0x1 FORMAT "%13.11" ECU_ADDRESS 0x60036DE4 /end MEASUREMENT
/begin MEASUREMENT FlLvl_flgVehHaltSeln "Vehicle halt slection flag" UBYTE B_TRUE 1 100 0.00 1.00000000000 BIT_MASK 0x1 FORMAT "%13.11" ECU_ADDRESS 0x60001049 /end MEASUREMENT
/begin MEASUREMENT FlLvl_flgVehMov "used by refuelling enable calculation" UBYTE B_TRUE 1 100 0.00 1.00000000000 BIT_MASK 0x1 FORMAT "%13.11" ECU_ADDRESS 0x60001048 /end MEASUREMENT
/begin MEASUREMENT FlLvl_flgVehStandStill "Vehicle standstill flag" UBYTE B_TRUE 1 100 0.00 1.00000000000 BIT_MASK 0x1 FORMAT "%13.11" ECU_ADDRESS 0x60039544 /end MEASUREMENT
/begin MEASUREMENT FlLvl_lenDstSnceLstRlsDenom "Distance travelled by the vehicle since the last release of the IUMPR denominator" SLONG Length 1 100 -2147483648.00 2147483647.00 FORMAT "%13.2" ECU_ADDRESS 0x60001044 /end MEASUREMENT
/begin MEASUREMENT FlLvl_tiLongStandStillIni "Time delay before resetting plausibility diagnosis in case of Kl15 Off and On" UBYTE t_q1 1 100 0.00 255.0 FORMAT "%5.1" ECU_ADDRESS 0x60001040 /end MEASUREMENT
/begin MEASUREMENT FlLvl_tiVehStandStill "Vehicle standstill timer" UBYTE t_q1 1 100 0.00 255.0 FORMAT "%5.1" ECU_ADDRESS 0x60039472 /end MEASUREMENT
/begin MEASUREMENT FlLvl_volPlausyCycFuInj "difference consumed fuel" UWORD vol_q3p90625Em3_l 1 100 0.00 255.9961 FORMAT "%8.4" ECU_ADDRESS 0x600014A2 /end MEASUREMENT
/begin MEASUREMENT FlLvl_volSnsr1Stk "Primary-fueltank volume at start of sensor-stuck check" UWORD vol_q0p1_l 1 100 0.00 6553.500 FORMAT "%8.3" ECU_ADDRESS 0x6000149E /end MEASUREMENT
/begin MEASUREMENT FlLv_cntrDualTankPlausRstrt "Counter to increment for tank plausibility restart" UWORD OneToOne 1 100 0.00 65535.00 FORMAT "%8.2" ECU_ADDRESS 0x60039470 /end MEASUREMENT
/begin MEASUREMENT FlLv_volLvlSnsrPlausChk "Calibrated fuel volume for sensor plausibility check" SWORD vol_q0p1_l 1 100 -3276.800 3276.700 FORMAT "%8.3" ECU_ADDRESS 0x6000103E /end MEASUREMENT
/begin MEASUREMENT FPCtl_flgCpvDiagFullEngModReq "CPV Diagnosis requests a full engine (or high valve lift) mode" UBYTE B_TRUE 1 100 0.00 1.00000000000 BIT_MASK 0x1 FORMAT "%13.11" ECU_ADDRESS 0x6000F124 /end MEASUREMENT
/begin MEASUREMENT FPCtl_flgRqstShrtTrpCPV1MnfPurgLn "Tester request for short trip CPV Diagnosis (Purge line to intake manifold). Replacement of B_fates" UBYTE B_TRUE 1 100 0.00 1.00000000000 BIT_MASK 0x1 FORMAT "%13.11" ECU_ADDRESS 0x6000EE4A /end MEASUREMENT
/begin MEASUREMENT fst1stk_w "Primary-fueltank volume at start of sensor-stuck check" UWORD vol_q0p1_l 1 100 0.00 6553.500 FORMAT "%8.3" ECU_ADDRESS 0x6003946E /end MEASUREMENT
/begin MEASUREMENT fstakt_w "current fuel level" UWORD vol_q0p1_l 1 100 0.00 6553.500 FORMAT "%8.3" ECU_ADDRESS 0x6000103C /end MEASUREMENT
/begin MEASUREMENT fstalt_w "last fuel level before ignition off" UWORD vol_q0p1_l 1 100 0.00 6553.500 FORMAT "%8.3" ECU_ADDRESS 0x60039466 /end MEASUREMENT
/begin MEASUREMENT fstalt_w_msg "last fuel level before ignition off" UWORD vol_q0p1_l 1 100 0.00 6553.500 FORMAT "%8.3" ECU_ADDRESS 0x60039572 /end MEASUREMENT
/begin MEASUREMENT fstercnt "number of successive plausibility errors on fuel-level" UBYTE dez 1 100 0.00 255.0 FORMAT "%5.1" ECU_ADDRESS 0x6003946D /end MEASUREMENT
/begin MEASUREMENT fsthin_w_msg "fuel level during vehicle stops" UWORD vol_q0p1_l 1 100 0.00 6553.500 FORMAT "%8.3" ECU_ADDRESS 0x60001484 /end MEASUREMENT
/begin MEASUREMENT fstokcnt "number of successive plausibility checks ok on fuel-level" UBYTE dez 1 100 0.00 255.0 FORMAT "%5.1" ECU_ADDRESS 0x6003946C /end MEASUREMENT
/begin MEASUREMENT fstold_w "Dualtank fuel-volume at the start of plausibility check" UWORD vol_q0p1_l 1 100 0.00 6553.500 FORMAT "%8.3" ECU_ADDRESS 0x6003946A /end MEASUREMENT
/begin MEASUREMENT fteadptf_w "filtered charcoal canister charge" SWORD fak_sw_b64 1 100 -64.00000 63.99805 FORMAT "%8.5" ECU_ADDRESS 0x60000FE0 /end MEASUREMENT
/begin MEASUREMENT guatld05_w_msg "calculated leak threshold for smallest leak check" UWORD pgrad_q2p38Em5 1 100 0.00 1.562476 FORMAT "%8.6" ECU_ADDRESS 0x60001468 /end MEASUREMENT
/begin MEASUREMENT guatld10_w_msg "calculated leak threshold for small leak check" UWORD pgrad_q2p38Em5 1 100 0.00 1.562476 FORMAT "%8.6" ECU_ADDRESS 0x60001466 /end MEASUREMENT
/begin MEASUREMENT gudabkk10_w_msg "corrected pressure removal gradient" UWORD pgrad_q2p38Em5 1 100 0.00 1.562476 FORMAT "%8.6" ECU_ADDRESS 0x60001460 /end MEASUREMENT
/begin MEASUREMENT gudabkk_w_msg "corrected pressure removal gradient" UWORD pgrad_q2p38Em5 1 100 0.00 1.562476 FORMAT "%8.6" ECU_ADDRESS 0x6000145E /end MEASUREMENT
/begin MEASUREMENT gudabk_w_msg "corrected pressure removal gradient" UWORD pgrad_q2p38Em5 1 100 0.00 1.562476 FORMAT "%8.6" ECU_ADDRESS 0x60001462 /end MEASUREMENT
/begin MEASUREMENT idmste_w "Integrated mass flow for release of offset check tank pressure sensor" UWORD m_ub_q0p0444 1 100 0.00 2909.754 FORMAT "%8.3" ECU_ADDRESS 0x6000101E /end MEASUREMENT
/begin MEASUREMENT InjSys_bCPVOpnForDia "Condition CPV open for diagnosis" UBYTE B_TRUE 1 100 0.00 1.00000000000 BIT_MASK 0x1 FORMAT "%13.11" ECU_ADDRESS 0x6000EE2F /end MEASUREMENT
/begin MEASUREMENT InjSys_bCPVRdyForDia "Condition CPV ready for diagnosis" UBYTE B_TRUE 1 100 0.00 1.00000000000 BIT_MASK 0x1 FORMAT "%13.11" ECU_ADDRESS 0x6000EE2E /end MEASUREMENT
/begin MEASUREMENT InjSys_flgDHDEVOReIni "State variable to allow reinitialization" UBYTE B_TRUE 1 100 0.00 1.00000000000 BIT_MASK 0x1 FORMAT "%13.11" ECU_ADDRESS 0x70000377 /end MEASUREMENT
/begin MEASUREMENT InjSys_nEngLResDiagOpenInjVlv "engine speed with low resolution for diagnosis open HDEV" UBYTE nmot_ub_q40 1 100 0.00 10200. FORMAT "%5.0" ECU_ADDRESS 0x6000E823 /end MEASUREMENT
/begin MEASUREMENT kvbmsold_w "Fuel consumption from actual driving cycle until detected refueling with negative algebraic sign." SWORD vol_q7p8125Em3_l 1 100 -256.0000 255.9922 FORMAT "%8.4" ECU_ADDRESS 0x6000103A /end MEASUREMENT
/begin MEASUREMENT kvbmssum_w "integrated fuel consumption for condition fuel consumption greater tank since last refueling" UWORD vol_q3p90625Em3_l 1 100 0.00 255.9961 FORMAT "%8.4" ECU_ADDRESS 0x60039468 /end MEASUREMENT
/begin MEASUREMENT kvbold_w "Volume of fuel-consumed at the start of dualtank fuel-level plausibility check" SWORD vol_q7p8125Em3_l 1 100 -256.0000 255.9922 FORMAT "%8.4" ECU_ADDRESS 0x60001038 /end MEASUREMENT
/begin MEASUREMENT misfire "number of misfire" UBYTE dez 1 100 0.00 255.0 FORMAT "%5.1" ARRAY_SIZE 4 ECU_ADDRESS 0x6000E81F /end MEASUREMENT
/begin MEASUREMENT msnitldv_w "Virtual integrated CPV - mass flow for calculation of IUMPR for tank leakage diagnosis" UWORD m_3p47222Em4_g 1 100 0.00 22.75521 FORMAT "%8.5" ECU_ADDRESS 0x60000FF6 /end MEASUREMENT
/begin MEASUREMENT msnv_w "vortual mass flow PCV for calculation of IUMPR for tank leakage diagnosis" UWORD m_uw_b25p6 1 100 0.00 25.59961 FORMAT "%8.5" ECU_ADDRESS 0x60000FF4 /end MEASUREMENT
/begin MEASUREMENT mstedtf_w "purge massflow (filtered value) for offset-diagnosis tank pressure sensor" UWORD m_uw_b25p6 1 100 0.00 25.59961 FORMAT "%8.5" ECU_ADDRESS 0x6000101C /end MEASUREMENT
/begin MEASUREMENT mstmxold_w "old maximum value CPV-mass flow for CPV-plausibility-check tank pressure sensor diagnosis" UWORD m_uw_b25p6 1 100 0.00 25.59961 FORMAT "%8.5" ECU_ADDRESS 0x6000101A /end MEASUREMENT
/begin MEASUREMENT mstmxsto_w "maximum value CPV-mass flow for CPV-plausibility-check tank pressure sensor diagnosis" UWORD m_uw_b25p6 1 100 0.00 25.59961 FORMAT "%8.5" ECU_ADDRESS 0x60001018 /end MEASUREMENT
/begin MEASUREMENT nomisfcnt "Counter no misfire counted" UBYTE dez 1 100 0.00 255.0 FORMAT "%5.1" ECU_ADDRESS 0x700030B0 /end MEASUREMENT
/begin MEASUREMENT pteaav_w_msg "ccv error threshold because cpv can not open because of vacuum" SWORD p_q0p00122 1 100 -40.00000 39.99878 FORMAT "%8.5" ECU_ADDRESS 0x600014C8 /end MEASUREMENT
/begin MEASUREMENT ptekfdst_w "tank pressure filtered for offset-diagnosis tank pressure sensor" SWORD p_q0p00122 1 100 -40.00000 39.99878 FORMAT "%8.5" ECU_ADDRESS 0x600014C6 /end MEASUREMENT
/begin MEASUREMENT ptekfdth_w "tank pressure filtered for offset-diagnosis tank pressure sensor highpass" SWORD p_q0p00122 1 100 -40.00000 39.99878 FORMAT "%8.5" ECU_ADDRESS 0x600014C4 /end MEASUREMENT
/begin MEASUREMENT ptekmaxdst_w "Maximum tank pressure for increment check tank pressure sensor (stuck signal)" SWORD p_q0p00122 1 100 -40.00000 39.99878 FORMAT "%8.5" ECU_ADDRESS 0x600014C2 /end MEASUREMENT
/begin MEASUREMENT ptekmindst_w "Minimum tank pressure for increment check tank pressure sensor (stuck signal)" SWORD p_q0p00122 1 100 -40.00000 39.99878 FORMAT "%8.5" ECU_ADDRESS 0x600014C0 /end MEASUREMENT
/begin MEASUREMENT ptekold "Referenze value of tank pressure for Oscillation test" SWORD p_q0p3125 1 100 -10240.00 10239.69 FORMAT "%8.2" ECU_ADDRESS 0x60001016 /end MEASUREMENT
/begin MEASUREMENT ptekrefo_w "old reference value tank pressure for offset-diagnosis tank pressure sensor" SWORD p_q0p00122 1 100 -40.00000 39.99878 FORMAT "%8.5" ECU_ADDRESS 0x60001014 /end MEASUREMENT
/begin MEASUREMENT ptekref_w "reference value tank pressure for offset-diagnosis tank pressure sensor" SWORD p_q0p00122 1 100 -40.00000 39.99878 FORMAT "%8.5" ECU_ADDRESS 0x60001012 /end MEASUREMENT
/begin MEASUREMENT pteksfdt_w_msg "tank pressure filtered for offset-diagnosis tank pressure sensor" SWORD p_q0p00122 1 100 -40.00000 39.99878 FORMAT "%8.5" ECU_ADDRESS 0x600014BE /end MEASUREMENT
/begin MEASUREMENT ptemnsto_w "minimum value tank pressure for offset-diagnosis tank pressure sensor" SWORD p_q0p00122 1 100 -40.00000 39.99878 FORMAT "%8.5" ECU_ADDRESS 0x60001010 /end MEASUREMENT
/begin MEASUREMENT ptkdfdst_w "difference tank pressure for %DDST-diagnosis (Word)" UWORD p_q0p00122 1 100 0.00 79.99878 FORMAT "%8.5" ECU_ADDRESS 0x6000100E /end MEASUREMENT
/begin MEASUREMENT puold_w "ambient pressure (old value)" UWORD p_uw_q0p039 1 100 0.00 2559.961 FORMAT "%8.3" ECU_ADDRESS 0x60000FDE /end MEASUREMENT
/begin MEASUREMENT purefdsa_w "array for ambient pressure change" UWORD p_uw_q0p039 1 100 0.00 2559.961 FORMAT "%8.3" ARRAY_SIZE 5 ECU_ADDRESS 0x6003945A /end MEASUREMENT
/begin MEASUREMENT PurgLeakDiag_flgBlkdLineErr "Error blocked line between tank and active carbon canister" UBYTE B_TRUE 1 100 0.00 1.00000000000 BIT_MASK 0x1 FORMAT "%13.11" ECU_ADDRESS 0x6000E817 /end MEASUREMENT
/begin MEASUREMENT PurgLeakDiag_flgColdStrtVld "Cold start condition for DTESK was calculated correctly" UBYTE B_TRUE 1 100 0.00 1.00000000000 BIT_MASK 0x1 FORMAT "%13.11" ECU_ADDRESS 0x60001396 /end MEASUREMENT
/begin MEASUREMENT PurgLeakDiag_flgDlyNewIdle "Diagnosis is released if idle phase was not fullfilled for a certain time" UBYTE B_TRUE 1 100 0.00 1.00000000000 BIT_MASK 0x1 FORMAT "%13.11" ECU_ADDRESS 0x60000FDD /end MEASUREMENT
/begin MEASUREMENT PurgLeakDiag_flgDSMChk "local flag for DSM Clear check" UBYTE B_TRUE 1 100 0.00 1.00000000000 BIT_MASK 0x1 FORMAT "%13.11" ECU_ADDRESS 0x60000FDC /end MEASUREMENT
/begin MEASUREMENT PurgLeakDiag_flgDSMclr "DSM clear flag" UBYTE B_TRUE 1 100 0.00 1.00000000000 BIT_MASK 0x1 FORMAT "%13.11" ECU_ADDRESS 0x60000FDB /end MEASUREMENT
/begin MEASUREMENT PurgLeakDiag_flgEnaCdnFuMixAdpn "conditions of the mixture adaptation for the DTESK are fulfilled" UBYTE B_TRUE 1 100 0.00 1.00000000000 BIT_MASK 0x1 FORMAT "%13.11" ECU_ADDRESS 0x60000FDA /end MEASUREMENT
/begin MEASUREMENT PurgLeakDiag_flgEnaCdnIdleCtrl "Idle phase for diagnosis detected" UBYTE B_TRUE 1 100 0.00 1.00000000000 BIT_MASK 0x1 FORMAT "%13.11" ECU_ADDRESS 0x60000FD9 /end MEASUREMENT
/begin MEASUREMENT PurgLeakDiag_flgTankLeakDiagFinshd "DTESK Diagnosis is inhibited, because it would not run again" UBYTE B_TRUE 1 100 0.00 1.00000000000 BIT_MASK 0x1 FORMAT "%13.11" ECU_ADDRESS 0x60001392 /end MEASUREMENT
/begin MEASUREMENT PurgLeakDiag_stftead "disabling because of high canister load." UBYTE B_TRUE 1 100 0.00 1.00000000000 BIT_MASK 0x1 FORMAT "%13.11" ECU_ADDRESS 0x60000FD8 /end MEASUREMENT
/begin MEASUREMENT PurgLeakDiag_tAmbAir "Ambient air temperature" UBYTE temp_ub_q0p75_o48 1 100 -48.0 143.3 FORMAT "%5.1" ECU_ADDRESS 0x60000FD7 /end MEASUREMENT
/begin MEASUREMENT PurgLeakDiag_tCEngStrt "Engine coolant downstream temperature during the first engine start of the driving cycle." UBYTE temp_ub_q0p75_o48 1 100 -48.0 143.3 FORMAT "%5.1" ECU_ADDRESS 0x60000FD6 /end MEASUREMENT
/begin MEASUREMENT PurgLeakDiag_uBatt "Battery voltage" UWORD spg_q0p00039 1 100 0.00 25.59961 FORMAT "%8.5" ECU_ADDRESS 0x60000FD4 /end MEASUREMENT
/begin MEASUREMENT PurgLeakDiag_vVeh "Vehicle speed" UWORD vfzg_uw_b512 1 100 0.00 511.9922 FORMAT "%8.4" ECU_ADDRESS 0x60000FD2 /end MEASUREMENT
/begin MEASUREMENT reqdtesk_msg "physically allowed tank leakage diagnoses" UBYTE dez 1 100 0.00 255.0 FORMAT "%5.1" ECU_ADDRESS 0x60001412 /end MEASUREMENT
/begin MEASUREMENT rqdteskt "physically allowed tank leakage diagnoses after enable condition" UBYTE dez 1 100 0.00 255.0 FORMAT "%5.1" ECU_ADDRESS 0x60000FD0 /end MEASUREMENT
/begin MEASUREMENT sdmglvav_w "virtual driven distance since virtual rough leak suspicion" UWORD s_q0p02777_m 1 100 0.00 1820.417 FORMAT "%8.3" ECU_ADDRESS 0x60000FF2 /end MEASUREMENT
/begin MEASUREMENT sdmglva_w "driven distance since rough leak recognized" UWORD s_q0p02777_m 1 100 0.00 1820.417 FORMAT "%8.3" ECU_ADDRESS 0x60000FF0 /end MEASUREMENT
/begin MEASUREMENT setdhdevo "Cylinder specific bitcoded errorbyte of diagnosis open high pressure injector (HPIV)" UBYTE dez 1 100 0.00 255.0 FORMAT "%5.1" ECU_ADDRESS 0x6000E81E /end MEASUREMENT
/begin MEASUREMENT setdhdevos "Cylinder specific bitcoded error suspicious byte of diagnosis open high pressure injector (HPIV)" UBYTE dez 1 100 0.00 255.0 FORMAT "%5.1" ECU_ADDRESS 0x6000E81D /end MEASUREMENT
/begin MEASUREMENT TankLeakDiag_facEthnlSensVal "Ethanol sensor value" UWORD fak_uw_b2 1 100 0.00 1.999969 FORMAT "%8.6" ECU_ADDRESS 0x60008592 /end MEASUREMENT
/begin MEASUREMENT TankP_pDifTankOffsChk "Pressure difference of tank pressure for offset check" UWORD p_q0p00122 1 100 0.00 79.99878 FORMAT "%8.5" ECU_ADDRESS 0x6000100C /end MEASUREMENT
/begin MEASUREMENT TankP_pDifTankStuckChk "Pressure difference of tank pressure for stuck check" ULONG p_q0p00122 1 100 0.00 5242879.99878 FORMAT "%13.5" ECU_ADDRESS 0x60001008 /end MEASUREMENT
/begin MEASUREMENT tdpu_w "timer for change in ambient pressure" UWORD t_q0p1 1 100 0.00 6553.500 FORMAT "%8.3" ECU_ADDRESS 0x60000FCE /end MEASUREMENT
/begin MEASUREMENT tedfto05_w "Remaining Inhibition time for tank leakage diagnosis (0.5mm) after high canister load" UWORD t_q0p1 1 100 0.00 6553.500 FORMAT "%8.3" ECU_ADDRESS 0x60000FCC /end MEASUREMENT
/begin MEASUREMENT tldnostp_msg "tank leakage diagnoses without fulfilled stop conditions" UBYTE dez 1 100 0.00 255.0 FORMAT "%5.1" ECU_ADDRESS 0x60001407 /end MEASUREMENT
/begin MEASUREMENT tpteksto "timer time window for calculation ptekref_w" UBYTE t_q0p1 1 100 0.00 25.50 FORMAT "%5.2" ECU_ADDRESS 0x60001006 /end MEASUREMENT
/begin MEASUREMENT tpurefdst_w "Counter for pressure change in tank pressure sensor" UWORD t_q0p1 1 100 0.00 6553.500 FORMAT "%8.3" ECU_ADDRESS 0x60001004 /end MEASUREMENT
/begin MEASUREMENT vfzggdst_w "vehicle acceleration for offset-diagnosis tank pressure sensor" SWORD acc_q0p021701_m_DIV_s2 1 100 -711.1111 711.0894 FORMAT "%8.4" ECU_ADDRESS 0x60001002 /end MEASUREMENT
/begin MEASUREMENT ztesggmx_w_msg "Latched upper threshold of rough leak gradient check for Mode6" SWORD p_q0p00122 1 100 -40.00000 39.99878 FORMAT "%8.5" ECU_ADDRESS 0x600395A0 /end MEASUREMENT
/begin MEASUREMENT ztesgg_w "Latched measured value of rough leak gradient check for Mode6" SWORD p_q0p00122 1 100 -40.00000 39.99878 FORMAT "%8.5" ECU_ADDRESS 0x60039456 /end MEASUREMENT
/begin MEASUREMENT _stcEmiMisfCntrCyl "cylinder individual misfire counter for emission statistic local" UWORD OneToOne 1 100 0.00 65535.00 FORMAT "%8.2" ARRAY_SIZE 4 ECU_ADDRESS 0x6000748C /end MEASUREMENT
/begin MEASUREMENT _stcEmiMisfCntrCyl_100ms "cylinder individual misfire counter for emission statistic local_100ms" UWORD OneToOne 1 100 0.00 65535.00 FORMAT "%8.2" ARRAY_SIZE 4 ECU_ADDRESS 0x60007484 /end MEASUREMENT
/begin FUNCTION DFES "30000.73.0_2.0.0Diagnostic Fault Event Storage"
 /begin DEF_CHARACTERISTIC DFES_xAsgnExtdFrzFrSig_CA DFES_xAsgnFrzFrSig_CA DFES_xClsDltTrg_CA DFES_xClsFaultTrg_CA DFES_xClsFltMIL_CA DFES_xClsFltSVS_CA DFES_xClsHealTrg_CA DFES_xClsPndDltTrg_CA DFES_xClsPrio_CA DFES_xClsSvcDltTrg_CA DFES_xClsSVSFaultTrg_CA DFES_xClsSVSHealTrg_CA /end DEF_CHARACTERISTIC
 FUNCTION_VERSION "30000.73.0_2.0.0" /end FUNCTION
/begin FUNCTION DFP "30000.7.0 Diagnostic Fault Path" FUNCTION_VERSION "30000.7.0" /end FUNCTION
/begin FUNCTION DfpCl "3.0.0     support of DFP handling" FUNCTION_VERSION "3.0.0" /end FUNCTION
/begin FUNCTION DFSTT "11.12.0   Diagnostics for fluid level sensor tank"
 /begin DEF_CHARACTERISTIC CWDFSTT DFSKVMN DFSKVMX DFSTTH DKVBTH FlLvl_ctMacCntRstPlausyChk_C Fllvl_lenPlausDiagFuSnsrMin_C FlLvl_stPlausyDiagRst_C FlLvl_stSlopDetn_C FlLvl_tiLongStandStill_C FlLvl_tiRefuOnDec_C FlLvl_tiRefuOnInc_C FlLvl_vMovingChkThdHi_C FlLvl_vMovingChkThdLo_C FlLvl_vVehStopChkThdHi_C FlLvl_vVehStopChkThdLo_C FST1SKTH KLDFSTVFZG NFSTPLMN TANKABN TANKMN TANKVOL TANKVOLH TVFAHRTT TVFSTPRC TVFSTTG TVHATA VFZGDFSTT VOLBMNSL VOLOMXSL ZFSTPLTH /end DEF_CHARACTERISTIC
 /begin IN_MEASUREMENT B_cdfst_msg B_clrfst_msg B_fstelerr_msg B_fstsok_msg B_fsttg_msg B_fsttldv_msg B_fsttrg_msg B_fsttsh_msg B_nachl_msg B_tal_msg B_tav_msg Eep_EnvRamHist Eep_EnvRamInvld EngStrt_bFrstStrtEnd Epm_stSpd FlLvl_volRefuFuLvlFild fstt_w_msg fstu_w_msg GlbDa_lTotDst InjSys_volFuConsDrvCyc SyC_stSub TiEngOff_stTi TiEngOff_ti VehV_v /end IN_MEASUREMENT
 /begin OUT_MEASUREMENT B_efstgth_msg B_efstnpl_msg B_efstsk1_msg B_fst1sk_msg B_fstpler_msg B_fstplok_msg B_fstrok_msg B_fsttnp_msg B_fsttzu_msg B_tankab_msg B_tankdy_msg B_tankg_msg B_tankzu_msg B_tank_msg dfstigof_w_msg dfstigo_w_msg FlLvl_cntrFuLvlErr FlLvl_flgRefuPsbl FlLvl_flgVehStandStill FlLvl_volPlausyCycFuInj FlLvl_volSnsr1Stk fstalt_w fstalt_w_msg fsthin_w_msg /end OUT_MEASUREMENT
 /begin LOC_MEASUREMENT B_dfsininv B_dfstvfzg B_dtankm B_fplreff B_fstneu B_fstofen B_fstplcfm B_fstplen B_fstploki B_fstplre B_fstplref B_fsttab B_iok B_tankend dfskv_w dfstig_w dfstt_w dkvbigo_w dkvb_w FlDev_lenTotDstLstRlsDenom FlLvl_ctPlausyRst FlLvl_flgFstPlausyOkCfm FlLvl_flgFuSnsrRlsDenom FlLvl_flgLongStandStill FlLvl_flgTankEmptyResv FlLvl_flgTankFull FlLvl_flgVehHaltSeln FlLvl_flgVehMov FlLvl_lenDstSnceLstRlsDenom FlLvl_tiLongStandStillIni FlLvl_tiVehStandStill FlLv_cntrDualTankPlausRstrt FlLv_volLvlSnsrPlausChk fst1stk_w fstakt_w fstercnt fstokcnt fstold_w kvbmsold_w kvbmssum_w kvbold_w /end LOC_MEASUREMENT
 FUNCTION_VERSION "11.12.0" /end FUNCTION
/begin FUNCTION DFSTTDFP "11.10.0   Connection to DFPM for fuel level sensor diagnosis" /begin DEF_CHARACTERISTIC SF_FST /end DEF_CHARACTERISTIC
 /begin IN_MEASUREMENT B_cdfstr_msg B_cdfst_msg B_efstgth_msg B_efstmn_msg B_efstmx_msg B_efstnpl_msg B_efstsk1_msg B_fstplok_msg B_fstrok_msg B_fstsok1_msg FlLvl_flgFuSnsrPhyRngMaxErr FlLvl_flgFuSnsrPhyRngMinErr SyC_stSub /end IN_MEASUREMENT
 /begin OUT_MEASUREMENT B_clrfste_msg B_clrfst_msg B_fstelerr_msg B_fsttldv_msg /end OUT_MEASUREMENT
 FUNCTION_VERSION "11.10.0" /end FUNCTION
/begin FUNCTION DHDEVO "3.7.0     diagnosis open HDEV"
 /begin DEF_CHARACTERISTIC DHDEVE0P DHDEVE1P MISFZUL NMNDHDEVO NMXDHDEVO RDHDEVOCTR RLMXDHDEVO TDDHDEVOER /end DEF_CHARACTERISTIC
 /begin IN_MEASUREMENT abmhdev_msg Epm_nEngLRes Epm_numCyl MisfDet_stBlkStc MisfDet_stCatDmgFcoCyl MisfDet_stcEmiMisfCntrCyl MisfDet_stcEmiMisfCntrSum rl_msg SyC_stSub /end IN_MEASUREMENT
 /begin OUT_MEASUREMENT B_hdevo_msg /end OUT_MEASUREMENT
 /begin LOC_MEASUREMENT B_dhdevoe B_dhdevom B_mnhdr B_nodhdevo B_nomfcnt B_nomfdet DHDEVO_flgDsmClr100ms DHDEVO_flgDsmClr50ms DHDEVO_flgDsmClrSyncS0 InjSys_flgDHDEVOReIni InjSys_nEngLResDiagOpenInjVlv misfire nomisfcnt setdhdevo setdhdevos _stcEmiMisfCntrCyl _stcEmiMisfCntrCyl_100ms /end LOC_MEASUREMENT
 FUNCTION_VERSION "3.7.0" /end FUNCTION
/begin FUNCTION DiaActr_ElecHBrdgDiag "1.9.0     Diagnostic service for electrical error detection on H-Bridge power stage outputs"
 /begin DEF_CHARACTERISTIC DiaActr_ElecHBrdgDiag_DbgSigId_C DiaActr_ElecHBrdgDiag_DbgSigType_C DiaActr_ElecHBrdgDiag_OlEnaSwtOff_C /end DEF_CHARACTERISTIC
 /begin LOC_MEASUREMENT DiaActr_ElecHBrdgDiag_HBrDiagInfo_mp DiaActr_ElecHBrdgDiag_HlfBrDiagInfo_mp DiaActr_ElecHBrdgDiag_nrDiagErr_mp DiaActr_ElecHBrdgDiag_OLSigErrInfo_mp DiaActr_ElecHBrdgDiag_ReasOLAbort_mp DiaActr_ElecHBrdgDiag_SigErrInfo_mp DiaActr_ElecHBrdgDiag_stAddOLDiag_mp DiaActr_ElecHBrdgDiag_stDiagCtrl_mp DiaActr_ElecHBrdgDiag_stDiagDi_mp DiaActr_ElecHBrdgDiag_stOLAbortReq_mp DiaActr_ElecHBrdgDiag_stOLDiagMode_mp DiaActr_ElecHBrdgDiag_stOLDiag_mp DiaActr_ElecHBrdgDiag_stSigQly_mp DiaActr_ElecHBrdgDiag_TestPlsReq_mp /end LOC_MEASUREMENT
 FUNCTION_VERSION "1.9.0" /end FUNCTION
/begin FUNCTION DiaActr_ElecPsDiag "1.6.0     Standardized electrical power stage diagnosis for discrete output signals"
 /begin DEF_CHARACTERISTIC DiaActr_ElecPsDiag_DbgSigId_C DiaActr_ElecPsDiag_DbgSigTyp_C DiaActr_ElecPsDiag_SigOutDurgOpenLd_C /end DEF_CHARACTERISTIC
 /begin LOC_MEASUREMENT DiaActrElecPsDiag_cntTestPlsTsk_mp DiaActrElecPsDiag_nrDiagErr_mp DiaActrElecPsDiag_nrTestPls_mp DiaActrElecPsDiag_stAttribOL_mp DiaActrElecPsDiag_stAttribOT_mp DiaActrElecPsDiag_stAttribSCB_mp DiaActrElecPsDiag_stAttribSCG_mp DiaActrElecPsDiag_stDsmDebOpenLoad_mp DiaActrElecPsDiag_stDsmDebOverT_mp DiaActrElecPsDiag_stDsmDebScb_mp DiaActrElecPsDiag_stDsmDebScg_mp DiaActrElecPsDiag_stErrCfgOpenLoad_mp DiaActrElecPsDiag_stErrCfgOverT_mp DiaActrElecPsDiag_stErrCfgScb_mp DiaActrElecPsDiag_stErrCfgScg_mp DiaActrElecPsDiag_stPrvTstRslt_mp DiaActrElecPsDiag_stSigCfg_mp DiaActrElecPsDiag_stSigErrInfo_mp DiaActrElecPsDiag_stSig_mp DiaActrElecPsDiag_stTestPls_mp DiaActrElecPsDiag_stTmngTestPls_mp DiaActrElecPsDiag_tiTstPls_mp DiaActrElecPsDiag_TstPlsCnt_Cfg_mp /end LOC_MEASUREMENT
 FUNCTION_VERSION "1.6.0" /end FUNCTION
/begin FUNCTION DiaBas_BufAcs "30000.7.0 Functions for platform independent access (swapping) to data stored in an MSB buffer" FUNCTION_VERSION "30000.7.0" /end FUNCTION
/begin FUNCTION DiagCpt_1PSnsrTank "30201.3.0 Tank pressure sensor diagnosis (1 sensor)"
 /begin DEF_CHARACTERISTIC CCPVPLAUMX DiagCpt_mfMinOffsChkPSnsr_C DiagCpt_mfMinOffsEol_C DiagCpt_stOffsDiag_C DiagCpt_stPSnsrTankDiag_C DiagCpt_vMinOffsEol_C DMSNTEVMN DPCPVPOF DPDSTNPW DPTEKDTHMX DPTEKO ENVTDSTOMN ENVTDSTOMX ENVTDSTUMN ENVTDSTUMX FSTDSTOZMX FTEADSTOMN MSTEDSOMNL MSTEDSTOMN MSTEPOFH MSTEPTOFMN PSPUDSTMX PSPUTH PTEDOZ PTEINCERMN PTEINCERMX PTEKREFMN PTEKREFMNL PTEKREFMX PUREFDMX TDCPVPOF TDDSTCON TDDSTCPVA TDDSTCPVIA TDDSTD TDDSTMSTE TDDSTPTEK TDPTEKH TDSTPTEKS TDTESKOFF TDTHPTEK TEDSTO TPTEKSTOMX TPUREFDSMX TSTDSTO TTDSTDST TTDSTP TTEDOZ TTEDOZG VEHDDSTOMN VEHDDSTOMX VEHDSTMN VEHDSTMX VFZGGDSOMX VFZGGDSTMX ZKMSTDST /end DEF_CHARACTERISTIC
 /begin REF_CHARACTERISTIC HPUTEDU MSTEPTEK /end REF_CHARACTERISTIC
 /begin IN_MEASUREMENT B_cddst_msg B_fadstof_msg B_fstdmn_msg B_fstdmx_msg B_fsttg_msg B_fsttldv_msg B_llr_msg B_tankg_msg B_tank_msg B_tldcvs_msg EngStrt_bFrstStrtEnd EngStrt_bStrt EnvT_t Epm_stSpd fstt_w_msg ftead_w_msg mstedte_w_msg mstesnc_w_msg PEnv_p pspu_msg pteker_msg pteker_w_msg ptek_msg ptek_w_msg SyC_stSub VehV_v /end IN_MEASUREMENT
 /begin OUT_MEASUREMENT B_ddstnp_msg B_dstrerr_msg B_dstrir_msg B_eaavp_msg B_edstof_msg B_stdsto_msg B_stincch_msg B_stosch_msg B_zaavp_msg B_zdstof_msg dmsntev_w_msg pteaav_w_msg ptekmaxdst_w ptekmindst_w pteksfdt_w_msg /end OUT_MEASUREMENT
 /begin LOC_MEASUREMENT B_ambpof B_cpvacheck B_cpvacof B_cpvplaus B_cpvplwth B_ddstnpo B_ddstnpp B_dstden B_edstoft B_edstosci B_eincch B_ptekstof B_pustpof B_refdstd B_stincche B_stosche B_vfzpof B_zdstoft B_zdstosci B_zincch ccpvplaus DiagCpt_flgPSnsrTankClr DiagCpt_flgPSnsrTankIUMPRClr dptekdth_w dptekp_w dpte_w idmste_w mstedtf_w mstmxold_w mstmxsto_w ptekfdst_w ptekfdth_w ptekold ptekrefo_w ptekref_w ptemnsto_w ptkdfdst_w purefdsa_w TankP_pDifTankOffsChk TankP_pDifTankStuckChk tpteksto tpurefdst_w vfzggdst_w /end LOC_MEASUREMENT
 FUNCTION_VERSION "30201.3.0" /end FUNCTION
/begin FUNCTION DiagCpv_Basc "30301.11.0diagnosis canister purge valve basic coordination" /begin DEF_CHARACTERISTIC CstrPurg_stDiagCpvDteskSeln_C /end DEF_CHARACTERISTIC
 /begin IN_MEASUREMENT B_cdtes_msg B_fates_msg B_tldinfo_msg B_tldobd_msg B_tldto_msg msnstld_w_msg SyC_ctPostDrvLeave SyC_stSub /end IN_MEASUREMENT
 /begin OUT_MEASUREMENT B_dteaa_msg B_dtest_msg B_dtes_msg B_dtezamh_msg B_fatldtev_msg CstrPurg_flgCpvDiagDteskActv CstrPurg_flgDiagCpv1DteskLoLoad CstrPurg_flgTstrReq CstrPurg_mfDiagCpv1w FPCtl_flgCpvDiagFullEngModReq FPCtl_flgRqstShrtTrpCPV1MnfPurgLn InjSys_bCPVOpnForDia InjSys_bCPVRdyForDia /end OUT_MEASUREMENT
 /begin LOC_MEASUREMENT CstrPurg_flgCpvDiagDteskCpvOpenChk CstrPurg_flgCpvDiagDteskCpvStrtOpen DiagCpv_cntrReIniBasc1 DiagCpv_flgCpv1TrbCdnFirstActvn DiagCpv_flgCpv1TrbCdnSecActvn DiagCpv_flgCpv2TrbCdnFirstActvn DiagCpv_flgCpv2TrbCdnSecActvn DiagCpv_flgReIniBasc1 DiagCpv_tiPrpnSysActv DiagCpv_tiSumCpv1TrbCond DiagCpv_tiSumCpv2TrbCond /end LOC_MEASUREMENT
 FUNCTION_VERSION "30301.11.0" /end FUNCTION
/begin FUNCTION DiagCpv_PSnsrTankDsm "30201.1.0 CPV diagnosis by tank pressure sensor DSM" /begin REF_CHARACTERISTIC DDPTEKU DPDELTA /end REF_CHARACTERISTIC
 /begin IN_MEASUREMENT B_eaav_msg B_etvtldmn_msg B_etvtldmx_msg B_spdtetld_msg B_tldobd_msg B_zaav_msg B_ztevtld_msg CstrPurg_flgDiagCpv1DteskLoLoad pttr_w_msg PurgLeakDiag_flgCycCpvStuckClsdChk PurgLeakDiag_flgCycCpvStuckOpenChk SyC_stSub /end IN_MEASUREMENT
 FUNCTION_VERSION "30201.1.0" /end FUNCTION
/begin FUNCTION DiagLeakDtesk_Alg "30201.2.0 Tank leak diagnosis DTESK algorithm"
 /begin DEF_CHARACTERISTIC EvapDi_facEthnlMax_C EvapDi_facPGradCalcdThdFlexfu_M KFFUTNKCENGT KLENVT KLFACCORRALTI KLTLDSFS05 KLTLDSFSFA KLTLDSFSFG STFST10TLD /end DEF_CHARACTERISTIC
 /begin IN_MEASUREMENT B_fatld05_msg B_fatldeg_msg CEngDsT_t EnvT_t Eonv_stRejDiagResActv fstttld_w_msg gkomp_w_msg gudab_w_msg PEnv_facCorrAlti SyC_stSub TankLeakDiag_facEthnlSensVal tnse_w_msg zadiagpr_msg /end IN_MEASUREMENT
 /begin OUT_MEASUREMENT B_etesf_msg B_etesk_msg B_ztesf_msg B_ztesk_msg guatld05_w_msg guatld10_w_msg gudabkk10_w_msg gudabkk_w_msg gudabk_w_msg /end OUT_MEASUREMENT
 FUNCTION_VERSION "30201.2.0" /end FUNCTION
/begin FUNCTION DiagLeakDtesk_Dsm "30201.3.0 Tank leak diagnosis DTESK DSM"
 /begin DEF_CHARACTERISTIC CWTLDDD DDPTETA EvapDi_stObdOpt_C FuEvapLeak_cwCcvPErrIgr_C SDMGLVU TDDPTETA /end DEF_CHARACTERISTIC
 /begin REF_CHARACTERISTIC EvapDi_facEthnlMax_C MSNTVMX05 PurgLeakDiag_volDiagBlkdLineErrThd_C /end REF_CHARACTERISTIC
 /begin IN_MEASUREMENT aktlauf_msg B_cddtesk_msg B_dteskfzg_msg B_dteskpid_msg B_eaavp_msg B_eaav_msg B_eeonv_msg B_etesf_msg B_etesgg_msg B_fatld05_msg B_fstdmn_msg B_fstdmx_msg B_fsttldv_msg B_tankg_msg B_tank_msg B_tldbccon_msg B_tlddicon_msg B_tldinfo_msg B_tldklcon_msg B_tldobd_msg B_tldwdcon_msg B_zaavp_msg B_zaav_msg B_zeonv_msg B_ztesf_msg B_ztesgg_msg B_ztesk_msg ddpterl_w_msg Eonv_stLeakErrWoEwma Eonv_stRejDiagResActv guatld10_w_msg gudabk_w_msg mstedte_w_msg pdptedud_w_msg pteaav_w_msg pteksfdt_w_msg ptek_w_msg pttp_w_msg pttr_w_msg PurgLeakDiag_flgColdStrtVld PurgLeakDiag_flgDiagBlkdLineActv PurgLeakDiag_flgDiagBlkdLineCyc PurgLeakDiag_flgDiagBlkdLineErr PurgLeakDiag_flgTankLeakDiagFinshd PurgLeakDiag_volDiagBlkdLine SyC_stSub TankLeakDiag_facEthnlSensVal tldnostp_msg VehV_v zadiag_msg /end IN_MEASUREMENT
 /begin OUT_MEASUREMENT B_dsttesffcl_msg B_dteskddr_msg B_endtesk_msg B_etesgdd_msg B_etesgloc_msg B_spdtetld_msg B_tesfmilerr_msg B_tesfmil_msg B_tesgmilerr_msg B_tesgmil_msg B_ztesgdd_msg ztesggmx_w_msg /end OUT_MEASUREMENT
 /begin LOC_MEASUREMENT B_cmpltld B_dteskddv B_etesggv B_infoTESFmax B_infoTESGmax B_rlirn B_rlirnv B_rtldio B_tldrlcv B_tldvrlc DTESK_flgRstDsmDfp msnitldv_w msnv_w sdmglvav_w sdmglva_w ztesgg_w /end LOC_MEASUREMENT
 FUNCTION_VERSION "30201.3.0" /end FUNCTION
/begin FUNCTION DiagLeakDtesk_EnaCdn "30201.2.0 Tank leak diagnosis DTESK enable conditions"
 /begin DEF_CHARACTERISTIC CWCCVCLSD CWDTESKAPP CWDTESKEB CWDTESKSTC CWDTESKTEAD CWSFTEDAFA CWTLDOBD EvapDi_flgEthnlSnsrSwt_C FSTEADENMN FSTEADENMX HPUTEDU IMSTEMNTLD KLFTEADDTESK MXDTESK05 PNDKPUEB PTEKORMN PTEKORMX PurgLeakDiag_tAbortDlyEol_C PurgLeakDiag_tiColdStrtEngOffMin_C PurgLeakDiag_vMaxPrio_C PUTEDO SFTEDA05 SFTEDA05FA SFTEDAO05 TABORDELAY TDPURE TMNHTOHTLD TMSTLDHB05 TMSTLDMN05 TMSTLDMX05 TNODTES TNSETLD05 TPUTEDSV TRIRVFZG TTDTESKSTO TTEDFTE05 TTEDFTEO05 TTENCT05 TTENOT05 TTFTEADPTF TUMSRVTLDO TUMSRVTLDU TUMTHEB TUMTLDO TUMTLDU UBTEDO UBTEDU VFZGTLDEB VFZGTLDSRO ZADIAGSTOP /end DEF_CHARACTERISTIC
 /begin REF_CHARACTERISTIC EvapDi_facEthnlMax_C /end REF_CHARACTERISTIC
 /begin IN_MEASUREMENT aktend_msg BattU_u B_abbrtld_msg B_cddtesk_msg B_dtetk_msg B_endtesk_msg B_etesgloc_msg B_fatld05_msg B_fatldtev_msg B_fa_msg B_fstdmn_msg B_fstdmx_msg B_fsttg_msg B_fvlra_msg B_gae_msg B_iatlddu_msg B_iatldha_msg B_llr_msg B_lr_msg B_mstefg_msg B_te_msg B_tldav_msg B_tldpsd_msg B_tumgg_msg B_ztesgdd_msg B_ztesgg_msg CEngDsT_tStrtFrst EngStrt_bFrstStrtEnd EnvT_t Epm_stSpd ETHSCP_perEthRaw FfPrm_facEth FlLvl_flgMaxFuLvlDiagcFct FlLvl_flgMinFuLvlDiagcFct ftead_w_msg imsteini_msg InjSys_bInjVlvActv PEnv_p pndkpu_w_msg ptek_w_msg PurgLeakDiag_flgDiagBlkdLineActv SyC_stSub TiEngOff_stTiFirstStrt TiEngOff_tiFirstStrt tnsez_w_msg VehV_v zadiag_msg /end IN_MEASUREMENT
 /begin OUT_MEASUREMENT aktbeg_msg aktdtesk_msg aktlauf_msg B_dteskfzg_msg B_dteskpid_msg B_dte_msg B_priodesk_msg B_punxc_msg B_scatldo_msg B_tldbccon_msg B_tlddicon_msg B_tldhb05_msg B_tldinfo_msg B_tldklcon_msg B_tldklnx_msg B_tldmderr_msg B_tldobd_msg B_tldres_msg B_tldrlerr_msg B_tldstnai_msg B_tldstpt_msg B_tldstub_msg B_tldwdcon_msg B_tumgnxc_msg B_tumgsrv_msg PurgLeakDiag_flgColdStrtVld PurgLeakDiag_flgTankLeakDiagFinshd reqdtesk_msg TankLeakDiag_facEthnlSensVal tldnostp_msg /end OUT_MEASUREMENT
 /begin LOC_MEASUREMENT aktlauft aktloc aktstopt B_abbrtldloc B_dtesk05 B_priodest B_rirvfzg B_sstp B_tldbcstp B_tldtestp B_tldvfzg B_tmstkpid B_ztesgst ctdtesk05 fteadptf_w puold_w PurgLeakDiag_flgBlkdLineErr PurgLeakDiag_flgDlyNewIdle PurgLeakDiag_flgDSMChk PurgLeakDiag_flgDSMclr PurgLeakDiag_flgEnaCdnFuMixAdpn PurgLeakDiag_flgEnaCdnIdleCtrl PurgLeakDiag_stftead PurgLeakDiag_tAmbAir PurgLeakDiag_tCEngStrt PurgLeakDiag_uBatt PurgLeakDiag_vVeh rqdteskt tdpu_w tedfto05_w /end LOC_MEASUREMENT
 FUNCTION_VERSION "30201.2.0" /end FUNCTION
/begin COMPU_METHOD acc_q0p021701_m_DIV_s2 "" RAT_FUNC "%6.4" "m/s^2" COEFFS 0 1152 0 0 0 25 /end COMPU_METHOD
/begin COMPU_METHOD B_TRUE "" TAB_VERB "%6.3" "" COMPU_TAB_REF B_TRUE /end COMPU_METHOD
/begin COMPU_VTAB B_TRUE "" TAB_VERB 2 0 "FALSE" 1 "TRUE" /end COMPU_VTAB
/begin COMPU_METHOD dez "" RAT_FUNC "%6.2" "" COEFFS 0 1 0 0 0 1 /end COMPU_METHOD
/begin COMPU_METHOD DFES_LampFltMIL "" TAB_VERB "%6.3" "-" COMPU_TAB_REF DFES_LampFltMIL /end COMPU_METHOD
/begin COMPU_VTAB DFES_LampFltMIL "" TAB_VERB 4 0 "NO_Lamp_Activation" 1 "Continous_Lamp_Support" 2 "Blinking_Lamp_Support" 3 "Blinking_and_Continous_Lamp_Supp" /end COMPU_VTAB
/begin COMPU_METHOD DFES_LampFltSVS "" TAB_VERB "%6.3" "-" COMPU_TAB_REF DFES_LampFltSVS /end COMPU_METHOD
/begin COMPU_VTAB DFES_LampFltSVS "" TAB_VERB 6 0 "NO_Lamp_Activation" 1 "Continous_Lamp_Support" 2 "Blinking_Lamp_Support" 3 "Blinking_and_Continous_Lamp_Supp" 4 "Continuous_SVS_Support_LDF" 8 "Continuous_SVS_Support_LDF_FLC" /end COMPU_VTAB
/begin COMPU_METHOD DFES_TstVisAndPrio "" TAB_VERB "%6.3" "-" COMPU_TAB_REF DFES_TstVisAndPrio /end COMPU_METHOD
/begin COMPU_VTAB DFES_TstVisAndPrio "" TAB_VERB 13 3 "invisible_for_all_Testers" 5 "ServiceLow" 7 "ServiceHigh" 9 "ServiceHigh_PrioOffs_1" 11 "ServiceHigh_PrioOffs_2" 27 "ServiceHighPlus" 205 "OBDLow" 207 "OBDHigh" 209 "OBDHighPlus" 211 "ServiceHigh_MaxPrio" 213 "ServiceHigh_OBDLow_MaxPrio" 215 "ServiceHigh_OBDHigh_MaxPrio" 217 "ServiceHigh_OBDHighPlus_MaxPrio" /end COMPU_VTAB
/begin COMPU_METHOD dfp_verbal "" TAB_VERB "%6.3" "-" COMPU_TAB_REF dfp_verbal /end COMPU_METHOD
/begin COMPU_VTAB dfp_verbal "" TAB_VERB 83 0 "DFP_AAA" 1 "DFP_AAV" 2 "DFP_AAVE" 3 "DFP_AGRE" 4 "DFP_AGRS" 5 "DFP_DHFHD" 6 "DFP_DK" 7 "DFP_DK1P" 8 "DFP_DK2P" 9 "DFP_DKVS" 10 "DFP_DSKV" 11 "DFP_DSKVR" 12 "DFP_DSKVS" 13 "DFP_DSS" 14 "DFP_DSU" 15 "DFP_DVEE" 16 "DFP_DVEF" 17 "DFP_DVEFO" 18 "DFP_DVEL" 19 "DFP_DVEN" 20 "DFP_DVER" 21 "DFP_DVEU" 22 "DFP_DVEUB" 23 "DFP_DVEUW" 24 "DFP_DYLSU" 25 "DFP_ENWCS" 26 "DFP_ENWS" 27 "DFP_ENWSE" 28 "DFP_EONV" 29 "DFP_FP1P" 30 "DFP_FP2P" 31 "DFP_FRA" 32 "DFP_FST" 33 "DFP_FSTE" 34 "DFP_FSTR" 35 "DFP_FTDLA" 36 "DFP_HDR" 37 "DFP_HDRKH" 38 "DFP_HDRPL" 39 "DFP_HFM" 40 "DFP_HSH" 41 "DFP_HSHE" 42 "DFP_KAT" 43 "DFP_KPE" 44 "DFP_KS1" 45 "DFP_LLRH" 46 "DFP_LLRKH" 47 "DFP_LM" 48 "DFP_LSH" 49 "DFP_LZSR" 50 "DFP_MD" 51 "DFP_NWS" 52 "DFP_NWSE" 53 "DFP_ORA" 54 "DFP_PLLSU" 55 "DFP_PSR" 56 "DFP_PSR1" 57 "DFP_PSRB" 58 "DFP_PSRE" 59 "DFP_PSRP" 60 "DFP_PU" 61 "DFP_PUE" 62 "DFP_PUPL" 63 "DFP_PUR" 64 "DFP_STHDR" 65 "DFP_TA" 66 "DFP_TANKL" 67 "DFP_TANLCS" 68 "DFP_TANLPRC" 69 "DFP_TANLR" 70 "DFP_TASRCS" 71 "DFP_TASRE" 72 "DFP_TASRPRC" 73 "DFP_TASRR" 74 "DFP_TESF" 75 "DFP_TESG" 76 "DFP_TM" 77 "DFP_TMCS" 78 "DFP_TME" 79 "DFP_TMP" 80 "DFP_UB" 81 "DFP_VFZ" 82 "DFP_ZZZ" DEFAULT_VALUE "---" /end COMPU_VTAB
/begin COMPU_METHOD DiaActrElecPsDiag_stSig_COMPU_VERB "" TAB_VERB "%6.3" "" COMPU_TAB_REF DiaActrElecPsDiag_stSig_COMPU_VERB /end COMPU_METHOD
/begin COMPU_VTAB DiaActrElecPsDiag_stSig_COMPU_VERB "" TAB_VERB 7 0 "INVALID" 1 "NOTEST" 2 "NOFAULT" 3 "FAULT" 4 "PREFAULT" 5 "HEALFAULT" 6 "WAITSTATE" DEFAULT_VALUE "0" /end COMPU_VTAB
/begin COMPU_METHOD DiaActrElecPsDiag_stTestPls_COMPU_VERB "" TAB_VERB "%6.3" "" COMPU_TAB_REF DiaActrElecPsDiag_stTestPls_COMPU_VERB /end COMPU_METHOD
/begin COMPU_VTAB DiaActrElecPsDiag_stTestPls_COMPU_VERB "" TAB_VERB 5 1 "NO" 2 "REQUESTED" 3 "RUNNING" 4 "FINISHED" 5 "RE-TRIGGERED" DEFAULT_VALUE "1" /end COMPU_VTAB
/begin COMPU_METHOD DiaActrElecPsDiag_stTmngTestPls_COMPU_VERB "" TAB_VERB "%6.3" "" COMPU_TAB_REF DiaActrElecPsDiag_stTmngTestPls_COMPU_VERB /end COMPU_METHOD
/begin COMPU_VTAB DiaActrElecPsDiag_stTmngTestPls_COMPU_VERB "" TAB_VERB 4 1 "EVERY_RASTER" 2 "TIME_BETWEEN_TEST_1" 3 "TIME_BETWEEN_TEST_2" 0 "NO" DEFAULT_VALUE "0" /end COMPU_VTAB
/begin COMPU_METHOD DiaActr_ElecHBrdgDiag_DbgSigType_COMPU_VERB "" TAB_VERB "%6.3" "" COMPU_TAB_REF DiaActr_ElecHBrdgDiag_DbgSigType_COMPU_VERB /end COMPU_METHOD
/begin COMPU_VTAB DiaActr_ElecHBrdgDiag_DbgSigType_COMPU_VERB "" TAB_VERB 2 0 "HBR_SIGNAL" 1 "HLFBR_SIGNAL" DEFAULT_VALUE "0" /end COMPU_VTAB
/begin COMPU_METHOD DiaActr_ElecHBrdgDiag_OlEnaSwtOff_COMPU_VERB "" TAB_VERB "%6.3" "" COMPU_TAB_REF DiaActr_ElecHBrdgDiag_OlEnaSwtOff_COMPU_VERB /end COMPU_METHOD
/begin COMPU_VTAB DiaActr_ElecHBrdgDiag_OlEnaSwtOff_COMPU_VERB "" TAB_VERB 2 0 "NO_SWITCHOFF" 1 "SWITCHOFF" DEFAULT_VALUE "0" /end COMPU_VTAB
/begin COMPU_METHOD DiaActr_ElecPsDiag_DbgSigTyp_COMPU_VERB "" TAB_VERB "%6.3" "" COMPU_TAB_REF DiaActr_ElecPsDiag_DbgSigTyp_COMPU_VERB /end COMPU_METHOD
/begin COMPU_VTAB DiaActr_ElecPsDiag_DbgSigTyp_COMPU_VERB "" TAB_VERB 4 1 "DIGITAL_OUTPUT" 2 "PWM_OUTPUT" 3 "PMD_OUTPUT" 0 "NONE" DEFAULT_VALUE "0" /end COMPU_VTAB
/begin COMPU_METHOD DSMAUX_DTRGVerb "" TAB_VERB "%6.3" "-" COMPU_TAB_REF DSMAUX_DTRGVerb /end COMPU_METHOD
/begin COMPU_VTAB DSMAUX_DTRGVerb "" TAB_VERB 12 1 "DTRG_AlwaysTrue" 2 "DTRG_DrivingCycleFLC" 3 "DTRG_DrivingCycleHLC" 4 "DTRG_MDCatHLC" 5 "DTRG_MDEmiHLC" 6 "DTRG_MDEmiStrtHLC" 7 "DTRG_MDFLC2" 8 "DTRG_MDHLC2" 9 "DTRG_NoTrigger" 10 "DTRG_SimilarCondHLC" 0 "DTRG_Time200ms" 11 "DTRG_WarmUpCycle" DEFAULT_VALUE "---" /end COMPU_VTAB
/begin COMPU_METHOD EPM_DSQACTVT_SC_Compu "" TAB_VERB "%6.3" "" COMPU_TAB_REF EPM_DSQACTVT_SC_Compu /end COMPU_METHOD
/begin COMPU_VTAB EPM_DSQACTVT_SC_Compu "" TAB_VERB 2 0 "Inactive" 1 "Active" /end COMPU_VTAB
/begin COMPU_METHOD EPM_HIRESLSEGLENCAL_SC_Compu "" TAB_VERB "%6.3" "" COMPU_TAB_REF EPM_HIRESLSEGLENCAL_SC_Compu /end COMPU_METHOD
/begin COMPU_VTAB EPM_HIRESLSEGLENCAL_SC_Compu "" TAB_VERB 2 0 "False" 1 "True" /end COMPU_VTAB
/begin COMPU_METHOD EPM_IAPACTV_SC_Compu "" TAB_VERB "%6.3" "" COMPU_TAB_REF EPM_IAPACTV_SC_Compu /end COMPU_METHOD
/begin COMPU_VTAB EPM_IAPACTV_SC_Compu "" TAB_VERB 2 0 "IAP_OFF" 1 "IAP_ON" /end COMPU_VTAB
/begin COMPU_METHOD EPM_INDCAMSFTCFG_SC_Compu "" TAB_VERB "%6.3" "" COMPU_TAB_REF EPM_INDCAMSFTCFG_SC_Compu /end COMPU_METHOD
/begin COMPU_VTAB EPM_INDCAMSFTCFG_SC_Compu "" TAB_VERB 2 0 "False" 1 "True" /end COMPU_VTAB
/begin COMPU_METHOD EPM_KEEPDGISYNC_SC_Compu "" TAB_VERB "%6.3" "" COMPU_TAB_REF EPM_KEEPDGISYNC_SC_Compu /end COMPU_METHOD
/begin COMPU_VTAB EPM_KEEPDGISYNC_SC_Compu "" TAB_VERB 2 0 "STD" 1 "KEEPDGISYNC" /end COMPU_VTAB
/begin COMPU_METHOD EPM_MEASURE_SY_Compu "" TAB_VERB "%6.3" "" COMPU_TAB_REF EPM_MEASURE_SY_Compu /end COMPU_METHOD
/begin COMPU_VTAB EPM_MEASURE_SY_Compu "" TAB_VERB 3 0 "NO_MP" 1 "TEST_MP" 2 "RAW_AG_TEST_MP" /end COMPU_VTAB
/begin COMPU_METHOD EPM_NRAGEVE_SC_Compu "" RAT_FUNC "%6.2" "" COEFFS 0 1 0 0 0 1 /end COMPU_METHOD
/begin COMPU_METHOD EPM_NRVIRTSYN_SC_Compu "" RAT_FUNC "%6.2" "" COEFFS 0 1 0 0 0 1 /end COMPU_METHOD
/begin COMPU_METHOD EPM_OPTMRT_SC_Compu "" TAB_VERB "%6.3" "" COMPU_TAB_REF EPM_OPTMRT_SC_Compu /end COMPU_METHOD
/begin COMPU_VTAB EPM_OPTMRT_SC_Compu "" TAB_VERB 2 0 "OPTMRT_OFF" 1 "OPTMRT_ON" /end COMPU_VTAB
/begin COMPU_METHOD EPM_RVSROTPRED_SC_Compu "" TAB_VERB "%6.3" "" COMPU_TAB_REF EPM_RVSROTPRED_SC_Compu /end COMPU_METHOD
/begin COMPU_VTAB EPM_RVSROTPRED_SC_Compu "" TAB_VERB 2 0 "Deactvd" 1 "Inct_Ti_Thd" /end COMPU_VTAB
/begin COMPU_METHOD EPM_SPD_CALC_SY_Compu "" TAB_VERB "%6.3" "" COMPU_TAB_REF EPM_SPD_CALC_SY_Compu /end COMPU_METHOD
/begin COMPU_VTAB EPM_SPD_CALC_SY_Compu "" TAB_VERB 4 0 "SPD_IN_IGNEDGE" 1 "SPD_IN_WAITGAP" 2 "SPD_LOW_NEG" 3 "SPD_LOW_NEG_HIRES" /end COMPU_VTAB
/begin COMPU_METHOD EPM_STRTSELECT_SC_Compu "" TAB_VERB "%6.3" "" COMPU_TAB_REF EPM_STRTSELECT_SC_Compu /end COMPU_METHOD
/begin COMPU_VTAB EPM_STRTSELECT_SC_Compu "" TAB_VERB 5 0 "NO_SELECT" 1 "SEL_StaActV_C" 2 "SEL_StaActV_CA02" 3 "SEL_StaActV_CA03" 4 "SEL_StaActV_CA04" /end COMPU_VTAB
/begin COMPU_METHOD EPM_STRTWOCAMSFTSIGDETN_SC_Compu "" TAB_VERB "%6.3" "" COMPU_TAB_REF EPM_STRTWOCAMSFTSIGDETN_SC_Compu /end COMPU_METHOD
/begin COMPU_VTAB EPM_STRTWOCAMSFTSIGDETN_SC_Compu "" TAB_VERB 2 0 "Disabled" 1 "Enabled" /end COMPU_VTAB
/begin COMPU_METHOD EPM_SYNCSLV_SY_Compu "" TAB_VERB "%6.3" "" COMPU_TAB_REF EPM_SYNCSLV_SY_Compu /end COMPU_METHOD
/begin COMPU_VTAB EPM_SYNCSLV_SY_Compu "" TAB_VERB 2 0 "NO_SLV_SYNC" 1 "SLV_VIA_CAN_SYNC" /end COMPU_VTAB
/begin COMPU_METHOD EPM_TDCDSTCLB_SC_Compu "" TAB_VERB "%6.3" "" COMPU_TAB_REF EPM_TDCDSTCLB_SC_Compu /end COMPU_METHOD
/begin COMPU_VTAB EPM_TDCDSTCLB_SC_Compu "" TAB_VERB 2 0 "STANDARD" 1 "ARRAY" /end COMPU_VTAB
/begin COMPU_METHOD EPM_TIMING_SY_Compu "" TAB_VERB "%6.3" "" COMPU_TAB_REF EPM_TIMING_SY_Compu /end COMPU_METHOD
/begin COMPU_VTAB EPM_TIMING_SY_Compu "" TAB_VERB 3 0 "STD" 1 "HE_ONEBOX" 2 "RC_MASLV" /end COMPU_VTAB
/begin COMPU_METHOD EPM_VAR_SY_Compu "" TAB_VERB "%6.3" "" COMPU_TAB_REF EPM_VAR_SY_Compu /end COMPU_METHOD
/begin COMPU_VTAB EPM_VAR_SY_Compu "" TAB_VERB 48 0 "no customer" 1 "DAI" 3 "VWW" 4 "POR" 5 "AUD" 6 "OPE" 9 "FIA" 11 "BMW" 14 "PSA" 15 "REN" 17 "ALF" 18 "SAB" 19 "VOL" 20 "NIS" 21 "GMU" 22 "FOR" 26 "ISZ" 36 "MAN" 51 "SEA" 53 "CHR" 54 "JAG" 55 "ROL" 69 "FER" 72 "TOY" 123 "MIT" 147 "HYU" 159 "HON" 160 "MAZ" 183 "CU" 190 "LRG" 204 "VVW" 214 "AVT" 242 "Iveco" 243 "DMC" 248 "SUZ" 267 "SSANGYONG" 270 "KEF" 289 "AMG" 308 "TAT" 319 "MVM" 385 "UAES" 699 "AGCO" 828 "RBCD" 898 "MFTBC" 999 "ALL" 2887 "Nonox" 9454 "Fuso" 9740 "Navistar" /end COMPU_VTAB
/begin COMPU_METHOD EPSLOADSNSRONLY_SC_Compu "" TAB_VERB "%6.3" "" COMPU_TAB_REF EPSLOADSNSRONLY_SC_Compu /end COMPU_METHOD
/begin COMPU_VTAB EPSLOADSNSRONLY_SC_Compu "" TAB_VERB 2 0 "EPSLOADSNSRONLY_OFF" 1 "EPSLOADSNSRONLY_ON" /end COMPU_VTAB
/begin COMPU_METHOD ERCLNTVLVI_TYPAVL_SC_Compu "" TAB_VERB "%6.3" "" COMPU_TAB_REF ERCLNTVLVI_TYPAVL_SC_Compu /end COMPU_METHOD
/begin COMPU_VTAB ERCLNTVLVI_TYPAVL_SC_Compu "" TAB_VERB 2 0 "False" 1 "True" /end COMPU_VTAB
/begin COMPU_METHOD ERCLNTVLVT_TYPAVL_SC_Compu "" TAB_VERB "%6.3" "" COMPU_TAB_REF ERCLNTVLVT_TYPAVL_SC_Compu /end COMPU_METHOD
/begin COMPU_VTAB ERCLNTVLVT_TYPAVL_SC_Compu "" TAB_VERB 2 0 "False" 1 "True" /end COMPU_VTAB
/begin COMPU_METHOD ERCLNTVLV_TYPAVLACTRLIB_SY_Compu "" TAB_VERB "%6.3" "" COMPU_TAB_REF ERCLNTVLV_TYPAVLACTRLIB_SY_Compu /end COMPU_METHOD
/begin COMPU_VTAB ERCLNTVLV_TYPAVLACTRLIB_SY_Compu "" TAB_VERB 2 0 "False" 1 "True" /end COMPU_VTAB
/begin COMPU_METHOD ERCLNTVLV_TYPAVL_SY_Compu "" TAB_VERB "%6.3" "" COMPU_TAB_REF ERCLNTVLV_TYPAVL_SY_Compu /end COMPU_METHOD
/begin COMPU_VTAB ERCLNTVLV_TYPAVL_SY_Compu "" TAB_VERB 2 0 "FALSE" 1 "TRUE" /end COMPU_VTAB
/begin COMPU_METHOD ERRLMP_CUST_SY_Compu "" TAB_VERB "%6.3" "" COMPU_TAB_REF ERRLMP_CUST_SY_Compu /end COMPU_METHOD
/begin COMPU_VTAB ERRLMP_CUST_SY_Compu "" TAB_VERB 5 0 "ERRLMP_RB" 1 "ERRLMP_VAG" 2 "ERRLMP_BMW" 3 "ERRLMP_DAcom" 4 "ERRLMP_MSE" /end COMPU_VTAB
/begin COMPU_METHOD ERRLMP_UNIFY_SC_Compu "" TAB_VERB "%6.3" "" COMPU_TAB_REF ERRLMP_UNIFY_SC_Compu /end COMPU_METHOD
/begin COMPU_VTAB ERRLMP_UNIFY_SC_Compu "" TAB_VERB 2 0 "False" 1 "True" /end COMPU_VTAB
/begin COMPU_METHOD ERRREACHPINJVLVSTK_SY_Compu "" TAB_VERB "%6.3" "" COMPU_TAB_REF ERRREACHPINJVLVSTK_SY_Compu /end COMPU_METHOD
/begin COMPU_VTAB ERRREACHPINJVLVSTK_SY_Compu "" TAB_VERB 2 0 "FALSE" 1 "TRUE" /end COMPU_VTAB
/begin COMPU_METHOD ESC_ACTVTSYNCHAINCFG_SC_Compu "" TAB_VERB "%6.3" "" COMPU_TAB_REF ESC_ACTVTSYNCHAINCFG_SC_Compu /end COMPU_METHOD
/begin COMPU_VTAB ESC_ACTVTSYNCHAINCFG_SC_Compu "" TAB_VERB 3 0 "ACTVTSYNCHAIN_NONE" 1 "ACTVTSYNCHAIN_EBOS" 2 "ACTVTSYNCHAIN_ESC" /end COMPU_VTAB
/begin COMPU_METHOD ESC_ACTVTSYNTSKCHAIN_SC_Compu "" TAB_VERB "%6.3" "" COMPU_TAB_REF ESC_ACTVTSYNTSKCHAIN_SC_Compu /end COMPU_METHOD
/begin COMPU_VTAB ESC_ACTVTSYNTSKCHAIN_SC_Compu "" TAB_VERB 2 0 "DEACTIVE" 1 "ACTIVE" /end COMPU_VTAB
/begin COMPU_METHOD ESC_ENAPROCGROUP_SC_Compu "" TAB_VERB "%6.3" "" COMPU_TAB_REF ESC_ENAPROCGROUP_SC_Compu /end COMPU_METHOD
/begin COMPU_VTAB ESC_ENAPROCGROUP_SC_Compu "" TAB_VERB 2 0 "DISABLED" 1 "ENABLED" /end COMPU_VTAB
/begin COMPU_METHOD ESC_MONSYNCTSKACTV_SC_Compu "" TAB_VERB "%6.3" "" COMPU_TAB_REF ESC_MONSYNCTSKACTV_SC_Compu /end COMPU_METHOD
/begin COMPU_VTAB ESC_MONSYNCTSKACTV_SC_Compu "" TAB_VERB 2 0 "ESC_MOSYNCTSK_INACTIVE" 1 "ESC_MOSYNCTSK_ACTIVE" /end COMPU_VTAB
/begin COMPU_METHOD ESC_NRAGEVEWCYC_SC_Compu "" RAT_FUNC "%6.2" "" COEFFS 0 1 0 0 0 1 /end COMPU_METHOD
/begin COMPU_METHOD ESC_NRTSKAGEVE_SC_Compu "" RAT_FUNC "%6.2" "" COEFFS 0 1 0 0 0 1 /end COMPU_METHOD
/begin COMPU_METHOD ESC_SAMPLETICALCN_SC_Compu "" TAB_VERB "%6.3" "" COMPU_TAB_REF ESC_SAMPLETICALCN_SC_Compu /end COMPU_METHOD
/begin COMPU_VTAB ESC_SAMPLETICALCN_SC_Compu "" TAB_VERB 2 0 "SEG_AG_BASD" 1 "TSK_TI_STAMP_BASD" /end COMPU_VTAB
/begin COMPU_METHOD ESC_SELNCAMSFTTSKACTVN_SC_Compu "" TAB_VERB "%6.3" "" COMPU_TAB_REF ESC_SELNCAMSFTTSKACTVN_SC_Compu /end COMPU_METHOD
/begin COMPU_VTAB ESC_SELNCAMSFTTSKACTVN_SC_Compu "" TAB_VERB 3 0 "NO_CAMSFTTSKACTVN" 1 "PLAT_CAMSFTTSKACTVN" 2 "HDP_CAMSFTTSKACTVN" /end COMPU_VTAB
/begin COMPU_METHOD ESC_SELNMETHSYNSDL_SC_Compu "" TAB_VERB "%6.3" "" COMPU_TAB_REF ESC_SELNMETHSYNSDL_SC_Compu /end COMPU_METHOD
/begin COMPU_VTAB ESC_SELNMETHSYNSDL_SC_Compu "" TAB_VERB 2 0 "OS_TSK_BASD_SDL" 1 "ESC_CNTNR_BASD_SDL" /end COMPU_VTAB
/begin COMPU_METHOD ESC_SELNNOTSTDTISYNCNTSK_SC_Compu "" TAB_VERB "%6.3" "" COMPU_TAB_REF ESC_SELNNOTSTDTISYNCNTSK_SC_Compu /end COMPU_METHOD
/begin COMPU_VTAB ESC_SELNNOTSTDTISYNCNTSK_SC_Compu "" TAB_VERB 2 0 "NO_SELN" 1 "40ms" /end COMPU_VTAB
/begin COMPU_METHOD ESC_SELSAMPLETICFGMETHOD_SC_Compu "" TAB_VERB "%6.3" "" COMPU_TAB_REF ESC_SELSAMPLETICFGMETHOD_SC_Compu /end COMPU_METHOD
/begin COMPU_VTAB ESC_SELSAMPLETICFGMETHOD_SC_Compu "" TAB_VERB 2 0 "MAN_CFG_METHOD" 1 "AUT_CFG_METHOD" /end COMPU_VTAB
/begin COMPU_METHOD ESC_SWTSYNRTMEASMT_SC_Compu "" TAB_VERB "%6.3" "" COMPU_TAB_REF ESC_SWTSYNRTMEASMT_SC_Compu /end COMPU_METHOD
/begin COMPU_VTAB ESC_SWTSYNRTMEASMT_SC_Compu "" TAB_VERB 2 0 "False" 1 "True" /end COMPU_VTAB
/begin COMPU_METHOD ESC_SYNCTASK_SC_Compu "" TAB_VERB "%6.3" "" COMPU_TAB_REF ESC_SYNCTASK_SC_Compu /end COMPU_METHOD
/begin COMPU_VTAB ESC_SYNCTASK_SC_Compu "" TAB_VERB 3 0 "0" 1 "1" 2 "2" /end COMPU_VTAB
/begin COMPU_METHOD fak_sw_b64 "" RAT_FUNC "%6.4" "-" COEFFS 0 65536 0 0 0 128 /end COMPU_METHOD
/begin COMPU_METHOD fak_ub_b2 "" RAT_FUNC "%8.5" "-" COEFFS 0 256 0 0 0 2 /end COMPU_METHOD
/begin COMPU_METHOD fak_uw_b2 "" RAT_FUNC "%7.6" "-" COEFFS 0 65536 0 0 0 2 /end COMPU_METHOD
/begin COMPU_METHOD fak_uw_b4 "" RAT_FUNC "%7.6" "-" COEFFS 0 65536 0 0 0 4 /end COMPU_METHOD
/begin COMPU_METHOD Length "" RAT_FUNC "%6.2" "m" COEFFS 0 1 0 0 0 1 /end COMPU_METHOD
/begin COMPU_METHOD m_3p47222Em4_g "" RAT_FUNC "%6.5" "g" COEFFS 0 2880 0 0 0 1 /end COMPU_METHOD
/begin COMPU_METHOD m_ub_q0p0444 "" RAT_FUNC "%6.4" "g" COEFFS 0 1 0 0 0 0.0444 /end COMPU_METHOD
/begin COMPU_METHOD m_uw_b25p6 "" RAT_FUNC "%6.5" "kg/h" COEFFS 0 65536 0 0 0 25.6 /end COMPU_METHOD
/begin COMPU_METHOD nmot_ub_q40 "" RAT_FUNC "%6.1" "1/min" COEFFS 0 1 0 0 0 40 /end COMPU_METHOD
/begin COMPU_METHOD OneToOne "" RAT_FUNC "%6.2" "-" COEFFS 0 1 0 0 0 1 /end COMPU_METHOD
/begin COMPU_METHOD pgrad_q2p38Em5 "" RAT_FUNC "%7.6" "hPa/s" COEFFS 0 65536 0 0 0 1.5625 /end COMPU_METHOD
/begin COMPU_METHOD p_q0p00122 "" RAT_FUNC "%6.4" "hPa" COEFFS 0 65536 0 0 0 80 /end COMPU_METHOD
/begin COMPU_METHOD p_q0p3125 "" RAT_FUNC "%6.3" "hPa" COEFFS 0 256 0 0 0 80 /end COMPU_METHOD
/begin COMPU_METHOD p_sw_q0p00244 "" RAT_FUNC "%6.4" "hPa" COEFFS 0 32768 0 0 0 80 /end COMPU_METHOD
/begin COMPU_METHOD p_uw_q0p039 "" RAT_FUNC "%6.4" "hPa" COEFFS 0 256 0 0 0 10 /end COMPU_METHOD
/begin COMPU_METHOD rel_ub_q0p75 "" RAT_FUNC "%6.3" "%" COEFFS 0 1 0 0 0 0.75 /end COMPU_METHOD
/begin COMPU_METHOD Signals_IntSigNumVerb "" TAB_VERB "%6.3" "" COMPU_TAB_REF Signals_IntSigNumVerb /end COMPU_METHOD
/begin COMPU_VTAB Signals_IntSigNumVerb "" TAB_VERB 1169 0 "SIGNALS_Signals_Default" 1 "SIGNALS_APP_rUnFlt" 2 "SIGNALS_APP_r_sig" 3 "SIGNALS_APP_r_signal" 4 "SIGNALS_APP_uRaw1_signal" 5 "SIGNALS_APP_uRaw2_signal" 6 "SIGNALS_AbsLdCom8Bit_PID43h" 7 "SIGNALS_AccPed_tqMapBasd_BENG_signal" 8 "SIGNALS_AccPed_tqMapBasd_TRQB_signal" 9 "SIGNALS_ActMod_trqInr_signal" 10 "SIGNALS_AirC_uAnaRawClnt_signal" 11 "SIGNALS_Alt_iExctLim_signal" 12 "SIGNALS_Alt_rAltExct_signal" 13 "SIGNALS_Alt_uFinalDes_signal" 14 "SIGNALS_BattU_u" 15 "SIGNALS_BattU_uSens1_signal" 16 "SIGNALS_BattU_uSens2_s" 17 "SIGNALS_BattU_uSens_signal" 18 "SIGNALS_Batt_lMaxCnsChk_signal" 19 "SIGNALS_Batt_lMinCnsChk_signal" 20 "SIGNALS_Batt_qCnsChkAH_signal" 21 "SIGNALS_Brk_st" 22 "SIGNALS_Brk_stRed" 23 "SIGNALS_CEngDsT_uRaw_s" 24 "SIGNALS_CEngDsT_uRaw_signal" 25 "SIGNALS_CEngUsT_t_signal" 26 "SIGNALS_CEngUsT_uSnsr_s" 27 "SIGNALS_CoEng_tiCranking_signal" 28 "SIGNALS_CoVeh_trqAcs_s" 29 "SIGNALS_ComEBS_BattID_signal" 30 "SIGNALS_ComEBS_rBattSensCh_signal" 31 "SIGNALS_ComEBS_rBattStrat_signal" 32 "SIGNALS_ComEBS_uBattSens_signal" 33 "SIGNALS_ComEBS_uBattUCO_signal" 34 "SIGNALS_Com_iBattEBS_signal" 35 "SIGNALS_Com_lDst_signal" 36 "SIGNALS_Com_rMeasdBattREbs_signal" 37 "SIGNALS_Com_stI_signal" 38 "SIGNALS_Com_stT_signal" 39 "SIGNALS_Com_stU_signal" 40 "SIGNALS_Com_tBattEBS_signal" 41 "SIGNALS_Com_trqAYCFDes_signal" 42 "SIGNALS_Com_uPeak_signal" 43 "SIGNALS_CrCtl_stShutOffCode0_signal" 44 "SIGNALS_CrCtl_stShutOffCode1_signal" 45 "SIGNALS_CrCtl_stShutOffCode2_signal" 46 "SIGNALS_CrCtl_stShutOffCode3_signal" 47 "SIGNALS_CrCtl_stShutOffCode4_signal" 48 "SIGNALS_CrCtl_stShutOffCode5_signal" 49 "SIGNALS_CrCtl_stShutOffCode6_signal" 50 "SIGNALS_CrCtl_stShutOffCode7_signal" 51 "SIGNALS_CrCtl_stShutOffCode8_signal" 52 "SIGNALS_CrCtl_stShutOffCode9_signal" 53 "SIGNALS_DIUMPR_ctGenDenom_signal" 54 "SIGNALS_DIUMPR_ctIgn_signal" 55 "SIGNALS_DRIVE_numDTCFrz_s" 56 "SIGNALS_DRIVE_stCurTrgMode_signal" 57 "SIGNALS_DRIVE_stHardToStrt_s" 58 "SIGNALS_DSM_tiMICumCont" 59 "SIGNALS_DcmDspUDS_rdbi_2612Byte10_signal" 60 "SIGNALS_DcmDspUDS_rdbi_2612Byte11_signal" 61 "SIGNALS_DcmDspUDS_rdbi_fixed_signal" 62 "SIGNALS_DcmDspUDS_rdbi_reserved0_signal_s" 63 "SIGNALS_DcmDspUDS_rdbi_reserved0_signal_w_s" 64 "SIGNALS_DcmDspUDS_rdbi_reserved1_signal" 65 "SIGNALS_Dspl_stCrsSwtInfo_signal" 66 "SIGNALS_Ebs_qBliChrg_signal" 67 "SIGNALS_Ebs_qBliDchaTotDcyc_0_signal" 68 "SIGNALS_Ebs_qBliDchaTotDcyc_1_signal" 69 "SIGNALS_Ebs_qBliDchaTotDcyc_2_signal" 70 "SIGNALS_Ebs_qBliDchaTotDcyc_3_signal" 71 "SIGNALS_Ebs_qBliDchaTotDcyc_4_signal" 72 "SIGNALS_Ebs_qBliDcha_signal" 73 "SIGNALS_Ebs_stStbIEBSByt0_0_signal" 74 "SIGNALS_Ebs_stStbIEBSByt0_1_signal" 75 "SIGNALS_Ebs_stStbIEBSByt0_2_signal" 76 "SIGNALS_Ebs_stStbIEBSByt0_3_signal" 77 "SIGNALS_Ebs_stStbIEBSByt0_4_signal" 78 "SIGNALS_Ebs_stStbIEBSByt1_0_signal" 79 "SIGNALS_Ebs_stStbIEBSByt1_1_signal" 80 "SIGNALS_Ebs_stStbIEBSByt1_2_signal" 81 "SIGNALS_Ebs_stStbIEBSByt1_3_signal" 82 "SIGNALS_Ebs_stStbIEBSByt1_4_signal" 83 "SIGNALS_Ebs_stStbIEBSByt2_0_signal" 84 "SIGNALS_Ebs_stStbIEBSByt2_1_signal" 85 "SIGNALS_Ebs_stStbIEBSByt2_2_signal" 86 "SIGNALS_Ebs_stStbIEBSByt2_3_signal" 87 "SIGNALS_Ebs_stStbIEBSByt2_4_signal" 88 "SIGNALS_Ebs_stStbIEBSByt3_0_signal" 89 "SIGNALS_Ebs_stStbIEBSByt3_1_signal" 90 "SIGNALS_Ebs_stStbIEBSByt3_2_signal" 91 "SIGNALS_Ebs_stStbIEBSByt3_3_signal" 92 "SIGNALS_Ebs_stStbIEBSByt3_4_signal" 93 "SIGNALS_Ebs_stStbIEBSByt4_0_signal" 94 "SIGNALS_Ebs_stStbIEBSByt4_1_signal" 95 "SIGNALS_Ebs_stStbIEBSByt4_2_signal" 96 "SIGNALS_Ebs_stStbIEBSByt4_3_signal" 97 "SIGNALS_Ebs_stStbIEBSByt4_4_signal" 98 "SIGNALS_EngTrqPtd_trqLead_s" 99 "SIGNALS_EngTrqPtd_trqLead_signal" 100 "SIGNALS_EngTrqPtd_trqSet_s" 101 "SIGNALS_EngTrqPtd_trqSet_signal" 102 "SIGNALS_EpmCaS_ctErrSig_signal" 103 "SIGNALS_EpmCaS_ctNoSig_signal" 104 "SIGNALS_EpmCaS_phiDiffCal2AdapEqAvg_0" 105 "SIGNALS_EpmCaS_phiOfsCorr" 106 "SIGNALS_Epm_nEngAct" 107 "SIGNALS_Epm_nEngRaw_s" 108 "SIGNALS_Epm_nEngRaw_signal" 109 "SIGNALS_Epm_stOpMode" 110 "SIGNALS_Epm_stSync" 111 "SIGNALS_FuPHi_uHiResl_signal" 112 "SIGNALS_GEVlv_ratPhaIntkB1_signal" 113 "SIGNALS_GlbDa_lenTotDstDcycHiResl_signal" 114 "SIGNALS_HEGO_uS2B1Extd_s" 115 "SIGNALS_HEGO_uS2B1HiRes_signal" 116 "SIGNALS_I14229CoEng_tiNormalOBDPrevDcyc_s" 117 "SIGNALS_I14229EpmCaS_ctErrSig1_signal" 118 "SIGNALS_I14229EpmCaS_ctNoSig1_signal" 119 "SIGNALS_I14229GlbDa_lTotDstDCHiReslPrevDcyc_s" 120 "SIGNALS_I14229IntkAirT_tSnsrTstrMax_s" 121 "SIGNALS_I14229IntkAirT_tSnsrTstrMin_s" 122 "SIGNALS_I14229RDBI_nOvrSpd_signal" 123 "SIGNALS_I14229RDBI_tiOvrSpd_signal" 124 "SIGNALS_I14229_AirC_pAnaClnt_signal" 125 "SIGNALS_I14229_ElecLd_iEPSLoadOnly_signal" 126 "SIGNALS_I14229_EpmCaS_ctErrSig2_signal" 127 "SIGNALS_I14229_EpmCaS_ctNoSig2_signal" 128 "SIGNALS_I14229_EpmCrS_ctCaSRev_signal" 129 "SIGNALS_I14229_EpmCrS_ctErrSig_signal" 130 "SIGNALS_I14229_GEVCtl_agMaxAdpdIntk_signal" 131 "SIGNALS_I14229_Gbx_uAna1NPosRaw_signal" 132 "SIGNALS_I14229_Gbx_uAna2NPosRaw_signal" 133 "SIGNALS_I14229_ivzabg_w_signal" 134 "SIGNALS_I14229_lDst_signal" 135 "SIGNALS_I14229_nstat_signal" 136 "SIGNALS_I14229_numDTCFrzFrmHi_signal" 137 "SIGNALS_I14229_numDTCFrzFrmLo_signal" 138 "SIGNALS_I14229_numDTCFrzFrmMid_signal" 139 "SIGNALS_I14229_ps_w_signal" 140 "SIGNALS_I14229_rTrqPT_signal" 141 "SIGNALS_I14229_stTURBODV_signal" 142 "SIGNALS_I14229_tSnsrFild1_signal" 143 "SIGNALS_I14229_tiInj1On_signal" 144 "SIGNALS_I14229_tiOilFlowCompl_signal" 145 "SIGNALS_I14229_tiSia_signal" 146 "SIGNALS_I14229_tkaMax_s" 147 "SIGNALS_I14229_tkaMin_s" 148 "SIGNALS_I14229_tka_signal" 149 "SIGNALS_I14229_tmotMaxCurrDcyc_s" 150 "SIGNALS_I14229_tmotMaxPrevDcyc_s" 151 "SIGNALS_I14229_tmotMinCurrDcyc_s" 152 "SIGNALS_I14229_tmotMinPrevDcyc_s" 153 "SIGNALS_I14229_ubsq_signal" 154 "SIGNALS_I14229_umsrln_w_signal" 155 "SIGNALS_I14229_wdks_w_signal" 156 "SIGNALS_I14229_wped1_signal" 157 "SIGNALS_I14229_wped2_signal" 158 "SIGNALS_I14229_zwist_signal" 159 "SIGNALS_I14229iocpMDA_numABV_signal" 160 "SIGNALS_I14229iocpMDA_numACGC_signal" 161 "SIGNALS_I14229iocpMDA_numAPS_signal" 162 "SIGNALS_I14229iocpMDA_numPSC_signal" 163 "SIGNALS_I14229iocpMDA_numRFAN_signal" 164 "SIGNALS_I14229iocpMDA_numRvsLck_signal" 165 "SIGNALS_I14229iocpMDA_numVTEC_signal" 166 "SIGNALS_I14229iocp_numCtlSt_s" 167 "SIGNALS_I14229iocp_numEXE_signal" 168 "SIGNALS_I14229iocp_numREQ_s" 169 "SIGNALS_I14229iocp_stSFTRJC_s" 170 "SIGNALS_I15031_PID1Dh" 171 "SIGNALS_I15031_PID65Ah" 172 "SIGNALS_I15031_PID66Ah" 173 "SIGNALS_I15031_PID69Ah" 174 "SIGNALS_I15031_PID6AAh" 175 "SIGNALS_I15031_PID6BAh" 176 "SIGNALS_I15031_PID6CAh" 177 "SIGNALS_I15031_PID6DAh" 178 "SIGNALS_I15031_PID6EAh" 179 "SIGNALS_I15031_PID6FAh" 180 "SIGNALS_I15031_PID70Ah" 181 "SIGNALS_I15031_PID71Ah" 182 "SIGNALS_I15031_PID72Ah" 183 "SIGNALS_I15031_PID73Ah" 184 "SIGNALS_I15031_PID74Ah" 185 "SIGNALS_I15031_PID75Ah" 186 "SIGNALS_I15031_PID76Ah" 187 "SIGNALS_I15031_PID77Ah" 188 "SIGNALS_I15031_PID78Ah" 189 "SIGNALS_I15031_PID79Ah" 190 "SIGNALS_I15031_PID7AAh" 191 "SIGNALS_I15031_PID7BAh" 192 "SIGNALS_I15031_PID7CAh" 193 "SIGNALS_I15031_PID7FAh" 194 "SIGNALS_I15031_PID81Ah" 195 "SIGNALS_I15031_PID82Ah" 196 "SIGNALS_I15031_PID85Ah" 197 "SIGNALS_I15031_PID86Ah" 198 "SIGNALS_I15031_PID87Ah" 199 "SIGNALS_I15031_PID89Ah" 200 "SIGNALS_I15031_PID8AAh" 201 "SIGNALS_I15031_PID8FAh" 202 "SIGNALS_I15031_PID92Ah" 203 "SIGNALS_I15031_PID93Ah" 204 "SIGNALS_I15031_PID94Ah" 205 "SIGNALS_I15031_PID98Ah" 206 "SIGNALS_I15031_PID99Ah" 207 "SIGNALS_I15031_PID9CAh" 208 "SIGNALS_I15031_PIDA3Ah" 209 "SIGNALS_I15031_PIDA4Ah" 210 "SIGNALS_I15031_PIDA5Ah" 211 "SIGNALS_I15031_PIDA9Ah" 212 "SIGNALS_I15031_PIDACAh" 213 "SIGNALS_IKCtl_agKnkAvrg_s8_signal" 214 "SIGNALS_InjSys_volFuConsDrvCycCAN_s" 215 "SIGNALS_IntkAirT_tSnsr2_signal" 216 "SIGNALS_IntkAirT_uSnsr1Exprt_signal" 217 "SIGNALS_IntkAirT_uSnsr3CrssSwtLoc_s" 218 "SIGNALS_MoF_rTrqInrAct_s" 219 "SIGNALS_MoF_rTrqPtdFlt_s" 220 "SIGNALS_OBD_ITID_InjSys_volFuConsDrvgCycTstrSrv" 221 "SIGNALS_OilSwmpT_uSnsrRaw_s" 222 "SIGNALS_Oil_pSensPSwmp_signal" 223 "SIGNALS_Oil_uRawPSwmp_signal" 224 "SIGNALS_PID01h" 225 "SIGNALS_PID03h_0" 226 "SIGNALS_PID03h_1" 227 "SIGNALS_PID04h" 228 "SIGNALS_PID05h" 229 "SIGNALS_PID06h_0" 230 "SIGNALS_PID07h_0" 231 "SIGNALS_PID0Ch_Epm_nEng" 232 "SIGNALS_PID0D_VehV_vSens" 233 "SIGNALS_PID0Eh" 234 "SIGNALS_PID0Fh" 235 "SIGNALS_PID0bh_PIntkVUs_pRawObd" 236 "SIGNALS_PID10h" 237 "SIGNALS_PID11h_ThrVlv_ratActSens1AbsltB1_u8" 238 "SIGNALS_PID13h" 239 "SIGNALS_PID15h_0" 240 "SIGNALS_PID15h_1" 241 "SIGNALS_PID1Ch" 242 "SIGNALS_PID1Fh_TiScneEngStrt" 243 "SIGNALS_PID21h" 244 "SIGNALS_PID23h" 245 "SIGNALS_PID2Ch_EGRVlv_rCmdNrm" 246 "SIGNALS_PID2Dh_EGRVlv_rGovDvtNrm" 247 "SIGNALS_PID2Eh" 248 "SIGNALS_PID2Fh" 249 "SIGNALS_PID30h" 250 "SIGNALS_PID31h" 251 "SIGNALS_PID33h_PEnv_pRaw" 252 "SIGNALS_PID34h_0" 253 "SIGNALS_PID34h_1" 254 "SIGNALS_PID3Ch" 255 "SIGNALS_PID41h" 256 "SIGNALS_PID42_BattU_uSens" 257 "SIGNALS_PID43h" 258 "SIGNALS_PID44h" 259 "SIGNALS_PID45h_ThrVlv_ratActSens1RelB1_u8" 260 "SIGNALS_PID46h" 261 "SIGNALS_PID47h_ThrVlv_ratActSens2AbsltB1_u8" 262 "SIGNALS_PID49_APP_uRaw1unLim" 263 "SIGNALS_PID4A_APP_uRaw2unLim" 264 "SIGNALS_PID4Ch_wdks_msg" 265 "SIGNALS_PID4FAh" 266 "SIGNALS_PID4FBh" 267 "SIGNALS_PID4FCh" 268 "SIGNALS_PID4FDh" 269 "SIGNALS_PID50Ah" 270 "SIGNALS_PID50Bh" 271 "SIGNALS_PID50Ch" 272 "SIGNALS_PID50Dh" 273 "SIGNALS_PID51h_PID51_stFuTyp" 274 "SIGNALS_PID52h" 275 "SIGNALS_PID56h_0" 276 "SIGNALS_PID5A_APP_rOBDPID5A" 277 "SIGNALS_PID5Eh_InjSys_volEngFuCnsPerHr" 278 "SIGNALS_PID5Fh" 279 "SIGNALS_PID62h_TME_ratActEngPercTqPrmIdH62" 280 "SIGNALS_IntFloat_PID63h_TqEngRef" 281 "SIGNALS_PID67h_ects2sva_msg" 282 "SIGNALS_PID67h_ects2svb_msg" 283 "SIGNALS_PID67h_ects2svc_msg" 284 "SIGNALS_PID68h_iats2sva" 285 "SIGNALS_PID68h_iats2svb" 286 "SIGNALS_PID68h_iats2svc" 287 "SIGNALS_PID68h_iats2svd" 288 "SIGNALS_PID68h_iats2sve" 289 "SIGNALS_PID68h_iats2svf" 290 "SIGNALS_PID68h_iats2svg" 291 "SIGNALS_PID69h_EGRVlv_rActNrm" 292 "SIGNALS_PID69h_EGRVlv_rCmdNrm" 293 "SIGNALS_PID69h_EGRVlv_rGovDvtNrm" 294 "SIGNALS_PID7Fh_RTId_TotRt" 295 "SIGNALS_PID7Fh_RtId_TotIdleRt" 296 "SIGNALS_PID7Fh_RtId_TotPtoRt" 297 "SIGNALS_PID87h_PIntkVUs_pRawObd" 298 "SIGNALS_PID8BAh" 299 "SIGNALS_PID8CAh" 300 "SIGNALS_PID8Eh_TME_ratEngFricPercTqPrmIdH8E" 301 "SIGNALS_PID93BCh" 302 "SIGNALS_PID9AAh" 303 "SIGNALS_PID9Dh_InjSys_mfEngFuRate" 304 "SIGNALS_PID9Dh_InjSys_mfVehFuRate" 305 "SIGNALS_PID9FAh" 306 "SIGNALS_PIDA6h_lTotDst" 307 "SIGNALS_PID_FILLSIG_1BIT" 308 "SIGNALS_PID_FILLSIG_1BITNZ" 309 "SIGNALS_PID_FILLSIG_1BYTE" 310 "SIGNALS_PID_FILLSIG_1BYTENZ" 311 "SIGNALS_PID_FILLSIG_2BIT" 312 "SIGNALS_PID_FILLSIG_2BITNZ" 313 "SIGNALS_PID_FILLSIG_2BYTE" 314 "SIGNALS_PID_FILLSIG_2BYTENZ" 315 "SIGNALS_PID_FILLSIG_3BIT" 316 "SIGNALS_PID_FILLSIG_3BITNZ" 317 "SIGNALS_PID_FILLSIG_4BIT" 318 "SIGNALS_PID_FILLSIG_4BITNZ" 319 "SIGNALS_PID_FILLSIG_4BYTE" 320 "SIGNALS_PID_FILLSIG_4BYTENZ" 321 "SIGNALS_PID_FILLSIG_5BIT" 322 "SIGNALS_PID_FILLSIG_5BITNZ" 323 "SIGNALS_PID_FILLSIG_6BIT" 324 "SIGNALS_PID_FILLSIG_6BITNZ" 325 "SIGNALS_PID_FILLSIG_7BIT" 326 "SIGNALS_PID_FILLSIG_7BITNZ" 327 "SIGNALS_PIntkVUs_uRawUnFlt_signal" 328 "SIGNALS_PT_rGrip_signal" 329 "SIGNALS_PT_trqLos_signal" 330 "SIGNALS_PThrVlvUs_uRawB1_signal" 331 "SIGNALS_PthLead_trqInrNoMon_s" 332 "SIGNALS_PthLead_trqInrNoMon_signal" 333 "SIGNALS_PthSet_trqInrIABef_s" 334 "SIGNALS_PthSet_trqInrLtd_s" 335 "SIGNALS_RngMod_trqDiffAdap_signal" 336 "SIGNALS_RngMod_trqDiffAdap_signal_s" 337 "SIGNALS_RngMod_trqInrBs_s" 338 "SIGNALS_SIGNAL_GEVlv_agSumSpCsersDeIntkB1" 339 "SIGNALS_Strt_uStrtMonDia_signal" 340 "SIGNALS_TWCD_numMeasB1_s" 341 "SIGNALS_TWCD_rOSCAvrgPriB1_s" 342 "SIGNALS_TWCD_rOSCAvrgPriB1_signal" 343 "SIGNALS_ThrVlv_uRawSens1B1_signal" 344 "SIGNALS_ThrVlv_uRawSens2B1_signal" 345 "SIGNALS_TiEngOff_ti_s" 346 "SIGNALS_VehStc_lDstCityEco_signal" 347 "SIGNALS_VehStc_lDstCity_signal" 348 "SIGNALS_VehStc_lDstHighWayEco_signal" 349 "SIGNALS_VehStc_lDstHighWay_signal" 350 "SIGNALS_VehStc_numFuDiagRecA_0_s" 351 "SIGNALS_VehStc_numFuDiagRecA_10_s" 352 "SIGNALS_VehStc_numFuDiagRecA_11_s" 353 "SIGNALS_VehStc_numFuDiagRecA_12_s" 354 "SIGNALS_VehStc_numFuDiagRecA_13_s" 355 "SIGNALS_VehStc_numFuDiagRecA_14_s" 356 "SIGNALS_VehStc_numFuDiagRecA_15_s" 357 "SIGNALS_VehStc_numFuDiagRecA_16_s" 358 "SIGNALS_VehStc_numFuDiagRecA_17_s" 359 "SIGNALS_VehStc_numFuDiagRecA_18_s" 360 "SIGNALS_VehStc_numFuDiagRecA_19_s" 361 "SIGNALS_VehStc_numFuDiagRecA_1_s" 362 "SIGNALS_VehStc_numFuDiagRecA_20_s" 363 "SIGNALS_VehStc_numFuDiagRecA_2_s" 364 "SIGNALS_VehStc_numFuDiagRecA_3_s" 365 "SIGNALS_VehStc_numFuDiagRecA_4_s" 366 "SIGNALS_VehStc_numFuDiagRecA_5_s" 367 "SIGNALS_VehStc_numFuDiagRecA_6_s" 368 "SIGNALS_VehStc_numFuDiagRecA_7_s" 369 "SIGNALS_VehStc_numFuDiagRecA_8_s" 370 "SIGNALS_VehStc_numFuDiagRecA_9_s" 371 "SIGNALS_VehStc_numMisfDetnHiEctA_0_s" 372 "SIGNALS_VehStc_numMisfDetnHiEctA_10_s" 373 "SIGNALS_VehStc_numMisfDetnHiEctA_11_s" 374 "SIGNALS_VehStc_numMisfDetnHiEctA_12_s" 375 "SIGNALS_VehStc_numMisfDetnHiEctA_13_s" 376 "SIGNALS_VehStc_numMisfDetnHiEctA_14_s" 377 "SIGNALS_VehStc_numMisfDetnHiEctA_15_s" 378 "SIGNALS_VehStc_numMisfDetnHiEctA_16_s" 379 "SIGNALS_VehStc_numMisfDetnHiEctA_17_s" 380 "SIGNALS_VehStc_numMisfDetnHiEctA_18_s" 381 "SIGNALS_VehStc_numMisfDetnHiEctA_19_s" 382 "SIGNALS_VehStc_numMisfDetnHiEctA_1_s" 383 "SIGNALS_VehStc_numMisfDetnHiEctA_20_s" 384 "SIGNALS_VehStc_numMisfDetnHiEctA_2_s" 385 "SIGNALS_VehStc_numMisfDetnHiEctA_3_s" 386 "SIGNALS_VehStc_numMisfDetnHiEctA_4_s" 387 "SIGNALS_VehStc_numMisfDetnHiEctA_5_s" 388 "SIGNALS_VehStc_numMisfDetnHiEctA_6_s" 389 "SIGNALS_VehStc_numMisfDetnHiEctA_7_s" 390 "SIGNALS_VehStc_numMisfDetnHiEctA_8_s" 391 "SIGNALS_VehStc_numMisfDetnHiEctA_9_s" 392 "SIGNALS_VehStc_numMisfDetnLoEctA_0_s" 393 "SIGNALS_VehStc_numMisfDetnLoEctA_10_s" 394 "SIGNALS_VehStc_numMisfDetnLoEctA_11_s" 395 "SIGNALS_VehStc_numMisfDetnLoEctA_12_s" 396 "SIGNALS_VehStc_numMisfDetnLoEctA_13_s" 397 "SIGNALS_VehStc_numMisfDetnLoEctA_14_s" 398 "SIGNALS_VehStc_numMisfDetnLoEctA_15_s" 399 "SIGNALS_VehStc_numMisfDetnLoEctA_16_s" 400 "SIGNALS_VehStc_numMisfDetnLoEctA_17_s" 401 "SIGNALS_VehStc_numMisfDetnLoEctA_18_s" 402 "SIGNALS_VehStc_numMisfDetnLoEctA_19_s" 403 "SIGNALS_VehStc_numMisfDetnLoEctA_1_s" 404 "SIGNALS_VehStc_numMisfDetnLoEctA_20_s" 405 "SIGNALS_VehStc_numMisfDetnLoEctA_2_s" 406 "SIGNALS_VehStc_numMisfDetnLoEctA_3_s" 407 "SIGNALS_VehStc_numMisfDetnLoEctA_4_s" 408 "SIGNALS_VehStc_numMisfDetnLoEctA_5_s" 409 "SIGNALS_VehStc_numMisfDetnLoEctA_6_s" 410 "SIGNALS_VehStc_numMisfDetnLoEctA_7_s" 411 "SIGNALS_VehStc_numMisfDetnLoEctA_8_s" 412 "SIGNALS_VehStc_numMisfDetnLoEctA_9_s" 413 "SIGNALS_VehStc_numMisfDetnNormA_0_s" 414 "SIGNALS_VehStc_numMisfDetnNormA_10_s" 415 "SIGNALS_VehStc_numMisfDetnNormA_11_s" 416 "SIGNALS_VehStc_numMisfDetnNormA_12_s" 417 "SIGNALS_VehStc_numMisfDetnNormA_13_s" 418 "SIGNALS_VehStc_numMisfDetnNormA_14_s" 419 "SIGNALS_VehStc_numMisfDetnNormA_15_s" 420 "SIGNALS_VehStc_numMisfDetnNormA_16_s" 421 "SIGNALS_VehStc_numMisfDetnNormA_17_s" 422 "SIGNALS_VehStc_numMisfDetnNormA_18_s" 423 "SIGNALS_VehStc_numMisfDetnNormA_19_s" 424 "SIGNALS_VehStc_numMisfDetnNormA_1_s" 425 "SIGNALS_VehStc_numMisfDetnNormA_20_s" 426 "SIGNALS_VehStc_numMisfDetnNormA_2_s" 427 "SIGNALS_VehStc_numMisfDetnNormA_3_s" 428 "SIGNALS_VehStc_numMisfDetnNormA_4_s" 429 "SIGNALS_VehStc_numMisfDetnNormA_5_s" 430 "SIGNALS_VehStc_numMisfDetnNormA_6_s" 431 "SIGNALS_VehStc_numMisfDetnNormA_7_s" 432 "SIGNALS_VehStc_numMisfDetnNormA_8_s" 433 "SIGNALS_VehStc_numMisfDetnNormA_9_s" 434 "SIGNALS_VehStc_rDiagRsltB1A_0_s" 435 "SIGNALS_VehStc_rDiagRsltB1A_1_s" 436 "SIGNALS_VehStc_rDiagRsltB1A_2_s" 437 "SIGNALS_VehStc_rDiagRsltB1A_3_s" 438 "SIGNALS_VehStc_rDiagRsltB1A_4_s" 439 "SIGNALS_VehStc_tiRtCityEco_signal" 440 "SIGNALS_VehStc_tiRtCity_signal" 441 "SIGNALS_VehStc_tiRtHighWayEco_signal" 442 "SIGNALS_VehStc_tiRtHighWay_signal" 443 "SIGNALS_VehStc_tiRtStop_signal" 444 "SIGNALS_VehStc_volCnsCityDcyc_signal" 445 "SIGNALS_VehStc_volCnsCityEcoDcyc_signal" 446 "SIGNALS_VehStc_volCnsHighWayDcyc_signal" 447 "SIGNALS_VehStc_volCnsHighWayEcoDcyc_signal" 448 "SIGNALS_VehStc_volCnsStopDcyc_signal" 449 "SIGNALS_VehV_a" 450 "SIGNALS_VehV_v" 451 "SIGNALS_VehV_vSens_signal" 452 "SIGNALS_fra_w_msg_signal" 453 "SIGNALS_fra_w_s" 454 "SIGNALS_ftead_w_msg_s" 455 "SIGNALS_ftead_w_si" 456 "SIGNALS_ftead_w_signal" 457 "SIGNALS_i14229_agIntkB1GEVlv_2Byte_signal" 458 "SIGNALS_i14229_agIntkB1GEVlv_signal" 459 "SIGNALS_i14229_agSpIntkB1GevCtl_2Byte_signal" 460 "SIGNALS_i14229_agSpIntkB1GevCtl_signal" 461 "SIGNALS_lutskzyl_w_0_signal" 462 "SIGNALS_lutskzyl_w_1_signal" 463 "SIGNALS_lutskzyl_w_2_signal" 464 "SIGNALS_lutskzyl_w_3_signal" 465 "SIGNALS_lutskzyl_w_msg_0_signal" 466 "SIGNALS_mshfmst_w_signal" 467 "SIGNALS_ofmsndkh1_w_msg_signal" 468 "SIGNALS_ofmsndkh2_w_msg_signal" 469 "SIGNALS_prsoll_w_msg_s" 470 "SIGNALS_tateout_w_signal" 471 "SIGNALS_tatesoll_w_msg_signal" 472 "SIGNALS_thdev_msg_signal" 473 "SIGNALS_tmst_signal" 474 "SIGNALS_wkratst_signal" 475 "SIGNALS_PID83h_A_BitCombineSignal" 476 "SIGNALS_PID9Bh_A_BitCombineSignal" 477 "SIGNALS_PIDA1h_A_BitCombineSignal" 478 "SIGNALS_PIDA7h_A_BitCombineSignal" 479 "SIGNALS_PIDA8h_A_BitCombineSignal" 480 "SIGNALS_Virtual_DcmDspUDS_2600Byte06_signal" 481 "SIGNALS_Virtual_DcmDspUDS_2610Byte00_signal" 482 "SIGNALS_Virtual_DcmDspUDS_2610Byte01_signal" 483 "SIGNALS_Virtual_DcmDspUDS_2610Byte02_signal" 484 "SIGNALS_Virtual_DcmDspUDS_2610Byte03_signal" 485 "SIGNALS_Virtual_DcmDspUDS_2610Byte04_signal" 486 "SIGNALS_Virtual_DcmDspUDS_2610Byte05_signal" 487 "SIGNALS_Virtual_DcmDspUDS_2610Byte0D_signal" 488 "SIGNALS_Virtual_DcmDspUDS_2610Byte0F_signal" 489 "SIGNALS_Virtual_DcmDspUDS_2610Byte10_signal" 490 "SIGNALS_Virtual_DcmDspUDS_2610Byte1A_signal" 491 "SIGNALS_Virtual_DcmDspUDS_2610Byte1B_signal" 492 "SIGNALS_Virtual_DcmDspUDS_2610Byte1C_signal" 493 "SIGNALS_Virtual_DcmDspUDS_2610Byte1D_signal" 494 "SIGNALS_Virtual_DcmDspUDS_2610Byte1F_signal" 495 "SIGNALS_Virtual_DcmDspUDS_2610Byte20_signal" 496 "SIGNALS_Virtual_DcmDspUDS_2610Byte21_signal" 497 "SIGNALS_Virtual_DcmDspUDS_2610Byte22to23_signal" 498 "SIGNALS_Virtual_DcmDspUDS_2610Byte29_signal" 499 "SIGNALS_Virtual_DcmDspUDS_2610Byte2A_signal" 500 "SIGNALS_Virtual_DcmDspUDS_2611Byte00_signal" 501 "SIGNALS_Virtual_DcmDspUDS_2611Byte01_signal" 502 "SIGNALS_Virtual_DcmDspUDS_2611Byte02_signal" 503 "SIGNALS_Virtual_DcmDspUDS_2611Byte03_signal" 504 "SIGNALS_Virtual_DcmDspUDS_2611Byte04_signal" 505 "SIGNALS_Virtual_DcmDspUDS_2611Byte05_signal" 506 "SIGNALS_Virtual_DcmDspUDS_2611Byte06_07_signal" 507 "SIGNALS_Virtual_DcmDspUDS_2611Byte08to09_signal" 508 "SIGNALS_Virtual_DcmDspUDS_2611Byte0A_signal" 509 "SIGNALS_Virtual_DcmDspUDS_2611Byte0B_signal" 510 "SIGNALS_Virtual_DcmDspUDS_2611Byte0Cto0D_signal" 511 "SIGNALS_Virtual_DcmDspUDS_2611Byte0E_signal" 512 "SIGNALS_Virtual_DcmDspUDS_2611Byte2A_signal" 513 "SIGNALS_Virtual_DcmDspUDS_2611Byte2B_signal" 514 "SIGNALS_Virtual_DcmDspUDS_2611Byte30_signal" 515 "SIGNALS_Virtual_DcmDspUDS_2611Byte31_signal" 516 "SIGNALS_Virtual_DcmDspUDS_2611Byte32_signal" 517 "SIGNALS_Virtual_DcmDspUDS_2611Byte33_signal" 518 "SIGNALS_Virtual_DcmDspUDS_2612Byte00_signal" 519 "SIGNALS_Virtual_DcmDspUDS_2612Byte01_signal" 520 "SIGNALS_Virtual_DcmDspUDS_2612Byte02_signal" 521 "SIGNALS_Virtual_DcmDspUDS_2612Byte03_signal" 522 "SIGNALS_Virtual_DcmDspUDS_2612Byte04_signal" 523 "SIGNALS_Virtual_DcmDspUDS_2612Byte05_signal" 524 "SIGNALS_Virtual_DcmDspUDS_2612Byte0B_0C_signal" 525 "SIGNALS_Virtual_DcmDspUDS_2612Byte14_signal" 526 "SIGNALS_Virtual_DcmDspUDS_2612Byte15_signal" 527 "SIGNALS_Virtual_DcmDspUDS_2612Byte16_signal" 528 "SIGNALS_Virtual_DcmDspUDS_2612Byte17_signal" 529 "SIGNALS_Virtual_DcmDspUDS_2612Byte1F_signal" 530 "SIGNALS_Virtual_DcmDspUDS_2612Byte20_signal" 531 "SIGNALS_Virtual_DcmDspUDS_2612Byte2A_signal" 532 "SIGNALS_Virtual_DcmDspUDS_2612Byte2B_signal" 533 "SIGNALS_Virtual_DcmDspUDS_2613Byte00_signal" 534 "SIGNALS_Virtual_DcmDspUDS_2613Byte01_signal" 535 "SIGNALS_Virtual_DcmDspUDS_2613Byte02_signal" 536 "SIGNALS_Virtual_DcmDspUDS_2613Byte03_signal" 537 "SIGNALS_Virtual_DcmDspUDS_2613Byte04_signal" 538 "SIGNALS_Virtual_DcmDspUDS_2613Byte05_signal" 539 "SIGNALS_Virtual_DcmDspUDS_2613Byte08_signal" 540 "SIGNALS_Virtual_DcmDspUDS_2613Byte09_signal" 541 "SIGNALS_Virtual_DcmDspUDS_2615Byte00_signal" 542 "SIGNALS_Virtual_DcmDspUDS_2615Byte01_signal" 543 "SIGNALS_Virtual_DcmDspUDS_2615Byte02_signal" 544 "SIGNALS_Virtual_DcmDspUDS_2615Byte03_signal" 545 "SIGNALS_Virtual_DcmDspUDS_2615Byte04_signal" 546 "SIGNALS_Virtual_DcmDspUDS_2615Byte05_signal" 547 "SIGNALS_Virtual_DcmDspUDS_2615Byte10_signal" 548 "SIGNALS_Virtual_DcmDspUDS_2615Byte26_signal" 549 "SIGNALS_Virtual_DcmDspUDS_2615Byte27_signal" 550 "SIGNALS_Virtual_DcmDspUDS_2617Byte00_signal" 551 "SIGNALS_Virtual_DcmDspUDS_2617Byte01_signal" 552 "SIGNALS_Virtual_DcmDspUDS_2617Byte02_signal" 553 "SIGNALS_Virtual_DcmDspUDS_2617Byte03_signal" 554 "SIGNALS_Virtual_DcmDspUDS_2617Byte04_signal" 555 "SIGNALS_Virtual_DcmDspUDS_2617Byte05_signal" 556 "SIGNALS_Virtual_DcmDspUDS_261AByte00_signal" 557 "SIGNALS_Virtual_DcmDspUDS_261AByte01_signal" 558 "SIGNALS_Virtual_DcmDspUDS_261AByte02_signal" 559 "SIGNALS_Virtual_DcmDspUDS_261AByte03_signal" 560 "SIGNALS_Virtual_DcmDspUDS_261AByte04_signal" 561 "SIGNALS_Virtual_DcmDspUDS_261AByte05_signal" 562 "SIGNALS_Virtual_DcmDspUDS_261AByte07_signal" 563 "SIGNALS_Virtual_DcmDspUDS_261AByte0A_signal" 564 "SIGNALS_Virtual_DcmDspUDS_261AByte0B_signal" 565 "SIGNALS_Virtual_DcmDspUDS_261AByte0C_signal" 566 "SIGNALS_Virtual_DcmDspUDS_261AByte0D_signal" 567 "SIGNALS_Virtual_DcmDspUDS_261AByte0E_signal" 568 "SIGNALS_Virtual_DcmDspUDS_2620Byte00_signal" 569 "SIGNALS_Virtual_DcmDspUDS_2620Byte01_signal" 570 "SIGNALS_Virtual_DcmDspUDS_2620Byte02_signal" 571 "SIGNALS_Virtual_DcmDspUDS_2620Byte03_signal" 572 "SIGNALS_Virtual_DcmDspUDS_2620Byte04_signal" 573 "SIGNALS_Virtual_DcmDspUDS_2620Byte05_signal" 574 "SIGNALS_Virtual_DcmDspUDS_2621Byte00_signal" 575 "SIGNALS_Virtual_DcmDspUDS_2621Byte01_signal" 576 "SIGNALS_Virtual_DcmDspUDS_2621Byte02_signal" 577 "SIGNALS_Virtual_DcmDspUDS_2621Byte03_signal" 578 "SIGNALS_Virtual_DcmDspUDS_2621Byte04_signal" 579 "SIGNALS_Virtual_DcmDspUDS_2621Byte05_signal" 580 "SIGNALS_Virtual_DcmDspUDS_2622Byte00_signal" 581 "SIGNALS_Virtual_DcmDspUDS_2622Byte01_signal" 582 "SIGNALS_Virtual_DcmDspUDS_2622Byte02_signal" 583 "SIGNALS_Virtual_DcmDspUDS_2622Byte03_signal" 584 "SIGNALS_Virtual_DcmDspUDS_2622Byte04_signal" 585 "SIGNALS_Virtual_DcmDspUDS_2622Byte05_signal" 586 "SIGNALS_Virtual_DcmDspUDS_2623Byte00_signal" 587 "SIGNALS_Virtual_DcmDspUDS_2623Byte01_signal" 588 "SIGNALS_Virtual_DcmDspUDS_2623Byte02_signal" 589 "SIGNALS_Virtual_DcmDspUDS_2623Byte03_signal" 590 "SIGNALS_Virtual_DcmDspUDS_2623Byte04_signal" 591 "SIGNALS_Virtual_DcmDspUDS_2623Byte05_signal" 592 "SIGNALS_Virtual_DcmDspUDS_2625Byte00_signal" 593 "SIGNALS_Virtual_DcmDspUDS_2625Byte01_signal" 594 "SIGNALS_Virtual_DcmDspUDS_2625Byte02_signal" 595 "SIGNALS_Virtual_DcmDspUDS_2625Byte03_signal" 596 "SIGNALS_Virtual_DcmDspUDS_2625Byte04_signal" 597 "SIGNALS_Virtual_DcmDspUDS_2625Byte05_signal" 598 "SIGNALS_Virtual_DcmDspUDS_2627Byte00_signal" 599 "SIGNALS_Virtual_DcmDspUDS_2627Byte01_signal" 600 "SIGNALS_Virtual_DcmDspUDS_2627Byte02_signal" 601 "SIGNALS_Virtual_DcmDspUDS_2627Byte03_signal" 602 "SIGNALS_Virtual_DcmDspUDS_2627Byte04_signal" 603 "SIGNALS_Virtual_DcmDspUDS_2627Byte05_signal" 604 "SIGNALS_Virtual_DcmDspUDS_262AByte00_signal" 605 "SIGNALS_Virtual_DcmDspUDS_262AByte01_signal" 606 "SIGNALS_Virtual_DcmDspUDS_262AByte02_signal" 607 "SIGNALS_Virtual_DcmDspUDS_262AByte03_signal" 608 "SIGNALS_Virtual_DcmDspUDS_262AByte04_signal" 609 "SIGNALS_Virtual_DcmDspUDS_262AByte05_signal" 610 "SIGNALS_Virtual_DcmDspUDS_2660Byte0_signal" 611 "SIGNALS_Virtual_DcmDspUDS_2660Byte11to12_signal" 612 "SIGNALS_Virtual_DcmDspUDS_2660Byte13to14_signal" 613 "SIGNALS_Virtual_DcmDspUDS_2660Byte15_signal" 614 "SIGNALS_Virtual_DcmDspUDS_2660Byte16_signal" 615 "SIGNALS_Virtual_DcmDspUDS_2660Byte17_signal" 616 "SIGNALS_Virtual_DcmDspUDS_2660Byte18_signal" 617 "SIGNALS_Virtual_DcmDspUDS_2660Byte19_signal" 618 "SIGNALS_Virtual_DcmDspUDS_2660Byte1A_signal" 619 "SIGNALS_Virtual_DcmDspUDS_2660Byte1B_signal" 620 "SIGNALS_Virtual_DcmDspUDS_2660Byte1C_signal" 621 "SIGNALS_Virtual_DcmDspUDS_2660Byte1D_signal" 622 "SIGNALS_Virtual_DcmDspUDS_2660Byte1E_signal" 623 "SIGNALS_Virtual_DcmDspUDS_2660Byte1_signal" 624 "SIGNALS_Virtual_DcmDspUDS_2660Byte26to27_signal" 625 "SIGNALS_Virtual_DcmDspUDS_2660Byte2A_signal" 626 "SIGNALS_Virtual_DcmDspUDS_2660Byte2Eto2F_signal" 627 "SIGNALS_Virtual_DcmDspUDS_2660Byte2_signal" 628 "SIGNALS_Virtual_DcmDspUDS_2660Byte3_signal" 629 "SIGNALS_Virtual_DcmDspUDS_2660Byte4_signal" 630 "SIGNALS_Virtual_DcmDspUDS_2660Byte5_signal" 631 "SIGNALS_Virtual_DcmDspUDS_2660Byte6_signal" 632 "SIGNALS_Virtual_DcmDspUDS_2661Byte0A_signal" 633 "SIGNALS_Virtual_DcmDspUDS_2661Byte0B_signal" 634 "SIGNALS_Virtual_DcmDspUDS_2661Byte0C_signal" 635 "SIGNALS_Virtual_DcmDspUDS_2661Byte0D_signal" 636 "SIGNALS_Virtual_DcmDspUDS_2661Byte0E_signal" 637 "SIGNALS_Virtual_DcmDspUDS_2661Byte0F_signal" 638 "SIGNALS_Virtual_DcmDspUDS_2661Byte0_signal" 639 "SIGNALS_Virtual_DcmDspUDS_2661Byte1_signal" 640 "SIGNALS_Virtual_DcmDspUDS_2661Byte2D_signal" 641 "SIGNALS_Virtual_DcmDspUDS_2661Byte2E_signal" 642 "SIGNALS_Virtual_DcmDspUDS_2661Byte2F_signal" 643 "SIGNALS_Virtual_DcmDspUDS_2661Byte2_signal" 644 "SIGNALS_Virtual_DcmDspUDS_2661Byte30_signal" 645 "SIGNALS_Virtual_DcmDspUDS_2661Byte31_signal" 646 "SIGNALS_Virtual_DcmDspUDS_2661Byte32_signal" 647 "SIGNALS_Virtual_DcmDspUDS_2661Byte3_signal" 648 "SIGNALS_Virtual_DcmDspUDS_2661Byte4_signal" 649 "SIGNALS_Virtual_DcmDspUDS_2661Byte5_signal" 650 "SIGNALS_Virtual_DcmDspUDS_2661Byte6_signal" 651 "SIGNALS_Virtual_DcmDspUDS_2661Byte7_signal" 652 "SIGNALS_Virtual_DcmDspUDS_2661Byte8_signal" 653 "SIGNALS_Virtual_DcmDspUDS_2661Byte9_signal" 654 "SIGNALS_Virtual_DcmDspUDS_2662Byte0Cto0D_signal" 655 "SIGNALS_Virtual_DcmDspUDS_2662Byte0_signal" 656 "SIGNALS_Virtual_DcmDspUDS_2662Byte18_signal" 657 "SIGNALS_Virtual_DcmDspUDS_2662Byte19_signal" 658 "SIGNALS_Virtual_DcmDspUDS_2662Byte1_signal" 659 "SIGNALS_Virtual_DcmDspUDS_2662Byte2_signal" 660 "SIGNALS_Virtual_DcmDspUDS_2662Byte3_signal" 661 "SIGNALS_Virtual_DcmDspUDS_2662Byte4_signal" 662 "SIGNALS_Virtual_DcmDspUDS_2662Byte5_signal" 663 "SIGNALS_Virtual_DcmDspUDS_2663Byte0_signal" 664 "SIGNALS_Virtual_DcmDspUDS_2663Byte14Byte15_signal" 665 "SIGNALS_Virtual_DcmDspUDS_2663Byte16Byte17_signal" 666 "SIGNALS_Virtual_DcmDspUDS_2663Byte18Byte19_signal" 667 "SIGNALS_Virtual_DcmDspUDS_2663Byte1AByte1B_signal" 668 "SIGNALS_Virtual_DcmDspUDS_2663Byte1_signal" 669 "SIGNALS_Virtual_DcmDspUDS_2663Byte2_signal" 670 "SIGNALS_Virtual_DcmDspUDS_2663Byte3_signal" 671 "SIGNALS_Virtual_DcmDspUDS_2663Byte4_signal" 672 "SIGNALS_Virtual_DcmDspUDS_2663Byte5_signal" 673 "SIGNALS_Virtual_DcmDspUDS_2664Byte0_signal" 674 "SIGNALS_Virtual_DcmDspUDS_2664Byte1_signal" 675 "SIGNALS_Virtual_DcmDspUDS_2664Byte25_signal" 676 "SIGNALS_Virtual_DcmDspUDS_2664Byte26_signal" 677 "SIGNALS_Virtual_DcmDspUDS_2664Byte2_signal" 678 "SIGNALS_Virtual_DcmDspUDS_2664Byte3_signal" 679 "SIGNALS_Virtual_DcmDspUDS_2664Byte4_signal" 680 "SIGNALS_Virtual_DcmDspUDS_2664Byte5_signal" 681 "SIGNALS_Virtual_DcmDspUDS_2664Byte6_signal" 682 "SIGNALS_Virtual_DcmDspUDS_2664Byte7_signal" 683 "SIGNALS_Virtual_DcmDspUDS_2665Byte0_signal" 684 "SIGNALS_Virtual_DcmDspUDS_2665Byte1_signal" 685 "SIGNALS_Virtual_DcmDspUDS_2665Byte2_signal" 686 "SIGNALS_Virtual_DcmDspUDS_2665Byte3_signal" 687 "SIGNALS_Virtual_DcmDspUDS_2665Byte4_signal" 688 "SIGNALS_Virtual_DcmDspUDS_2665Byte5_signal" 689 "SIGNALS_Virtual_DcmDspUDS_2666Byte0_signal" 690 "SIGNALS_Virtual_DcmDspUDS_2666Byte1_signal" 691 "SIGNALS_Virtual_DcmDspUDS_2666Byte2_signal" 692 "SIGNALS_Virtual_DcmDspUDS_2666Byte3_signal" 693 "SIGNALS_Virtual_DcmDspUDS_2666Byte4_signal" 694 "SIGNALS_Virtual_DcmDspUDS_2666Byte5_signal" 695 "SIGNALS_Virtual_DcmDspUDS_2668Byte0_signal" 696 "SIGNALS_Virtual_DcmDspUDS_2668Byte1_signal" 697 "SIGNALS_Virtual_DcmDspUDS_2668Byte2_signal" 698 "SIGNALS_Virtual_DcmDspUDS_2668Byte3_signal" 699 "SIGNALS_Virtual_DcmDspUDS_2668Byte4_signal" 700 "SIGNALS_Virtual_DcmDspUDS_2668Byte5_signal" 701 "SIGNALS_Virtual_DcmDspUDS_266CByte0_signal" 702 "SIGNALS_Virtual_DcmDspUDS_266CByte1_signal" 703 "SIGNALS_Virtual_DcmDspUDS_266CByte26_signal" 704 "SIGNALS_Virtual_DcmDspUDS_266CByte27_signal" 705 "SIGNALS_Virtual_DcmDspUDS_266CByte2_signal" 706 "SIGNALS_Virtual_DcmDspUDS_266CByte3_signal" 707 "SIGNALS_Virtual_DcmDspUDS_266CByte4_signal" 708 "SIGNALS_Virtual_DcmDspUDS_266CByte5_signal" 709 "SIGNALS_Virtual_DcmDspUDS_266CByte6_signal" 710 "SIGNALS_Virtual_DcmDspUDS_266CByte7_signal" 711 "SIGNALS_Virtual_DcmDspUDS_266CByte8_signal" 712 "SIGNALS_Virtual_DcmDspUDS_266CByte9_signal" 713 "SIGNALS_Virtual_DcmDspUDS_266DByte0_signal" 714 "SIGNALS_Virtual_DcmDspUDS_266DByte1_signal" 715 "SIGNALS_Virtual_DcmDspUDS_266DByte2_signal" 716 "SIGNALS_Virtual_DcmDspUDS_266DByte3_signal" 717 "SIGNALS_Virtual_DcmDspUDS_266DByte4_signal" 718 "SIGNALS_Virtual_DcmDspUDS_266DByte5_signal" 719 "SIGNALS_Virtual_DcmDspUDS_266FByte0_signal" 720 "SIGNALS_Virtual_DcmDspUDS_266FByte1_signal" 721 "SIGNALS_Virtual_DcmDspUDS_266FByte2_signal" 722 "SIGNALS_Virtual_DcmDspUDS_266FByte3_signal" 723 "SIGNALS_Virtual_DcmDspUDS_2673Byte0A_signal" 724 "SIGNALS_Virtual_DcmDspUDS_2673Byte0B_signal" 725 "SIGNALS_Virtual_DcmDspUDS_2673Byte0_signal" 726 "SIGNALS_Virtual_DcmDspUDS_2673Byte12_signal" 727 "SIGNALS_Virtual_DcmDspUDS_2673Byte13_signal" 728 "SIGNALS_Virtual_DcmDspUDS_2673Byte16_signal" 729 "SIGNALS_Virtual_DcmDspUDS_2673Byte17_signal" 730 "SIGNALS_Virtual_DcmDspUDS_2673Byte1E_signal" 731 "SIGNALS_Virtual_DcmDspUDS_2673Byte1F_signal" 732 "SIGNALS_Virtual_DcmDspUDS_2673Byte1_signal" 733 "SIGNALS_Virtual_DcmDspUDS_2673Byte2_signal" 734 "SIGNALS_Virtual_DcmDspUDS_2673Byte3_signal" 735 "SIGNALS_Virtual_DcmDspUDS_2673Byte4_signal" 736 "SIGNALS_Virtual_DcmDspUDS_2673Byte5_signal" 737 "SIGNALS_Virtual_DcmDspUDS_2673Byte6_signal" 738 "SIGNALS_Virtual_DcmDspUDS_2673Byte7_signal" 739 "SIGNALS_Virtual_DcmDspUDS_2676Byte0_signal" 740 "SIGNALS_Virtual_DcmDspUDS_2676Byte1_signal" 741 "SIGNALS_Virtual_DcmDspUDS_2676Byte2E_signal" 742 "SIGNALS_Virtual_DcmDspUDS_2676Byte2F_signal" 743 "SIGNALS_Virtual_DcmDspUDS_2676Byte2_signal" 744 "SIGNALS_Virtual_DcmDspUDS_2676Byte3_signal" 745 "SIGNALS_Virtual_DcmDspUDS_2676Byte4_signal" 746 "SIGNALS_Virtual_DcmDspUDS_2676Byte5_signal" 747 "SIGNALS_Virtual_DcmDspUDS_2676Byte6_signal" 748 "SIGNALS_Virtual_DcmDspUDS_2676Byte7_signal" 749 "SIGNALS_Virtual_DcmDspUDS_267BByte0_signal" 750 "SIGNALS_Virtual_DcmDspUDS_267BByte1_signal" 751 "SIGNALS_Virtual_DcmDspUDS_267BByte2_signal" 752 "SIGNALS_Virtual_DcmDspUDS_267BByte3_signal" 753 "SIGNALS_Virtual_DcmDspUDS_267BByte4_signal" 754 "SIGNALS_Virtual_DcmDspUDS_267BByte5_signal" 755 "SIGNALS_Virtual_DcmDspUDS_267EByte0_signal" 756 "SIGNALS_Virtual_DcmDspUDS_267EByte1_signal" 757 "SIGNALS_Virtual_DcmDspUDS_267EByte22_signal" 758 "SIGNALS_Virtual_DcmDspUDS_267EByte2_signal" 759 "SIGNALS_Virtual_DcmDspUDS_2680Byte00_signal" 760 "SIGNALS_Virtual_DcmDspUDS_2680Byte01_signal" 761 "SIGNALS_Virtual_DcmDspUDS_2680Byte02_signal" 762 "SIGNALS_Virtual_DcmDspUDS_2680Byte03_signal" 763 "SIGNALS_Virtual_DcmDspUDS_2680Byte04_signal" 764 "SIGNALS_Virtual_DcmDspUDS_2680Byte05_signal" 765 "SIGNALS_Virtual_DcmDspUDS_2680Byte08_signal" 766 "SIGNALS_Virtual_DcmDspUDS_2680Byte09_signal" 767 "SIGNALS_Virtual_DcmDspUDS_2680Byte0E_signal" 768 "SIGNALS_Virtual_DcmDspUDS_2680Byte0F_signal" 769 "SIGNALS_Virtual_DcmDspUDS_2681Byte00_signal" 770 "SIGNALS_Virtual_DcmDspUDS_2681Byte01_signal" 771 "SIGNALS_Virtual_DcmDspUDS_2681Byte02_signal" 772 "SIGNALS_Virtual_DcmDspUDS_2681Byte03_signal" 773 "SIGNALS_Virtual_DcmDspUDS_2681Byte04_signal" 774 "SIGNALS_Virtual_DcmDspUDS_2681Byte05_signal" 775 "SIGNALS_Virtual_DcmDspUDS_2681Byte0F_signal" 776 "SIGNALS_Virtual_DcmDspUDS_2681Byte10_signal" 777 "SIGNALS_Virtual_DcmDspUDS_2681Byte13_signal" 778 "SIGNALS_Virtual_DcmDspUDS_2681Byte14_signal" 779 "SIGNALS_Virtual_DcmDspUDS_2681Byte1D_signal" 780 "SIGNALS_Virtual_DcmDspUDS_2681Byte1E_signal" 781 "SIGNALS_Virtual_DcmDspUDS_2682Byte00_signal" 782 "SIGNALS_Virtual_DcmDspUDS_2682Byte01_signal" 783 "SIGNALS_Virtual_DcmDspUDS_2682Byte02_signal" 784 "SIGNALS_Virtual_DcmDspUDS_2682Byte03_signal" 785 "SIGNALS_Virtual_DcmDspUDS_2682Byte04_signal" 786 "SIGNALS_Virtual_DcmDspUDS_2682Byte05_signal" 787 "SIGNALS_Virtual_DcmDspUDS_2682Byte06_07_signal" 788 "SIGNALS_Virtual_DcmDspUDS_2682Byte08_09_signal" 789 "SIGNALS_Virtual_DcmDspUDS_2682Byte0E_signal" 790 "SIGNALS_Virtual_DcmDspUDS_2682Byte11_12_signal" 791 "SIGNALS_Virtual_DcmDspUDS_2682Byte13_14_signal" 792 "SIGNALS_Virtual_DcmDspUDS_2682Byte15_16_signal" 793 "SIGNALS_Virtual_DcmDspUDS_2682Byte18_19_signal" 794 "SIGNALS_Virtual_DcmDspUDS_2682Byte1B_signal" 795 "SIGNALS_Virtual_DcmDspUDS_2682Byte1C_signal" 796 "SIGNALS_Virtual_DcmDspUDS_2683Byte00_signal" 797 "SIGNALS_Virtual_DcmDspUDS_2683Byte01_signal" 798 "SIGNALS_Virtual_DcmDspUDS_2683Byte02_signal" 799 "SIGNALS_Virtual_DcmDspUDS_2683Byte03_signal" 800 "SIGNALS_Virtual_DcmDspUDS_2683Byte04_signal" 801 "SIGNALS_Virtual_DcmDspUDS_2683Byte05_signal" 802 "SIGNALS_Virtual_DcmDspUDS_2684Byte00_signal" 803 "SIGNALS_Virtual_DcmDspUDS_2684Byte01_signal" 804 "SIGNALS_Virtual_DcmDspUDS_2684Byte02_signal" 805 "SIGNALS_Virtual_DcmDspUDS_2684Byte03_signal" 806 "SIGNALS_Virtual_DcmDspUDS_2684Byte04_signal" 807 "SIGNALS_Virtual_DcmDspUDS_2684Byte05_signal" 808 "SIGNALS_Virtual_DcmDspUDS_2688Byte00_signal" 809 "SIGNALS_Virtual_DcmDspUDS_2688Byte01_signal" 810 "SIGNALS_Virtual_DcmDspUDS_2688Byte02_signal" 811 "SIGNALS_Virtual_DcmDspUDS_2688Byte03_signal" 812 "SIGNALS_Virtual_DcmDspUDS_2688Byte04_signal" 813 "SIGNALS_Virtual_DcmDspUDS_2688Byte05_signal" 814 "SIGNALS_Virtual_DcmDspUDS_2689Byte00_signal" 815 "SIGNALS_Virtual_DcmDspUDS_2689Byte01_signal" 816 "SIGNALS_Virtual_DcmDspUDS_2689Byte02_signal" 817 "SIGNALS_Virtual_DcmDspUDS_2689Byte03_signal" 818 "SIGNALS_Virtual_DcmDspUDS_2689Byte04_signal" 819 "SIGNALS_Virtual_DcmDspUDS_2689Byte05_signal" 820 "SIGNALS_Virtual_DcmDspUDS_2689Byte06to09_signal" 821 "SIGNALS_Virtual_DcmDspUDS_2689Byte0Eto11_signal" 822 "SIGNALS_Virtual_DcmDspUDS_2689Byte12to15_signal" 823 "SIGNALS_Virtual_DcmDspUDS_2689Byte16to19_signal" 824 "SIGNALS_Virtual_DcmDspUDS_2689Byte1Ato1D_signal" 825 "SIGNALS_Virtual_DcmDspUDS_2689Byte1Eto21_signal" 826 "SIGNALS_Virtual_DcmDspUDS_2689Byte22to25_signal" 827 "SIGNALS_Virtual_DcmDspUDS_2689Byte26to29_signal" 828 "SIGNALS_Virtual_DcmDspUDS_2689Byte2Ato2D_signal" 829 "SIGNALS_Virtual_DcmDspUDS_2689Byte2Eto31_signal" 830 "SIGNALS_Virtual_DcmDspUDS_268BByte00_signal" 831 "SIGNALS_Virtual_DcmDspUDS_268BByte01_signal" 832 "SIGNALS_Virtual_DcmDspUDS_268BByte02_signal" 833 "SIGNALS_Virtual_DcmDspUDS_268BByte03_signal" 834 "SIGNALS_Virtual_DcmDspUDS_268BByte04_signal" 835 "SIGNALS_Virtual_DcmDspUDS_268BByte05_signal" 836 "SIGNALS_Virtual_DcmDspUDS_268BByte06_signal" 837 "SIGNALS_Virtual_DcmDspUDS_268BByte07_signal" 838 "SIGNALS_Virtual_DcmDspUDS_268BByte08_signal" 839 "SIGNALS_Virtual_DcmDspUDS_268BByte09_signal" 840 "SIGNALS_Virtual_DcmDspUDS_268BByte0A_signal" 841 "SIGNALS_Virtual_DcmDspUDS_268BByte0B_signal" 842 "SIGNALS_Virtual_DcmDspUDS_268BByte0C_signal" 843 "SIGNALS_Virtual_DcmDspUDS_268BByte0D_signal" 844 "SIGNALS_Virtual_DcmDspUDS_268CByte00_signal" 845 "SIGNALS_Virtual_DcmDspUDS_268CByte01_signal" 846 "SIGNALS_Virtual_DcmDspUDS_268CByte02_signal" 847 "SIGNALS_Virtual_DcmDspUDS_268CByte03_signal" 848 "SIGNALS_Virtual_DcmDspUDS_268CByte04_signal" 849 "SIGNALS_Virtual_DcmDspUDS_268CByte05_signal" 850 "SIGNALS_Virtual_DcmDspUDS_268CByte06_signal" 851 "SIGNALS_Virtual_DcmDspUDS_268CByte07_signal" 852 "SIGNALS_Virtual_DcmDspUDS_268CByte08_signal" 853 "SIGNALS_Virtual_DcmDspUDS_268CByte09_signal" 854 "SIGNALS_Virtual_DcmDspUDS_268CByte0A_signal" 855 "SIGNALS_Virtual_DcmDspUDS_268CByte2E_signal" 856 "SIGNALS_Virtual_DcmDspUDS_268CByte2F_signal" 857 "SIGNALS_Virtual_DcmDspUDS_268CByte30_signal" 858 "SIGNALS_Virtual_DcmDspUDS_268CByte31_signal" 859 "SIGNALS_Virtual_DcmDspUDS_268CByte32_signal" 860 "SIGNALS_Virtual_DcmDspUDS_268CByte33_signal" 861 "SIGNALS_Virtual_DcmDspUDS_268EByte00_signal" 862 "SIGNALS_Virtual_DcmDspUDS_268EByte01_signal" 863 "SIGNALS_Virtual_DcmDspUDS_268EByte02_signal" 864 "SIGNALS_Virtual_DcmDspUDS_268EByte03_signal" 865 "SIGNALS_Virtual_DcmDspUDS_268EByte04_signal" 866 "SIGNALS_Virtual_DcmDspUDS_268EByte05_signal" 867 "SIGNALS_Virtual_DcmDspUDS_268EByte08to09_signal" 868 "SIGNALS_Virtual_DcmDspUDS_268EByte0A_signal" 869 "SIGNALS_Virtual_DcmDspUDS_268EByte0B_signal" 870 "SIGNALS_Virtual_DcmDspUDS_268FByte00_signal" 871 "SIGNALS_Virtual_DcmDspUDS_268FByte01_signal" 872 "SIGNALS_Virtual_DcmDspUDS_268FByte02_signal" 873 "SIGNALS_Virtual_DcmDspUDS_268FByte03_signal" 874 "SIGNALS_Virtual_DcmDspUDS_268FByte04_signal" 875 "SIGNALS_Virtual_DcmDspUDS_268FByte05_signal" 876 "SIGNALS_Virtual_DcmDspUDS_268FByte0A_signal" 877 "SIGNALS_Virtual_DcmDspUDS_268FByte0B_signal" 878 "SIGNALS_Virtual_DcmDspUDS_268FByte16_17_signal" 879 "SIGNALS_Virtual_DcmDspUDS_268FByte18_19_signal" 880 "SIGNALS_Virtual_DcmDspUDS_268FByte1A_1B_signal" 881 "SIGNALS_Virtual_DcmDspUDS_2699Byte00_signal" 882 "SIGNALS_Virtual_DcmDspUDS_2699Byte01_signal" 883 "SIGNALS_Virtual_DcmDspUDS_2699Byte02_signal" 884 "SIGNALS_Virtual_DcmDspUDS_2699Byte03_signal" 885 "SIGNALS_Virtual_DcmDspUDS_2699Byte04_signal" 886 "SIGNALS_Virtual_DcmDspUDS_2699Byte05_signal" 887 "SIGNALS_Virtual_DcmDspUDS_2699Byte06_signal" 888 "SIGNALS_Virtual_DcmDspUDS_2699Byte07_signal" 889 "SIGNALS_Virtual_DcmDspUDS_2699Byte0B_0C_signal" 890 "SIGNALS_Virtual_DcmDspUDS_2699Byte16_signal" 891 "SIGNALS_Virtual_DcmDspUDS_2699Byte17_signal" 892 "SIGNALS_Virtual_DcmDspUDS_2699Byte26_27_signal" 893 "SIGNALS_Virtual_DcmDspUDS_2699Byte28_29_signal" 894 "SIGNALS_Virtual_DcmDspUDS_2699Byte2A_2B_signal" 895 "SIGNALS_Virtual_DcmDspUDS_2699Byte2E_signal" 896 "SIGNALS_Virtual_DcmDspUDS_2699Byte2F_30_signal" 897 "SIGNALS_Virtual_DcmDspUDS_269AByte00_signal" 898 "SIGNALS_Virtual_DcmDspUDS_269AByte01_signal" 899 "SIGNALS_Virtual_DcmDspUDS_269AByte02_signal" 900 "SIGNALS_Virtual_DcmDspUDS_269AByte03_signal" 901 "SIGNALS_Virtual_DcmDspUDS_269AByte04_signal" 902 "SIGNALS_Virtual_DcmDspUDS_269AByte05_signal" 903 "SIGNALS_Virtual_DcmDspUDS_269BByte00_signal" 904 "SIGNALS_Virtual_DcmDspUDS_269BByte01_signal" 905 "SIGNALS_Virtual_DcmDspUDS_269BByte02_signal" 906 "SIGNALS_Virtual_DcmDspUDS_269BByte03_signal" 907 "SIGNALS_Virtual_DcmDspUDS_269BByte04_signal" 908 "SIGNALS_Virtual_DcmDspUDS_269BByte05_signal" 909 "SIGNALS_Virtual_DcmDspUDS_269EByte00_signal" 910 "SIGNALS_Virtual_DcmDspUDS_269EByte01_signal" 911 "SIGNALS_Virtual_DcmDspUDS_269EByte02_signal" 912 "SIGNALS_Virtual_DcmDspUDS_269EByte03_signal" 913 "SIGNALS_Virtual_DcmDspUDS_269EByte04_signal" 914 "SIGNALS_Virtual_DcmDspUDS_269EByte05_signal" 915 "SIGNALS_Virtual_DcmDspUDS_26A0Byte00_signal" 916 "SIGNALS_Virtual_DcmDspUDS_26A0Byte01_signal" 917 "SIGNALS_Virtual_DcmDspUDS_26A0Byte02_signal" 918 "SIGNALS_Virtual_DcmDspUDS_26A0Byte03_signal" 919 "SIGNALS_Virtual_DcmDspUDS_26A0Byte04_signal" 920 "SIGNALS_Virtual_DcmDspUDS_26A0Byte05_signal" 921 "SIGNALS_Virtual_DcmDspUDS_26A0Byte06_signal" 922 "SIGNALS_Virtual_DcmDspUDS_26A0Byte07_signal" 923 "SIGNALS_Virtual_DcmDspUDS_26A0Byte08_signal" 924 "SIGNALS_Virtual_DcmDspUDS_26A0Byte09_signal" 925 "SIGNALS_Virtual_DcmDspUDS_26A0Byte0A_signal" 926 "SIGNALS_Virtual_DcmDspUDS_26A0Byte0B_signal" 927 "SIGNALS_Virtual_DcmDspUDS_26A0Byte0C_signal" 928 "SIGNALS_Virtual_DcmDspUDS_26A0Byte0D_signal" 929 "SIGNALS_Virtual_DcmDspUDS_26A0Byte0E_signal" 930 "SIGNALS_Virtual_DcmDspUDS_26A0Byte0F_signal" 931 "SIGNALS_Virtual_DcmDspUDS_26A0Byte10_signal" 932 "SIGNALS_Virtual_DcmDspUDS_26A0Byte11_signal" 933 "SIGNALS_Virtual_DcmDspUDS_26A0Byte12_signal" 934 "SIGNALS_Virtual_DcmDspUDS_26A0Byte13_signal" 935 "SIGNALS_Virtual_DcmDspUDS_26A0Byte14_signal" 936 "SIGNALS_Virtual_DcmDspUDS_26A0Byte15_signal" 937 "SIGNALS_Virtual_DcmDspUDS_26A0Byte16_signal" 938 "SIGNALS_Virtual_DcmDspUDS_26A0Byte17_signal" 939 "SIGNALS_Virtual_DcmDspUDS_26A0Byte18_signal" 940 "SIGNALS_Virtual_DcmDspUDS_26A0Byte19_signal" 941 "SIGNALS_Virtual_DcmDspUDS_26A0Byte1A_signal" 942 "SIGNALS_Virtual_DcmDspUDS_26A0Byte4E_signal" 943 "SIGNALS_Virtual_DcmDspUDS_26A0Byte52_53_signal" 944 "SIGNALS_Virtual_DcmDspUDS_26A0Byte54_55_signal" 945 "SIGNALS_Virtual_DcmDspUDS_26A0Byte56_57_signal" 946 "SIGNALS_Virtual_DcmDspUDS_26A0Byte66_signal" 947 "SIGNALS_Virtual_DcmDspUDS_26A0Byte67_signal" 948 "SIGNALS_Virtual_DcmDspUDS_26A0Byte68_signal" 949 "SIGNALS_Virtual_DcmDspUDS_26A0Byte69_signal" 950 "SIGNALS_Virtual_DcmDspUDS_26A0Byte6A_signal" 951 "SIGNALS_Virtual_DcmDspUDS_26A0Byte6B_signal" 952 "SIGNALS_Virtual_DcmDspUDS_26A0Byte6C_signal" 953 "SIGNALS_Virtual_DcmDspUDS_26A0Byte6D_signal" 954 "SIGNALS_Virtual_DcmDspUDS_26A0Byte7F_80_signal" 955 "SIGNALS_Virtual_DcmDspUDS_26A0Byte81_82_signal" 956 "SIGNALS_Virtual_DcmDspUDS_26A0Byte83_84_signal" 957 "SIGNALS_Virtual_DcmDspUDS_26A0Byte85_86_signal" 958 "SIGNALS_Virtual_DcmDspUDS_26A0Byte87_88_signal" 959 "SIGNALS_Virtual_DcmDspUDS_26A0Byte89_8A_signal" 960 "SIGNALS_Virtual_DcmDspUDS_26A0Byte8B_8C_signal" 961 "SIGNALS_Virtual_DcmDspUDS_26A0Byte8D_8E_signal" 962 "SIGNALS_Virtual_DcmDspUDS_26A0Byte8F_90_signal" 963 "SIGNALS_Virtual_DcmDspUDS_26A0Byte91_92_signal" 964 "SIGNALS_Virtual_DcmDspUDS_26A0Byte93_94_signal" 965 "SIGNALS_Virtual_DcmDspUDS_26A0Byte95_96_signal" 966 "SIGNALS_Virtual_DcmDspUDS_26A0Byte97_98_signal" 967 "SIGNALS_Virtual_DcmDspUDS_26A0Byte99_9A_signal" 968 "SIGNALS_Virtual_DcmDspUDS_26A0Byte9B_9C_signal" 969 "SIGNALS_Virtual_DcmDspUDS_26A0Byte9D_9E_signal" 970 "SIGNALS_Virtual_DcmDspUDS_26A0Byte9F_A0_signal" 971 "SIGNALS_Virtual_DcmDspUDS_26A0ByteA1_A2_signal" 972 "SIGNALS_Virtual_DcmDspUDS_26A0ByteA3_A4_signal" 973 "SIGNALS_Virtual_DcmDspUDS_26A0ByteA5_A6_signal" 974 "SIGNALS_Virtual_DcmDspUDS_26A0ByteA7_A8_signal" 975 "SIGNALS_Virtual_DcmDspUDS_26A0ByteA9_AA_signal" 976 "SIGNALS_Virtual_DcmDspUDS_26A0ByteAB_AC_signal" 977 "SIGNALS_Virtual_DcmDspUDS_26A0ByteAD_AE_signal" 978 "SIGNALS_Virtual_DcmDspUDS_26A0ByteAF_B0_signal" 979 "SIGNALS_Virtual_DcmDspUDS_26A0ByteB1_B2_signal" 980 "SIGNALS_Virtual_DcmDspUDS_26A0ByteB3_B4_signal" 981 "SIGNALS_Virtual_DcmDspUDS_26A0ByteB5_B6_signal" 982 "SIGNALS_Virtual_DcmDspUDS_26A0ByteB7_B8_signal" 983 "SIGNALS_Virtual_DcmDspUDS_26A0ByteB9_BA_signal" 984 "SIGNALS_Virtual_DcmDspUDS_26A0ByteBB_BC_signal" 985 "SIGNALS_Virtual_DcmDspUDS_26A0ByteBD_BE_signal" 986 "SIGNALS_Virtual_DcmDspUDS_26A0ByteBF_C0_signal" 987 "SIGNALS_Virtual_DcmDspUDS_26A0ByteC1_C2_signal" 988 "SIGNALS_Virtual_DcmDspUDS_26A0ByteC3_C4_signal" 989 "SIGNALS_Virtual_DcmDspUDS_26A0ByteC5_C6_signal" 990 "SIGNALS_Virtual_DcmDspUDS_26A0ByteC7_C8_signal" 991 "SIGNALS_Virtual_DcmDspUDS_26A0ByteC9_CA_signal" 992 "SIGNALS_Virtual_DcmDspUDS_26A0ByteCB_CC_signal" 993 "SIGNALS_Virtual_DcmDspUDS_26A0ByteCD_CE_signal" 994 "SIGNALS_Virtual_DcmDspUDS_26A0ByteCF_D0_signal" 995 "SIGNALS_Virtual_DcmDspUDS_26A0ByteD1_D2_signal" 996 "SIGNALS_Virtual_DcmDspUDS_26A0ByteD3_D4_signal" 997 "SIGNALS_Virtual_DcmDspUDS_26A0ByteD5_D6_signal" 998 "SIGNALS_Virtual_DcmDspUDS_26A0ByteD7_D8_signal" 999 "SIGNALS_Virtual_DcmDspUDS_26A0ByteD9_DA_signal" 1000 "SIGNALS_Virtual_DcmDspUDS_26A0ByteDB_DC_signal" 1001 "SIGNALS_Virtual_DcmDspUDS_26A0ByteDD_DE_signal" 1002 "SIGNALS_Virtual_DcmDspUDS_26A0ByteDF_E0_signal" 1003 "SIGNALS_Virtual_DcmDspUDS_26A0ByteE1_E2_signal" 1004 "SIGNALS_Virtual_DcmDspUDS_26A0ByteE3_E4_signal" 1005 "SIGNALS_Virtual_DcmDspUDS_26A0ByteE5_E6_signal" 1006 "SIGNALS_Virtual_DcmDspUDS_26A0ByteE7_E8_signal" 1007 "SIGNALS_Virtual_DcmDspUDS_26A0ByteE9_EA_signal" 1008 "SIGNALS_Virtual_DcmDspUDS_26A0ByteEB_EC_signal" 1009 "SIGNALS_Virtual_DcmDspUDS_26A0ByteED_EE_signal" 1010 "SIGNALS_Virtual_DcmDspUDS_26A0ByteEF_F0_signal" 1011 "SIGNALS_Virtual_DcmDspUDS_26A0ByteF1_F2_signal" 1012 "SIGNALS_Virtual_DcmDspUDS_26A1Byte00_signal" 1013 "SIGNALS_Virtual_DcmDspUDS_26A1Byte01_signal" 1014 "SIGNALS_Virtual_DcmDspUDS_26A1Byte02_signal" 1015 "SIGNALS_Virtual_DcmDspUDS_26A1Byte03_signal" 1016 "SIGNALS_Virtual_DcmDspUDS_26A1Byte04_signal" 1017 "SIGNALS_Virtual_DcmDspUDS_26A1Byte05_signal" 1018 "SIGNALS_Virtual_DcmDspUDS_26A1Byte06_signal" 1019 "SIGNALS_Virtual_DcmDspUDS_26A1Byte07_signal" 1020 "SIGNALS_Virtual_DcmDspUDS_26A1Byte08_signal" 1021 "SIGNALS_Virtual_DcmDspUDS_26A1Byte09_signal" 1022 "SIGNALS_Virtual_DcmDspUDS_26A1Byte0A_signal" 1023 "SIGNALS_Virtual_DcmDspUDS_26A1Byte0B_signal" 1024 "SIGNALS_Virtual_DcmDspUDS_26A1Byte0C_signal" 1025 "SIGNALS_Virtual_DcmDspUDS_26A1Byte0D_signal" 1026 "SIGNALS_Virtual_DcmDspUDS_26A1Byte0E_signal" 1027 "SIGNALS_Virtual_DcmDspUDS_26A1Byte0F_signal" 1028 "SIGNALS_Virtual_DcmDspUDS_26A1Byte10_signal" 1029 "SIGNALS_Virtual_DcmDspUDS_26A1Byte11_signal" 1030 "SIGNALS_Virtual_DcmDspUDS_26A1Byte12_signal" 1031 "SIGNALS_Virtual_DcmDspUDS_26A1Byte13_signal" 1032 "SIGNALS_Virtual_DcmDspUDS_26A1Byte14_signal" 1033 "SIGNALS_Virtual_DcmDspUDS_26A1Byte15_signal" 1034 "SIGNALS_Virtual_DcmDspUDS_26A1Byte16_signal" 1035 "SIGNALS_Virtual_DcmDspUDS_26A1Byte17_signal" 1036 "SIGNALS_Virtual_DcmDspUDS_26A1Byte18_signal" 1037 "SIGNALS_Virtual_DcmDspUDS_26A1Byte19_signal" 1038 "SIGNALS_Virtual_DcmDspUDS_26A1Byte1A_signal" 1039 "SIGNALS_Virtual_DcmDspUDS_26A1Byte1B_1C_signal" 1040 "SIGNALS_Virtual_DcmDspUDS_26A1Byte1D_1E_signal" 1041 "SIGNALS_Virtual_DcmDspUDS_26A1Byte1F_20_signal" 1042 "SIGNALS_Virtual_DcmDspUDS_26A1Byte21_22_signal" 1043 "SIGNALS_Virtual_DcmDspUDS_26A1Byte23_24_signal" 1044 "SIGNALS_Virtual_DcmDspUDS_26A1Byte25_signal" 1045 "SIGNALS_Virtual_DcmDspUDS_26A1Byte26_signal" 1046 "SIGNALS_Virtual_DcmDspUDS_26A1Byte27_signal" 1047 "SIGNALS_Virtual_DcmDspUDS_26A1Byte28_signal" 1048 "SIGNALS_Virtual_DcmDspUDS_26A1Byte29_signal" 1049 "SIGNALS_Virtual_DcmDspUDS_26A1Byte2A_signal" 1050 "SIGNALS_Virtual_DcmDspUDS_26A1Byte2B_signal" 1051 "SIGNALS_Virtual_DcmDspUDS_26A1Byte2C_signal" 1052 "SIGNALS_Virtual_DcmDspUDS_26A1Byte2D_signal" 1053 "SIGNALS_Virtual_DcmDspUDS_26A1Byte2E_signal" 1054 "SIGNALS_Virtual_DcmDspUDS_26A1Byte2F_signal" 1055 "SIGNALS_Virtual_DcmDspUDS_26A1Byte30_signal" 1056 "SIGNALS_Virtual_DcmDspUDS_26A1Byte31_signal" 1057 "SIGNALS_Virtual_DcmDspUDS_26A1Byte32_signal" 1058 "SIGNALS_Virtual_DcmDspUDS_26A1Byte33_signal" 1059 "SIGNALS_Virtual_DcmDspUDS_26A1Byte34_signal" 1060 "SIGNALS_Virtual_DcmDspUDS_26A1Byte35_signal" 1061 "SIGNALS_Virtual_DcmDspUDS_26A1Byte36_signal" 1062 "SIGNALS_Virtual_DcmDspUDS_26A1Byte37_signal" 1063 "SIGNALS_Virtual_DcmDspUDS_26A1Byte38_signal" 1064 "SIGNALS_Virtual_DcmDspUDS_26A1Byte39_signal" 1065 "SIGNALS_Virtual_DcmDspUDS_26A1Byte6F_70_signal" 1066 "SIGNALS_Virtual_DcmDspUDS_26A1Byte71_72_signal" 1067 "SIGNALS_Virtual_DcmDspUDS_26A1Byte73_74_signal" 1068 "SIGNALS_Virtual_DcmDspUDS_26A1Byte75_76_signal" 1069 "SIGNALS_Virtual_DcmDspUDS_26A1Byte77_78_signal" 1070 "SIGNALS_Virtual_DcmDspUDS_26A1Byte79_signal" 1071 "SIGNALS_Virtual_DcmDspUDS_26A1Byte7B_signal" 1072 "SIGNALS_Virtual_DcmDspUDS_26A2Byte00_signal" 1073 "SIGNALS_Virtual_DcmDspUDS_26A2Byte01_signal" 1074 "SIGNALS_Virtual_DcmDspUDS_26A2Byte02_signal" 1075 "SIGNALS_Virtual_DcmDspUDS_26A2Byte03_signal" 1076 "SIGNALS_Virtual_DcmDspUDS_26A2Byte04_signal" 1077 "SIGNALS_Virtual_DcmDspUDS_26A2Byte05_signal" 1078 "SIGNALS_Virtual_DcmDspUDS_26A2Byte12_13_signal" 1079 "SIGNALS_Virtual_DcmDspUDS_26A2Byte1C_signal" 1080 "SIGNALS_Virtual_DcmDspUDS_26A2Byte1D_signal" 1081 "SIGNALS_Virtual_DcmDspUDS_26A2Byte21_signal" 1082 "SIGNALS_Virtual_DcmDspUDS_26A2Byte22_signal" 1083 "SIGNALS_Virtual_DcmDspUDS_Acm_fzabgs_w_signal" 1084 "SIGNALS_Virtual_DcmDspUDS_DID_2613Byte2Eto2F_signal_VirtFunc_s" 1085 "SIGNALS_Virtual_DcmDspUDS_DID_261AByte08_signal" 1086 "SIGNALS_Virtual_DcmDspUDS_DID_261AByte09_signal" 1087 "SIGNALS_Virtual_DcmDspUDS_DID_E402Byte00_signal" 1088 "SIGNALS_Virtual_DcmDspUDS_DID_E402Byte01_signal" 1089 "SIGNALS_Virtual_DcmDspUDS_DID_E402Byte07to08_signal" 1090 "SIGNALS_Virtual_DcmDspUDS_DID_E402Byte10to11_signal" 1091 "SIGNALS_Virtual_DcmDspUDS_DID_E402Byte19to1A_signal" 1092 "SIGNALS_Virtual_DcmDspUDS_DID_E402Byte22to23_signal" 1093 "SIGNALS_Virtual_DcmDspUDS_DID_E402Byte2Bto2C_signal" 1094 "SIGNALS_Virtual_DcmDspUDS_DID_F110Byte0_3_signal" 1095 "SIGNALS_Virtual_DcmDspUDS_DID_F110Byte12_15_signal" 1096 "SIGNALS_Virtual_DcmDspUDS_DID_F110Byte16_signal" 1097 "SIGNALS_Virtual_DcmDspUDS_DID_F110Byte4_7_signal" 1098 "SIGNALS_Virtual_DcmDspUDS_DID_F110Byte8_11_signal" 1099 "SIGNALS_Virtual_DcmDspUDS_DID_F112Byte0_3_signal" 1100 "SIGNALS_Virtual_DcmDspUDS_DID_F112Byte12_15_signal" 1101 "SIGNALS_Virtual_DcmDspUDS_DID_F112Byte16_19_signal" 1102 "SIGNALS_Virtual_DcmDspUDS_DID_F112Byte20_23_signal" 1103 "SIGNALS_Virtual_DcmDspUDS_DID_F112Byte24_27_signal" 1104 "SIGNALS_Virtual_DcmDspUDS_DID_F112Byte28_29_signal" 1105 "SIGNALS_Virtual_DcmDspUDS_DID_F112Byte30_signal" 1106 "SIGNALS_Virtual_DcmDspUDS_DID_F112Byte4_7_signal" 1107 "SIGNALS_Virtual_DcmDspUDS_DID_F112Byte8_11_signal" 1108 "SIGNALS_Virtual_DcmDspUDS_E602Byte2_signal" 1109 "SIGNALS_Virtual_DcmDspUDS_F181Byte0_3_signal" 1110 "SIGNALS_Virtual_DcmDspUDS_F181Byte12_15_signal" 1111 "SIGNALS_Virtual_DcmDspUDS_F181Byte4_7_signal" 1112 "SIGNALS_Virtual_DcmDspUDS_F181Byte8_11_signal" 1113 "SIGNALS_Virtual_DcmDspUDS_fzabgs_w_signal" 1114 "SIGNALS_Virtual_DcmDspUDS_numReWrECUID1_signal" 1115 "SIGNALS_Virtual_DcmDspUDS_numReWrECUID2_signal" 1116 "SIGNALS_Virtual_I14229B9_0490_FrNo09_signal" 1117 "SIGNALS_Virtual_I14229B9_0490_FrNo10_signal" 1118 "SIGNALS_Virtual_I14229B9_04B1_FrNo16_signal" 1119 "SIGNALS_Virtual_I14229B9_04B1_FrNo17_signal" 1120 "SIGNALS_Virtual_I14229B9_04B1_FrNo20_signal" 1121 "SIGNALS_Virtual_I14229B9_04B1_FrNo21_signal" 1122 "SIGNALS_Virtual_I14229B9_04B1_FrNo22_signal" 1123 "SIGNALS_Virtual_I14229B9_04B1_FrNo23_signal" 1124 "SIGNALS_Virtual_I14229B9_04C2_FrNo2021_signal" 1125 "SIGNALS_Virtual_I14229B9_04D2_FrNo24_signal" 1126 "SIGNALS_Virtual_I14229B9_04D2_FrNo25_signal" 1127 "SIGNALS_Virtual_I14229B9_0520_FrNo15_signal" 1128 "SIGNALS_Virtual_I14229B9_0520_FrNo16_signal" 1129 "SIGNALS_Virtual_I14229B9_0523_FrNo42_signal" 1130 "SIGNALS_Virtual_I14229B9_0523_FrNo43_signal" 1131 "SIGNALS_Virtual_I14229B9_0524_FrNo09_signal" 1132 "SIGNALS_Virtual_I14229B9_0524_FrNo10_signal" 1133 "SIGNALS_Virtual_I14229B9_0550_FrNo09_signal" 1134 "SIGNALS_Virtual_I14229B9_0550_FrNo10_signal" 1135 "SIGNALS_Virtual_I14229B9_0553_FrNo13_signal" 1136 "SIGNALS_Virtual_I14229B9_0553_FrNo14_signal" 1137 "SIGNALS_Virtual_I14229B9_056A_FrNo8_signal" 1138 "SIGNALS_Virtual_I14229B9_056A_FrNo9_signal" 1139 "SIGNALS_Virtual_I14229B9_0588_FrNo15_signal" 1140 "SIGNALS_Virtual_I14229B9_0588_FrNo16_signal" 1141 "SIGNALS_Virtual_I14229B9_05A0_FrNo40_signal" 1142 "SIGNALS_Virtual_I14229B9_05A0_FrNo41_signal" 1143 "SIGNALS_Virtual_I14229B9_05B0_FrNo13_signal" 1144 "SIGNALS_Virtual_I14229B9_05B0_FrNo14_signal" 1145 "SIGNALS_Virtual_I14229B9_05C0_FrNo12_signal" 1146 "SIGNALS_Virtual_I14229B9_05C0_FrNo13_signal" 1147 "SIGNALS_Virtual_I14229B9_05E0_FrNo19_signal" 1148 "SIGNALS_Virtual_I14229B9_05E0_FrNo20_signal" 1149 "SIGNALS_Virtual_I14229B9_05E0_FrNo21_signal" 1150 "SIGNALS_Virtual_I14229B9_05E0_FrNo22_signal" 1151 "SIGNALS_Virtual_I14229B9_05E0_FrNo23_signal" 1152 "SIGNALS_Virtual_I14229B9_05E0_FrNo24_signal" 1153 "SIGNALS_Virtual_I14229B9_1208_FrNo34_signal" 1154 "SIGNALS_Virtual_I14229B9_1208_FrNo35_signal" 1155 "SIGNALS_Virtual_I14229B9_1208_FrNo36_signal" 1156 "SIGNALS_Virtual_I14229B9_1208_FrNo37_signal" 1157 "SIGNALS_Virtual_I14229B9_120A_FrNo09_signal" 1158 "SIGNALS_Virtual_I14229B9_120A_FrNo10_signal" 1159 "SIGNALS_Virtual_I14229B9_120B_FrNo09_signal" 1160 "SIGNALS_Virtual_I14229B9_120B_FrNo10_signal" 1161 "SIGNALS_Virtual_I14229_Com_aLgtG_signal" 1162 "SIGNALS_Virtual_I14229_pEngSrtMin_signal" 1163 "SIGNALS_Virtual_IKCtl_agAdpnCurr_s16_signal" 1164 "SIGNALS_Virtual_IKCtl_wIntgRef_au32_0__s" 1165 "SIGNALS_Virtual_PtCoornDyn_tqCluDes_signal" 1166 "SIGNALS_Virtual_PtCoornDyn_tqCluLeadTrsmIntv_signal" 1167 "SIGNALS_Virtual_Tra_numGear_signal" 1168 "SIGNALS_Virtual_i14229_agIntkB1GEVlvSig_signal" /end COMPU_VTAB
/begin COMPU_METHOD spg_q0p00039 "" RAT_FUNC "%6.5" "V" COEFFS 0 1 0 0 0 0.000390625 /end COMPU_METHOD
/begin COMPU_METHOD s_q0p02777_m "" RAT_FUNC "%6.4" "m" COEFFS 0 36 0 0 0 1 /end COMPU_METHOD
/begin COMPU_METHOD t100msxs_uw_b6553p5 "" RAT_FUNC "%6.3" "s" COEFFS 0 1 0 0 0 0.1 /end COMPU_METHOD
/begin COMPU_METHOD Temp_Cels "" RAT_FUNC "%6.1" "deg C" COEFFS 0 10 2731.4 0 0 1 /end COMPU_METHOD
/begin COMPU_METHOD temp_ub_q0p75 "" RAT_FUNC "%6.3" "Grad C" COEFFS 0 1 0 0 0 0.75 /end COMPU_METHOD
/begin COMPU_METHOD temp_ub_q0p75_o48 "" RAT_FUNC "%6.2" "Grad C" COEFFS 0 1 48 0 0 0.75 /end COMPU_METHOD
/begin COMPU_METHOD Time_sec_q1_COMPU "" RAT_FUNC "%6.2" "s" COEFFS 0 1 0 0 0 1 /end COMPU_METHOD
/begin COMPU_METHOD t_q0p02 "" RAT_FUNC "%6.4" "s" COEFFS 0 100 0 0 0 2 /end COMPU_METHOD
/begin COMPU_METHOD t_q0p1 "" RAT_FUNC "%6.3" "s" COEFFS 0 10 0 0 0 1 /end COMPU_METHOD
/begin COMPU_METHOD t_q1 "" RAT_FUNC "%6.2" "s" COEFFS 0 1 0 0 0 1 /end COMPU_METHOD
/begin COMPU_METHOD Vel "" RAT_FUNC "%6.4" "km/h" COEFFS 0 100 0 0 0 1 /end COMPU_METHOD
/begin COMPU_METHOD vfzg_ub_q1p25 "" RAT_FUNC "%6.2" "km/h" COEFFS 0 1 0 0 0 1.25 /end COMPU_METHOD
/begin COMPU_METHOD vfzg_uw_b512 "" RAT_FUNC "%6.4" "km/h" COEFFS 0 65536 0 0 0 512 /end COMPU_METHOD
/begin COMPU_METHOD vol_q0p1_l "" RAT_FUNC "%6.3" "l" COEFFS 0 1 0 0 0 0.1 /end COMPU_METHOD
/begin COMPU_METHOD vol_q3p90625Em3_l "" RAT_FUNC "%6.4" "l" COEFFS 0 65536 0 0 0 256 /end COMPU_METHOD
/begin COMPU_METHOD vol_q7p8125Em3_l "" RAT_FUNC "%6.4" "l" COEFFS 0 128 0 0 0 1 /end COMPU_METHOD
/begin COMPU_METHOD zk100msxs_uw_b6553p6 "" RAT_FUNC "%6.1" "s" COEFFS 0 0 65536 0 10 0 /end COMPU_METHOD
/begin COMPU_METHOD zk10msxs_uw_b655p36 "" RAT_FUNC "%6.2" "s" COEFFS 0 0 65536 0 100 0 /end COMPU_METHOD
/begin RECORD_LAYOUT RB_Axis_U16 NO_AXIS_PTS_X 1 UWORD AXIS_PTS_X 2 UWORD INDEX_INCR DIRECT /end RECORD_LAYOUT
/begin RECORD_LAYOUT RB_CurveGroup_U16 FNC_VALUES 1 UWORD COLUMN_DIR DIRECT /end RECORD_LAYOUT
/begin RECORD_LAYOUT RB_Curve_S16_U8_Static NO_AXIS_PTS_X 1 SWORD AXIS_PTS_X 2 SWORD INDEX_INCR DIRECT FNC_VALUES 3 UBYTE COLUMN_DIR DIRECT STATIC_RECORD_LAYOUT /end RECORD_LAYOUT
/begin RECORD_LAYOUT RB_Curve_U16_U16 NO_AXIS_PTS_X 1 UWORD AXIS_PTS_X 2 UWORD INDEX_INCR DIRECT FNC_VALUES 3 UWORD COLUMN_DIR DIRECT /end RECORD_LAYOUT
/begin RECORD_LAYOUT RB_Curve_U16_U8_Static NO_AXIS_PTS_X 1 UWORD AXIS_PTS_X 2 UWORD INDEX_INCR DIRECT FNC_VALUES 3 UBYTE COLUMN_DIR DIRECT STATIC_RECORD_LAYOUT /end RECORD_LAYOUT
/begin RECORD_LAYOUT RB_Curve_U8_S16_Static NO_AXIS_PTS_X 1 UBYTE AXIS_PTS_X 2 UBYTE INDEX_INCR DIRECT FNC_VALUES 3 SWORD COLUMN_DIR DIRECT STATIC_RECORD_LAYOUT /end RECORD_LAYOUT
/begin RECORD_LAYOUT RB_Map_U16S16_U8 NO_AXIS_PTS_X 1 UWORD NO_AXIS_PTS_Y 2 UWORD AXIS_PTS_X 3 UWORD INDEX_INCR DIRECT AXIS_PTS_Y 4 SWORD INDEX_INCR DIRECT FNC_VALUES 5 UBYTE COLUMN_DIR DIRECT /end RECORD_LAYOUT
/begin RECORD_LAYOUT RB_Map_U16U16_U16 NO_AXIS_PTS_X 1 UWORD NO_AXIS_PTS_Y 2 UWORD AXIS_PTS_X 3 UWORD INDEX_INCR DIRECT AXIS_PTS_Y 4 UWORD INDEX_INCR DIRECT FNC_VALUES 5 UWORD COLUMN_DIR DIRECT /end RECORD_LAYOUT
/begin RECORD_LAYOUT RB_ValA_Wu16 FNC_VALUES 1 UWORD COLUMN_DIR DIRECT /end RECORD_LAYOUT
/begin RECORD_LAYOUT RB_Val_Wboolean FNC_VALUES 1 UBYTE COLUMN_DIR DIRECT /end RECORD_LAYOUT
/begin RECORD_LAYOUT RB_Val_Ws16 FNC_VALUES 1 SWORD COLUMN_DIR DIRECT /end RECORD_LAYOUT
/begin RECORD_LAYOUT RB_Val_Ws32 FNC_VALUES 1 SLONG COLUMN_DIR DIRECT /end RECORD_LAYOUT
/begin RECORD_LAYOUT RB_Val_Wu16 FNC_VALUES 1 UWORD COLUMN_DIR DIRECT /end RECORD_LAYOUT
/begin RECORD_LAYOUT RB_Val_Wu8 FNC_VALUES 1 UBYTE COLUMN_DIR DIRECT /end RECORD_LAYOUT
/begin RECORD_LAYOUT ValA_Wu16 FNC_VALUES 1 UWORD COLUMN_DIR DIRECT /end RECORD_LAYOUT
/begin RECORD_LAYOUT ValA_Wu8 FNC_VALUES 1 UBYTE COLUMN_DIR DIRECT /end RECORD_LAYOUT
/begin RECORD_LAYOUT Val_Wu16 FNC_VALUES 1 UWORD COLUMN_DIR DIRECT /end RECORD_LAYOUT
/begin RECORD_LAYOUT Val_Wu32 FNC_VALUES 1 ULONG COLUMN_DIR DIRECT /end RECORD_LAYOUT
/begin RECORD_LAYOUT Val_Wu8 FNC_VALUES 1 UBYTE COLUMN_DIR DIRECT /end RECORD_LAYOUT
/end MODULE
/end PROJECT
