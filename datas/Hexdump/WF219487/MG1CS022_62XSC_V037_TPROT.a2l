ASAP2_VERSION 1 60
/begin PROJECT MG1CS022 "MG1CS022"
/begin HEADER "" VERSION "MG1CS022_62XSC_V037_TPROT" PROJECT_NO MG1CS022 /end HEADER
/begin MODULE DIM ""
/begin MOD_COMMON "" BYTE_ORDER MSB_LAST ALIGNMENT_BYTE 1 ALIGNMENT_WORD 2 ALIGNMENT_LONG 4 ALIGNMENT_INT64 4 ALIGNMENT_FLOAT32_IEEE 4 ALIGNMENT_FLOAT64_IEEE 4 DATA_SIZE 32 /end MOD_COMMON
/begin CHARACTERISTIC DFES_DTCO.DFC_ETHSFsig_C "OBD specific trouble code / OBD specific diagnostic trouble code for check DFC_ETHSFsig" VALUE 0x80504120 Val_Wu16 65535.00 DFES_OneToOne 0.00 65535.00 FORMAT "%8.2" /end CHARACTERISTIC
/begin CHARACTERISTIC DFES_DTCO.DFC_ETHSNPWmax_C "OBD specific trouble code / OBD specific diagnostic trouble code for check DFC_ETHSNPWmax" VALUE 0x80504122 Val_Wu16 65535.00 DFES_OneToOne 0.00 65535.00 FORMAT "%8.2" /end CHARACTERISTIC
/begin CHARACTERISTIC DFES_DTCO.DFC_ETHSNPWmin_C "OBD specific trouble code / OBD specific diagnostic trouble code for check DFC_ETHSNPWmin" VALUE 0x80504124 Val_Wu16 65535.00 DFES_OneToOne 0.00 65535.00 FORMAT "%8.2" /end CHARACTERISTIC
/begin CHARACTERISTIC DFES_DTCO.DFC_ETHSNPWsig_C "OBD specific trouble code / OBD specific diagnostic trouble code for check DFC_ETHSNPWsig" VALUE 0x80504126 Val_Wu16 65535.00 DFES_OneToOne 0.00 65535.00 FORMAT "%8.2" /end CHARACTERISTIC
/begin CHARACTERISTIC DFES_DTCO.DFC_ETHSPLnpl_C "OBD specific trouble code / OBD specific diagnostic trouble code for check DFC_ETHSPLnpl" VALUE 0x80504128 Val_Wu16 65535.00 DFES_OneToOne 0.00 65535.00 FORMAT "%8.2" /end CHARACTERISTIC
/begin CHARACTERISTIC DFES_DTCO.DFC_ETHSTPLnpl_C "OBD specific trouble code / OBD specific diagnostic trouble code for check DFC_ETHSTPLnpl" VALUE 0x8050412A Val_Wu16 65535.00 DFES_OneToOne 0.00 65535.00 FORMAT "%8.2" /end CHARACTERISTIC
/begin CHARACTERISTIC DFES_DTCO.DFC_EngICO_C "OBD specific trouble code / OBD specific diagnostic trouble code for check DFC_EngICO" VALUE 0x8050412C Val_Wu16 65535.00 DFES_OneToOne 0.00 65535.00 FORMAT "%8.2" /end CHARACTERISTIC
/begin CHARACTERISTIC DFES_DTCO.DFC_EngPrtOvrSpdMon_C "OBD specific trouble code / OBD specific diagnostic trouble code for check DFC_EngPrtOvrSpdMon" VALUE 0x8050412E Val_Wu16 65535.00 DFES_OneToOne 0.00 65535.00 FORMAT "%8.2" /end CHARACTERISTIC
/begin CHARACTERISTIC DFES_DTCO.DFC_EpmCaSI1ErrSig_C "OBD specific trouble code / OBD specific diagnostic trouble code for check DFC_EpmCaSI1ErrSig" VALUE 0x80504130 Val_Wu16 65535.00 DFES_OneToOne 0.00 65535.00 FORMAT "%8.2" /end CHARACTERISTIC
/begin CHARACTERISTIC DFES_DTCO.DFC_EpmCaSI1MntErr_C "OBD specific trouble code / OBD specific diagnostic trouble code for check DFC_EpmCaSI1MntErr" VALUE 0x80504132 Val_Wu16 65535.00 DFES_OneToOne 0.00 65535.00 FORMAT "%8.2" /end CHARACTERISTIC
/begin CHARACTERISTIC DFES_DTCO.DFC_EpmCaSI1NoSigMax_C "OBD specific trouble code / OBD specific diagnostic trouble code for check DFC_EpmCaSI1NoSigMax" VALUE 0x80504134 Val_Wu16 65535.00 DFES_OneToOne 0.00 65535.00 FORMAT "%8.2" /end CHARACTERISTIC
/begin CHARACTERISTIC DFES_DTCO.DFC_EpmCaSI1NoSigMin_C "OBD specific trouble code / OBD specific diagnostic trouble code for check DFC_EpmCaSI1NoSigMin" VALUE 0x80504136 Val_Wu16 65535.00 DFES_OneToOne 0.00 65535.00 FORMAT "%8.2" /end CHARACTERISTIC
/begin CHARACTERISTIC DFES_DTCO.DFC_EpmCaSI1OfsErr_C "OBD specific trouble code / OBD specific diagnostic trouble code for check DFC_EpmCaSI1OfsErr" VALUE 0x80504138 Val_Wu16 65535.00 DFES_OneToOne 0.00 65535.00 FORMAT "%8.2" /end CHARACTERISTIC
/begin CHARACTERISTIC DFES_DTCO.DFC_EpmCrSDGI_C "OBD specific trouble code / OBD specific diagnostic trouble code for check DFC_EpmCrSDGI" VALUE 0x8050413A Val_Wu16 65535.00 DFES_OneToOne 0.00 65535.00 FORMAT "%8.2" /end CHARACTERISTIC
/begin CHARACTERISTIC DFES_DTCO.DFC_EpmCrSErrSig_C "OBD specific trouble code / OBD specific diagnostic trouble code for check DFC_EpmCrSErrSig" VALUE 0x8050413C Val_Wu16 65535.00 DFES_OneToOne 0.00 65535.00 FORMAT "%8.2" /end CHARACTERISTIC
/begin CHARACTERISTIC DFES_DTCO.DFC_EpmCrSNoSig_C "OBD specific trouble code / OBD specific diagnostic trouble code for check DFC_EpmCrSNoSig" VALUE 0x8050413E Val_Wu16 65535.00 DFES_OneToOne 0.00 65535.00 FORMAT "%8.2" /end CHARACTERISTIC
/begin CHARACTERISTIC DFES_DTCO.DFC_EtaEngIdleNonCsers_C "OBD specific trouble code / OBD specific diagnostic trouble code for check DFC_EtaEngIdleNonCsers" VALUE 0x80504140 Val_Wu16 65535.00 DFES_OneToOne 0.00 65535.00 FORMAT "%8.2" /end CHARACTERISTIC
/begin CHARACTERISTIC DFES_DTCO.DFC_EtaEngPtlNonCsers_C "OBD specific trouble code / OBD specific diagnostic trouble code for check DFC_EtaEngPtlNonCsers" VALUE 0x80504142 Val_Wu16 65535.00 DFES_OneToOne 0.00 65535.00 FORMAT "%8.2" /end CHARACTERISTIC
/begin CHARACTERISTIC DFES_DTCO.DFC_FRAmax_C "OBD specific trouble code / OBD specific diagnostic trouble code for check DFC_FRAmax" VALUE 0x80504144 Val_Wu16 65535.00 DFES_OneToOne 0.00 65535.00 FORMAT "%8.2" /end CHARACTERISTIC
/begin CHARACTERISTIC DFES_DTCO.DFC_FRAmin_C "OBD specific trouble code / OBD specific diagnostic trouble code for check DFC_FRAmin" VALUE 0x80504146 Val_Wu16 65535.00 DFES_OneToOne 0.00 65535.00 FORMAT "%8.2" /end CHARACTERISTIC
/begin CHARACTERISTIC DFES_DTCO.DFC_FSTEmax_C "OBD specific trouble code / OBD specific diagnostic trouble code for check DFC_FSTEmax" VALUE 0x80504148 Val_Wu16 65535.00 DFES_OneToOne 0.00 65535.00 FORMAT "%8.2" /end CHARACTERISTIC
/begin CHARACTERISTIC DFES_DTCO.DFC_FSTEmin_C "OBD specific trouble code / OBD specific diagnostic trouble code for check DFC_FSTEmin" VALUE 0x8050414A Val_Wu16 65535.00 DFES_OneToOne 0.00 65535.00 FORMAT "%8.2" /end CHARACTERISTIC
/begin CHARACTERISTIC DFES_DTCO.DFC_FSTRmax_C "OBD specific trouble code / OBD specific diagnostic trouble code for check DFC_FSTRmax" VALUE 0x8050414C Val_Wu16 65535.00 DFES_OneToOne 0.00 65535.00 FORMAT "%8.2" /end CHARACTERISTIC
/begin CHARACTERISTIC DFES_DTCO.DFC_FSTRmin_C "OBD specific trouble code / OBD specific diagnostic trouble code for check DFC_FSTRmin" VALUE 0x8050414E Val_Wu16 65535.00 DFES_OneToOne 0.00 65535.00 FORMAT "%8.2" /end CHARACTERISTIC
/begin CHARACTERISTIC DFES_DTCO.DFC_FSTRnpl_C "OBD specific trouble code / OBD specific diagnostic trouble code for check DFC_FSTRnpl" VALUE 0x80504150 Val_Wu16 65535.00 DFES_OneToOne 0.00 65535.00 FORMAT "%8.2" /end CHARACTERISTIC
/begin CHARACTERISTIC DFES_DTCO.DFC_FSTmax_C "OBD specific trouble code / OBD specific diagnostic trouble code for check DFC_FSTmax" VALUE 0x80504152 Val_Wu16 65535.00 DFES_OneToOne 0.00 65535.00 FORMAT "%8.2" /end CHARACTERISTIC
/begin CHARACTERISTIC DFES_DTCO.DFC_FTDLAmax_C "OBD specific trouble code / OBD specific diagnostic trouble code for check DFC_FTDLAmax" VALUE 0x80504154 Val_Wu16 65535.00 DFES_OneToOne 0.00 65535.00 FORMAT "%8.2" /end CHARACTERISTIC
/begin CHARACTERISTIC DFES_DTCO.DFC_FTDLAmin_C "OBD specific trouble code / OBD specific diagnostic trouble code for check DFC_FTDLAmin" VALUE 0x80504156 Val_Wu16 65535.00 DFES_OneToOne 0.00 65535.00 FORMAT "%8.2" /end CHARACTERISTIC
/begin CHARACTERISTIC DFES_DTCO.DFC_FuPHiSnsrEleclmax_C "OBD specific trouble code / OBD specific diagnostic trouble code for check DFC_FuPHiSnsrEleclmax" VALUE 0x80504158 Val_Wu16 65535.00 DFES_OneToOne 0.00 65535.00 FORMAT "%8.2" /end CHARACTERISTIC
/begin CHARACTERISTIC DFES_DTCO.DFC_FuPHiSnsrEleclmin_C "OBD specific trouble code / OBD specific diagnostic trouble code for check DFC_FuPHiSnsrEleclmin" VALUE 0x8050415A Val_Wu16 65535.00 DFES_OneToOne 0.00 65535.00 FORMAT "%8.2" /end CHARACTERISTIC
/begin CHARACTERISTIC DFES_DTCO.DFC_FuPHiSnsrEleclnpl_C "OBD specific trouble code / OBD specific diagnostic trouble code for check DFC_FuPHiSnsrEleclnpl" VALUE 0x8050415C Val_Wu16 65535.00 DFES_OneToOne 0.00 65535.00 FORMAT "%8.2" /end CHARACTERISTIC
/begin CHARACTERISTIC DFES_DTCO.DFC_FuPHiSnsrURngMax_C "OBD specific trouble code / OBD specific diagnostic trouble code for check DFC_FuPHiSnsrURngMax" VALUE 0x8050415E Val_Wu16 65535.00 DFES_OneToOne 0.00 65535.00 FORMAT "%8.2" /end CHARACTERISTIC
/begin CHARACTERISTIC DFES_DTCO.DFC_FuPHiSnsrURngMin_C "OBD specific trouble code / OBD specific diagnostic trouble code for check DFC_FuPHiSnsrURngMin" VALUE 0x80504160 Val_Wu16 65535.00 DFES_OneToOne 0.00 65535.00 FORMAT "%8.2" /end CHARACTERISTIC
/begin CHARACTERISTIC DFES_DTCO.DFC_FuSnsrPhyRngMaxErr_C "OBD specific trouble code / OBD specific diagnostic trouble code for check DFC_FuSnsrPhyRngMaxErr" VALUE 0x80504162 Val_Wu16 65535.00 DFES_OneToOne 0.00 65535.00 FORMAT "%8.2" /end CHARACTERISTIC
/begin CHARACTERISTIC DFES_DTCO.DFC_FuSnsrPhyRngMinErr_C "OBD specific trouble code / OBD specific diagnostic trouble code for check DFC_FuSnsrPhyRngMinErr" VALUE 0x80504164 Val_Wu16 65535.00 DFES_OneToOne 0.00 65535.00 FORMAT "%8.2" /end CHARACTERISTIC
/begin CHARACTERISTIC DFES_DTCO.DFC_GEVlvLockPinDiagIntkB1_C "OBD specific trouble code / OBD specific diagnostic trouble code for check DFC_GEVlvLockPinDiagIntkB1" VALUE 0x80504166 Val_Wu16 65535.00 DFES_OneToOne 0.00 65535.00 FORMAT "%8.2" /end CHARACTERISTIC
/begin CHARACTERISTIC DFES_DTCO.DFC_GEVlvPhaSlowIntkB1_C "OBD specific trouble code / OBD specific diagnostic trouble code for check DFC_GEVlvPhaSlowIntkB1" VALUE 0x80504168 Val_Wu16 65535.00 DFES_OneToOne 0.00 65535.00 FORMAT "%8.2" /end CHARACTERISTIC
/begin CHARACTERISTIC DFES_DTCO.DFC_GEVlvPhaTargIntkB1_C "OBD specific trouble code / OBD specific diagnostic trouble code for check DFC_GEVlvPhaTargIntkB1" VALUE 0x8050416A Val_Wu16 65535.00 DFES_OneToOne 0.00 65535.00 FORMAT "%8.2" /end CHARACTERISTIC
/begin CHARACTERISTIC DFES_DTCO.DFC_GbxRvsSwtStk_C "OBD specific trouble code / OBD specific diagnostic trouble code for check DFC_GbxRvsSwtStk" VALUE 0x8050416C Val_Wu16 65535.00 DFES_OneToOne 0.00 65535.00 FORMAT "%8.2" /end CHARACTERISTIC
/begin CHARACTERISTIC DFES_DTCO.DFC_HDRKHmax_C "OBD specific trouble code / OBD specific diagnostic trouble code for check DFC_HDRKHmax" VALUE 0x8050416E Val_Wu16 65535.00 DFES_OneToOne 0.00 65535.00 FORMAT "%8.2" /end CHARACTERISTIC
/begin CHARACTERISTIC DFES_DTCO.DFC_HDRKHmin_C "OBD specific trouble code / OBD specific diagnostic trouble code for check DFC_HDRKHmin" VALUE 0x80504170 Val_Wu16 65535.00 DFES_OneToOne 0.00 65535.00 FORMAT "%8.2" /end CHARACTERISTIC
/begin CHARACTERISTIC DFES_DTCO.DFC_HDRPLmax_C "OBD specific trouble code / OBD specific diagnostic trouble code for check DFC_HDRPLmax" VALUE 0x80504172 Val_Wu16 65535.00 DFES_OneToOne 0.00 65535.00 FORMAT "%8.2" /end CHARACTERISTIC
/begin CHARACTERISTIC DFES_DTCO.DFC_HDRPLmin_C "OBD specific trouble code / OBD specific diagnostic trouble code for check DFC_HDRPLmin" VALUE 0x80504174 Val_Wu16 65535.00 DFES_OneToOne 0.00 65535.00 FORMAT "%8.2" /end CHARACTERISTIC
/begin CHARACTERISTIC DFES_DTCO.DFC_HDRmax_C "OBD specific trouble code / OBD specific diagnostic trouble code for check DFC_HDRmax" VALUE 0x80504176 Val_Wu16 65535.00 DFES_OneToOne 0.00 65535.00 FORMAT "%8.2" /end CHARACTERISTIC
/begin CHARACTERISTIC DFES_DTCO.DFC_HDRmin_C "OBD specific trouble code / OBD specific diagnostic trouble code for check DFC_HDRmin" VALUE 0x80504178 Val_Wu16 65535.00 DFES_OneToOne 0.00 65535.00 FORMAT "%8.2" /end CHARACTERISTIC
/begin CHARACTERISTIC DFES_DTCO.DFC_HEGOS2B1ElecMax_C "OBD specific trouble code / OBD specific diagnostic trouble code for check DFC_HEGOS2B1ElecMax" VALUE 0x8050417A Val_Wu16 65535.00 DFES_OneToOne 0.00 65535.00 FORMAT "%8.2" /end CHARACTERISTIC
/begin CHARACTERISTIC DFES_DTCO.DFC_HEGOS2B1ElecMin_C "OBD specific trouble code / OBD specific diagnostic trouble code for check DFC_HEGOS2B1ElecMin" VALUE 0x8050417C Val_Wu16 65535.00 DFES_OneToOne 0.00 65535.00 FORMAT "%8.2" /end CHARACTERISTIC
/begin CHARACTERISTIC DFES_DTCO.DFC_HEGOS2B1ElecSig_C "OBD specific trouble code / OBD specific diagnostic trouble code for check DFC_HEGOS2B1ElecSig" VALUE 0x8050417E Val_Wu16 65535.00 DFES_OneToOne 0.00 65535.00 FORMAT "%8.2" /end CHARACTERISTIC
/begin CHARACTERISTIC DFES_DTCO.DFC_HEGOS2B1HtgNpl_C "OBD specific trouble code / OBD specific diagnostic trouble code for check DFC_HEGOS2B1HtgNpl" VALUE 0x80504180 Val_Wu16 65535.00 DFES_OneToOne 0.00 65535.00 FORMAT "%8.2" /end CHARACTERISTIC
/begin CHARACTERISTIC DFES_DTCO.DFC_HEV00max_C "OBD specific trouble code / OBD specific diagnostic trouble code for check DFC_HEV00max" VALUE 0x80504182 Val_Wu16 65535.00 DFES_OneToOne 0.00 65535.00 FORMAT "%8.2" /end CHARACTERISTIC
/begin CHARACTERISTIC DFES_DTCO.DFC_HEV01max_C "OBD specific trouble code / OBD specific diagnostic trouble code for check DFC_HEV01max" VALUE 0x80504184 Val_Wu16 65535.00 DFES_OneToOne 0.00 65535.00 FORMAT "%8.2" /end CHARACTERISTIC
/begin CHARACTERISTIC DFES_DTCO.DFC_HEV02max_C "OBD specific trouble code / OBD specific diagnostic trouble code for check DFC_HEV02max" VALUE 0x80504186 Val_Wu16 65535.00 DFES_OneToOne 0.00 65535.00 FORMAT "%8.2" /end CHARACTERISTIC
/begin CHARACTERISTIC DFES_DTCO.DFC_HEV03max_C "OBD specific trouble code / OBD specific diagnostic trouble code for check DFC_HEV03max" VALUE 0x80504188 Val_Wu16 65535.00 DFES_OneToOne 0.00 65535.00 FORMAT "%8.2" /end CHARACTERISTIC
/begin CHARACTERISTIC DFES_DTCO.DFC_HEVE0max_C "OBD specific trouble code / OBD specific diagnostic trouble code for check DFC_HEVE0max" VALUE 0x8050418A Val_Wu16 65535.00 DFES_OneToOne 0.00 65535.00 FORMAT "%8.2" /end CHARACTERISTIC
/begin CHARACTERISTIC DFES_DTCO.DFC_HEVE1max_C "OBD specific trouble code / OBD specific diagnostic trouble code for check DFC_HEVE1max" VALUE 0x8050418C Val_Wu16 65535.00 DFES_OneToOne 0.00 65535.00 FORMAT "%8.2" /end CHARACTERISTIC
/begin CHARACTERISTIC DFES_DTCO.DFC_HFMmax_C "OBD specific trouble code / OBD specific diagnostic trouble code for check DFC_HFMmax" VALUE 0x8050418E Val_Wu16 65535.00 DFES_OneToOne 0.00 65535.00 FORMAT "%8.2" /end CHARACTERISTIC
/begin CHARACTERISTIC DFES_DTCO.DFC_HiPSysHiPMaxLimExcdd_C "OBD specific trouble code / OBD specific diagnostic trouble code for check DFC_HiPSysHiPMaxLimExcdd" VALUE 0x80504190 Val_Wu16 65535.00 DFES_OneToOne 0.00 65535.00 FORMAT "%8.2" /end CHARACTERISTIC
/begin CHARACTERISTIC DFES_DTCO.DFC_IVGdiCtlCvoErrMax_0_C "OBD specific trouble code / OBD specific diagnostic trouble code for check DFC_IVGdiCtlCvoErrMax_0" VALUE 0x80504192 Val_Wu16 65535.00 DFES_OneToOne 0.00 65535.00 FORMAT "%8.2" /end CHARACTERISTIC
/begin CHARACTERISTIC DFES_DTCO.DFC_IVGdiCtlCvoErrMax_1_C "OBD specific trouble code / OBD specific diagnostic trouble code for check DFC_IVGdiCtlCvoErrMax_1" VALUE 0x80504194 Val_Wu16 65535.00 DFES_OneToOne 0.00 65535.00 FORMAT "%8.2" /end CHARACTERISTIC
/begin CHARACTERISTIC DFES_DTCO.DFC_IVGdiCtlCvoErrMax_2_C "OBD specific trouble code / OBD specific diagnostic trouble code for check DFC_IVGdiCtlCvoErrMax_2" VALUE 0x80504196 Val_Wu16 65535.00 DFES_OneToOne 0.00 65535.00 FORMAT "%8.2" /end CHARACTERISTIC
/begin CHARACTERISTIC DFES_DTCO.DFC_IVGdiCtlCvoErrMax_3_C "OBD specific trouble code / OBD specific diagnostic trouble code for check DFC_IVGdiCtlCvoErrMax_3" VALUE 0x80504198 Val_Wu16 65535.00 DFES_OneToOne 0.00 65535.00 FORMAT "%8.2" /end CHARACTERISTIC
/begin CHARACTERISTIC DFES_DTCO.DFC_IVGdiCtlCvoErrMin_0_C "OBD specific trouble code / OBD specific diagnostic trouble code for check DFC_IVGdiCtlCvoErrMin_0" VALUE 0x8050419A Val_Wu16 65535.00 DFES_OneToOne 0.00 65535.00 FORMAT "%8.2" /end CHARACTERISTIC
/begin CHARACTERISTIC DFES_DTCO.DFC_IVGdiCtlCvoErrMin_1_C "OBD specific trouble code / OBD specific diagnostic trouble code for check DFC_IVGdiCtlCvoErrMin_1" VALUE 0x8050419C Val_Wu16 65535.00 DFES_OneToOne 0.00 65535.00 FORMAT "%8.2" /end CHARACTERISTIC
/begin CHARACTERISTIC DFES_DTCO.DFC_IVGdiCtlCvoErrMin_2_C "OBD specific trouble code / OBD specific diagnostic trouble code for check DFC_IVGdiCtlCvoErrMin_2" VALUE 0x8050419E Val_Wu16 65535.00 DFES_OneToOne 0.00 65535.00 FORMAT "%8.2" /end CHARACTERISTIC
/begin CHARACTERISTIC DFES_DTCO.DFC_IVGdiCtlCvoErrMin_3_C "OBD specific trouble code / OBD specific diagnostic trouble code for check DFC_IVGdiCtlCvoErrMin_3" VALUE 0x805041A0 Val_Wu16 65535.00 DFES_OneToOne 0.00 65535.00 FORMAT "%8.2" /end CHARACTERISTIC
/begin CHARACTERISTIC DFES_DTCO.DFC_IVGdiCtlCvoErrMinMax_C "OBD specific trouble code / OBD specific diagnostic trouble code for check DFC_IVGdiCtlCvoErrMinMax" VALUE 0x805041A2 Val_Wu16 65535.00 DFES_OneToOne 0.00 65535.00 FORMAT "%8.2" /end CHARACTERISTIC
/begin CHARACTERISTIC DFES_DTCO.DFC_IVGdiCtlCvoSigPlausErrSmrCdn_C "OBD specific trouble code / OBD specific diagnostic trouble code for check DFC_IVGdiCtlCvoSigPlausErrSmrCdn" VALUE 0x805041A4 Val_Wu16 65535.00 DFES_OneToOne 0.00 65535.00 FORMAT "%8.2" /end CHARACTERISTIC
/begin CHARACTERISTIC DFES_DTCO.DFC_IVGdiCtl_CvoErr_C "OBD specific trouble code / OBD specific diagnostic trouble code for check DFC_IVGdiCtl_CvoErr" VALUE 0x805041A6 Val_Wu16 65535.00 DFES_OneToOne 0.00 65535.00 FORMAT "%8.2" /end CHARACTERISTIC
/begin CHARACTERISTIC DFES_DTCO.DFC_IVGdiCtl_CvoSigPlaus_0_C "OBD specific trouble code / OBD specific diagnostic trouble code for check DFC_IVGdiCtl_CvoSigPlaus_0" VALUE 0x805041A8 Val_Wu16 65535.00 DFES_OneToOne 0.00 65535.00 FORMAT "%8.2" /end CHARACTERISTIC
/begin CHARACTERISTIC DFES_DTCO.DFC_IVGdiCtl_CvoSigPlaus_1_C "OBD specific trouble code / OBD specific diagnostic trouble code for check DFC_IVGdiCtl_CvoSigPlaus_1" VALUE 0x805041AA Val_Wu16 65535.00 DFES_OneToOne 0.00 65535.00 FORMAT "%8.2" /end CHARACTERISTIC
/begin CHARACTERISTIC DFES_DTCO.DFC_IVGdiCtl_CvoSigPlaus_2_C "OBD specific trouble code / OBD specific diagnostic trouble code for check DFC_IVGdiCtl_CvoSigPlaus_2" VALUE 0x805041AC Val_Wu16 65535.00 DFES_OneToOne 0.00 65535.00 FORMAT "%8.2" /end CHARACTERISTIC
/begin CHARACTERISTIC DFES_DTCO.DFC_IVGdiCtl_CvoSigPlaus_3_C "OBD specific trouble code / OBD specific diagnostic trouble code for check DFC_IVGdiCtl_CvoSigPlaus_3" VALUE 0x805041AE Val_Wu16 65535.00 DFES_OneToOne 0.00 65535.00 FORMAT "%8.2" /end CHARACTERISTIC
/begin CHARACTERISTIC DFES_DTCO.DFC_IntkAirTAirFltDsCrssMax_C "OBD specific trouble code / OBD specific diagnostic trouble code for check DFC_IntkAirTAirFltDsCrssMax" VALUE 0x805041B0 Val_Wu16 65535.00 DFES_OneToOne 0.00 65535.00 FORMAT "%8.2" /end CHARACTERISTIC
/begin CHARACTERISTIC DFES_DTCO.DFC_IntkAirTAirFltDsCrssMin_C "OBD specific trouble code / OBD specific diagnostic trouble code for check DFC_IntkAirTAirFltDsCrssMin" VALUE 0x805041B2 Val_Wu16 65535.00 DFES_OneToOne 0.00 65535.00 FORMAT "%8.2" /end CHARACTERISTIC
/begin CHARACTERISTIC DFES_DTCO.DFC_IntkAirTAirFltDsHSCMax_C "OBD specific trouble code / OBD specific diagnostic trouble code for check DFC_IntkAirTAirFltDsHSCMax" VALUE 0x805041B4 Val_Wu16 65535.00 DFES_OneToOne 0.00 65535.00 FORMAT "%8.2" /end CHARACTERISTIC
/begin CHARACTERISTIC DFES_DTCO.DFC_IntkAirTAirFltDsImps_C "OBD specific trouble code / OBD specific diagnostic trouble code for check DFC_IntkAirTAirFltDsImps" VALUE 0x805041B6 Val_Wu16 65535.00 DFES_OneToOne 0.00 65535.00 FORMAT "%8.2" /end CHARACTERISTIC
/begin CHARACTERISTIC DFES_DTCO.DFC_IntkAirTAirFltDsPRCMax_C "OBD specific trouble code / OBD specific diagnostic trouble code for check DFC_IntkAirTAirFltDsPRCMax" VALUE 0x805041B8 Val_Wu16 65535.00 DFES_OneToOne 0.00 65535.00 FORMAT "%8.2" /end CHARACTERISTIC
/begin CHARACTERISTIC DFES_DTCO.DFC_IntkAirTAirFltDsPRCMin_C "OBD specific trouble code / OBD specific diagnostic trouble code for check DFC_IntkAirTAirFltDsPRCMin" VALUE 0x805041BA Val_Wu16 65535.00 DFES_OneToOne 0.00 65535.00 FORMAT "%8.2" /end CHARACTERISTIC
/begin CHARACTERISTIC DFES_DTCO.DFC_IntkAirTAirFltDsSRCMax_C "OBD specific trouble code / OBD specific diagnostic trouble code for check DFC_IntkAirTAirFltDsSRCMax" VALUE 0x805041BC Val_Wu16 65535.00 DFES_OneToOne 0.00 65535.00 FORMAT "%8.2" /end CHARACTERISTIC
/begin CHARACTERISTIC DFES_DTCO.DFC_IntkAirTAirFltDsSRCMin_C "OBD specific trouble code / OBD specific diagnostic trouble code for check DFC_IntkAirTAirFltDsSRCMin" VALUE 0x805041BE Val_Wu16 65535.00 DFES_OneToOne 0.00 65535.00 FORMAT "%8.2" /end CHARACTERISTIC
/begin CHARACTERISTIC DFES_DTCO.DFC_IntkAirTAirFltDsSTC_C "OBD specific trouble code / OBD specific diagnostic trouble code for check DFC_IntkAirTAirFltDsSTC" VALUE 0x805041C0 Val_Wu16 65535.00 DFES_OneToOne 0.00 65535.00 FORMAT "%8.2" /end CHARACTERISTIC
/begin CHARACTERISTIC DFES_DTCO.DFC_IntkAirTIntkMnfldCrssMax_C "OBD specific trouble code / OBD specific diagnostic trouble code for check DFC_IntkAirTIntkMnfldCrssMax" VALUE 0x805041C2 Val_Wu16 65535.00 DFES_OneToOne 0.00 65535.00 FORMAT "%8.2" /end CHARACTERISTIC
/begin CHARACTERISTIC DFES_DTCO.DFC_IntkAirTIntkMnfldCrssMin_C "OBD specific trouble code / OBD specific diagnostic trouble code for check DFC_IntkAirTIntkMnfldCrssMin" VALUE 0x805041C4 Val_Wu16 65535.00 DFES_OneToOne 0.00 65535.00 FORMAT "%8.2" /end CHARACTERISTIC
/begin CHARACTERISTIC DFES_DTCO.DFC_IntkAirTIntkMnfldHSCMax_C "OBD specific trouble code / OBD specific diagnostic trouble code for check DFC_IntkAirTIntkMnfldHSCMax" VALUE 0x805041C6 Val_Wu16 65535.00 DFES_OneToOne 0.00 65535.00 FORMAT "%8.2" /end CHARACTERISTIC
/begin CHARACTERISTIC DFES_DTCO.DFC_IntkAirTIntkMnfldImps_C "OBD specific trouble code / OBD specific diagnostic trouble code for check DFC_IntkAirTIntkMnfldImps" VALUE 0x805041C8 Val_Wu16 65535.00 DFES_OneToOne 0.00 65535.00 FORMAT "%8.2" /end CHARACTERISTIC
/begin CHARACTERISTIC DFES_DTCO.DFC_IntkAirTIntkMnfldPRCMax_C "OBD specific trouble code / OBD specific diagnostic trouble code for check DFC_IntkAirTIntkMnfldPRCMax" VALUE 0x805041CA Val_Wu16 65535.00 DFES_OneToOne 0.00 65535.00 FORMAT "%8.2" /end CHARACTERISTIC
/begin CHARACTERISTIC DFES_DTCO.DFC_IntkAirTIntkMnfldPRCMin_C "OBD specific trouble code / OBD specific diagnostic trouble code for check DFC_IntkAirTIntkMnfldPRCMin" VALUE 0x805041CC Val_Wu16 65535.00 DFES_OneToOne 0.00 65535.00 FORMAT "%8.2" /end CHARACTERISTIC
/begin CHARACTERISTIC DFES_DTCO.DFC_IntkAirTIntkMnfldSRCMax_C "OBD specific trouble code / OBD specific diagnostic trouble code for check DFC_IntkAirTIntkMnfldSRCMax" VALUE 0x805041CE Val_Wu16 65535.00 DFES_OneToOne 0.00 65535.00 FORMAT "%8.2" /end CHARACTERISTIC
/begin CHARACTERISTIC DFES_DTCO.DFC_IntkAirTIntkMnfldSRCMin_C "OBD specific trouble code / OBD specific diagnostic trouble code for check DFC_IntkAirTIntkMnfldSRCMin" VALUE 0x805041D0 Val_Wu16 65535.00 DFES_OneToOne 0.00 65535.00 FORMAT "%8.2" /end CHARACTERISTIC
/begin CHARACTERISTIC DFES_DTCO.DFC_IntkAirTIntkMnfldSTC_C "OBD specific trouble code / OBD specific diagnostic trouble code for check DFC_IntkAirTIntkMnfldSTC" VALUE 0x805041D2 Val_Wu16 65535.00 DFES_OneToOne 0.00 65535.00 FORMAT "%8.2" /end CHARACTERISTIC
/begin CHARACTERISTIC DFES_DTCO.DFC_KRREGRLMX_C "OBD specific trouble code / OBD specific diagnostic trouble code for check DFC_KRREGRLMX" VALUE 0x805041D4 Val_Wu16 65535.00 DFES_OneToOne 0.00 65535.00 FORMAT "%8.2" /end CHARACTERISTIC
/begin CHARACTERISTIC DFES_DTCO.DFC_KRVEKOCVLCI_C "OBD specific trouble code / OBD specific diagnostic trouble code for check DFC_KRVEKOCVLCI" VALUE 0x805041D6 Val_Wu16 65535.00 DFES_OneToOne 0.00 65535.00 FORMAT "%8.2" /end CHARACTERISTIC
/begin CHARACTERISTIC DFES_DTCO.DFC_KRVEKOENCHMT_C "OBD specific trouble code / OBD specific diagnostic trouble code for check DFC_KRVEKOENCHMT" VALUE 0x805041D8 Val_Wu16 65535.00 DFES_OneToOne 0.00 65535.00 FORMAT "%8.2" /end CHARACTERISTIC
/begin CHARACTERISTIC DFES_DTCO.DFC_KRVEKOENCHMT0_C "OBD specific trouble code / OBD specific diagnostic trouble code for check DFC_KRVEKOENCHMT0" VALUE 0x805041DA Val_Wu16 65535.00 DFES_OneToOne 0.00 65535.00 FORMAT "%8.2" /end CHARACTERISTIC
/begin CHARACTERISTIC DFES_DTCO.DFC_KRVEKOENCHMT1_C "OBD specific trouble code / OBD specific diagnostic trouble code for check DFC_KRVEKOENCHMT1" VALUE 0x805041DC Val_Wu16 65535.00 DFES_OneToOne 0.00 65535.00 FORMAT "%8.2" /end CHARACTERISTIC
/begin CHARACTERISTIC DFES_DTCO.DFC_KRVEKOENCHMT2_C "OBD specific trouble code / OBD specific diagnostic trouble code for check DFC_KRVEKOENCHMT2" VALUE 0x805041DE Val_Wu16 65535.00 DFES_OneToOne 0.00 65535.00 FORMAT "%8.2" /end CHARACTERISTIC
/begin CHARACTERISTIC DFES_DTCO.DFC_KRVEKOENCHMT3_C "OBD specific trouble code / OBD specific diagnostic trouble code for check DFC_KRVEKOENCHMT3" VALUE 0x805041E0 Val_Wu16 65535.00 DFES_OneToOne 0.00 65535.00 FORMAT "%8.2" /end CHARACTERISTIC
/begin CHARACTERISTIC DFES_DTCO.DFC_KRVEKOENCHMT4_C "OBD specific trouble code / OBD specific diagnostic trouble code for check DFC_KRVEKOENCHMT4" VALUE 0x805041E2 Val_Wu16 65535.00 DFES_OneToOne 0.00 65535.00 FORMAT "%8.2" /end CHARACTERISTIC
/begin CHARACTERISTIC DFES_DTCO.DFC_KRVEKOENCHMT5_C "OBD specific trouble code / OBD specific diagnostic trouble code for check DFC_KRVEKOENCHMT5" VALUE 0x805041E4 Val_Wu16 65535.00 DFES_OneToOne 0.00 65535.00 FORMAT "%8.2" /end CHARACTERISTIC
/begin CHARACTERISTIC DFES_DTCO.DFC_KRVEKOENCHMT6_C "OBD specific trouble code / OBD specific diagnostic trouble code for check DFC_KRVEKOENCHMT6" VALUE 0x805041E6 Val_Wu16 65535.00 DFES_OneToOne 0.00 65535.00 FORMAT "%8.2" /end CHARACTERISTIC
/begin CHARACTERISTIC DFES_DTCO.DFC_KRVEKOENCHMT7_C "OBD specific trouble code / OBD specific diagnostic trouble code for check DFC_KRVEKOENCHMT7" VALUE 0x805041E8 Val_Wu16 65535.00 DFES_OneToOne 0.00 65535.00 FORMAT "%8.2" /end CHARACTERISTIC
/begin CHARACTERISTIC DFES_DTCO.DFC_KRVEKORLMX_C "OBD specific trouble code / OBD specific diagnostic trouble code for check DFC_KRVEKORLMX" VALUE 0x805041EA Val_Wu16 65535.00 DFES_OneToOne 0.00 65535.00 FORMAT "%8.2" /end CHARACTERISTIC
/begin CHARACTERISTIC DFES_DTCO.DFC_KRVEKORLMXL_C "OBD specific trouble code / OBD specific diagnostic trouble code for check DFC_KRVEKORLMXL" VALUE 0x805041EC Val_Wu16 65535.00 DFES_OneToOne 0.00 65535.00 FORMAT "%8.2" /end CHARACTERISTIC
/begin CHARACTERISTIC DFES_DTCO.DFC_KS1max_C "OBD specific trouble code / OBD specific diagnostic trouble code for check DFC_KS1max" VALUE 0x805041EE Val_Wu16 65535.00 DFES_OneToOne 0.00 65535.00 FORMAT "%8.2" /end CHARACTERISTIC
/begin CHARACTERISTIC DFES_DTCO.DFC_KS1min_C "OBD specific trouble code / OBD specific diagnostic trouble code for check DFC_KS1min" VALUE 0x805041F0 Val_Wu16 65535.00 DFES_OneToOne 0.00 65535.00 FORMAT "%8.2" /end CHARACTERISTIC
/begin CHARACTERISTIC DFES_DTCO.DFC_LMmax_C "OBD specific trouble code / OBD specific diagnostic trouble code for check DFC_LMmax" VALUE 0x805041F2 Val_Wu16 65535.00 DFES_OneToOne 0.00 65535.00 FORMAT "%8.2" /end CHARACTERISTIC
/begin CHARACTERISTIC DFES_DTCO.DFC_LZSRnpl_C "OBD specific trouble code / OBD specific diagnostic trouble code for check DFC_LZSRnpl" VALUE 0x805041F4 Val_Wu16 65535.00 DFES_OneToOne 0.00 65535.00 FORMAT "%8.2" /end CHARACTERISTIC
/begin CHARACTERISTIC DFES_DTCO.DFC_LamDynDiagS1B1_C "OBD specific trouble code / OBD specific diagnostic trouble code for check DFC_LamDynDiagS1B1" VALUE 0x805041F6 Val_Wu16 65535.00 DFES_OneToOne 0.00 65535.00 FORMAT "%8.2" /end CHARACTERISTIC
/begin CHARACTERISTIC DFES_DTCO.DFC_LeakIntkMnfldEmiInfl_C "OBD specific trouble code / OBD specific diagnostic trouble code for check DFC_LeakIntkMnfldEmiInfl" VALUE 0x805041F8 Val_Wu16 65535.00 DFES_OneToOne 0.00 65535.00 FORMAT "%8.2" /end CHARACTERISTIC
/begin CHARACTERISTIC DFES_DTCO.DFC_LinFrameErrDCDC_C "OBD specific trouble code / OBD specific diagnostic trouble code for check DFC_LinFrameErrDCDC" VALUE 0x805041FA Val_Wu16 65535.00 DFES_OneToOne 0.00 65535.00 FORMAT "%8.2" /end CHARACTERISTIC
/begin CHARACTERISTIC DFES_DTCO.DFC_LinOverrunErrDCDC_C "OBD specific trouble code / OBD specific diagnostic trouble code for check DFC_LinOverrunErrDCDC" VALUE 0x805041FC Val_Wu16 65535.00 DFES_OneToOne 0.00 65535.00 FORMAT "%8.2" /end CHARACTERISTIC
/begin CHARACTERISTIC DFES_DTCO.DFC_MD00max_C "OBD specific trouble code / OBD specific diagnostic trouble code for check DFC_MD00max" VALUE 0x805041FE Val_Wu16 65535.00 DFES_OneToOne 0.00 65535.00 FORMAT "%8.2" /end CHARACTERISTIC
/begin CHARACTERISTIC DFES_DTCO.DFC_MDBmax_C "OBD specific trouble code / OBD specific diagnostic trouble code for check DFC_MDBmax" VALUE 0x80504200 Val_Wu16 65535.00 DFES_OneToOne 0.00 65535.00 FORMAT "%8.2" /end CHARACTERISTIC
/begin CHARACTERISTIC DFES_DTCO.DFC_MDCat_C "OBD specific trouble code / OBD specific diagnostic trouble code for check DFC_MDCat" VALUE 0x80504202 Val_Wu16 65535.00 DFES_OneToOne 0.00 65535.00 FORMAT "%8.2" /end CHARACTERISTIC
/begin CHARACTERISTIC DFES_DTCO.DFC_MDCatCrit_C "OBD specific trouble code / OBD specific diagnostic trouble code for check DFC_MDCatCrit" VALUE 0x80504204 Val_Wu16 65535.00 DFES_OneToOne 0.00 65535.00 FORMAT "%8.2" /end CHARACTERISTIC
/begin CHARACTERISTIC DFES_DTCO.DFC_MDCatCurr_C "OBD specific trouble code / OBD specific diagnostic trouble code for check DFC_MDCatCurr" VALUE 0x80504206 Val_Wu16 65535.00 DFES_OneToOne 0.00 65535.00 FORMAT "%8.2" /end CHARACTERISTIC
/begin CHARACTERISTIC DFES_DTCO.DFC_MDCyl_0_C "OBD specific trouble code / OBD specific diagnostic trouble code for check DFC_MDCyl_0" VALUE 0x80504208 Val_Wu16 65535.00 DFES_OneToOne 0.00 65535.00 FORMAT "%8.2" /end CHARACTERISTIC
/begin CHARACTERISTIC DFES_DTCO.DFC_MDCyl_1_C "OBD specific trouble code / OBD specific diagnostic trouble code for check DFC_MDCyl_1" VALUE 0x8050420A Val_Wu16 65535.00 DFES_OneToOne 0.00 65535.00 FORMAT "%8.2" /end CHARACTERISTIC
/begin CHARACTERISTIC DFES_DTCO.DFC_MDCyl_2_C "OBD specific trouble code / OBD specific diagnostic trouble code for check DFC_MDCyl_2" VALUE 0x8050420C Val_Wu16 65535.00 DFES_OneToOne 0.00 65535.00 FORMAT "%8.2" /end CHARACTERISTIC
/begin CHARACTERISTIC DFES_DTCO.DFC_MDCyl_3_C "OBD specific trouble code / OBD specific diagnostic trouble code for check DFC_MDCyl_3" VALUE 0x8050420E Val_Wu16 65535.00 DFES_OneToOne 0.00 65535.00 FORMAT "%8.2" /end CHARACTERISTIC
/begin CHARACTERISTIC DFES_DTCO.DFC_MDEmi_C "OBD specific trouble code / OBD specific diagnostic trouble code for check DFC_MDEmi" VALUE 0x80504210 Val_Wu16 65535.00 DFES_OneToOne 0.00 65535.00 FORMAT "%8.2" /end CHARACTERISTIC
/begin CHARACTERISTIC DFES_DTCO.DFC_MDEmiStrt_C "OBD specific trouble code / OBD specific diagnostic trouble code for check DFC_MDEmiStrt" VALUE 0x80504212 Val_Wu16 65535.00 DFES_OneToOne 0.00 65535.00 FORMAT "%8.2" /end CHARACTERISTIC
/begin CHARACTERISTIC DFES_DTCO.DFC_MDFco_C "OBD specific trouble code / OBD specific diagnostic trouble code for check DFC_MDFco" VALUE 0x80504214 Val_Wu16 65535.00 DFES_OneToOne 0.00 65535.00 FORMAT "%8.2" /end CHARACTERISTIC
/begin CHARACTERISTIC DFES_DTCO.DFC_MDMpl_C "OBD specific trouble code / OBD specific diagnostic trouble code for check DFC_MDMpl" VALUE 0x80504216 Val_Wu16 65535.00 DFES_OneToOne 0.00 65535.00 FORMAT "%8.2" /end CHARACTERISTIC
/begin CHARACTERISTIC DFES_DTCO.DFC_MDSegTiAdpn_C "OBD specific trouble code / OBD specific diagnostic trouble code for check DFC_MDSegTiAdpn" VALUE 0x80504218 Val_Wu16 65535.00 DFES_OneToOne 0.00 65535.00 FORMAT "%8.2" /end CHARACTERISTIC
/begin CHARACTERISTIC DFES_DTCO.DFC_MDmax_C "OBD specific trouble code / OBD specific diagnostic trouble code for check DFC_MDmax" VALUE 0x8050421A Val_Wu16 65535.00 DFES_OneToOne 0.00 65535.00 FORMAT "%8.2" /end CHARACTERISTIC
/begin CHARACTERISTIC DFES_DTCO.DFC_MFuOilMax_C "OBD specific trouble code / OBD specific diagnostic trouble code for check DFC_MFuOilMax" VALUE 0x8050421C Val_Wu16 65535.00 DFES_OneToOne 0.00 65535.00 FORMAT "%8.2" /end CHARACTERISTIC
/begin CHARACTERISTIC DFES_DTCO.DFC_MOXEMM_SMU_ALM0_0_C "OBD specific trouble code / OBD specific diagnostic trouble code for check DFC_MOXEMM_SMU_ALM0_0" VALUE 0x8050421E Val_Wu16 65535.00 DFES_OneToOne 0.00 65535.00 FORMAT "%8.2" /end CHARACTERISTIC
/begin CHARACTERISTIC DFES_DTCO.DFC_MOXEMM_SMU_ALM0_1_C "OBD specific trouble code / OBD specific diagnostic trouble code for check DFC_MOXEMM_SMU_ALM0_1" VALUE 0x80504220 Val_Wu16 65535.00 DFES_OneToOne 0.00 65535.00 FORMAT "%8.2" /end CHARACTERISTIC
/begin CHARACTERISTIC DFES_DTCO.DFC_MOXEMM_SMU_ALM0_10_C "OBD specific trouble code / OBD specific diagnostic trouble code for check DFC_MOXEMM_SMU_ALM0_10" VALUE 0x80504222 Val_Wu16 65535.00 DFES_OneToOne 0.00 65535.00 FORMAT "%8.2" /end CHARACTERISTIC
/begin CHARACTERISTIC DFES_DTCO.DFC_MOXEMM_SMU_ALM0_11_C "OBD specific trouble code / OBD specific diagnostic trouble code for check DFC_MOXEMM_SMU_ALM0_11" VALUE 0x80504224 Val_Wu16 65535.00 DFES_OneToOne 0.00 65535.00 FORMAT "%8.2" /end CHARACTERISTIC
/begin CHARACTERISTIC DFES_DTCO.DFC_MOXEMM_SMU_ALM0_13_C "OBD specific trouble code / OBD specific diagnostic trouble code for check DFC_MOXEMM_SMU_ALM0_13" VALUE 0x80504226 Val_Wu16 65535.00 DFES_OneToOne 0.00 65535.00 FORMAT "%8.2" /end CHARACTERISTIC
/begin CHARACTERISTIC DFES_DTCO.DFC_MOXEMM_SMU_ALM0_14_C "OBD specific trouble code / OBD specific diagnostic trouble code for check DFC_MOXEMM_SMU_ALM0_14" VALUE 0x80504228 Val_Wu16 65535.00 DFES_OneToOne 0.00 65535.00 FORMAT "%8.2" /end CHARACTERISTIC
/begin CHARACTERISTIC DFES_DTCO.DFC_MOXEMM_SMU_ALM0_2_C "OBD specific trouble code / OBD specific diagnostic trouble code for check DFC_MOXEMM_SMU_ALM0_2" VALUE 0x8050422A Val_Wu16 65535.00 DFES_OneToOne 0.00 65535.00 FORMAT "%8.2" /end CHARACTERISTIC
/begin CHARACTERISTIC DFES_DTCO.DFC_MOXEMM_SMU_ALM0_22_C "OBD specific trouble code / OBD specific diagnostic trouble code for check DFC_MOXEMM_SMU_ALM0_22" VALUE 0x8050422C Val_Wu16 65535.00 DFES_OneToOne 0.00 65535.00 FORMAT "%8.2" /end CHARACTERISTIC
/begin CHARACTERISTIC DFES_DTCO.DFC_MOXEMM_SMU_ALM0_23_C "OBD specific trouble code / OBD specific diagnostic trouble code for check DFC_MOXEMM_SMU_ALM0_23" VALUE 0x8050422E Val_Wu16 65535.00 DFES_OneToOne 0.00 65535.00 FORMAT "%8.2" /end CHARACTERISTIC
/begin CHARACTERISTIC DFES_DTCO.DFC_MOXEMM_SMU_ALM0_4_C "OBD specific trouble code / OBD specific diagnostic trouble code for check DFC_MOXEMM_SMU_ALM0_4" VALUE 0x80504230 Val_Wu16 65535.00 DFES_OneToOne 0.00 65535.00 FORMAT "%8.2" /end CHARACTERISTIC
/begin CHARACTERISTIC DFES_DTCO.DFC_MOXEMM_SMU_ALM0_5_C "OBD specific trouble code / OBD specific diagnostic trouble code for check DFC_MOXEMM_SMU_ALM0_5" VALUE 0x80504232 Val_Wu16 65535.00 DFES_OneToOne 0.00 65535.00 FORMAT "%8.2" /end CHARACTERISTIC
/begin CHARACTERISTIC DFES_DTCO.DFC_MOXEMM_SMU_ALM0_7_C "OBD specific trouble code / OBD specific diagnostic trouble code for check DFC_MOXEMM_SMU_ALM0_7" VALUE 0x80504234 Val_Wu16 65535.00 DFES_OneToOne 0.00 65535.00 FORMAT "%8.2" /end CHARACTERISTIC
/begin CHARACTERISTIC DFES_DTCO.DFC_MOXEMM_SMU_ALM0_8_C "OBD specific trouble code / OBD specific diagnostic trouble code for check DFC_MOXEMM_SMU_ALM0_8" VALUE 0x80504236 Val_Wu16 65535.00 DFES_OneToOne 0.00 65535.00 FORMAT "%8.2" /end CHARACTERISTIC
/begin CHARACTERISTIC DFES_DTCO.DFC_MOXEMM_SMU_ALM10_16_C "OBD specific trouble code / OBD specific diagnostic trouble code for check DFC_MOXEMM_SMU_ALM10_16" VALUE 0x80504238 Val_Wu16 65535.00 DFES_OneToOne 0.00 65535.00 FORMAT "%8.2" /end CHARACTERISTIC
/begin CHARACTERISTIC DFES_DTCO.DFC_MOXEMM_SMU_ALM10_17_C "OBD specific trouble code / OBD specific diagnostic trouble code for check DFC_MOXEMM_SMU_ALM10_17" VALUE 0x8050423A Val_Wu16 65535.00 DFES_OneToOne 0.00 65535.00 FORMAT "%8.2" /end CHARACTERISTIC
/begin CHARACTERISTIC DFES_DTCO.DFC_MOXEMM_SMU_ALM10_21_C "OBD specific trouble code / OBD specific diagnostic trouble code for check DFC_MOXEMM_SMU_ALM10_21" VALUE 0x8050423C Val_Wu16 65535.00 DFES_OneToOne 0.00 65535.00 FORMAT "%8.2" /end CHARACTERISTIC
/begin CHARACTERISTIC DFES_DTCO.DFC_MOXEMM_SMU_ALM11_0_C "OBD specific trouble code / OBD specific diagnostic trouble code for check DFC_MOXEMM_SMU_ALM11_0" VALUE 0x8050423E Val_Wu16 65535.00 DFES_OneToOne 0.00 65535.00 FORMAT "%8.2" /end CHARACTERISTIC
/begin CHARACTERISTIC DFES_DTCO.DFC_MOXEMM_SMU_ALM11_1_C "OBD specific trouble code / OBD specific diagnostic trouble code for check DFC_MOXEMM_SMU_ALM11_1" VALUE 0x80504240 Val_Wu16 65535.00 DFES_OneToOne 0.00 65535.00 FORMAT "%8.2" /end CHARACTERISTIC
/begin CHARACTERISTIC DFES_DTCO.DFC_MOXEMM_SMU_ALM11_2_C "OBD specific trouble code / OBD specific diagnostic trouble code for check DFC_MOXEMM_SMU_ALM11_2" VALUE 0x80504242 Val_Wu16 65535.00 DFES_OneToOne 0.00 65535.00 FORMAT "%8.2" /end CHARACTERISTIC
/begin CHARACTERISTIC DFES_DTCO.DFC_MOXEMM_SMU_ALM11_3_C "OBD specific trouble code / OBD specific diagnostic trouble code for check DFC_MOXEMM_SMU_ALM11_3" VALUE 0x80504244 Val_Wu16 65535.00 DFES_OneToOne 0.00 65535.00 FORMAT "%8.2" /end CHARACTERISTIC
/begin CHARACTERISTIC DFES_DTCO.DFC_MOXEMM_SMU_ALM11_4_C "OBD specific trouble code / OBD specific diagnostic trouble code for check DFC_MOXEMM_SMU_ALM11_4" VALUE 0x80504246 Val_Wu16 65535.00 DFES_OneToOne 0.00 65535.00 FORMAT "%8.2" /end CHARACTERISTIC
/begin CHARACTERISTIC DFES_DTCO.DFC_MOXEMM_SMU_ALM11_5_C "OBD specific trouble code / OBD specific diagnostic trouble code for check DFC_MOXEMM_SMU_ALM11_5" VALUE 0x80504248 Val_Wu16 65535.00 DFES_OneToOne 0.00 65535.00 FORMAT "%8.2" /end CHARACTERISTIC
/begin CHARACTERISTIC DFES_DTCO.DFC_MOXEMM_SMU_ALM11_8_C "OBD specific trouble code / OBD specific diagnostic trouble code for check DFC_MOXEMM_SMU_ALM11_8" VALUE 0x8050424A Val_Wu16 65535.00 DFES_OneToOne 0.00 65535.00 FORMAT "%8.2" /end CHARACTERISTIC
/begin CHARACTERISTIC DFES_DTCO.DFC_MOXEMM_SMU_ALM11_9_C "OBD specific trouble code / OBD specific diagnostic trouble code for check DFC_MOXEMM_SMU_ALM11_9" VALUE 0x8050424C Val_Wu16 65535.00 DFES_OneToOne 0.00 65535.00 FORMAT "%8.2" /end CHARACTERISTIC
/begin CHARACTERISTIC DFES_DTCO.DFC_MOXEMM_SMU_ALM1_0_C "OBD specific trouble code / OBD specific diagnostic trouble code for check DFC_MOXEMM_SMU_ALM1_0" VALUE 0x8050424E Val_Wu16 65535.00 DFES_OneToOne 0.00 65535.00 FORMAT "%8.2" /end CHARACTERISTIC
/begin CHARACTERISTIC DFES_DTCO.DFC_MOXEMM_SMU_ALM1_1_C "OBD specific trouble code / OBD specific diagnostic trouble code for check DFC_MOXEMM_SMU_ALM1_1" VALUE 0x80504250 Val_Wu16 65535.00 DFES_OneToOne 0.00 65535.00 FORMAT "%8.2" /end CHARACTERISTIC
/begin CHARACTERISTIC DFES_DTCO.DFC_MOXEMM_SMU_ALM1_10_C "OBD specific trouble code / OBD specific diagnostic trouble code for check DFC_MOXEMM_SMU_ALM1_10" VALUE 0x80504252 Val_Wu16 65535.00 DFES_OneToOne 0.00 65535.00 FORMAT "%8.2" /end CHARACTERISTIC
/begin CHARACTERISTIC DFES_DTCO.DFC_MOXEMM_SMU_ALM1_11_C "OBD specific trouble code / OBD specific diagnostic trouble code for check DFC_MOXEMM_SMU_ALM1_11" VALUE 0x80504254 Val_Wu16 65535.00 DFES_OneToOne 0.00 65535.00 FORMAT "%8.2" /end CHARACTERISTIC
/begin CHARACTERISTIC DFES_DTCO.DFC_MOXEMM_SMU_ALM1_13_C "OBD specific trouble code / OBD specific diagnostic trouble code for check DFC_MOXEMM_SMU_ALM1_13" VALUE 0x80504256 Val_Wu16 65535.00 DFES_OneToOne 0.00 65535.00 FORMAT "%8.2" /end CHARACTERISTIC
/begin CHARACTERISTIC DFES_DTCO.DFC_MOXEMM_SMU_ALM1_14_C "OBD specific trouble code / OBD specific diagnostic trouble code for check DFC_MOXEMM_SMU_ALM1_14" VALUE 0x80504258 Val_Wu16 65535.00 DFES_OneToOne 0.00 65535.00 FORMAT "%8.2" /end CHARACTERISTIC
/begin CHARACTERISTIC DFES_DTCO.DFC_MOXEMM_SMU_ALM1_2_C "OBD specific trouble code / OBD specific diagnostic trouble code for check DFC_MOXEMM_SMU_ALM1_2" VALUE 0x8050425A Val_Wu16 65535.00 DFES_OneToOne 0.00 65535.00 FORMAT "%8.2" /end CHARACTERISTIC
/begin CHARACTERISTIC DFES_DTCO.DFC_MOXEMM_SMU_ALM1_22_C "OBD specific trouble code / OBD specific diagnostic trouble code for check DFC_MOXEMM_SMU_ALM1_22" VALUE 0x8050425C Val_Wu16 65535.00 DFES_OneToOne 0.00 65535.00 FORMAT "%8.2" /end CHARACTERISTIC
/begin CHARACTERISTIC DFES_DTCO.DFC_MOXEMM_SMU_ALM1_23_C "OBD specific trouble code / OBD specific diagnostic trouble code for check DFC_MOXEMM_SMU_ALM1_23" VALUE 0x8050425E Val_Wu16 65535.00 DFES_OneToOne 0.00 65535.00 FORMAT "%8.2" /end CHARACTERISTIC
/begin CHARACTERISTIC DFES_DTCO.DFC_MOXEMM_SMU_ALM1_4_C "OBD specific trouble code / OBD specific diagnostic trouble code for check DFC_MOXEMM_SMU_ALM1_4" VALUE 0x80504260 Val_Wu16 65535.00 DFES_OneToOne 0.00 65535.00 FORMAT "%8.2" /end CHARACTERISTIC
/begin CHARACTERISTIC DFES_DTCO.DFC_MOXEMM_SMU_ALM1_5_C "OBD specific trouble code / OBD specific diagnostic trouble code for check DFC_MOXEMM_SMU_ALM1_5" VALUE 0x80504262 Val_Wu16 65535.00 DFES_OneToOne 0.00 65535.00 FORMAT "%8.2" /end CHARACTERISTIC
/begin CHARACTERISTIC DFES_DTCO.DFC_MOXEMM_SMU_ALM1_7_C "OBD specific trouble code / OBD specific diagnostic trouble code for check DFC_MOXEMM_SMU_ALM1_7" VALUE 0x80504264 Val_Wu16 65535.00 DFES_OneToOne 0.00 65535.00 FORMAT "%8.2" /end CHARACTERISTIC
/begin CHARACTERISTIC DFES_DTCO.DFC_MOXEMM_SMU_ALM1_8_C "OBD specific trouble code / OBD specific diagnostic trouble code for check DFC_MOXEMM_SMU_ALM1_8" VALUE 0x80504266 Val_Wu16 65535.00 DFES_OneToOne 0.00 65535.00 FORMAT "%8.2" /end CHARACTERISTIC
/begin CHARACTERISTIC DFES_DTCO.DFC_MOXEMM_SMU_ALM21_0_C "OBD specific trouble code / OBD specific diagnostic trouble code for check DFC_MOXEMM_SMU_ALM21_0" VALUE 0x80504268 Val_Wu16 65535.00 DFES_OneToOne 0.00 65535.00 FORMAT "%8.2" /end CHARACTERISTIC
/begin CHARACTERISTIC DFES_DTCO.DFC_MOXEMM_SMU_ALM21_16_C "OBD specific trouble code / OBD specific diagnostic trouble code for check DFC_MOXEMM_SMU_ALM21_16" VALUE 0x8050426A Val_Wu16 65535.00 DFES_OneToOne 0.00 65535.00 FORMAT "%8.2" /end CHARACTERISTIC
/begin CHARACTERISTIC DFES_DTCO.DFC_MOXEMM_SMU_ALM21_3_C "OBD specific trouble code / OBD specific diagnostic trouble code for check DFC_MOXEMM_SMU_ALM21_3" VALUE 0x8050426C Val_Wu16 65535.00 DFES_OneToOne 0.00 65535.00 FORMAT "%8.2" /end CHARACTERISTIC
/begin CHARACTERISTIC DFES_DTCO.DFC_MOXEMM_SMU_ALM2_1_C "OBD specific trouble code / OBD specific diagnostic trouble code for check DFC_MOXEMM_SMU_ALM2_1" VALUE 0x8050426E Val_Wu16 65535.00 DFES_OneToOne 0.00 65535.00 FORMAT "%8.2" /end CHARACTERISTIC
/begin CHARACTERISTIC DFES_DTCO.DFC_MOXEMM_SMU_ALM2_10_C "OBD specific trouble code / OBD specific diagnostic trouble code for check DFC_MOXEMM_SMU_ALM2_10" VALUE 0x80504270 Val_Wu16 65535.00 DFES_OneToOne 0.00 65535.00 FORMAT "%8.2" /end CHARACTERISTIC
/begin CHARACTERISTIC DFES_DTCO.DFC_MOXEMM_SMU_ALM2_11_C "OBD specific trouble code / OBD specific diagnostic trouble code for check DFC_MOXEMM_SMU_ALM2_11" VALUE 0x80504272 Val_Wu16 65535.00 DFES_OneToOne 0.00 65535.00 FORMAT "%8.2" /end CHARACTERISTIC
/begin CHARACTERISTIC DFES_DTCO.DFC_MOXEMM_SMU_ALM2_13_C "OBD specific trouble code / OBD specific diagnostic trouble code for check DFC_MOXEMM_SMU_ALM2_13" VALUE 0x80504274 Val_Wu16 65535.00 DFES_OneToOne 0.00 65535.00 FORMAT "%8.2" /end CHARACTERISTIC
/begin CHARACTERISTIC DFES_DTCO.DFC_MOXEMM_SMU_ALM2_14_C "OBD specific trouble code / OBD specific diagnostic trouble code for check DFC_MOXEMM_SMU_ALM2_14" VALUE 0x80504276 Val_Wu16 65535.00 DFES_OneToOne 0.00 65535.00 FORMAT "%8.2" /end CHARACTERISTIC
/begin CHARACTERISTIC DFES_DTCO.DFC_MOXEMM_SMU_ALM2_22_C "OBD specific trouble code / OBD specific diagnostic trouble code for check DFC_MOXEMM_SMU_ALM2_22" VALUE 0x80504278 Val_Wu16 65535.00 DFES_OneToOne 0.00 65535.00 FORMAT "%8.2" /end CHARACTERISTIC
/begin CHARACTERISTIC DFES_DTCO.DFC_MOXEMM_SMU_ALM2_23_C "OBD specific trouble code / OBD specific diagnostic trouble code for check DFC_MOXEMM_SMU_ALM2_23" VALUE 0x8050427A Val_Wu16 65535.00 DFES_OneToOne 0.00 65535.00 FORMAT "%8.2" /end CHARACTERISTIC
/begin CHARACTERISTIC DFES_DTCO.DFC_MOXEMM_SMU_ALM2_4_C "OBD specific trouble code / OBD specific diagnostic trouble code for check DFC_MOXEMM_SMU_ALM2_4" VALUE 0x8050427C Val_Wu16 65535.00 DFES_OneToOne 0.00 65535.00 FORMAT "%8.2" /end CHARACTERISTIC
/begin CHARACTERISTIC DFES_DTCO.DFC_MOXEMM_SMU_ALM2_5_C "OBD specific trouble code / OBD specific diagnostic trouble code for check DFC_MOXEMM_SMU_ALM2_5" VALUE 0x8050427E Val_Wu16 65535.00 DFES_OneToOne 0.00 65535.00 FORMAT "%8.2" /end CHARACTERISTIC
/begin CHARACTERISTIC DFES_DTCO.DFC_MOXEMM_SMU_ALM2_7_C "OBD specific trouble code / OBD specific diagnostic trouble code for check DFC_MOXEMM_SMU_ALM2_7" VALUE 0x80504280 Val_Wu16 65535.00 DFES_OneToOne 0.00 65535.00 FORMAT "%8.2" /end CHARACTERISTIC
/begin CHARACTERISTIC DFES_DTCO.DFC_MOXEMM_SMU_ALM2_8_C "OBD specific trouble code / OBD specific diagnostic trouble code for check DFC_MOXEMM_SMU_ALM2_8" VALUE 0x80504282 Val_Wu16 65535.00 DFES_OneToOne 0.00 65535.00 FORMAT "%8.2" /end CHARACTERISTIC
/begin CHARACTERISTIC DFES_DTCO.DFC_MOXEMM_SMU_ALM6_0_C "OBD specific trouble code / OBD specific diagnostic trouble code for check DFC_MOXEMM_SMU_ALM6_0" VALUE 0x80504284 Val_Wu16 65535.00 DFES_OneToOne 0.00 65535.00 FORMAT "%8.2" /end CHARACTERISTIC
/begin CHARACTERISTIC DFES_DTCO.DFC_MOXEMM_SMU_ALM6_11_C "OBD specific trouble code / OBD specific diagnostic trouble code for check DFC_MOXEMM_SMU_ALM6_11" VALUE 0x80504286 Val_Wu16 65535.00 DFES_OneToOne 0.00 65535.00 FORMAT "%8.2" /end CHARACTERISTIC
/begin CHARACTERISTIC DFES_DTCO.DFC_MOXEMM_SMU_ALM6_12_C "OBD specific trouble code / OBD specific diagnostic trouble code for check DFC_MOXEMM_SMU_ALM6_12" VALUE 0x80504288 Val_Wu16 65535.00 DFES_OneToOne 0.00 65535.00 FORMAT "%8.2" /end CHARACTERISTIC
/begin CHARACTERISTIC DFES_DTCO.DFC_MOXEMM_SMU_ALM6_14_C "OBD specific trouble code / OBD specific diagnostic trouble code for check DFC_MOXEMM_SMU_ALM6_14" VALUE 0x8050428A Val_Wu16 65535.00 DFES_OneToOne 0.00 65535.00 FORMAT "%8.2" /end CHARACTERISTIC
/begin CHARACTERISTIC DFES_DTCO.DFC_MOXEMM_SMU_ALM6_15_C "OBD specific trouble code / OBD specific diagnostic trouble code for check DFC_MOXEMM_SMU_ALM6_15" VALUE 0x8050428C Val_Wu16 65535.00 DFES_OneToOne 0.00 65535.00 FORMAT "%8.2" /end CHARACTERISTIC
/begin CHARACTERISTIC DFES_DTCO.DFC_MOXEMM_SMU_ALM6_17_C "OBD specific trouble code / OBD specific diagnostic trouble code for check DFC_MOXEMM_SMU_ALM6_17" VALUE 0x8050428E Val_Wu16 65535.00 DFES_OneToOne 0.00 65535.00 FORMAT "%8.2" /end CHARACTERISTIC
/begin CHARACTERISTIC DFES_DTCO.DFC_MOXEMM_SMU_ALM6_18_C "OBD specific trouble code / OBD specific diagnostic trouble code for check DFC_MOXEMM_SMU_ALM6_18" VALUE 0x80504290 Val_Wu16 65535.00 DFES_OneToOne 0.00 65535.00 FORMAT "%8.2" /end CHARACTERISTIC
/begin CHARACTERISTIC DFES_DTCO.DFC_MOXEMM_SMU_ALM6_20_C "OBD specific trouble code / OBD specific diagnostic trouble code for check DFC_MOXEMM_SMU_ALM6_20" VALUE 0x80504292 Val_Wu16 65535.00 DFES_OneToOne 0.00 65535.00 FORMAT "%8.2" /end CHARACTERISTIC
/begin CHARACTERISTIC DFES_DTCO.DFC_MOXEMM_SMU_ALM6_21_C "OBD specific trouble code / OBD specific diagnostic trouble code for check DFC_MOXEMM_SMU_ALM6_21" VALUE 0x80504294 Val_Wu16 65535.00 DFES_OneToOne 0.00 65535.00 FORMAT "%8.2" /end CHARACTERISTIC
/begin CHARACTERISTIC DFES_DTCO.DFC_MOXEMM_SMU_ALM6_25_C "OBD specific trouble code / OBD specific diagnostic trouble code for check DFC_MOXEMM_SMU_ALM6_25" VALUE 0x80504296 Val_Wu16 65535.00 DFES_OneToOne 0.00 65535.00 FORMAT "%8.2" /end CHARACTERISTIC
/begin CHARACTERISTIC DFES_DTCO.DFC_MOXEMM_SMU_ALM6_4_C "OBD specific trouble code / OBD specific diagnostic trouble code for check DFC_MOXEMM_SMU_ALM6_4" VALUE 0x80504298 Val_Wu16 65535.00 DFES_OneToOne 0.00 65535.00 FORMAT "%8.2" /end CHARACTERISTIC
/begin CHARACTERISTIC DFES_DTCO.DFC_MOXEMM_SMU_ALM6_5_C "OBD specific trouble code / OBD specific diagnostic trouble code for check DFC_MOXEMM_SMU_ALM6_5" VALUE 0x8050429A Val_Wu16 65535.00 DFES_OneToOne 0.00 65535.00 FORMAT "%8.2" /end CHARACTERISTIC
/begin CHARACTERISTIC DFES_DTCO.DFC_MOXEMM_SMU_ALM6_7_C "OBD specific trouble code / OBD specific diagnostic trouble code for check DFC_MOXEMM_SMU_ALM6_7" VALUE 0x8050429C Val_Wu16 65535.00 DFES_OneToOne 0.00 65535.00 FORMAT "%8.2" /end CHARACTERISTIC
/begin CHARACTERISTIC DFES_DTCO.DFC_MOXEMM_SMU_ALM6_8_C "OBD specific trouble code / OBD specific diagnostic trouble code for check DFC_MOXEMM_SMU_ALM6_8" VALUE 0x8050429E Val_Wu16 65535.00 DFES_OneToOne 0.00 65535.00 FORMAT "%8.2" /end CHARACTERISTIC
/begin CHARACTERISTIC DFES_DTCO.DFC_MOXEMM_SMU_ALM7_1_C "OBD specific trouble code / OBD specific diagnostic trouble code for check DFC_MOXEMM_SMU_ALM7_1" VALUE 0x805042A0 Val_Wu16 65535.00 DFES_OneToOne 0.00 65535.00 FORMAT "%8.2" /end CHARACTERISTIC
/begin CHARACTERISTIC DFES_DTCO.DFC_MOXEMM_SMU_ALM7_12_C "OBD specific trouble code / OBD specific diagnostic trouble code for check DFC_MOXEMM_SMU_ALM7_12" VALUE 0x805042A2 Val_Wu16 65535.00 DFES_OneToOne 0.00 65535.00 FORMAT "%8.2" /end CHARACTERISTIC
/begin CHARACTERISTIC DFES_DTCO.DFC_MOXEMM_SMU_ALM7_13_C "OBD specific trouble code / OBD specific diagnostic trouble code for check DFC_MOXEMM_SMU_ALM7_13" VALUE 0x805042A4 Val_Wu16 65535.00 DFES_OneToOne 0.00 65535.00 FORMAT "%8.2" /end CHARACTERISTIC
/begin CHARACTERISTIC DFES_DTCO.DFC_MOXEMM_SMU_ALM7_14_C "OBD specific trouble code / OBD specific diagnostic trouble code for check DFC_MOXEMM_SMU_ALM7_14" VALUE 0x805042A6 Val_Wu16 65535.00 DFES_OneToOne 0.00 65535.00 FORMAT "%8.2" /end CHARACTERISTIC
/begin CHARACTERISTIC DFES_DTCO.DFC_MOXEMM_SMU_ALM7_15_C "OBD specific trouble code / OBD specific diagnostic trouble code for check DFC_MOXEMM_SMU_ALM7_15" VALUE 0x805042A8 Val_Wu16 65535.00 DFES_OneToOne 0.00 65535.00 FORMAT "%8.2" /end CHARACTERISTIC
/begin CHARACTERISTIC DFES_DTCO.DFC_MOXEMM_SMU_ALM7_16_C "OBD specific trouble code / OBD specific diagnostic trouble code for check DFC_MOXEMM_SMU_ALM7_16" VALUE 0x805042AA Val_Wu16 65535.00 DFES_OneToOne 0.00 65535.00 FORMAT "%8.2" /end CHARACTERISTIC
/begin CHARACTERISTIC DFES_DTCO.DFC_MOXEMM_SMU_ALM7_17_C "OBD specific trouble code / OBD specific diagnostic trouble code for check DFC_MOXEMM_SMU_ALM7_17" VALUE 0x805042AC Val_Wu16 65535.00 DFES_OneToOne 0.00 65535.00 FORMAT "%8.2" /end CHARACTERISTIC
/begin CHARACTERISTIC DFES_DTCO.DFC_MOXEMM_SMU_ALM7_2_C "OBD specific trouble code / OBD specific diagnostic trouble code for check DFC_MOXEMM_SMU_ALM7_2" VALUE 0x805042AE Val_Wu16 65535.00 DFES_OneToOne 0.00 65535.00 FORMAT "%8.2" /end CHARACTERISTIC
/begin CHARACTERISTIC DFES_DTCO.DFC_MOXEMM_SMU_ALM7_20_C "OBD specific trouble code / OBD specific diagnostic trouble code for check DFC_MOXEMM_SMU_ALM7_20" VALUE 0x805042B0 Val_Wu16 65535.00 DFES_OneToOne 0.00 65535.00 FORMAT "%8.2" /end CHARACTERISTIC
/begin CHARACTERISTIC DFES_DTCO.DFC_MOXEMM_SMU_ALM7_25_C "OBD specific trouble code / OBD specific diagnostic trouble code for check DFC_MOXEMM_SMU_ALM7_25" VALUE 0x805042B2 Val_Wu16 65535.00 DFES_OneToOne 0.00 65535.00 FORMAT "%8.2" /end CHARACTERISTIC
/begin CHARACTERISTIC DFES_DTCO.DFC_MOXEMM_SMU_ALM7_26_C "OBD specific trouble code / OBD specific diagnostic trouble code for check DFC_MOXEMM_SMU_ALM7_26" VALUE 0x805042B4 Val_Wu16 65535.00 DFES_OneToOne 0.00 65535.00 FORMAT "%8.2" /end CHARACTERISTIC
/begin CHARACTERISTIC DFES_DTCO.DFC_MOXEMM_SMU_ALM7_28_C "OBD specific trouble code / OBD specific diagnostic trouble code for check DFC_MOXEMM_SMU_ALM7_28" VALUE 0x805042B6 Val_Wu16 65535.00 DFES_OneToOne 0.00 65535.00 FORMAT "%8.2" /end CHARACTERISTIC
/begin CHARACTERISTIC DFES_DTCO.DFC_MOXEMM_SMU_ALM7_29_C "OBD specific trouble code / OBD specific diagnostic trouble code for check DFC_MOXEMM_SMU_ALM7_29" VALUE 0x805042B8 Val_Wu16 65535.00 DFES_OneToOne 0.00 65535.00 FORMAT "%8.2" /end CHARACTERISTIC
/begin CHARACTERISTIC DFES_DTCO.DFC_MOXEMM_SMU_ALM7_30_C "OBD specific trouble code / OBD specific diagnostic trouble code for check DFC_MOXEMM_SMU_ALM7_30" VALUE 0x805042BA Val_Wu16 65535.00 DFES_OneToOne 0.00 65535.00 FORMAT "%8.2" /end CHARACTERISTIC
/begin CHARACTERISTIC DFES_DTCO.DFC_MOXEMM_SMU_ALM7_31_C "OBD specific trouble code / OBD specific diagnostic trouble code for check DFC_MOXEMM_SMU_ALM7_31" VALUE 0x805042BC Val_Wu16 65535.00 DFES_OneToOne 0.00 65535.00 FORMAT "%8.2" /end CHARACTERISTIC
/begin CHARACTERISTIC DFES_DTCO.DFC_MOXEMM_SMU_ALM8_0_C "OBD specific trouble code / OBD specific diagnostic trouble code for check DFC_MOXEMM_SMU_ALM8_0" VALUE 0x805042BE Val_Wu16 65535.00 DFES_OneToOne 0.00 65535.00 FORMAT "%8.2" /end CHARACTERISTIC
/begin CHARACTERISTIC DFES_DTCO.DFC_MOXEMM_SMU_ALM8_1_C "OBD specific trouble code / OBD specific diagnostic trouble code for check DFC_MOXEMM_SMU_ALM8_1" VALUE 0x805042C0 Val_Wu16 65535.00 DFES_OneToOne 0.00 65535.00 FORMAT "%8.2" /end CHARACTERISTIC
/begin CHARACTERISTIC DFES_DTCO.DFC_MOXEMM_SMU_ALM8_10_C "OBD specific trouble code / OBD specific diagnostic trouble code for check DFC_MOXEMM_SMU_ALM8_10" VALUE 0x805042C2 Val_Wu16 65535.00 DFES_OneToOne 0.00 65535.00 FORMAT "%8.2" /end CHARACTERISTIC
/begin CHARACTERISTIC DFES_DTCO.DFC_MOXEMM_SMU_ALM8_11_C "OBD specific trouble code / OBD specific diagnostic trouble code for check DFC_MOXEMM_SMU_ALM8_11" VALUE 0x805042C4 Val_Wu16 65535.00 DFES_OneToOne 0.00 65535.00 FORMAT "%8.2" /end CHARACTERISTIC
/begin CHARACTERISTIC DFES_DTCO.DFC_MOXEMM_SMU_ALM8_12_C "OBD specific trouble code / OBD specific diagnostic trouble code for check DFC_MOXEMM_SMU_ALM8_12" VALUE 0x805042C6 Val_Wu16 65535.00 DFES_OneToOne 0.00 65535.00 FORMAT "%8.2" /end CHARACTERISTIC
/begin CHARACTERISTIC DFES_DTCO.DFC_MOXEMM_SMU_ALM8_16_C "OBD specific trouble code / OBD specific diagnostic trouble code for check DFC_MOXEMM_SMU_ALM8_16" VALUE 0x805042C8 Val_Wu16 65535.00 DFES_OneToOne 0.00 65535.00 FORMAT "%8.2" /end CHARACTERISTIC
/begin CHARACTERISTIC DFES_DTCO.DFC_MOXEMM_SMU_ALM8_18_C "OBD specific trouble code / OBD specific diagnostic trouble code for check DFC_MOXEMM_SMU_ALM8_18" VALUE 0x805042CA Val_Wu16 65535.00 DFES_OneToOne 0.00 65535.00 FORMAT "%8.2" /end CHARACTERISTIC
/begin CHARACTERISTIC DFES_DTCO.DFC_MOXEMM_SMU_ALM8_2_C "OBD specific trouble code / OBD specific diagnostic trouble code for check DFC_MOXEMM_SMU_ALM8_2" VALUE 0x805042CC Val_Wu16 65535.00 DFES_OneToOne 0.00 65535.00 FORMAT "%8.2" /end CHARACTERISTIC
/begin CHARACTERISTIC DFES_DTCO.DFC_MOXEMM_SMU_ALM8_3_C "OBD specific trouble code / OBD specific diagnostic trouble code for check DFC_MOXEMM_SMU_ALM8_3" VALUE 0x805042CE Val_Wu16 65535.00 DFES_OneToOne 0.00 65535.00 FORMAT "%8.2" /end CHARACTERISTIC
/begin CHARACTERISTIC DFES_DTCO.DFC_MOXEMM_SMU_ALM8_31_C "OBD specific trouble code / OBD specific diagnostic trouble code for check DFC_MOXEMM_SMU_ALM8_31" VALUE 0x805042D0 Val_Wu16 65535.00 DFES_OneToOne 0.00 65535.00 FORMAT "%8.2" /end CHARACTERISTIC
/begin CHARACTERISTIC DFES_DTCO.DFC_MOXEMM_SMU_ALM8_4_C "OBD specific trouble code / OBD specific diagnostic trouble code for check DFC_MOXEMM_SMU_ALM8_4" VALUE 0x805042D2 Val_Wu16 65535.00 DFES_OneToOne 0.00 65535.00 FORMAT "%8.2" /end CHARACTERISTIC
/begin CHARACTERISTIC DFES_DTCO.DFC_MOXEMM_SMU_ALM9_0_C "OBD specific trouble code / OBD specific diagnostic trouble code for check DFC_MOXEMM_SMU_ALM9_0" VALUE 0x805042D4 Val_Wu16 65535.00 DFES_OneToOne 0.00 65535.00 FORMAT "%8.2" /end CHARACTERISTIC
/begin CHARACTERISTIC DFES_DTCO.DFC_MOXEMM_SMU_ALM9_15_C "OBD specific trouble code / OBD specific diagnostic trouble code for check DFC_MOXEMM_SMU_ALM9_15" VALUE 0x805042D6 Val_Wu16 65535.00 DFES_OneToOne 0.00 65535.00 FORMAT "%8.2" /end CHARACTERISTIC
/begin CHARACTERISTIC DFES_DTCO.DFC_MOXEMM_SMU_ALM9_3_C "OBD specific trouble code / OBD specific diagnostic trouble code for check DFC_MOXEMM_SMU_ALM9_3" VALUE 0x805042D8 Val_Wu16 65535.00 DFES_OneToOne 0.00 65535.00 FORMAT "%8.2" /end CHARACTERISTIC
/begin CHARACTERISTIC DFES_DTCO.DFC_MoCADCNTP_C "OBD specific trouble code / OBD specific diagnostic trouble code for check DFC_MoCADCNTP" VALUE 0x805042DA Val_Wu16 65535.00 DFES_OneToOne 0.00 65535.00 FORMAT "%8.2" /end CHARACTERISTIC
/begin CHARACTERISTIC DFES_DTCO.DFC_MoCADCTst_C "OBD specific trouble code / OBD specific diagnostic trouble code for check DFC_MoCADCTst" VALUE 0x805042DC Val_Wu16 65535.00 DFES_OneToOne 0.00 65535.00 FORMAT "%8.2" /end CHARACTERISTIC
/begin CHARACTERISTIC DFES_DTCO.DFC_MoCSOPICO_C "OBD specific trouble code / OBD specific diagnostic trouble code for check DFC_MoCSOPICO" VALUE 0x805042DE Val_Wu16 65535.00 DFES_OneToOne 0.00 65535.00 FORMAT "%8.2" /end CHARACTERISTIC
/begin CHARACTERISTIC DFES_DTCO.DFC_MoFAPP_C "OBD specific trouble code / OBD specific diagnostic trouble code for check DFC_MoFAPP" VALUE 0x805042E0 Val_Wu16 65535.00 DFES_OneToOne 0.00 65535.00 FORMAT "%8.2" /end CHARACTERISTIC
/begin CHARACTERISTIC DFES_DTCO.DFC_MoFAirFilgPrdc_C "OBD specific trouble code / OBD specific diagnostic trouble code for check DFC_MoFAirFilgPrdc" VALUE 0x805042E2 Val_Wu16 65535.00 DFES_OneToOne 0.00 65535.00 FORMAT "%8.2" /end CHARACTERISTIC
/begin CHARACTERISTIC DFES_DTCO.DFC_MoFAirFlCtOffGdi_C "OBD specific trouble code / OBD specific diagnostic trouble code for check DFC_MoFAirFlCtOffGdi" VALUE 0x805042E4 Val_Wu16 65535.00 DFES_OneToOne 0.00 65535.00 FORMAT "%8.2" /end CHARACTERISTIC
/begin CHARACTERISTIC DFES_DTCO.DFC_MoFAirFlCylGdi_C "OBD specific trouble code / OBD specific diagnostic trouble code for check DFC_MoFAirFlCylGdi" VALUE 0x805042E6 Val_Wu16 65535.00 DFES_OneToOne 0.00 65535.00 FORMAT "%8.2" /end CHARACTERISTIC
/begin CHARACTERISTIC DFES_DTCO.DFC_MoFAirFlFF_C "OBD specific trouble code / OBD specific diagnostic trouble code for check DFC_MoFAirFlFF" VALUE 0x805042E8 Val_Wu16 65535.00 DFES_OneToOne 0.00 65535.00 FORMAT "%8.2" /end CHARACTERISTIC
/begin CHARACTERISTIC DFES_DTCO.DFC_MoFAirFlIn_C "OBD specific trouble code / OBD specific diagnostic trouble code for check DFC_MoFAirFlIn" VALUE 0x805042EA Val_Wu16 65535.00 DFES_OneToOne 0.00 65535.00 FORMAT "%8.2" /end CHARACTERISTIC
/begin CHARACTERISTIC DFES_DTCO.DFC_MoFAirFlMixCtlGdiChkAirFl_C "OBD specific trouble code / OBD specific diagnostic trouble code for check DFC_MoFAirFlMixCtlGdiChkAirFl" VALUE 0x805042EC Val_Wu16 65535.00 DFES_OneToOne 0.00 65535.00 FORMAT "%8.2" /end CHARACTERISTIC
/begin CHARACTERISTIC DFES_DTCO.DFC_MoFAirFlMixCtlGdiChkCtrl_C "OBD specific trouble code / OBD specific diagnostic trouble code for check DFC_MoFAirFlMixCtlGdiChkCtrl" VALUE 0x805042EE Val_Wu16 65535.00 DFES_OneToOne 0.00 65535.00 FORMAT "%8.2" /end CHARACTERISTIC
/begin CHARACTERISTIC DFES_DTCO.DFC_MoFAirFlMode_C "OBD specific trouble code / OBD specific diagnostic trouble code for check DFC_MoFAirFlMode" VALUE 0x805042F0 Val_Wu16 65535.00 DFES_OneToOne 0.00 65535.00 FORMAT "%8.2" /end CHARACTERISTIC
/begin CHARACTERISTIC DFES_DTCO.DFC_MoFESpd_C "OBD specific trouble code / OBD specific diagnostic trouble code for check DFC_MoFESpd" VALUE 0x805042F2 Val_Wu16 65535.00 DFES_OneToOne 0.00 65535.00 FORMAT "%8.2" /end CHARACTERISTIC
/begin CHARACTERISTIC DFES_DTCO.DFC_MoFIACo_C "OBD specific trouble code / OBD specific diagnostic trouble code for check DFC_MoFIACo" VALUE 0x805042F4 Val_Wu16 65535.00 DFES_OneToOne 0.00 65535.00 FORMAT "%8.2" /end CHARACTERISTIC
/begin CHARACTERISTIC DFES_DTCO.DFC_MoFICOL1_C "OBD specific trouble code / OBD specific diagnostic trouble code for check DFC_MoFICOL1" VALUE 0x805042F6 Val_Wu16 65535.00 DFES_OneToOne 0.00 65535.00 FORMAT "%8.2" /end CHARACTERISTIC
/begin CHARACTERISTIC DFES_DTCO.DFC_MoFICOL2_C "OBD specific trouble code / OBD specific diagnostic trouble code for check DFC_MoFICOL2" VALUE 0x805042F8 Val_Wu16 65535.00 DFES_OneToOne 0.00 65535.00 FORMAT "%8.2" /end CHARACTERISTIC
/begin CHARACTERISTIC DFES_DTCO.DFC_MoFStrt_C "OBD specific trouble code / OBD specific diagnostic trouble code for check DFC_MoFStrt" VALUE 0x805042FA Val_Wu16 65535.00 DFES_OneToOne 0.00 65535.00 FORMAT "%8.2" /end CHARACTERISTIC
/begin CHARACTERISTIC DFES_DTCO.DFC_MoFTrqCmp_C "OBD specific trouble code / OBD specific diagnostic trouble code for check DFC_MoFTrqCmp" VALUE 0x805042FC Val_Wu16 65535.00 DFES_OneToOne 0.00 65535.00 FORMAT "%8.2" /end CHARACTERISTIC
/begin CHARACTERISTIC DFES_DTCO.DFC_MoFTrqCmpMax_C "OBD specific trouble code / OBD specific diagnostic trouble code for check DFC_MoFTrqCmpMax" VALUE 0x805042FE Val_Wu16 65535.00 DFES_OneToOne 0.00 65535.00 FORMAT "%8.2" /end CHARACTERISTIC
/begin CHARACTERISTIC DFES_DTCO.DFC_MoFTrqCmpMin_C "OBD specific trouble code / OBD specific diagnostic trouble code for check DFC_MoFTrqCmpMin" VALUE 0x80504300 Val_Wu16 65535.00 DFES_OneToOne 0.00 65535.00 FORMAT "%8.2" /end CHARACTERISTIC
/begin CHARACTERISTIC DFES_DTCO.DFC_MoFVarPostBldSel_C "OBD specific trouble code / OBD specific diagnostic trouble code for check DFC_MoFVarPostBldSel" VALUE 0x80504302 Val_Wu16 65535.00 DFES_OneToOne 0.00 65535.00 FORMAT "%8.2" /end CHARACTERISTIC
/begin CHARACTERISTIC DFES_DTCO.DFC_MoXEMMHwLTMCUFW_C "OBD specific trouble code / OBD specific diagnostic trouble code for check DFC_MoXEMMHwLTMCUFW" VALUE 0x80504304 Val_Wu16 65535.00 DFES_OneToOne 0.00 65535.00 FORMAT "%8.2" /end CHARACTERISTIC
/begin CHARACTERISTIC DFES_DTCO.DFC_MoXEMMHwLTMonBIST_C "OBD specific trouble code / OBD specific diagnostic trouble code for check DFC_MoXEMMHwLTMonBIST" VALUE 0x80504306 Val_Wu16 65535.00 DFES_OneToOne 0.00 65535.00 FORMAT "%8.2" /end CHARACTERISTIC
/begin CHARACTERISTIC DFES_DTCO.DFC_MoXEMMHwLTRegMonTest_C "OBD specific trouble code / OBD specific diagnostic trouble code for check DFC_MoXEMMHwLTRegMonTest" VALUE 0x80504308 Val_Wu16 65535.00 DFES_OneToOne 0.00 65535.00 FORMAT "%8.2" /end CHARACTERISTIC
/begin CHARACTERISTIC DFES_DTCO.DFC_MoXEMMHwLTStbySMUAlvTest_C "OBD specific trouble code / OBD specific diagnostic trouble code for check DFC_MoXEMMHwLTStbySMUAlvTest" VALUE 0x8050430A Val_Wu16 65535.00 DFES_OneToOne 0.00 65535.00 FORMAT "%8.2" /end CHARACTERISTIC
/begin CHARACTERISTIC DFES_DTCO.DFC_MoXEMMHwLTTempSens_C "OBD specific trouble code / OBD specific diagnostic trouble code for check DFC_MoXEMMHwLTTempSens" VALUE 0x8050430C Val_Wu16 65535.00 DFES_OneToOne 0.00 65535.00 FORMAT "%8.2" /end CHARACTERISTIC
/begin CHARACTERISTIC DFES_DTCO.DFC_MoXEMMHwLTUCBCfg_C "OBD specific trouble code / OBD specific diagnostic trouble code for check DFC_MoXEMMHwLTUCBCfg" VALUE 0x8050430E Val_Wu16 65535.00 DFES_OneToOne 0.00 65535.00 FORMAT "%8.2" /end CHARACTERISTIC
/begin CHARACTERISTIC DFES_DTCO.DFC_NWSEmax_C "OBD specific trouble code / OBD specific diagnostic trouble code for check DFC_NWSEmax" VALUE 0x80504310 Val_Wu16 65535.00 DFES_OneToOne 0.00 65535.00 FORMAT "%8.2" /end CHARACTERISTIC
/begin CHARACTERISTIC DFES_DTCO.DFC_NWSmax_C "OBD specific trouble code / OBD specific diagnostic trouble code for check DFC_NWSmax" VALUE 0x80504312 Val_Wu16 65535.00 DFES_OneToOne 0.00 65535.00 FORMAT "%8.2" /end CHARACTERISTIC
/begin CHARACTERISTIC DFES_DTCO.DFC_OCWDAABEActv_C "OBD specific trouble code / OBD specific diagnostic trouble code for check DFC_OCWDAABEActv" VALUE 0x80504314 Val_Wu16 65535.00 DFES_OneToOne 0.00 65535.00 FORMAT "%8.2" /end CHARACTERISTIC
/begin CHARACTERISTIC DFES_DTCO.DFC_OCWDACom_C "OBD specific trouble code / OBD specific diagnostic trouble code for check DFC_OCWDACom" VALUE 0x80504316 Val_Wu16 65535.00 DFES_OneToOne 0.00 65535.00 FORMAT "%8.2" /end CHARACTERISTIC
/begin CHARACTERISTIC DFES_DTCO.DFC_OCWDAErrPin_C "OBD specific trouble code / OBD specific diagnostic trouble code for check DFC_OCWDAErrPin" VALUE 0x80504318 Val_Wu16 65535.00 DFES_OneToOne 0.00 65535.00 FORMAT "%8.2" /end CHARACTERISTIC
/begin CHARACTERISTIC DFES_DTCO.DFC_OCWDAOvrVltg_C "OBD specific trouble code / OBD specific diagnostic trouble code for check DFC_OCWDAOvrVltg" VALUE 0x8050431A Val_Wu16 65535.00 DFES_OneToOne 0.00 65535.00 FORMAT "%8.2" /end CHARACTERISTIC
/begin CHARACTERISTIC DFES_DTCO.DFC_ORAmax_C "OBD specific trouble code / OBD specific diagnostic trouble code for check DFC_ORAmax" VALUE 0x8050431C Val_Wu16 65535.00 DFES_OneToOne 0.00 65535.00 FORMAT "%8.2" /end CHARACTERISTIC
/begin CHARACTERISTIC DFES_DTCO.DFC_ORAmin_C "OBD specific trouble code / OBD specific diagnostic trouble code for check DFC_ORAmin" VALUE 0x8050431E Val_Wu16 65535.00 DFES_OneToOne 0.00 65535.00 FORMAT "%8.2" /end CHARACTERISTIC
/begin CHARACTERISTIC DFES_DTCO.DFC_OilPPlaus_C "OBD specific trouble code / OBD specific diagnostic trouble code for check DFC_OilPPlaus" VALUE 0x80504320 Val_Wu16 65535.00 DFES_OneToOne 0.00 65535.00 FORMAT "%8.2" /end CHARACTERISTIC
/begin CHARACTERISTIC DFES_DTCO.DFC_PLLSUmax_C "OBD specific trouble code / OBD specific diagnostic trouble code for check DFC_PLLSUmax" VALUE 0x80504322 Val_Wu16 65535.00 DFES_OneToOne 0.00 65535.00 FORMAT "%8.2" /end CHARACTERISTIC
/begin CHARACTERISTIC DFES_DTCO.DFC_PLLSUmin_C "OBD specific trouble code / OBD specific diagnostic trouble code for check DFC_PLLSUmin" VALUE 0x80504324 Val_Wu16 65535.00 DFES_OneToOne 0.00 65535.00 FORMAT "%8.2" /end CHARACTERISTIC
/begin CHARACTERISTIC DFES_DTCO.DFC_PSR1max_C "OBD specific trouble code / OBD specific diagnostic trouble code for check DFC_PSR1max" VALUE 0x80504326 Val_Wu16 65535.00 DFES_OneToOne 0.00 65535.00 FORMAT "%8.2" /end CHARACTERISTIC
/begin CHARACTERISTIC DFES_DTCO.DFC_PSRBmax_C "OBD specific trouble code / OBD specific diagnostic trouble code for check DFC_PSRBmax" VALUE 0x80504328 Val_Wu16 65535.00 DFES_OneToOne 0.00 65535.00 FORMAT "%8.2" /end CHARACTERISTIC
/begin CHARACTERISTIC DFES_DTCO.DFC_PSRBmin_C "OBD specific trouble code / OBD specific diagnostic trouble code for check DFC_PSRBmin" VALUE 0x8050432A Val_Wu16 65535.00 DFES_OneToOne 0.00 65535.00 FORMAT "%8.2" /end CHARACTERISTIC
/begin CHARACTERISTIC DFES_DTCO.DFC_PSRPmax_C "OBD specific trouble code / OBD specific diagnostic trouble code for check DFC_PSRPmax" VALUE 0x8050432C Val_Wu16 65535.00 DFES_OneToOne 0.00 65535.00 FORMAT "%8.2" /end CHARACTERISTIC
/begin CHARACTERISTIC DFES_DTCO.DFC_PSRPmin_C "OBD specific trouble code / OBD specific diagnostic trouble code for check DFC_PSRPmin" VALUE 0x8050432E Val_Wu16 65535.00 DFES_OneToOne 0.00 65535.00 FORMAT "%8.2" /end CHARACTERISTIC
/begin CHARACTERISTIC DFES_DTCO.DFC_PSRPsig_C "OBD specific trouble code / OBD specific diagnostic trouble code for check DFC_PSRPsig" VALUE 0x80504330 Val_Wu16 65535.00 DFES_OneToOne 0.00 65535.00 FORMAT "%8.2" /end CHARACTERISTIC
/begin CHARACTERISTIC DFES_DTCO.DFC_PSRmax_C "OBD specific trouble code / OBD specific diagnostic trouble code for check DFC_PSRmax" VALUE 0x80504332 Val_Wu16 65535.00 DFES_OneToOne 0.00 65535.00 FORMAT "%8.2" /end CHARACTERISTIC
/begin CHARACTERISTIC DFES_DTCO.DFC_PUmax_C "OBD specific trouble code / OBD specific diagnostic trouble code for check DFC_PUmax" VALUE 0x80504334 Val_Wu16 65535.00 DFES_OneToOne 0.00 65535.00 FORMAT "%8.2" /end CHARACTERISTIC
/begin CHARACTERISTIC DFES_DTCO.DFC_P_VSE11_OL_C "OBD specific trouble code / OBD specific diagnostic trouble code for check DFC_P_VSE11_OL" VALUE 0x80504336 Val_Wu16 65535.00 DFES_OneToOne 0.00 65535.00 FORMAT "%8.2" /end CHARACTERISTIC
/begin CHARACTERISTIC DFES_DTCO.DFC_P_VSE11_SCB_C "OBD specific trouble code / OBD specific diagnostic trouble code for check DFC_P_VSE11_SCB" VALUE 0x80504338 Val_Wu16 65535.00 DFES_OneToOne 0.00 65535.00 FORMAT "%8.2" /end CHARACTERISTIC
/begin CHARACTERISTIC DFES_DTCO.DFC_P_VSE11_SCG_C "OBD specific trouble code / OBD specific diagnostic trouble code for check DFC_P_VSE11_SCG" VALUE 0x8050433A Val_Wu16 65535.00 DFES_OneToOne 0.00 65535.00 FORMAT "%8.2" /end CHARACTERISTIC
/begin CHARACTERISTIC DFES_DTCO.DFC_PhyHighAPP1_C "OBD specific trouble code / OBD specific diagnostic trouble code for check DFC_PhyHighAPP1" VALUE 0x8050433C Val_Wu16 65535.00 DFES_OneToOne 0.00 65535.00 FORMAT "%8.2" /end CHARACTERISTIC
/begin CHARACTERISTIC DFES_DTCO.DFC_PhyHighAPP2_C "OBD specific trouble code / OBD specific diagnostic trouble code for check DFC_PhyHighAPP2" VALUE 0x8050433E Val_Wu16 65535.00 DFES_OneToOne 0.00 65535.00 FORMAT "%8.2" /end CHARACTERISTIC
/begin CHARACTERISTIC DFES_DTCO.DFC_PhyLowAPP1_C "OBD specific trouble code / OBD specific diagnostic trouble code for check DFC_PhyLowAPP1" VALUE 0x80504340 Val_Wu16 65535.00 DFES_OneToOne 0.00 65535.00 FORMAT "%8.2" /end CHARACTERISTIC
/begin CHARACTERISTIC DFES_DTCO.DFC_PhyLowAPP2_C "OBD specific trouble code / OBD specific diagnostic trouble code for check DFC_PhyLowAPP2" VALUE 0x80504342 Val_Wu16 65535.00 DFES_OneToOne 0.00 65535.00 FORMAT "%8.2" /end CHARACTERISTIC
/begin CHARACTERISTIC DFES_DTCO.DFC_SRCHighAPP1_C "OBD specific trouble code / OBD specific diagnostic trouble code for check DFC_SRCHighAPP1" VALUE 0x80504344 Val_Wu16 65535.00 DFES_OneToOne 0.00 65535.00 FORMAT "%8.2" /end CHARACTERISTIC
/begin CHARACTERISTIC DFES_DTCO.DFC_SRCHighAPP2_C "OBD specific trouble code / OBD specific diagnostic trouble code for check DFC_SRCHighAPP2" VALUE 0x80504346 Val_Wu16 65535.00 DFES_OneToOne 0.00 65535.00 FORMAT "%8.2" /end CHARACTERISTIC
/begin CHARACTERISTIC DFES_DTCO.DFC_SRCLowAPP1_C "OBD specific trouble code / OBD specific diagnostic trouble code for check DFC_SRCLowAPP1" VALUE 0x80504348 Val_Wu16 65535.00 DFES_OneToOne 0.00 65535.00 FORMAT "%8.2" /end CHARACTERISTIC
/begin CHARACTERISTIC DFES_DTCO.DFC_SRCLowAPP2_C "OBD specific trouble code / OBD specific diagnostic trouble code for check DFC_SRCLowAPP2" VALUE 0x8050434A Val_Wu16 65535.00 DFES_OneToOne 0.00 65535.00 FORMAT "%8.2" /end CHARACTERISTIC
/begin CHARACTERISTIC DFES_DTCO.DFC_SSpMon2_C "OBD specific trouble code / OBD specific diagnostic trouble code for check DFC_SSpMon2" VALUE 0x8050434C Val_Wu16 65535.00 DFES_OneToOne 0.00 65535.00 FORMAT "%8.2" /end CHARACTERISTIC
/begin CHARACTERISTIC DFES_DTCO.DFC_STHDRmax_C "OBD specific trouble code / OBD specific diagnostic trouble code for check DFC_STHDRmax" VALUE 0x8050434E Val_Wu16 65535.00 DFES_OneToOne 0.00 65535.00 FORMAT "%8.2" /end CHARACTERISTIC
/begin CHARACTERISTIC DFES_DTCO.DFC_SWReset_0_C "OBD specific trouble code / OBD specific diagnostic trouble code for check DFC_SWReset_0" VALUE 0x80504350 Val_Wu16 65535.00 DFES_OneToOne 0.00 65535.00 FORMAT "%8.2" /end CHARACTERISTIC
/begin CHARACTERISTIC DFES_DTCO.DFC_SWReset_1_C "OBD specific trouble code / OBD specific diagnostic trouble code for check DFC_SWReset_1" VALUE 0x80504352 Val_Wu16 65535.00 DFES_OneToOne 0.00 65535.00 FORMAT "%8.2" /end CHARACTERISTIC
/begin CHARACTERISTIC DFES_DTCO.DFC_SWReset_2_C "OBD specific trouble code / OBD specific diagnostic trouble code for check DFC_SWReset_2" VALUE 0x80504354 Val_Wu16 65535.00 DFES_OneToOne 0.00 65535.00 FORMAT "%8.2" /end CHARACTERISTIC
/begin CHARACTERISTIC DFES_DTCO.DFC_SyncAPP_C "OBD specific trouble code / OBD specific diagnostic trouble code for check DFC_SyncAPP" VALUE 0x80504356 Val_Wu16 65535.00 DFES_OneToOne 0.00 65535.00 FORMAT "%8.2" /end CHARACTERISTIC
/begin CHARACTERISTIC DFES_DTCO.DFC_TANKLnpl_C "OBD specific trouble code / OBD specific diagnostic trouble code for check DFC_TANKLnpl" VALUE 0x80504358 Val_Wu16 65535.00 DFES_OneToOne 0.00 65535.00 FORMAT "%8.2" /end CHARACTERISTIC
/begin CHARACTERISTIC DFES_DTCO.DFC_TAmax_Dummy_C "OBD specific trouble code / OBD specific diagnostic trouble code for check DFC_TAmax_Dummy" VALUE 0x8050435A Val_Wu16 65535.00 DFES_OneToOne 0.00 65535.00 FORMAT "%8.2" /end CHARACTERISTIC
/begin CHARACTERISTIC DFES_DTCO.DFC_TESFmax_C "OBD specific trouble code / OBD specific diagnostic trouble code for check DFC_TESFmax" VALUE 0x8050435C Val_Wu16 65535.00 DFES_OneToOne 0.00 65535.00 FORMAT "%8.2" /end CHARACTERISTIC
/begin CHARACTERISTIC DFES_DTCO.DFC_TESGmax_C "OBD specific trouble code / OBD specific diagnostic trouble code for check DFC_TESGmax" VALUE 0x8050435E Val_Wu16 65535.00 DFES_OneToOne 0.00 65535.00 FORMAT "%8.2" /end CHARACTERISTIC
/begin CHARACTERISTIC DFES_DTCO.DFC_TKAEmax_C "OBD specific trouble code / OBD specific diagnostic trouble code for check DFC_TKAEmax" VALUE 0x80504360 Val_Wu16 65535.00 DFES_OneToOne 0.00 65535.00 FORMAT "%8.2" /end CHARACTERISTIC
/begin CHARACTERISTIC DFES_DTCO.DFC_TKAEmin_C "OBD specific trouble code / OBD specific diagnostic trouble code for check DFC_TKAEmin" VALUE 0x80504362 Val_Wu16 65535.00 DFES_OneToOne 0.00 65535.00 FORMAT "%8.2" /end CHARACTERISTIC
/begin CHARACTERISTIC DFES_DTCO.DFC_TKARmax_C "OBD specific trouble code / OBD specific diagnostic trouble code for check DFC_TKARmax" VALUE 0x80504364 Val_Wu16 65535.00 DFES_OneToOne 0.00 65535.00 FORMAT "%8.2" /end CHARACTERISTIC
/begin CHARACTERISTIC DFES_DTCO.DFC_TKARnpl_C "OBD specific trouble code / OBD specific diagnostic trouble code for check DFC_TKARnpl" VALUE 0x80504366 Val_Wu16 65535.00 DFES_OneToOne 0.00 65535.00 FORMAT "%8.2" /end CHARACTERISTIC
/begin CHARACTERISTIC DFES_DTCO.DFC_TMmax_Dummy_C "OBD specific trouble code / OBD specific diagnostic trouble code for check DFC_TMmax_Dummy" VALUE 0x80504368 Val_Wu16 65535.00 DFES_OneToOne 0.00 65535.00 FORMAT "%8.2" /end CHARACTERISTIC
/begin CHARACTERISTIC DFES_DTCO.DFC_TUMmax_Dummy_C "OBD specific trouble code / OBD specific diagnostic trouble code for check DFC_TUMmax_Dummy" VALUE 0x8050436A Val_Wu16 65535.00 DFES_OneToOne 0.00 65535.00 FORMAT "%8.2" /end CHARACTERISTIC
/begin CHARACTERISTIC DFES_DTCO.DFC_TWCDPriCatB1_C "OBD specific trouble code / OBD specific diagnostic trouble code for check DFC_TWCDPriCatB1" VALUE 0x8050436C Val_Wu16 65535.00 DFES_OneToOne 0.00 65535.00 FORMAT "%8.2" /end CHARACTERISTIC
/begin CHARACTERISTIC DFES_DTCO.DFC_ThrVlvClsdPosnFirstOffsLrnImpoB1_C "OBD specific trouble code / OBD specific diagnostic trouble code for check DFC_ThrVlvClsdPosnFirstOffsLrnImpoB1" VALUE 0x8050436E Val_Wu16 65535.00 DFES_OneToOne 0.00 65535.00 FORMAT "%8.2" /end CHARACTERISTIC
/begin CHARACTERISTIC DFES_DTCO.DFC_ThrVlvClsdPosnOffsLrnImpoB1_C "OBD specific trouble code / OBD specific diagnostic trouble code for check DFC_ThrVlvClsdPosnOffsLrnImpoB1" VALUE 0x80504370 Val_Wu16 65535.00 DFES_OneToOne 0.00 65535.00 FORMAT "%8.2" /end CHARACTERISTIC
/begin CHARACTERISTIC DFES_DTCO.DFC_ThrVlvClsdPosnOffsLrnMaxB1_C "OBD specific trouble code / OBD specific diagnostic trouble code for check DFC_ThrVlvClsdPosnOffsLrnMaxB1" VALUE 0x80504372 Val_Wu16 65535.00 DFES_OneToOne 0.00 65535.00 FORMAT "%8.2" /end CHARACTERISTIC
/begin CHARACTERISTIC DFES_DTCO.DFC_ThrVlvClsdPosnOffsLrnMinB1_C "OBD specific trouble code / OBD specific diagnostic trouble code for check DFC_ThrVlvClsdPosnOffsLrnMinB1" VALUE 0x80504374 Val_Wu16 65535.00 DFES_OneToOne 0.00 65535.00 FORMAT "%8.2" /end CHARACTERISTIC
/begin CHARACTERISTIC DFES_DTCO.DFC_ThrVlvCtrlDeB1_C "OBD specific trouble code / OBD specific diagnostic trouble code for check DFC_ThrVlvCtrlDeB1" VALUE 0x80504376 Val_Wu16 65535.00 DFES_OneToOne 0.00 65535.00 FORMAT "%8.2" /end CHARACTERISTIC
/begin CHARACTERISTIC DFES_DTCO.DFC_ThrVlvDycB1_C "OBD specific trouble code / OBD specific diagnostic trouble code for check DFC_ThrVlvDycB1" VALUE 0x80504378 Val_Wu16 65535.00 DFES_OneToOne 0.00 65535.00 FORMAT "%8.2" /end CHARACTERISTIC
/begin CHARACTERISTIC DFES_DTCO.DFC_ThrVlvLimpAirPosnMaxAbsltDriftB1_C "OBD specific trouble code / OBD specific diagnostic trouble code for check DFC_ThrVlvLimpAirPosnMaxAbsltDriftB1" VALUE 0x8050437A Val_Wu16 65535.00 DFES_OneToOne 0.00 65535.00 FORMAT "%8.2" /end CHARACTERISTIC
/begin CHARACTERISTIC DFES_DTCO.DFC_ThrVlvLimpAirPosnMaxB1_C "OBD specific trouble code / OBD specific diagnostic trouble code for check DFC_ThrVlvLimpAirPosnMaxB1" VALUE 0x8050437C Val_Wu16 65535.00 DFES_OneToOne 0.00 65535.00 FORMAT "%8.2" /end CHARACTERISTIC
/begin CHARACTERISTIC DFES_DTCO.DFC_ThrVlvLimpAirPosnMaxRelDriftB1_C "OBD specific trouble code / OBD specific diagnostic trouble code for check DFC_ThrVlvLimpAirPosnMaxRelDriftB1" VALUE 0x8050437E Val_Wu16 65535.00 DFES_OneToOne 0.00 65535.00 FORMAT "%8.2" /end CHARACTERISTIC
/begin CHARACTERISTIC DFES_DTCO.DFC_ThrVlvLimpAirPosnMinB1_C "OBD specific trouble code / OBD specific diagnostic trouble code for check DFC_ThrVlvLimpAirPosnMinB1" VALUE 0x80504380 Val_Wu16 65535.00 DFES_OneToOne 0.00 65535.00 FORMAT "%8.2" /end CHARACTERISTIC
/begin CHARACTERISTIC DFES_DTCO.DFC_ThrVlvOpenLoadB1_C "OBD specific trouble code / OBD specific diagnostic trouble code for check DFC_ThrVlvOpenLoadB1" VALUE 0x80504382 Val_Wu16 65535.00 DFES_OneToOne 0.00 65535.00 FORMAT "%8.2" /end CHARACTERISTIC
/begin CHARACTERISTIC DFES_DTCO.DFC_ThrVlvOpenSprgB1_C "OBD specific trouble code / OBD specific diagnostic trouble code for check DFC_ThrVlvOpenSprgB1" VALUE 0x80504384 Val_Wu16 65535.00 DFES_OneToOne 0.00 65535.00 FORMAT "%8.2" /end CHARACTERISTIC
/begin CHARACTERISTIC DFES_DTCO.DFC_ThrVlvOpenSprgSprdB1_C "OBD specific trouble code / OBD specific diagnostic trouble code for check DFC_ThrVlvOpenSprgSprdB1" VALUE 0x80504386 Val_Wu16 65535.00 DFES_OneToOne 0.00 65535.00 FORMAT "%8.2" /end CHARACTERISTIC
/begin CHARACTERISTIC DFES_DTCO.DFC_ThrVlvOpenSprgTwnB1_C "OBD specific trouble code / OBD specific diagnostic trouble code for check DFC_ThrVlvOpenSprgTwnB1" VALUE 0x80504388 Val_Wu16 65535.00 DFES_OneToOne 0.00 65535.00 FORMAT "%8.2" /end CHARACTERISTIC
/begin CHARACTERISTIC DFES_DTCO.DFC_ThrVlvOverTB1_C "OBD specific trouble code / OBD specific diagnostic trouble code for check DFC_ThrVlvOverTB1" VALUE 0x8050438A Val_Wu16 65535.00 DFES_OneToOne 0.00 65535.00 FORMAT "%8.2" /end CHARACTERISTIC
/begin CHARACTERISTIC DFES_DTCO.DFC_ThrVlvRetSprgB1_C "OBD specific trouble code / OBD specific diagnostic trouble code for check DFC_ThrVlvRetSprgB1" VALUE 0x8050438C Val_Wu16 65535.00 DFES_OneToOne 0.00 65535.00 FORMAT "%8.2" /end CHARACTERISTIC
/begin CHARACTERISTIC DFES_DTCO.DFC_ThrVlvRetSprgSprdB1_C "OBD specific trouble code / OBD specific diagnostic trouble code for check DFC_ThrVlvRetSprgSprdB1" VALUE 0x8050438E Val_Wu16 65535.00 DFES_OneToOne 0.00 65535.00 FORMAT "%8.2" /end CHARACTERISTIC
/begin CHARACTERISTIC DFES_DTCO.DFC_ThrVlvRetSprgTwnB1_C "OBD specific trouble code / OBD specific diagnostic trouble code for check DFC_ThrVlvRetSprgTwnB1" VALUE 0x80504390 Val_Wu16 65535.00 DFES_OneToOne 0.00 65535.00 FORMAT "%8.2" /end CHARACTERISTIC
/begin CHARACTERISTIC DFES_DTCO.DFC_ThrVlvSens1MaxB1_C "OBD specific trouble code / OBD specific diagnostic trouble code for check DFC_ThrVlvSens1MaxB1" VALUE 0x80504392 Val_Wu16 65535.00 DFES_OneToOne 0.00 65535.00 FORMAT "%8.2" /end CHARACTERISTIC
/begin CHARACTERISTIC DFES_DTCO.DFC_ThrVlvSens1NplB1_C "OBD specific trouble code / OBD specific diagnostic trouble code for check DFC_ThrVlvSens1NplB1" VALUE 0x80504394 Val_Wu16 65535.00 DFES_OneToOne 0.00 65535.00 FORMAT "%8.2" /end CHARACTERISTIC
/begin CHARACTERISTIC DFES_DTCO.DFC_ThrVlvSens2MaxB1_C "OBD specific trouble code / OBD specific diagnostic trouble code for check DFC_ThrVlvSens2MaxB1" VALUE 0x80504396 Val_Wu16 65535.00 DFES_OneToOne 0.00 65535.00 FORMAT "%8.2" /end CHARACTERISTIC
/begin CHARACTERISTIC DFES_DTCO.DFC_ThrVlvSens2MinB1_C "OBD specific trouble code / OBD specific diagnostic trouble code for check DFC_ThrVlvSens2MinB1" VALUE 0x80504398 Val_Wu16 65535.00 DFES_OneToOne 0.00 65535.00 FORMAT "%8.2" /end CHARACTERISTIC
/begin CHARACTERISTIC DFES_DTCO.DFC_ThrVlvSens2NplB1_C "OBD specific trouble code / OBD specific diagnostic trouble code for check DFC_ThrVlvSens2NplB1" VALUE 0x8050439A Val_Wu16 65535.00 DFES_OneToOne 0.00 65535.00 FORMAT "%8.2" /end CHARACTERISTIC
/begin CHARACTERISTIC DFES_DTCO.DFC_ThrVlvShoCircB1_C "OBD specific trouble code / OBD specific diagnostic trouble code for check DFC_ThrVlvShoCircB1" VALUE 0x8050439C Val_Wu16 65535.00 DFES_OneToOne 0.00 65535.00 FORMAT "%8.2" /end CHARACTERISTIC
/begin CHARACTERISTIC DFES_DTCO.DFC_ThrVlvSpiErrB1_C "OBD specific trouble code / OBD specific diagnostic trouble code for check DFC_ThrVlvSpiErrB1" VALUE 0x8050439E Val_Wu16 65535.00 DFES_OneToOne 0.00 65535.00 FORMAT "%8.2" /end CHARACTERISTIC
/begin CHARACTERISTIC DFES_DTCO.DFC_ThrvlvSens1MinB1_C "OBD specific trouble code / OBD specific diagnostic trouble code for check DFC_ThrvlvSens1MinB1" VALUE 0x805043A0 Val_Wu16 65535.00 DFES_OneToOne 0.00 65535.00 FORMAT "%8.2" /end CHARACTERISTIC
/begin CHARACTERISTIC DFES_DTCO.DFC_TiOffTBasdChkFast_C "OBD specific trouble code / OBD specific diagnostic trouble code for check DFC_TiOffTBasdChkFast" VALUE 0x805043A2 Val_Wu16 65535.00 DFES_OneToOne 0.00 65535.00 FORMAT "%8.2" /end CHARACTERISTIC
/begin CHARACTERISTIC DFES_DTCO.DFC_TiOffTBasdChkSlow_C "OBD specific trouble code / OBD specific diagnostic trouble code for check DFC_TiOffTBasdChkSlow" VALUE 0x805043A4 Val_Wu16 65535.00 DFES_OneToOne 0.00 65535.00 FORMAT "%8.2" /end CHARACTERISTIC
/begin CHARACTERISTIC DFES_DTCO.DFC_UEGOSnsrMntdS1B1_C "OBD specific trouble code / OBD specific diagnostic trouble code for check DFC_UEGOSnsrMntdS1B1" VALUE 0x805043A6 Val_Wu16 65535.00 DFES_OneToOne 0.00 65535.00 FORMAT "%8.2" /end CHARACTERISTIC
/begin CHARACTERISTIC DFES_DTCO.DFC_VehVSig_C "OBD specific trouble code / OBD specific diagnostic trouble code for check DFC_VehVSig" VALUE 0x805043A8 Val_Wu16 65535.00 DFES_OneToOne 0.00 65535.00 FORMAT "%8.2" /end CHARACTERISTIC
/begin CHARACTERISTIC DFES_DTCO.DFC_VlvLftFbSwtIntk11SpclFail_C "OBD specific trouble code / OBD specific diagnostic trouble code for check DFC_VlvLftFbSwtIntk11SpclFail" VALUE 0x805043AA Val_Wu16 65535.00 DFES_OneToOne 0.00 65535.00 FORMAT "%8.2" /end CHARACTERISTIC
/begin CHARACTERISTIC DFES_DTCO.DFC_VlvLftFbSwtIntk11StdFail_C "OBD specific trouble code / OBD specific diagnostic trouble code for check DFC_VlvLftFbSwtIntk11StdFail" VALUE 0x805043AC Val_Wu16 65535.00 DFES_OneToOne 0.00 65535.00 FORMAT "%8.2" /end CHARACTERISTIC
/begin CHARACTERISTIC DFES_Env.xSet1_CA "set of signals per environment data / Signal selection for environment dataset 1" VAL_BLK 0x80504ACA ValA_Wu16 1168.00000000 Signals_IntSigNumVerb 0.00 1168.00000000 FORMAT "%13.8" NUMBER 1 /end CHARACTERISTIC
/begin CHARACTERISTIC DFES_Env.xSet2_CA "set of signals per environment data / Signal selection for environment dataset 2" VAL_BLK 0x80504ACC ValA_Wu16 1168.00000000 Signals_IntSigNumVerb 0.00 1168.00000000 FORMAT "%13.8" NUMBER 1 /end CHARACTERISTIC
/begin CHARACTERISTIC DFES_EnvRef.DFC_Unused_C "used environment signals / " VALUE 0x805043B2 Val_Wu8 1.00000000000 DFES_EnvTabVerb 0.00 1.00000000000 FORMAT "%13.11" READ_ONLY /end CHARACTERISTIC
/begin CHARACTERISTIC DFES_EnvRef.DFC_AAVEmax_C "used environment signals / Reference to used environment condition set for check DFC_AAVEmax" VALUE 0x805043B3 Val_Wu8 1.00000000000 DFES_EnvTabVerb 0.00 1.00000000000 FORMAT "%13.11" /end CHARACTERISTIC
/begin CHARACTERISTIC DFES_EnvRef.DFC_AAVEmin_C "used environment signals / Reference to used environment condition set for check DFC_AAVEmin" VALUE 0x805043B4 Val_Wu8 1.00000000000 DFES_EnvTabVerb 0.00 1.00000000000 FORMAT "%13.11" /end CHARACTERISTIC
/begin CHARACTERISTIC DFES_EnvRef.DFC_AAVEsig_C "used environment signals / Reference to used environment condition set for check DFC_AAVEsig" VALUE 0x805043B5 Val_Wu8 1.00000000000 DFES_EnvTabVerb 0.00 1.00000000000 FORMAT "%13.11" /end CHARACTERISTIC
/begin CHARACTERISTIC DFES_EnvRef.DFC_AltIOACGFailr_C "used environment signals / Reference to used environment condition set for check DFC_AltIOACGFailr" VALUE 0x805043B6 Val_Wu8 1.00000000000 DFES_EnvTabVerb 0.00 1.00000000000 FORMAT "%13.11" /end CHARACTERISTIC
/begin CHARACTERISTIC DFES_EnvRef.DFC_AltIOACGHiVltg_C "used environment signals / Reference to used environment condition set for check DFC_AltIOACGHiVltg" VALUE 0x805043B7 Val_Wu8 1.00000000000 DFES_EnvTabVerb 0.00 1.00000000000 FORMAT "%13.11" /end CHARACTERISTIC
/begin CHARACTERISTIC DFES_EnvRef.DFC_AltIOACGLoVltg_C "used environment signals / Reference to used environment condition set for check DFC_AltIOACGLoVltg" VALUE 0x805043B8 Val_Wu8 1.00000000000 DFES_EnvTabVerb 0.00 1.00000000000 FORMAT "%13.11" /end CHARACTERISTIC
/begin CHARACTERISTIC DFES_EnvRef.DFC_AltIOACGTHi_C "used environment signals / Reference to used environment condition set for check DFC_AltIOACGTHi" VALUE 0x805043B9 Val_Wu8 1.00000000000 DFES_EnvTabVerb 0.00 1.00000000000 FORMAT "%13.11" /end CHARACTERISTIC
/begin CHARACTERISTIC DFES_EnvRef.DFC_AltIODConnACG_C "used environment signals / Reference to used environment condition set for check DFC_AltIODConnACG" VALUE 0x805043BA Val_Wu8 1.00000000000 DFES_EnvTabVerb 0.00 1.00000000000 FORMAT "%13.11" /end CHARACTERISTIC
/begin CHARACTERISTIC DFES_EnvRef.DFC_BGOELWAF_C "used environment signals / Reference to used environment condition set for check DFC_BGOELWAF" VALUE 0x805043BB Val_Wu8 1.00000000000 DFES_EnvTabVerb 0.00 1.00000000000 FORMAT "%13.11" /end CHARACTERISTIC
/begin CHARACTERISTIC DFES_EnvRef.DFC_BattUHiFailr_C "used environment signals / Reference to used environment condition set for check DFC_BattUHiFailr" VALUE 0x805043BC Val_Wu8 1.00000000000 DFES_EnvTabVerb 0.00 1.00000000000 FORMAT "%13.11" /end CHARACTERISTIC
/begin CHARACTERISTIC DFES_EnvRef.DFC_BattULoFailr_C "used environment signals / Reference to used environment condition set for check DFC_BattULoFailr" VALUE 0x805043BD Val_Wu8 1.00000000000 DFES_EnvTabVerb 0.00 1.00000000000 FORMAT "%13.11" /end CHARACTERISTIC
/begin CHARACTERISTIC DFES_EnvRef.DFC_BrkBstPDriftHiErr_C "used environment signals / Reference to used environment condition set for check DFC_BrkBstPDriftHiErr" VALUE 0x805043BE Val_Wu8 1.00000000000 DFES_EnvTabVerb 0.00 1.00000000000 FORMAT "%13.11" /end CHARACTERISTIC
/begin CHARACTERISTIC DFES_EnvRef.DFC_BrkBstPDriftLoErr_C "used environment signals / Reference to used environment condition set for check DFC_BrkBstPDriftLoErr" VALUE 0x805043BF Val_Wu8 1.00000000000 DFES_EnvTabVerb 0.00 1.00000000000 FORMAT "%13.11" /end CHARACTERISTIC
/begin CHARACTERISTIC DFES_EnvRef.DFC_BrkBstPSnsrStuck_C "used environment signals / Reference to used environment condition set for check DFC_BrkBstPSnsrStuck" VALUE 0x805043C0 Val_Wu8 1.00000000000 DFES_EnvTabVerb 0.00 1.00000000000 FORMAT "%13.11" /end CHARACTERISTIC
/begin CHARACTERISTIC DFES_EnvRef.DFC_BrkMnSwtContOn_C "used environment signals / Reference to used environment condition set for check DFC_BrkMnSwtContOn" VALUE 0x805043C1 Val_Wu8 1.00000000000 DFES_EnvTabVerb 0.00 1.00000000000 FORMAT "%13.11" /end CHARACTERISTIC
/begin CHARACTERISTIC DFES_EnvRef.DFC_BrkMnSwtNotStp_C "used environment signals / Reference to used environment condition set for check DFC_BrkMnSwtNotStp" VALUE 0x805043C2 Val_Wu8 1.00000000000 DFES_EnvTabVerb 0.00 1.00000000000 FORMAT "%13.11" /end CHARACTERISTIC
/begin CHARACTERISTIC DFES_EnvRef.DFC_BrkNpl_C "used environment signals / Reference to used environment condition set for check DFC_BrkNpl" VALUE 0x805043C3 Val_Wu8 1.00000000000 DFES_EnvTabVerb 0.00 1.00000000000 FORMAT "%13.11" /end CHARACTERISTIC
/begin CHARACTERISTIC DFES_EnvRef.DFC_BrkRdntSwtContOn_C "used environment signals / Reference to used environment condition set for check DFC_BrkRdntSwtContOn" VALUE 0x805043C4 Val_Wu8 1.00000000000 DFES_EnvTabVerb 0.00 1.00000000000 FORMAT "%13.11" /end CHARACTERISTIC
/begin CHARACTERISTIC DFES_EnvRef.DFC_BrkRdntSwtNotStp_C "used environment signals / Reference to used environment condition set for check DFC_BrkRdntSwtNotStp" VALUE 0x805043C5 Val_Wu8 1.00000000000 DFES_EnvTabVerb 0.00 1.00000000000 FORMAT "%13.11" /end CHARACTERISTIC
/begin CHARACTERISTIC DFES_EnvRef.DFC_Clth3ONStuck_C "used environment signals / Reference to used environment condition set for check DFC_Clth3ONStuck" VALUE 0x805043C6 Val_Wu8 1.00000000000 DFES_EnvTabVerb 0.00 1.00000000000 FORMAT "%13.11" /end CHARACTERISTIC
/begin CHARACTERISTIC DFES_EnvRef.DFC_Clth4OFFStuck_C "used environment signals / Reference to used environment condition set for check DFC_Clth4OFFStuck" VALUE 0x805043C7 Val_Wu8 1.00000000000 DFES_EnvTabVerb 0.00 1.00000000000 FORMAT "%13.11" /end CHARACTERISTIC
/begin CHARACTERISTIC DFES_EnvRef.DFC_ClthOFFStuck_C "used environment signals / Reference to used environment condition set for check DFC_ClthOFFStuck" VALUE 0x805043C8 Val_Wu8 1.00000000000 DFES_EnvTabVerb 0.00 1.00000000000 FORMAT "%13.11" /end CHARACTERISTIC
/begin CHARACTERISTIC DFES_EnvRef.DFC_ClthONStuck_C "used environment signals / Reference to used environment condition set for check DFC_ClthONStuck" VALUE 0x805043C9 Val_Wu8 1.00000000000 DFES_EnvTabVerb 0.00 1.00000000000 FORMAT "%13.11" /end CHARACTERISTIC
/begin CHARACTERISTIC DFES_EnvRef.DFC_ClthStkFailInfo_C "used environment signals / Reference to used environment condition set for check DFC_ClthStkFailInfo" VALUE 0x805043CA Val_Wu8 1.00000000000 DFES_EnvTabVerb 0.00 1.00000000000 FORMAT "%13.11" /end CHARACTERISTIC
/begin CHARACTERISTIC DFES_EnvRef.DFC_ComACFailInfo_C "used environment signals / Reference to used environment condition set for check DFC_ComACFailInfo" VALUE 0x805043CB Val_Wu8 1.00000000000 DFES_EnvTabVerb 0.00 1.00000000000 FORMAT "%13.11" /end CHARACTERISTIC
/begin CHARACTERISTIC DFES_EnvRef.DFC_ComATFTValErr_C "used environment signals / Reference to used environment condition set for check DFC_ComATFTValErr" VALUE 0x805043CC Val_Wu8 1.00000000000 DFES_EnvTabVerb 0.00 1.00000000000 FORMAT "%13.11" /end CHARACTERISTIC
/begin CHARACTERISTIC DFES_EnvRef.DFC_ComATMILReq_C "used environment signals / Reference to used environment condition set for check DFC_ComATMILReq" VALUE 0x805043CD Val_Wu8 1.00000000000 DFES_EnvTabVerb 0.00 1.00000000000 FORMAT "%13.11" /end CHARACTERISTIC
/begin CHARACTERISTIC DFES_EnvRef.DFC_ComAYCAChksum_C "used environment signals / Reference to used environment condition set for check DFC_ComAYCAChksum" VALUE 0x805043CE Val_Wu8 1.00000000000 DFES_EnvTabVerb 0.00 1.00000000000 FORMAT "%13.11" /end CHARACTERISTIC
/begin CHARACTERISTIC DFES_EnvRef.DFC_ComAYCARingCnt_C "used environment signals / Reference to used environment condition set for check DFC_ComAYCARingCnt" VALUE 0x805043CF Val_Wu8 1.00000000000 DFES_EnvTabVerb 0.00 1.00000000000 FORMAT "%13.11" /end CHARACTERISTIC
/begin CHARACTERISTIC DFES_EnvRef.DFC_ComAYCATOut_C "used environment signals / Reference to used environment condition set for check DFC_ComAYCATOut" VALUE 0x805043D0 Val_Wu8 1.00000000000 DFES_EnvTabVerb 0.00 1.00000000000 FORMAT "%13.11" /end CHARACTERISTIC
/begin CHARACTERISTIC DFES_EnvRef.DFC_ComAYCDChkSum_C "used environment signals / Reference to used environment condition set for check DFC_ComAYCDChkSum" VALUE 0x805043D1 Val_Wu8 1.00000000000 DFES_EnvTabVerb 0.00 1.00000000000 FORMAT "%13.11" /end CHARACTERISTIC
/begin CHARACTERISTIC DFES_EnvRef.DFC_ComAYCDTOut_C "used environment signals / Reference to used environment condition set for check DFC_ComAYCDTOut" VALUE 0x805043D2 Val_Wu8 1.00000000000 DFES_EnvTabVerb 0.00 1.00000000000 FORMAT "%13.11" /end CHARACTERISTIC
/begin CHARACTERISTIC DFES_EnvRef.DFC_ComAYCFChksum_C "used environment signals / Reference to used environment condition set for check DFC_ComAYCFChksum" VALUE 0x805043D3 Val_Wu8 1.00000000000 DFES_EnvTabVerb 0.00 1.00000000000 FORMAT "%13.11" /end CHARACTERISTIC
/begin CHARACTERISTIC DFES_EnvRef.DFC_ComAYCFRingCnt_C "used environment signals / Reference to used environment condition set for check DFC_ComAYCFRingCnt" VALUE 0x805043D4 Val_Wu8 1.00000000000 DFES_EnvTabVerb 0.00 1.00000000000 FORMAT "%13.11" /end CHARACTERISTIC
/begin CHARACTERISTIC DFES_EnvRef.DFC_ComAYCFTOut_C "used environment signals / Reference to used environment condition set for check DFC_ComAYCFTOut" VALUE 0x805043D5 Val_Wu8 1.00000000000 DFES_EnvTabVerb 0.00 1.00000000000 FORMAT "%13.11" /end CHARACTERISTIC
/begin CHARACTERISTIC DFES_EnvRef.DFC_ComAYCGChksum_C "used environment signals / Reference to used environment condition set for check DFC_ComAYCGChksum" VALUE 0x805043D6 Val_Wu8 1.00000000000 DFES_EnvTabVerb 0.00 1.00000000000 FORMAT "%13.11" /end CHARACTERISTIC
/begin CHARACTERISTIC DFES_EnvRef.DFC_ComAYCGRingCnt_C "used environment signals / Reference to used environment condition set for check DFC_ComAYCGRingCnt" VALUE 0x805043D7 Val_Wu8 1.00000000000 DFES_EnvTabVerb 0.00 1.00000000000 FORMAT "%13.11" /end CHARACTERISTIC
/begin CHARACTERISTIC DFES_EnvRef.DFC_ComAYCGTOut_C "used environment signals / Reference to used environment condition set for check DFC_ComAYCGTOut" VALUE 0x805043D8 Val_Wu8 1.00000000000 DFES_EnvTabVerb 0.00 1.00000000000 FORMAT "%13.11" /end CHARACTERISTIC
/begin CHARACTERISTIC DFES_EnvRef.DFC_ComAYCIChkSum_C "used environment signals / Reference to used environment condition set for check DFC_ComAYCIChkSum" VALUE 0x805043D9 Val_Wu8 1.00000000000 DFES_EnvTabVerb 0.00 1.00000000000 FORMAT "%13.11" /end CHARACTERISTIC
/begin CHARACTERISTIC DFES_EnvRef.DFC_ComAYCIRingCnt_C "used environment signals / Reference to used environment condition set for check DFC_ComAYCIRingCnt" VALUE 0x805043DA Val_Wu8 1.00000000000 DFES_EnvTabVerb 0.00 1.00000000000 FORMAT "%13.11" /end CHARACTERISTIC
/begin CHARACTERISTIC DFES_EnvRef.DFC_ComAYCITOut_C "used environment signals / Reference to used environment condition set for check DFC_ComAYCITOut" VALUE 0x805043DB Val_Wu8 1.00000000000 DFES_EnvTabVerb 0.00 1.00000000000 FORMAT "%13.11" /end CHARACTERISTIC
/begin CHARACTERISTIC DFES_EnvRef.DFC_ComBCM1ChkSum_C "used environment signals / Reference to used environment condition set for check DFC_ComBCM1ChkSum" VALUE 0x805043DC Val_Wu8 1.00000000000 DFES_EnvTabVerb 0.00 1.00000000000 FORMAT "%13.11" /end CHARACTERISTIC
/begin CHARACTERISTIC DFES_EnvRef.DFC_ComBCM1RingCnt_C "used environment signals / Reference to used environment condition set for check DFC_ComBCM1RingCnt" VALUE 0x805043DD Val_Wu8 1.00000000000 DFES_EnvTabVerb 0.00 1.00000000000 FORMAT "%13.11" /end CHARACTERISTIC
/begin CHARACTERISTIC DFES_EnvRef.DFC_ComBCM1TOut_C "used environment signals / Reference to used environment condition set for check DFC_ComBCM1TOut" VALUE 0x805043DE Val_Wu8 1.00000000000 DFES_EnvTabVerb 0.00 1.00000000000 FORMAT "%13.11" /end CHARACTERISTIC
/begin CHARACTERISTIC DFES_EnvRef.DFC_ComCANABusOffErr_C "used environment signals / Reference to used environment condition set for check DFC_ComCANABusOffErr" VALUE 0x805043DF Val_Wu8 1.00000000000 DFES_EnvTabVerb 0.00 1.00000000000 FORMAT "%13.11" /end CHARACTERISTIC
/begin CHARACTERISTIC DFES_EnvRef.DFC_ComCANBBusOffErr_C "used environment signals / Reference to used environment condition set for check DFC_ComCANBBusOffErr" VALUE 0x805043E0 Val_Wu8 1.00000000000 DFES_EnvTabVerb 0.00 1.00000000000 FORMAT "%13.11" /end CHARACTERISTIC
/begin CHARACTERISTIC DFES_EnvRef.DFC_ComCANCBusOffErr_C "used environment signals / Reference to used environment condition set for check DFC_ComCANCBusOffErr" VALUE 0x805043E1 Val_Wu8 1.00000000000 DFES_EnvTabVerb 0.00 1.00000000000 FORMAT "%13.11" /end CHARACTERISTIC
/begin CHARACTERISTIC DFES_EnvRef.DFC_ComCGW1ChkSum_C "used environment signals / Reference to used environment condition set for check DFC_ComCGW1ChkSum" VALUE 0x805043E2 Val_Wu8 1.00000000000 DFES_EnvTabVerb 0.00 1.00000000000 FORMAT "%13.11" /end CHARACTERISTIC
/begin CHARACTERISTIC DFES_EnvRef.DFC_ComCGW1RingCnt_C "used environment signals / Reference to used environment condition set for check DFC_ComCGW1RingCnt" VALUE 0x805043E3 Val_Wu8 1.00000000000 DFES_EnvTabVerb 0.00 1.00000000000 FORMAT "%13.11" /end CHARACTERISTIC
/begin CHARACTERISTIC DFES_EnvRef.DFC_ComCGW1TOut_C "used environment signals / Reference to used environment condition set for check DFC_ComCGW1TOut" VALUE 0x805043E4 Val_Wu8 1.00000000000 DFES_EnvTabVerb 0.00 1.00000000000 FORMAT "%13.11" /end CHARACTERISTIC
/begin CHARACTERISTIC DFES_EnvRef.DFC_ComConvBoostErr_C "used environment signals / Reference to used environment condition set for check DFC_ComConvBoostErr" VALUE 0x805043E5 Val_Wu8 1.00000000000 DFES_EnvTabVerb 0.00 1.00000000000 FORMAT "%13.11" /end CHARACTERISTIC
/begin CHARACTERISTIC DFES_EnvRef.DFC_ComConvSlipErr_C "used environment signals / Reference to used environment condition set for check DFC_ComConvSlipErr" VALUE 0x805043E6 Val_Wu8 1.00000000000 DFES_EnvTabVerb 0.00 1.00000000000 FORMAT "%13.11" /end CHARACTERISTIC
/begin CHARACTERISTIC DFES_EnvRef.DFC_ComDCDCPrfmncErr_C "used environment signals / Reference to used environment condition set for check DFC_ComDCDCPrfmncErr" VALUE 0x805043E7 Val_Wu8 1.00000000000 DFES_EnvTabVerb 0.00 1.00000000000 FORMAT "%13.11" /end CHARACTERISTIC
/begin CHARACTERISTIC DFES_EnvRef.DFC_ComDCDCTempWarn_C "used environment signals / Reference to used environment condition set for check DFC_ComDCDCTempWarn" VALUE 0x805043E8 Val_Wu8 1.00000000000 DFES_EnvTabVerb 0.00 1.00000000000 FORMAT "%13.11" /end CHARACTERISTIC
/begin CHARACTERISTIC DFES_EnvRef.DFC_ComEAT10Chksum_C "used environment signals / Reference to used environment condition set for check DFC_ComEAT10Chksum" VALUE 0x805043E9 Val_Wu8 1.00000000000 DFES_EnvTabVerb 0.00 1.00000000000 FORMAT "%13.11" /end CHARACTERISTIC
/begin CHARACTERISTIC DFES_EnvRef.DFC_ComEAT10RingCnt_C "used environment signals / Reference to used environment condition set for check DFC_ComEAT10RingCnt" VALUE 0x805043EA Val_Wu8 1.00000000000 DFES_EnvTabVerb 0.00 1.00000000000 FORMAT "%13.11" /end CHARACTERISTIC
/begin CHARACTERISTIC DFES_EnvRef.DFC_ComEAT10TOut_C "used environment signals / Reference to used environment condition set for check DFC_ComEAT10TOut" VALUE 0x805043EB Val_Wu8 1.00000000000 DFES_EnvTabVerb 0.00 1.00000000000 FORMAT "%13.11" /end CHARACTERISTIC
/begin CHARACTERISTIC DFES_EnvRef.DFC_ComEAT11ChkSum_C "used environment signals / Reference to used environment condition set for check DFC_ComEAT11ChkSum" VALUE 0x805043EC Val_Wu8 1.00000000000 DFES_EnvTabVerb 0.00 1.00000000000 FORMAT "%13.11" /end CHARACTERISTIC
/begin CHARACTERISTIC DFES_EnvRef.DFC_ComEAT11RingCnt_C "used environment signals / Reference to used environment condition set for check DFC_ComEAT11RingCnt" VALUE 0x805043ED Val_Wu8 1.00000000000 DFES_EnvTabVerb 0.00 1.00000000000 FORMAT "%13.11" /end CHARACTERISTIC
/begin CHARACTERISTIC DFES_EnvRef.DFC_ComEAT11TOut_C "used environment signals / Reference to used environment condition set for check DFC_ComEAT11TOut" VALUE 0x805043EE Val_Wu8 1.00000000000 DFES_EnvTabVerb 0.00 1.00000000000 FORMAT "%13.11" /end CHARACTERISTIC
/begin CHARACTERISTIC DFES_EnvRef.DFC_ComEAT12ChkSum_C "used environment signals / Reference to used environment condition set for check DFC_ComEAT12ChkSum" VALUE 0x805043EF Val_Wu8 1.00000000000 DFES_EnvTabVerb 0.00 1.00000000000 FORMAT "%13.11" /end CHARACTERISTIC
/begin CHARACTERISTIC DFES_EnvRef.DFC_ComEAT12RingCnt_C "used environment signals / Reference to used environment condition set for check DFC_ComEAT12RingCnt" VALUE 0x805043F0 Val_Wu8 1.00000000000 DFES_EnvTabVerb 0.00 1.00000000000 FORMAT "%13.11" /end CHARACTERISTIC
/begin CHARACTERISTIC DFES_EnvRef.DFC_ComEAT12TOut_C "used environment signals / Reference to used environment condition set for check DFC_ComEAT12TOut" VALUE 0x805043F1 Val_Wu8 1.00000000000 DFES_EnvTabVerb 0.00 1.00000000000 FORMAT "%13.11" /end CHARACTERISTIC
/begin CHARACTERISTIC DFES_EnvRef.DFC_ComEAT13ChkSum_C "used environment signals / Reference to used environment condition set for check DFC_ComEAT13ChkSum" VALUE 0x805043F2 Val_Wu8 1.00000000000 DFES_EnvTabVerb 0.00 1.00000000000 FORMAT "%13.11" /end CHARACTERISTIC
/begin CHARACTERISTIC DFES_EnvRef.DFC_ComEAT13RingCnt_C "used environment signals / Reference to used environment condition set for check DFC_ComEAT13RingCnt" VALUE 0x805043F3 Val_Wu8 1.00000000000 DFES_EnvTabVerb 0.00 1.00000000000 FORMAT "%13.11" /end CHARACTERISTIC
/begin CHARACTERISTIC DFES_EnvRef.DFC_ComEAT13TOut_C "used environment signals / Reference to used environment condition set for check DFC_ComEAT13TOut" VALUE 0x805043F4 Val_Wu8 1.00000000000 DFES_EnvTabVerb 0.00 1.00000000000 FORMAT "%13.11" /end CHARACTERISTIC
/begin CHARACTERISTIC DFES_EnvRef.DFC_ComEAT1Chksum_C "used environment signals / Reference to used environment condition set for check DFC_ComEAT1Chksum" VALUE 0x805043F5 Val_Wu8 1.00000000000 DFES_EnvTabVerb 0.00 1.00000000000 FORMAT "%13.11" /end CHARACTERISTIC
/begin CHARACTERISTIC DFES_EnvRef.DFC_ComEAT1RingCnt_C "used environment signals / Reference to used environment condition set for check DFC_ComEAT1RingCnt" VALUE 0x805043F6 Val_Wu8 1.00000000000 DFES_EnvTabVerb 0.00 1.00000000000 FORMAT "%13.11" /end CHARACTERISTIC
/begin CHARACTERISTIC DFES_EnvRef.DFC_ComEAT1TOut_C "used environment signals / Reference to used environment condition set for check DFC_ComEAT1TOut" VALUE 0x805043F7 Val_Wu8 1.00000000000 DFES_EnvTabVerb 0.00 1.00000000000 FORMAT "%13.11" /end CHARACTERISTIC
/begin CHARACTERISTIC DFES_EnvRef.DFC_ComEAT2ChkSum_C "used environment signals / Reference to used environment condition set for check DFC_ComEAT2ChkSum" VALUE 0x805043F8 Val_Wu8 1.00000000000 DFES_EnvTabVerb 0.00 1.00000000000 FORMAT "%13.11" /end CHARACTERISTIC
/begin CHARACTERISTIC DFES_EnvRef.DFC_ComEAT2RingCnt_C "used environment signals / Reference to used environment condition set for check DFC_ComEAT2RingCnt" VALUE 0x805043F9 Val_Wu8 1.00000000000 DFES_EnvTabVerb 0.00 1.00000000000 FORMAT "%13.11" /end CHARACTERISTIC
/begin CHARACTERISTIC DFES_EnvRef.DFC_ComEAT2TOut_C "used environment signals / Reference to used environment condition set for check DFC_ComEAT2TOut" VALUE 0x805043FA Val_Wu8 1.00000000000 DFES_EnvTabVerb 0.00 1.00000000000 FORMAT "%13.11" /end CHARACTERISTIC
/begin CHARACTERISTIC DFES_EnvRef.DFC_ComEAT4ChkSum_C "used environment signals / Reference to used environment condition set for check DFC_ComEAT4ChkSum" VALUE 0x805043FB Val_Wu8 1.00000000000 DFES_EnvTabVerb 0.00 1.00000000000 FORMAT "%13.11" /end CHARACTERISTIC
/begin CHARACTERISTIC DFES_EnvRef.DFC_ComEAT4RingCnt_C "used environment signals / Reference to used environment condition set for check DFC_ComEAT4RingCnt" VALUE 0x805043FC Val_Wu8 1.00000000000 DFES_EnvTabVerb 0.00 1.00000000000 FORMAT "%13.11" /end CHARACTERISTIC
/begin CHARACTERISTIC DFES_EnvRef.DFC_ComEAT4TOut_C "used environment signals / Reference to used environment condition set for check DFC_ComEAT4TOut" VALUE 0x805043FD Val_Wu8 1.00000000000 DFES_EnvTabVerb 0.00 1.00000000000 FORMAT "%13.11" /end CHARACTERISTIC
/begin CHARACTERISTIC DFES_EnvRef.DFC_ComEAT6Chksum_C "used environment signals / Reference to used environment condition set for check DFC_ComEAT6Chksum" VALUE 0x805043FE Val_Wu8 1.00000000000 DFES_EnvTabVerb 0.00 1.00000000000 FORMAT "%13.11" /end CHARACTERISTIC
/begin CHARACTERISTIC DFES_EnvRef.DFC_ComEAT6RingCnt_C "used environment signals / Reference to used environment condition set for check DFC_ComEAT6RingCnt" VALUE 0x805043FF Val_Wu8 1.00000000000 DFES_EnvTabVerb 0.00 1.00000000000 FORMAT "%13.11" /end CHARACTERISTIC
/begin CHARACTERISTIC DFES_EnvRef.DFC_ComEAT6TOut_C "used environment signals / Reference to used environment condition set for check DFC_ComEAT6TOut" VALUE 0x80504400 Val_Wu8 1.00000000000 DFES_EnvTabVerb 0.00 1.00000000000 FORMAT "%13.11" /end CHARACTERISTIC
/begin CHARACTERISTIC DFES_EnvRef.DFC_ComEAT7Chksum_C "used environment signals / Reference to used environment condition set for check DFC_ComEAT7Chksum" VALUE 0x80504401 Val_Wu8 1.00000000000 DFES_EnvTabVerb 0.00 1.00000000000 FORMAT "%13.11" /end CHARACTERISTIC
/begin CHARACTERISTIC DFES_EnvRef.DFC_ComEAT7RingCnt_C "used environment signals / Reference to used environment condition set for check DFC_ComEAT7RingCnt" VALUE 0x80504402 Val_Wu8 1.00000000000 DFES_EnvTabVerb 0.00 1.00000000000 FORMAT "%13.11" /end CHARACTERISTIC
/begin CHARACTERISTIC DFES_EnvRef.DFC_ComEAT7TOut_C "used environment signals / Reference to used environment condition set for check DFC_ComEAT7TOut" VALUE 0x80504403 Val_Wu8 1.00000000000 DFES_EnvTabVerb 0.00 1.00000000000 FORMAT "%13.11" /end CHARACTERISTIC
/begin CHARACTERISTIC DFES_EnvRef.DFC_ComEAT8Chksum_C "used environment signals / Reference to used environment condition set for check DFC_ComEAT8Chksum" VALUE 0x80504404 Val_Wu8 1.00000000000 DFES_EnvTabVerb 0.00 1.00000000000 FORMAT "%13.11" /end CHARACTERISTIC
/begin CHARACTERISTIC DFES_EnvRef.DFC_ComEAT8RingCnt_C "used environment signals / Reference to used environment condition set for check DFC_ComEAT8RingCnt" VALUE 0x80504405 Val_Wu8 1.00000000000 DFES_EnvTabVerb 0.00 1.00000000000 FORMAT "%13.11" /end CHARACTERISTIC
/begin CHARACTERISTIC DFES_EnvRef.DFC_ComEAT8TOut_C "used environment signals / Reference to used environment condition set for check DFC_ComEAT8TOut" VALUE 0x80504406 Val_Wu8 1.00000000000 DFES_EnvTabVerb 0.00 1.00000000000 FORMAT "%13.11" /end CHARACTERISTIC
/begin CHARACTERISTIC DFES_EnvRef.DFC_ComEATAChksum_C "used environment signals / Reference to used environment condition set for check DFC_ComEATAChksum" VALUE 0x80504407 Val_Wu8 1.00000000000 DFES_EnvTabVerb 0.00 1.00000000000 FORMAT "%13.11" /end CHARACTERISTIC
/begin CHARACTERISTIC DFES_EnvRef.DFC_ComEATARingCnt_C "used environment signals / Reference to used environment condition set for check DFC_ComEATARingCnt" VALUE 0x80504408 Val_Wu8 1.00000000000 DFES_EnvTabVerb 0.00 1.00000000000 FORMAT "%13.11" /end CHARACTERISTIC
/begin CHARACTERISTIC DFES_EnvRef.DFC_ComEATATOut_C "used environment signals / Reference to used environment condition set for check DFC_ComEATATOut" VALUE 0x80504409 Val_Wu8 1.00000000000 DFES_EnvTabVerb 0.00 1.00000000000 FORMAT "%13.11" /end CHARACTERISTIC
/begin CHARACTERISTIC DFES_EnvRef.DFC_ComEATBChkSum_C "used environment signals / Reference to used environment condition set for check DFC_ComEATBChkSum" VALUE 0x8050440A Val_Wu8 1.00000000000 DFES_EnvTabVerb 0.00 1.00000000000 FORMAT "%13.11" /end CHARACTERISTIC
/begin CHARACTERISTIC DFES_EnvRef.DFC_ComEATBRingCnt_C "used environment signals / Reference to used environment condition set for check DFC_ComEATBRingCnt" VALUE 0x8050440B Val_Wu8 1.00000000000 DFES_EnvTabVerb 0.00 1.00000000000 FORMAT "%13.11" /end CHARACTERISTIC
/begin CHARACTERISTIC DFES_EnvRef.DFC_ComEATBTOut_C "used environment signals / Reference to used environment condition set for check DFC_ComEATBTOut" VALUE 0x8050440C Val_Wu8 1.00000000000 DFES_EnvTabVerb 0.00 1.00000000000 FORMAT "%13.11" /end CHARACTERISTIC
/begin CHARACTERISTIC DFES_EnvRef.DFC_ComEATCChksum_C "used environment signals / Reference to used environment condition set for check DFC_ComEATCChksum" VALUE 0x8050440D Val_Wu8 1.00000000000 DFES_EnvTabVerb 0.00 1.00000000000 FORMAT "%13.11" /end CHARACTERISTIC
/begin CHARACTERISTIC DFES_EnvRef.DFC_ComEATCRingCnt_C "used environment signals / Reference to used environment condition set for check DFC_ComEATCRingCnt" VALUE 0x8050440E Val_Wu8 1.00000000000 DFES_EnvTabVerb 0.00 1.00000000000 FORMAT "%13.11" /end CHARACTERISTIC
/begin CHARACTERISTIC DFES_EnvRef.DFC_ComEATCTOut_C "used environment signals / Reference to used environment condition set for check DFC_ComEATCTOut" VALUE 0x8050440F Val_Wu8 1.00000000000 DFES_EnvTabVerb 0.00 1.00000000000 FORMAT "%13.11" /end CHARACTERISTIC
/begin CHARACTERISTIC DFES_EnvRef.DFC_ComEPBBChkSum_C "used environment signals / Reference to used environment condition set for check DFC_ComEPBBChkSum" VALUE 0x80504410 Val_Wu8 1.00000000000 DFES_EnvTabVerb 0.00 1.00000000000 FORMAT "%13.11" /end CHARACTERISTIC
/begin CHARACTERISTIC DFES_EnvRef.DFC_ComEPBBRingCnt_C "used environment signals / Reference to used environment condition set for check DFC_ComEPBBRingCnt" VALUE 0x80504411 Val_Wu8 1.00000000000 DFES_EnvTabVerb 0.00 1.00000000000 FORMAT "%13.11" /end CHARACTERISTIC
/begin CHARACTERISTIC DFES_EnvRef.DFC_ComEPBBTOut_C "used environment signals / Reference to used environment condition set for check DFC_ComEPBBTOut" VALUE 0x80504412 Val_Wu8 1.00000000000 DFES_EnvTabVerb 0.00 1.00000000000 FORMAT "%13.11" /end CHARACTERISTIC
/begin CHARACTERISTIC DFES_EnvRef.DFC_ComEPBChksum_C "used environment signals / Reference to used environment condition set for check DFC_ComEPBChksum" VALUE 0x80504413 Val_Wu8 1.00000000000 DFES_EnvTabVerb 0.00 1.00000000000 FORMAT "%13.11" /end CHARACTERISTIC
/begin CHARACTERISTIC DFES_EnvRef.DFC_ComEPBTOut_C "used environment signals / Reference to used environment condition set for check DFC_ComEPBTOut" VALUE 0x80504414 Val_Wu8 1.00000000000 DFES_EnvTabVerb 0.00 1.00000000000 FORMAT "%13.11" /end CHARACTERISTIC
/begin CHARACTERISTIC DFES_EnvRef.DFC_ComEPBctRing_C "used environment signals / Reference to used environment condition set for check DFC_ComEPBctRing" VALUE 0x80504415 Val_Wu8 1.00000000000 DFES_EnvTabVerb 0.00 1.00000000000 FORMAT "%13.11" /end CHARACTERISTIC
/begin CHARACTERISTIC DFES_EnvRef.DFC_ComEPS1Chksum_C "used environment signals / Reference to used environment condition set for check DFC_ComEPS1Chksum" VALUE 0x80504416 Val_Wu8 1.00000000000 DFES_EnvTabVerb 0.00 1.00000000000 FORMAT "%13.11" /end CHARACTERISTIC
/begin CHARACTERISTIC DFES_EnvRef.DFC_ComEPS1RingCnt_C "used environment signals / Reference to used environment condition set for check DFC_ComEPS1RingCnt" VALUE 0x80504417 Val_Wu8 1.00000000000 DFES_EnvTabVerb 0.00 1.00000000000 FORMAT "%13.11" /end CHARACTERISTIC
/begin CHARACTERISTIC DFES_EnvRef.DFC_ComEPS1TOut_C "used environment signals / Reference to used environment condition set for check DFC_ComEPS1TOut" VALUE 0x80504418 Val_Wu8 1.00000000000 DFES_EnvTabVerb 0.00 1.00000000000 FORMAT "%13.11" /end CHARACTERISTIC
/begin CHARACTERISTIC DFES_EnvRef.DFC_ComEngCanRxErr_C "used environment signals / Reference to used environment condition set for check DFC_ComEngCanRxErr" VALUE 0x80504419 Val_Wu8 1.00000000000 DFES_EnvTabVerb 0.00 1.00000000000 FORMAT "%13.11" /end CHARACTERISTIC
/begin CHARACTERISTIC DFES_EnvRef.DFC_ComGrvySnsrErr_C "used environment signals / Reference to used environment condition set for check DFC_ComGrvySnsrErr" VALUE 0x8050441A Val_Wu8 1.00000000000 DFES_EnvTabVerb 0.00 1.00000000000 FORMAT "%13.11" /end CHARACTERISTIC
/begin CHARACTERISTIC DFES_EnvRef.DFC_ComGwIMG1ChkSum_C "used environment signals / Reference to used environment condition set for check DFC_ComGwIMG1ChkSum" VALUE 0x8050441B Val_Wu8 1.00000000000 DFES_EnvTabVerb 0.00 1.00000000000 FORMAT "%13.11" /end CHARACTERISTIC
/begin CHARACTERISTIC DFES_EnvRef.DFC_ComGwIMG1RingCnt_C "used environment signals / Reference to used environment condition set for check DFC_ComGwIMG1RingCnt" VALUE 0x8050441C Val_Wu8 1.00000000000 DFES_EnvTabVerb 0.00 1.00000000000 FORMAT "%13.11" /end CHARACTERISTIC
/begin CHARACTERISTIC DFES_EnvRef.DFC_ComGwIMG1TOut_C "used environment signals / Reference to used environment condition set for check DFC_ComGwIMG1TOut" VALUE 0x8050441D Val_Wu8 1.00000000000 DFES_EnvTabVerb 0.00 1.00000000000 FORMAT "%13.11" /end CHARACTERISTIC
/begin CHARACTERISTIC DFES_EnvRef.DFC_ComGwIMG3ChkSum_C "used environment signals / Reference to used environment condition set for check DFC_ComGwIMG3ChkSum" VALUE 0x8050441E Val_Wu8 1.00000000000 DFES_EnvTabVerb 0.00 1.00000000000 FORMAT "%13.11" /end CHARACTERISTIC
/begin CHARACTERISTIC DFES_EnvRef.DFC_ComGwIMG3RingCnt_C "used environment signals / Reference to used environment condition set for check DFC_ComGwIMG3RingCnt" VALUE 0x8050441F Val_Wu8 1.00000000000 DFES_EnvTabVerb 0.00 1.00000000000 FORMAT "%13.11" /end CHARACTERISTIC
/begin CHARACTERISTIC DFES_EnvRef.DFC_ComGwIMG3TOut_C "used environment signals / Reference to used environment condition set for check DFC_ComGwIMG3TOut" VALUE 0x80504420 Val_Wu8 1.00000000000 DFES_EnvTabVerb 0.00 1.00000000000 FORMAT "%13.11" /end CHARACTERISTIC
/begin CHARACTERISTIC DFES_EnvRef.DFC_ComGwIMG4ChkSum_C "used environment signals / Reference to used environment condition set for check DFC_ComGwIMG4ChkSum" VALUE 0x80504421 Val_Wu8 1.00000000000 DFES_EnvTabVerb 0.00 1.00000000000 FORMAT "%13.11" /end CHARACTERISTIC
/begin CHARACTERISTIC DFES_EnvRef.DFC_ComGwIMG4RingCnt_C "used environment signals / Reference to used environment condition set for check DFC_ComGwIMG4RingCnt" VALUE 0x80504422 Val_Wu8 1.00000000000 DFES_EnvTabVerb 0.00 1.00000000000 FORMAT "%13.11" /end CHARACTERISTIC
/begin CHARACTERISTIC DFES_EnvRef.DFC_ComGwIMG4TOut_C "used environment signals / Reference to used environment condition set for check DFC_ComGwIMG4TOut" VALUE 0x80504423 Val_Wu8 1.00000000000 DFES_EnvTabVerb 0.00 1.00000000000 FORMAT "%13.11" /end CHARACTERISTIC
/begin CHARACTERISTIC DFES_EnvRef.DFC_ComGwIMG5ChkSum_C "used environment signals / Reference to used environment condition set for check DFC_ComGwIMG5ChkSum" VALUE 0x80504424 Val_Wu8 1.00000000000 DFES_EnvTabVerb 0.00 1.00000000000 FORMAT "%13.11" /end CHARACTERISTIC
/begin CHARACTERISTIC DFES_EnvRef.DFC_ComGwIMG5RingCnt_C "used environment signals / Reference to used environment condition set for check DFC_ComGwIMG5RingCnt" VALUE 0x80504425 Val_Wu8 1.00000000000 DFES_EnvTabVerb 0.00 1.00000000000 FORMAT "%13.11" /end CHARACTERISTIC
/begin CHARACTERISTIC DFES_EnvRef.DFC_ComGwIMG5TOut_C "used environment signals / Reference to used environment condition set for check DFC_ComGwIMG5TOut" VALUE 0x80504426 Val_Wu8 1.00000000000 DFES_EnvTabVerb 0.00 1.00000000000 FORMAT "%13.11" /end CHARACTERISTIC
/begin CHARACTERISTIC DFES_EnvRef.DFC_ComGwIMG6ChkSum_C "used environment signals / Reference to used environment condition set for check DFC_ComGwIMG6ChkSum" VALUE 0x80504427 Val_Wu8 1.00000000000 DFES_EnvTabVerb 0.00 1.00000000000 FORMAT "%13.11" /end CHARACTERISTIC
/begin CHARACTERISTIC DFES_EnvRef.DFC_ComGwIMG6RingCnt_C "used environment signals / Reference to used environment condition set for check DFC_ComGwIMG6RingCnt" VALUE 0x80504428 Val_Wu8 1.00000000000 DFES_EnvTabVerb 0.00 1.00000000000 FORMAT "%13.11" /end CHARACTERISTIC
/begin CHARACTERISTIC DFES_EnvRef.DFC_ComGwIMG6TOut_C "used environment signals / Reference to used environment condition set for check DFC_ComGwIMG6TOut" VALUE 0x80504429 Val_Wu8 1.00000000000 DFES_EnvTabVerb 0.00 1.00000000000 FORMAT "%13.11" /end CHARACTERISTIC
/begin CHARACTERISTIC DFES_EnvRef.DFC_ComIDASBChksum_C "used environment signals / Reference to used environment condition set for check DFC_ComIDASBChksum" VALUE 0x8050442A Val_Wu8 1.00000000000 DFES_EnvTabVerb 0.00 1.00000000000 FORMAT "%13.11" /end CHARACTERISTIC
/begin CHARACTERISTIC DFES_EnvRef.DFC_ComIDASBRingCnt_C "used environment signals / Reference to used environment condition set for check DFC_ComIDASBRingCnt" VALUE 0x8050442B Val_Wu8 1.00000000000 DFES_EnvTabVerb 0.00 1.00000000000 FORMAT "%13.11" /end CHARACTERISTIC
/begin CHARACTERISTIC DFES_EnvRef.DFC_ComIDASBTOut_C "used environment signals / Reference to used environment condition set for check DFC_ComIDASBTOut" VALUE 0x8050442C Val_Wu8 1.00000000000 DFES_EnvTabVerb 0.00 1.00000000000 FORMAT "%13.11" /end CHARACTERISTIC
/begin CHARACTERISTIC DFES_EnvRef.DFC_ComIMGMILReq_C "used environment signals / Reference to used environment condition set for check DFC_ComIMGMILReq" VALUE 0x8050442D Val_Wu8 1.00000000000 DFES_EnvTabVerb 0.00 1.00000000000 FORMAT "%13.11" /end CHARACTERISTIC
/begin CHARACTERISTIC DFES_EnvRef.DFC_ComISSPrms_C "used environment signals / Reference to used environment condition set for check DFC_ComISSPrms" VALUE 0x8050442E Val_Wu8 1.00000000000 DFES_EnvTabVerb 0.00 1.00000000000 FORMAT "%13.11" /end CHARACTERISTIC
/begin CHARACTERISTIC DFES_EnvRef.DFC_ComMETAChksum_C "used environment signals / Reference to used environment condition set for check DFC_ComMETAChksum" VALUE 0x8050442F Val_Wu8 1.00000000000 DFES_EnvTabVerb 0.00 1.00000000000 FORMAT "%13.11" /end CHARACTERISTIC
/begin CHARACTERISTIC DFES_EnvRef.DFC_ComMETAChksumPstDrv_C "used environment signals / Reference to used environment condition set for check DFC_ComMETAChksumPstDrv" VALUE 0x80504430 Val_Wu8 1.00000000000 DFES_EnvTabVerb 0.00 1.00000000000 FORMAT "%13.11" /end CHARACTERISTIC
/begin CHARACTERISTIC DFES_EnvRef.DFC_ComMETARingCnt_C "used environment signals / Reference to used environment condition set for check DFC_ComMETARingCnt" VALUE 0x80504431 Val_Wu8 1.00000000000 DFES_EnvTabVerb 0.00 1.00000000000 FORMAT "%13.11" /end CHARACTERISTIC
/begin CHARACTERISTIC DFES_EnvRef.DFC_ComMETARingCntPstDrv_C "used environment signals / Reference to used environment condition set for check DFC_ComMETARingCntPstDrv" VALUE 0x80504432 Val_Wu8 1.00000000000 DFES_EnvTabVerb 0.00 1.00000000000 FORMAT "%13.11" /end CHARACTERISTIC
/begin CHARACTERISTIC DFES_EnvRef.DFC_ComMETATOut_C "used environment signals / Reference to used environment condition set for check DFC_ComMETATOut" VALUE 0x80504433 Val_Wu8 1.00000000000 DFES_EnvTabVerb 0.00 1.00000000000 FORMAT "%13.11" /end CHARACTERISTIC
/begin CHARACTERISTIC DFES_EnvRef.DFC_ComMETATOutPstDrv_C "used environment signals / Reference to used environment condition set for check DFC_ComMETATOutPstDrv" VALUE 0x80504434 Val_Wu8 1.00000000000 DFES_EnvTabVerb 0.00 1.00000000000 FORMAT "%13.11" /end CHARACTERISTIC
/begin CHARACTERISTIC DFES_EnvRef.DFC_ComMETCChksum_C "used environment signals / Reference to used environment condition set for check DFC_ComMETCChksum" VALUE 0x80504435 Val_Wu8 1.00000000000 DFES_EnvTabVerb 0.00 1.00000000000 FORMAT "%13.11" /end CHARACTERISTIC
/begin CHARACTERISTIC DFES_EnvRef.DFC_ComMETCRingCnt_C "used environment signals / Reference to used environment condition set for check DFC_ComMETCRingCnt" VALUE 0x80504436 Val_Wu8 1.00000000000 DFES_EnvTabVerb 0.00 1.00000000000 FORMAT "%13.11" /end CHARACTERISTIC
/begin CHARACTERISTIC DFES_EnvRef.DFC_ComMETCTOut_C "used environment signals / Reference to used environment condition set for check DFC_ComMETCTOut" VALUE 0x80504437 Val_Wu8 1.00000000000 DFES_EnvTabVerb 0.00 1.00000000000 FORMAT "%13.11" /end CHARACTERISTIC
/begin CHARACTERISTIC DFES_EnvRef.DFC_ComMETDChksum_C "used environment signals / Reference to used environment condition set for check DFC_ComMETDChksum" VALUE 0x80504438 Val_Wu8 1.00000000000 DFES_EnvTabVerb 0.00 1.00000000000 FORMAT "%13.11" /end CHARACTERISTIC
/begin CHARACTERISTIC DFES_EnvRef.DFC_ComMETDRingCnt_C "used environment signals / Reference to used environment condition set for check DFC_ComMETDRingCnt" VALUE 0x80504439 Val_Wu8 1.00000000000 DFES_EnvTabVerb 0.00 1.00000000000 FORMAT "%13.11" /end CHARACTERISTIC
/begin CHARACTERISTIC DFES_EnvRef.DFC_ComMETDTOut_C "used environment signals / Reference to used environment condition set for check DFC_ComMETDTOut" VALUE 0x8050443A Val_Wu8 1.00000000000 DFES_EnvTabVerb 0.00 1.00000000000 FORMAT "%13.11" /end CHARACTERISTIC
/begin CHARACTERISTIC DFES_EnvRef.DFC_ComMETE2Chksum_C "used environment signals / Reference to used environment condition set for check DFC_ComMETE2Chksum" VALUE 0x8050443B Val_Wu8 1.00000000000 DFES_EnvTabVerb 0.00 1.00000000000 FORMAT "%13.11" /end CHARACTERISTIC
/begin CHARACTERISTIC DFES_EnvRef.DFC_ComMETE2RingCnt_C "used environment signals / Reference to used environment condition set for check DFC_ComMETE2RingCnt" VALUE 0x8050443C Val_Wu8 1.00000000000 DFES_EnvTabVerb 0.00 1.00000000000 FORMAT "%13.11" /end CHARACTERISTIC
/begin CHARACTERISTIC DFES_EnvRef.DFC_ComMETE2TOut_C "used environment signals / Reference to used environment condition set for check DFC_ComMETE2TOut" VALUE 0x8050443D Val_Wu8 1.00000000000 DFES_EnvTabVerb 0.00 1.00000000000 FORMAT "%13.11" /end CHARACTERISTIC
/begin CHARACTERISTIC DFES_EnvRef.DFC_ComMETFChksum_C "used environment signals / Reference to used environment condition set for check DFC_ComMETFChksum" VALUE 0x8050443E Val_Wu8 1.00000000000 DFES_EnvTabVerb 0.00 1.00000000000 FORMAT "%13.11" /end CHARACTERISTIC
/begin CHARACTERISTIC DFES_EnvRef.DFC_ComMETFRingCnt_C "used environment signals / Reference to used environment condition set for check DFC_ComMETFRingCnt" VALUE 0x8050443F Val_Wu8 1.00000000000 DFES_EnvTabVerb 0.00 1.00000000000 FORMAT "%13.11" /end CHARACTERISTIC
/begin CHARACTERISTIC DFES_EnvRef.DFC_ComMETFTOut_C "used environment signals / Reference to used environment condition set for check DFC_ComMETFTOut" VALUE 0x80504440 Val_Wu8 1.00000000000 DFES_EnvTabVerb 0.00 1.00000000000 FORMAT "%13.11" /end CHARACTERISTIC
/begin CHARACTERISTIC DFES_EnvRef.DFC_ComMETGChksum_C "used environment signals / Reference to used environment condition set for check DFC_ComMETGChksum" VALUE 0x80504441 Val_Wu8 1.00000000000 DFES_EnvTabVerb 0.00 1.00000000000 FORMAT "%13.11" /end CHARACTERISTIC
/begin CHARACTERISTIC DFES_EnvRef.DFC_ComMETGRingCnt_C "used environment signals / Reference to used environment condition set for check DFC_ComMETGRingCnt" VALUE 0x80504442 Val_Wu8 1.00000000000 DFES_EnvTabVerb 0.00 1.00000000000 FORMAT "%13.11" /end CHARACTERISTIC
/begin CHARACTERISTIC DFES_EnvRef.DFC_ComMETGTOut_C "used environment signals / Reference to used environment condition set for check DFC_ComMETGTOut" VALUE 0x80504443 Val_Wu8 1.00000000000 DFES_EnvTabVerb 0.00 1.00000000000 FORMAT "%13.11" /end CHARACTERISTIC
/begin CHARACTERISTIC DFES_EnvRef.DFC_ComMETH2Chksum_C "used environment signals / Reference to used environment condition set for check DFC_ComMETH2Chksum" VALUE 0x80504444 Val_Wu8 1.00000000000 DFES_EnvTabVerb 0.00 1.00000000000 FORMAT "%13.11" /end CHARACTERISTIC
/begin CHARACTERISTIC DFES_EnvRef.DFC_ComMETH2RingCnt_C "used environment signals / Reference to used environment condition set for check DFC_ComMETH2RingCnt" VALUE 0x80504445 Val_Wu8 1.00000000000 DFES_EnvTabVerb 0.00 1.00000000000 FORMAT "%13.11" /end CHARACTERISTIC
/begin CHARACTERISTIC DFES_EnvRef.DFC_ComMETH2TOut_C "used environment signals / Reference to used environment condition set for check DFC_ComMETH2TOut" VALUE 0x80504446 Val_Wu8 1.00000000000 DFES_EnvTabVerb 0.00 1.00000000000 FORMAT "%13.11" /end CHARACTERISTIC
/begin CHARACTERISTIC DFES_EnvRef.DFC_ComMETHChksum_C "used environment signals / Reference to used environment condition set for check DFC_ComMETHChksum" VALUE 0x80504447 Val_Wu8 1.00000000000 DFES_EnvTabVerb 0.00 1.00000000000 FORMAT "%13.11" /end CHARACTERISTIC
/begin CHARACTERISTIC DFES_EnvRef.DFC_ComMETHRingCnt_C "used environment signals / Reference to used environment condition set for check DFC_ComMETHRingCnt" VALUE 0x80504448 Val_Wu8 1.00000000000 DFES_EnvTabVerb 0.00 1.00000000000 FORMAT "%13.11" /end CHARACTERISTIC
/begin CHARACTERISTIC DFES_EnvRef.DFC_ComMETHTOut_C "used environment signals / Reference to used environment condition set for check DFC_ComMETHTOut" VALUE 0x80504449 Val_Wu8 1.00000000000 DFES_EnvTabVerb 0.00 1.00000000000 FORMAT "%13.11" /end CHARACTERISTIC
/begin CHARACTERISTIC DFES_EnvRef.DFC_ComMETIChksum_C "used environment signals / Reference to used environment condition set for check DFC_ComMETIChksum" VALUE 0x8050444A Val_Wu8 1.00000000000 DFES_EnvTabVerb 0.00 1.00000000000 FORMAT "%13.11" /end CHARACTERISTIC
/begin CHARACTERISTIC DFES_EnvRef.DFC_ComMETIRingCnt_C "used environment signals / Reference to used environment condition set for check DFC_ComMETIRingCnt" VALUE 0x8050444B Val_Wu8 1.00000000000 DFES_EnvTabVerb 0.00 1.00000000000 FORMAT "%13.11" /end CHARACTERISTIC
/begin CHARACTERISTIC DFES_EnvRef.DFC_ComMETITOut_C "used environment signals / Reference to used environment condition set for check DFC_ComMETITOut" VALUE 0x8050444C Val_Wu8 1.00000000000 DFES_EnvTabVerb 0.00 1.00000000000 FORMAT "%13.11" /end CHARACTERISTIC
/begin CHARACTERISTIC DFES_EnvRef.DFC_ComMETKChksum_C "used environment signals / Reference to used environment condition set for check DFC_ComMETKChksum" VALUE 0x8050444D Val_Wu8 1.00000000000 DFES_EnvTabVerb 0.00 1.00000000000 FORMAT "%13.11" /end CHARACTERISTIC
/begin CHARACTERISTIC DFES_EnvRef.DFC_ComMETKRingCnt_C "used environment signals / Reference to used environment condition set for check DFC_ComMETKRingCnt" VALUE 0x8050444E Val_Wu8 1.00000000000 DFES_EnvTabVerb 0.00 1.00000000000 FORMAT "%13.11" /end CHARACTERISTIC
/begin CHARACTERISTIC DFES_EnvRef.DFC_ComMETKTOut_C "used environment signals / Reference to used environment condition set for check DFC_ComMETKTOut" VALUE 0x8050444F Val_Wu8 1.00000000000 DFES_EnvTabVerb 0.00 1.00000000000 FORMAT "%13.11" /end CHARACTERISTIC
/begin CHARACTERISTIC DFES_EnvRef.DFC_ComMETLChksum_C "used environment signals / Reference to used environment condition set for check DFC_ComMETLChksum" VALUE 0x80504450 Val_Wu8 1.00000000000 DFES_EnvTabVerb 0.00 1.00000000000 FORMAT "%13.11" /end CHARACTERISTIC
/begin CHARACTERISTIC DFES_EnvRef.DFC_ComMETLRingCnt_C "used environment signals / Reference to used environment condition set for check DFC_ComMETLRingCnt" VALUE 0x80504451 Val_Wu8 1.00000000000 DFES_EnvTabVerb 0.00 1.00000000000 FORMAT "%13.11" /end CHARACTERISTIC
/begin CHARACTERISTIC DFES_EnvRef.DFC_ComMETLTOut_C "used environment signals / Reference to used environment condition set for check DFC_ComMETLTOut" VALUE 0x80504452 Val_Wu8 1.00000000000 DFES_EnvTabVerb 0.00 1.00000000000 FORMAT "%13.11" /end CHARACTERISTIC
/begin CHARACTERISTIC DFES_EnvRef.DFC_ComMETMChksum_C "used environment signals / Reference to used environment condition set for check DFC_ComMETMChksum" VALUE 0x80504453 Val_Wu8 1.00000000000 DFES_EnvTabVerb 0.00 1.00000000000 FORMAT "%13.11" /end CHARACTERISTIC
/begin CHARACTERISTIC DFES_EnvRef.DFC_ComMETMRingCnt_C "used environment signals / Reference to used environment condition set for check DFC_ComMETMRingCnt" VALUE 0x80504454 Val_Wu8 1.00000000000 DFES_EnvTabVerb 0.00 1.00000000000 FORMAT "%13.11" /end CHARACTERISTIC
/begin CHARACTERISTIC DFES_EnvRef.DFC_ComMETMTOut_C "used environment signals / Reference to used environment condition set for check DFC_ComMETMTOut" VALUE 0x80504455 Val_Wu8 1.00000000000 DFES_EnvTabVerb 0.00 1.00000000000 FORMAT "%13.11" /end CHARACTERISTIC
/begin CHARACTERISTIC DFES_EnvRef.DFC_ComMETNChksum_C "used environment signals / Reference to used environment condition set for check DFC_ComMETNChksum" VALUE 0x80504456 Val_Wu8 1.00000000000 DFES_EnvTabVerb 0.00 1.00000000000 FORMAT "%13.11" /end CHARACTERISTIC
/begin CHARACTERISTIC DFES_EnvRef.DFC_ComMETNRingCnt_C "used environment signals / Reference to used environment condition set for check DFC_ComMETNRingCnt" VALUE 0x80504457 Val_Wu8 1.00000000000 DFES_EnvTabVerb 0.00 1.00000000000 FORMAT "%13.11" /end CHARACTERISTIC
/begin CHARACTERISTIC DFES_EnvRef.DFC_ComMETNTOut_C "used environment signals / Reference to used environment condition set for check DFC_ComMETNTOut" VALUE 0x80504458 Val_Wu8 1.00000000000 DFES_EnvTabVerb 0.00 1.00000000000 FORMAT "%13.11" /end CHARACTERISTIC
/begin CHARACTERISTIC DFES_EnvRef.DFC_ComMtrCom_C "used environment signals / Reference to used environment condition set for check DFC_ComMtrCom" VALUE 0x80504459 Val_Wu8 1.00000000000 DFES_EnvTabVerb 0.00 1.00000000000 FORMAT "%13.11" /end CHARACTERISTIC
/begin CHARACTERISTIC DFES_EnvRef.DFC_ComPCUChkSum_C "used environment signals / Reference to used environment condition set for check DFC_ComPCUChkSum" VALUE 0x8050445A Val_Wu8 1.00000000000 DFES_EnvTabVerb 0.00 1.00000000000 FORMAT "%13.11" /end CHARACTERISTIC
/begin CHARACTERISTIC DFES_EnvRef.DFC_ComPCURingCnt_C "used environment signals / Reference to used environment condition set for check DFC_ComPCURingCnt" VALUE 0x8050445B Val_Wu8 1.00000000000 DFES_EnvTabVerb 0.00 1.00000000000 FORMAT "%13.11" /end CHARACTERISTIC
/begin CHARACTERISTIC DFES_EnvRef.DFC_ComPCUTOut_C "used environment signals / Reference to used environment condition set for check DFC_ComPCUTOut" VALUE 0x8050445C Val_Wu8 1.00000000000 DFES_EnvTabVerb 0.00 1.00000000000 FORMAT "%13.11" /end CHARACTERISTIC
/begin CHARACTERISTIC DFES_EnvRef.DFC_ComSRSAChksum_C "used environment signals / Reference to used environment condition set for check DFC_ComSRSAChksum" VALUE 0x8050445D Val_Wu8 1.00000000000 DFES_EnvTabVerb 0.00 1.00000000000 FORMAT "%13.11" /end CHARACTERISTIC
/begin CHARACTERISTIC DFES_EnvRef.DFC_ComSRSARingCnt_C "used environment signals / Reference to used environment condition set for check DFC_ComSRSARingCnt" VALUE 0x8050445E Val_Wu8 1.00000000000 DFES_EnvTabVerb 0.00 1.00000000000 FORMAT "%13.11" /end CHARACTERISTIC
/begin CHARACTERISTIC DFES_EnvRef.DFC_ComSRSATOut_C "used environment signals / Reference to used environment condition set for check DFC_ComSRSATOut" VALUE 0x8050445F Val_Wu8 1.00000000000 DFES_EnvTabVerb 0.00 1.00000000000 FORMAT "%13.11" /end CHARACTERISTIC
/begin CHARACTERISTIC DFES_EnvRef.DFC_ComSRSBChksum_C "used environment signals / Reference to used environment condition set for check DFC_ComSRSBChksum" VALUE 0x80504460 Val_Wu8 1.00000000000 DFES_EnvTabVerb 0.00 1.00000000000 FORMAT "%13.11" /end CHARACTERISTIC
/begin CHARACTERISTIC DFES_EnvRef.DFC_ComSRSBRingCnt_C "used environment signals / Reference to used environment condition set for check DFC_ComSRSBRingCnt" VALUE 0x80504461 Val_Wu8 1.00000000000 DFES_EnvTabVerb 0.00 1.00000000000 FORMAT "%13.11" /end CHARACTERISTIC
/begin CHARACTERISTIC DFES_EnvRef.DFC_ComSRSBTOut_C "used environment signals / Reference to used environment condition set for check DFC_ComSRSBTOut" VALUE 0x80504462 Val_Wu8 1.00000000000 DFES_EnvTabVerb 0.00 1.00000000000 FORMAT "%13.11" /end CHARACTERISTIC
/begin CHARACTERISTIC DFES_EnvRef.DFC_ComSRSChksum_C "used environment signals / Reference to used environment condition set for check DFC_ComSRSChksum" VALUE 0x80504463 Val_Wu8 1.00000000000 DFES_EnvTabVerb 0.00 1.00000000000 FORMAT "%13.11" /end CHARACTERISTIC
/begin CHARACTERISTIC DFES_EnvRef.DFC_ComSRSErr_C "used environment signals / Reference to used environment condition set for check DFC_ComSRSErr" VALUE 0x80504464 Val_Wu8 1.00000000000 DFES_EnvTabVerb 0.00 1.00000000000 FORMAT "%13.11" /end CHARACTERISTIC
/begin CHARACTERISTIC DFES_EnvRef.DFC_ComSRSRingCnt_C "used environment signals / Reference to used environment condition set for check DFC_ComSRSRingCnt" VALUE 0x80504465 Val_Wu8 1.00000000000 DFES_EnvTabVerb 0.00 1.00000000000 FORMAT "%13.11" /end CHARACTERISTIC
/begin CHARACTERISTIC DFES_EnvRef.DFC_ComSRSTOut_C "used environment signals / Reference to used environment condition set for check DFC_ComSRSTOut" VALUE 0x80504466 Val_Wu8 1.00000000000 DFES_EnvTabVerb 0.00 1.00000000000 FORMAT "%13.11" /end CHARACTERISTIC
/begin CHARACTERISTIC DFES_EnvRef.DFC_ComVehSpdPndFltTCU_C "used environment signals / Reference to used environment condition set for check DFC_ComVehSpdPndFltTCU" VALUE 0x80504467 Val_Wu8 1.00000000000 DFES_EnvTabVerb 0.00 1.00000000000 FORMAT "%13.11" /end CHARACTERISTIC
/begin FUNCTION DFES "30000.73.0_2.0.0Diagnostic Fault Event Storage"
 /begin DEF_CHARACTERISTIC DFES_DTCO.DFC_ETHSFsig_C DFES_DTCO.DFC_ETHSNPWmax_C DFES_DTCO.DFC_ETHSNPWmin_C DFES_DTCO.DFC_ETHSNPWsig_C DFES_DTCO.DFC_ETHSPLnpl_C DFES_DTCO.DFC_ETHSTPLnpl_C DFES_DTCO.DFC_EngICO_C DFES_DTCO.DFC_EngPrtOvrSpdMon_C DFES_DTCO.DFC_EpmCaSI1ErrSig_C DFES_DTCO.DFC_EpmCaSI1MntErr_C DFES_DTCO.DFC_EpmCaSI1NoSigMax_C DFES_DTCO.DFC_EpmCaSI1NoSigMin_C DFES_DTCO.DFC_EpmCaSI1OfsErr_C DFES_DTCO.DFC_EpmCrSDGI_C DFES_DTCO.DFC_EpmCrSErrSig_C DFES_DTCO.DFC_EpmCrSNoSig_C DFES_DTCO.DFC_EtaEngIdleNonCsers_C DFES_DTCO.DFC_EtaEngPtlNonCsers_C DFES_DTCO.DFC_FRAmax_C DFES_DTCO.DFC_FRAmin_C DFES_DTCO.DFC_FSTEmax_C DFES_DTCO.DFC_FSTEmin_C DFES_DTCO.DFC_FSTRmax_C DFES_DTCO.DFC_FSTRmin_C DFES_DTCO.DFC_FSTRnpl_C DFES_DTCO.DFC_FSTmax_C DFES_DTCO.DFC_FTDLAmax_C DFES_DTCO.DFC_FTDLAmin_C DFES_DTCO.DFC_FuPHiSnsrEleclmax_C DFES_DTCO.DFC_FuPHiSnsrEleclmin_C DFES_DTCO.DFC_FuPHiSnsrEleclnpl_C DFES_DTCO.DFC_FuPHiSnsrURngMax_C DFES_DTCO.DFC_FuPHiSnsrURngMin_C DFES_DTCO.DFC_FuSnsrPhyRngMaxErr_C DFES_DTCO.DFC_FuSnsrPhyRngMinErr_C DFES_DTCO.DFC_GEVlvLockPinDiagIntkB1_C DFES_DTCO.DFC_GEVlvPhaSlowIntkB1_C DFES_DTCO.DFC_GEVlvPhaTargIntkB1_C DFES_DTCO.DFC_GbxRvsSwtStk_C DFES_DTCO.DFC_HDRKHmax_C DFES_DTCO.DFC_HDRKHmin_C DFES_DTCO.DFC_HDRPLmax_C DFES_DTCO.DFC_HDRPLmin_C DFES_DTCO.DFC_HDRmax_C DFES_DTCO.DFC_HDRmin_C DFES_DTCO.DFC_HEGOS2B1ElecMax_C DFES_DTCO.DFC_HEGOS2B1ElecMin_C DFES_DTCO.DFC_HEGOS2B1ElecSig_C DFES_DTCO.DFC_HEGOS2B1HtgNpl_C DFES_DTCO.DFC_HEV00max_C DFES_DTCO.DFC_HEV01max_C DFES_DTCO.DFC_HEV02max_C DFES_DTCO.DFC_HEV03max_C DFES_DTCO.DFC_HEVE0max_C DFES_DTCO.DFC_HEVE1max_C DFES_DTCO.DFC_HFMmax_C DFES_DTCO.DFC_HiPSysHiPMaxLimExcdd_C DFES_DTCO.DFC_IVGdiCtlCvoErrMax_0_C DFES_DTCO.DFC_IVGdiCtlCvoErrMax_1_C DFES_DTCO.DFC_IVGdiCtlCvoErrMax_2_C DFES_DTCO.DFC_IVGdiCtlCvoErrMax_3_C DFES_DTCO.DFC_IVGdiCtlCvoErrMin_0_C DFES_DTCO.DFC_IVGdiCtlCvoErrMin_1_C DFES_DTCO.DFC_IVGdiCtlCvoErrMin_2_C DFES_DTCO.DFC_IVGdiCtlCvoErrMin_3_C DFES_DTCO.DFC_IVGdiCtlCvoErrMinMax_C DFES_DTCO.DFC_IVGdiCtlCvoSigPlausErrSmrCdn_C DFES_DTCO.DFC_IVGdiCtl_CvoErr_C DFES_DTCO.DFC_IVGdiCtl_CvoSigPlaus_0_C DFES_DTCO.DFC_IVGdiCtl_CvoSigPlaus_1_C DFES_DTCO.DFC_IVGdiCtl_CvoSigPlaus_2_C DFES_DTCO.DFC_IVGdiCtl_CvoSigPlaus_3_C DFES_DTCO.DFC_IntkAirTAirFltDsCrssMax_C DFES_DTCO.DFC_IntkAirTAirFltDsCrssMin_C DFES_DTCO.DFC_IntkAirTAirFltDsHSCMax_C DFES_DTCO.DFC_IntkAirTAirFltDsImps_C DFES_DTCO.DFC_IntkAirTAirFltDsPRCMax_C DFES_DTCO.DFC_IntkAirTAirFltDsPRCMin_C DFES_DTCO.DFC_IntkAirTAirFltDsSRCMax_C DFES_DTCO.DFC_IntkAirTAirFltDsSRCMin_C DFES_DTCO.DFC_IntkAirTAirFltDsSTC_C DFES_DTCO.DFC_IntkAirTIntkMnfldCrssMax_C DFES_DTCO.DFC_IntkAirTIntkMnfldCrssMin_C DFES_DTCO.DFC_IntkAirTIntkMnfldHSCMax_C DFES_DTCO.DFC_IntkAirTIntkMnfldImps_C DFES_DTCO.DFC_IntkAirTIntkMnfldPRCMax_C DFES_DTCO.DFC_IntkAirTIntkMnfldPRCMin_C DFES_DTCO.DFC_IntkAirTIntkMnfldSRCMax_C DFES_DTCO.DFC_IntkAirTIntkMnfldSRCMin_C DFES_DTCO.DFC_IntkAirTIntkMnfldSTC_C DFES_DTCO.DFC_KRREGRLMX_C DFES_DTCO.DFC_KRVEKOCVLCI_C DFES_DTCO.DFC_KRVEKOENCHMT_C DFES_DTCO.DFC_KRVEKOENCHMT0_C DFES_DTCO.DFC_KRVEKOENCHMT1_C DFES_DTCO.DFC_KRVEKOENCHMT2_C DFES_DTCO.DFC_KRVEKOENCHMT3_C DFES_DTCO.DFC_KRVEKOENCHMT4_C DFES_DTCO.DFC_KRVEKOENCHMT5_C DFES_DTCO.DFC_KRVEKOENCHMT6_C DFES_DTCO.DFC_KRVEKOENCHMT7_C DFES_DTCO.DFC_KRVEKORLMX_C DFES_DTCO.DFC_KRVEKORLMXL_C DFES_DTCO.DFC_KS1max_C DFES_DTCO.DFC_KS1min_C DFES_DTCO.DFC_LMmax_C DFES_DTCO.DFC_LZSRnpl_C DFES_DTCO.DFC_LamDynDiagS1B1_C DFES_DTCO.DFC_LeakIntkMnfldEmiInfl_C DFES_DTCO.DFC_LinFrameErrDCDC_C DFES_DTCO.DFC_LinOverrunErrDCDC_C DFES_DTCO.DFC_MD00max_C DFES_DTCO.DFC_MDBmax_C DFES_DTCO.DFC_MDCat_C DFES_DTCO.DFC_MDCatCrit_C DFES_DTCO.DFC_MDCatCurr_C DFES_DTCO.DFC_MDCyl_0_C DFES_DTCO.DFC_MDCyl_1_C DFES_DTCO.DFC_MDCyl_2_C DFES_DTCO.DFC_MDCyl_3_C DFES_DTCO.DFC_MDEmi_C DFES_DTCO.DFC_MDEmiStrt_C DFES_DTCO.DFC_MDFco_C DFES_DTCO.DFC_MDMpl_C DFES_DTCO.DFC_MDSegTiAdpn_C DFES_DTCO.DFC_MDmax_C DFES_DTCO.DFC_MFuOilMax_C DFES_DTCO.DFC_MOXEMM_SMU_ALM0_0_C DFES_DTCO.DFC_MOXEMM_SMU_ALM0_1_C DFES_DTCO.DFC_MOXEMM_SMU_ALM0_10_C DFES_DTCO.DFC_MOXEMM_SMU_ALM0_11_C DFES_DTCO.DFC_MOXEMM_SMU_ALM0_13_C DFES_DTCO.DFC_MOXEMM_SMU_ALM0_14_C DFES_DTCO.DFC_MOXEMM_SMU_ALM0_2_C DFES_DTCO.DFC_MOXEMM_SMU_ALM0_22_C DFES_DTCO.DFC_MOXEMM_SMU_ALM0_23_C DFES_DTCO.DFC_MOXEMM_SMU_ALM0_4_C DFES_DTCO.DFC_MOXEMM_SMU_ALM0_5_C DFES_DTCO.DFC_MOXEMM_SMU_ALM0_7_C DFES_DTCO.DFC_MOXEMM_SMU_ALM0_8_C DFES_DTCO.DFC_MOXEMM_SMU_ALM10_16_C DFES_DTCO.DFC_MOXEMM_SMU_ALM10_17_C DFES_DTCO.DFC_MOXEMM_SMU_ALM10_21_C DFES_DTCO.DFC_MOXEMM_SMU_ALM11_0_C DFES_DTCO.DFC_MOXEMM_SMU_ALM11_1_C DFES_DTCO.DFC_MOXEMM_SMU_ALM11_2_C DFES_DTCO.DFC_MOXEMM_SMU_ALM11_3_C DFES_DTCO.DFC_MOXEMM_SMU_ALM11_4_C DFES_DTCO.DFC_MOXEMM_SMU_ALM11_5_C DFES_DTCO.DFC_MOXEMM_SMU_ALM11_8_C DFES_DTCO.DFC_MOXEMM_SMU_ALM11_9_C DFES_DTCO.DFC_MOXEMM_SMU_ALM1_0_C DFES_DTCO.DFC_MOXEMM_SMU_ALM1_1_C DFES_DTCO.DFC_MOXEMM_SMU_ALM1_10_C DFES_DTCO.DFC_MOXEMM_SMU_ALM1_11_C DFES_DTCO.DFC_MOXEMM_SMU_ALM1_13_C DFES_DTCO.DFC_MOXEMM_SMU_ALM1_14_C DFES_DTCO.DFC_MOXEMM_SMU_ALM1_2_C DFES_DTCO.DFC_MOXEMM_SMU_ALM1_22_C DFES_DTCO.DFC_MOXEMM_SMU_ALM1_23_C DFES_DTCO.DFC_MOXEMM_SMU_ALM1_4_C DFES_DTCO.DFC_MOXEMM_SMU_ALM1_5_C DFES_DTCO.DFC_MOXEMM_SMU_ALM1_7_C DFES_DTCO.DFC_MOXEMM_SMU_ALM1_8_C DFES_DTCO.DFC_MOXEMM_SMU_ALM21_0_C DFES_DTCO.DFC_MOXEMM_SMU_ALM21_16_C DFES_DTCO.DFC_MOXEMM_SMU_ALM21_3_C DFES_DTCO.DFC_MOXEMM_SMU_ALM2_1_C DFES_DTCO.DFC_MOXEMM_SMU_ALM2_10_C DFES_DTCO.DFC_MOXEMM_SMU_ALM2_11_C DFES_DTCO.DFC_MOXEMM_SMU_ALM2_13_C DFES_DTCO.DFC_MOXEMM_SMU_ALM2_14_C DFES_DTCO.DFC_MOXEMM_SMU_ALM2_22_C DFES_DTCO.DFC_MOXEMM_SMU_ALM2_23_C DFES_DTCO.DFC_MOXEMM_SMU_ALM2_4_C DFES_DTCO.DFC_MOXEMM_SMU_ALM2_5_C DFES_DTCO.DFC_MOXEMM_SMU_ALM2_7_C DFES_DTCO.DFC_MOXEMM_SMU_ALM2_8_C DFES_DTCO.DFC_MOXEMM_SMU_ALM6_0_C DFES_DTCO.DFC_MOXEMM_SMU_ALM6_11_C DFES_DTCO.DFC_MOXEMM_SMU_ALM6_12_C DFES_DTCO.DFC_MOXEMM_SMU_ALM6_14_C DFES_DTCO.DFC_MOXEMM_SMU_ALM6_15_C DFES_DTCO.DFC_MOXEMM_SMU_ALM6_17_C DFES_DTCO.DFC_MOXEMM_SMU_ALM6_18_C DFES_DTCO.DFC_MOXEMM_SMU_ALM6_20_C DFES_DTCO.DFC_MOXEMM_SMU_ALM6_21_C DFES_DTCO.DFC_MOXEMM_SMU_ALM6_25_C DFES_DTCO.DFC_MOXEMM_SMU_ALM6_4_C DFES_DTCO.DFC_MOXEMM_SMU_ALM6_5_C DFES_DTCO.DFC_MOXEMM_SMU_ALM6_7_C DFES_DTCO.DFC_MOXEMM_SMU_ALM6_8_C DFES_DTCO.DFC_MOXEMM_SMU_ALM7_1_C DFES_DTCO.DFC_MOXEMM_SMU_ALM7_12_C DFES_DTCO.DFC_MOXEMM_SMU_ALM7_13_C DFES_DTCO.DFC_MOXEMM_SMU_ALM7_14_C DFES_DTCO.DFC_MOXEMM_SMU_ALM7_15_C DFES_DTCO.DFC_MOXEMM_SMU_ALM7_16_C DFES_DTCO.DFC_MOXEMM_SMU_ALM7_17_C DFES_DTCO.DFC_MOXEMM_SMU_ALM7_2_C DFES_DTCO.DFC_MOXEMM_SMU_ALM7_20_C DFES_DTCO.DFC_MOXEMM_SMU_ALM7_25_C DFES_DTCO.DFC_MOXEMM_SMU_ALM7_26_C DFES_DTCO.DFC_MOXEMM_SMU_ALM7_28_C DFES_DTCO.DFC_MOXEMM_SMU_ALM7_29_C DFES_DTCO.DFC_MOXEMM_SMU_ALM7_30_C DFES_DTCO.DFC_MOXEMM_SMU_ALM7_31_C DFES_DTCO.DFC_MOXEMM_SMU_ALM8_0_C DFES_DTCO.DFC_MOXEMM_SMU_ALM8_1_C DFES_DTCO.DFC_MOXEMM_SMU_ALM8_10_C DFES_DTCO.DFC_MOXEMM_SMU_ALM8_11_C DFES_DTCO.DFC_MOXEMM_SMU_ALM8_12_C DFES_DTCO.DFC_MOXEMM_SMU_ALM8_16_C DFES_DTCO.DFC_MOXEMM_SMU_ALM8_18_C DFES_DTCO.DFC_MOXEMM_SMU_ALM8_2_C DFES_DTCO.DFC_MOXEMM_SMU_ALM8_3_C DFES_DTCO.DFC_MOXEMM_SMU_ALM8_31_C DFES_DTCO.DFC_MOXEMM_SMU_ALM8_4_C DFES_DTCO.DFC_MOXEMM_SMU_ALM9_0_C DFES_DTCO.DFC_MOXEMM_SMU_ALM9_15_C DFES_DTCO.DFC_MOXEMM_SMU_ALM9_3_C DFES_DTCO.DFC_MoCADCNTP_C DFES_DTCO.DFC_MoCADCTst_C DFES_DTCO.DFC_MoCSOPICO_C DFES_DTCO.DFC_MoFAPP_C DFES_DTCO.DFC_MoFAirFilgPrdc_C DFES_DTCO.DFC_MoFAirFlCtOffGdi_C DFES_DTCO.DFC_MoFAirFlCylGdi_C DFES_DTCO.DFC_MoFAirFlFF_C DFES_DTCO.DFC_MoFAirFlIn_C DFES_DTCO.DFC_MoFAirFlMixCtlGdiChkAirFl_C DFES_DTCO.DFC_MoFAirFlMixCtlGdiChkCtrl_C DFES_DTCO.DFC_MoFAirFlMode_C DFES_DTCO.DFC_MoFESpd_C DFES_DTCO.DFC_MoFIACo_C DFES_DTCO.DFC_MoFICOL1_C DFES_DTCO.DFC_MoFICOL2_C DFES_DTCO.DFC_MoFStrt_C DFES_DTCO.DFC_MoFTrqCmp_C DFES_DTCO.DFC_MoFTrqCmpMax_C DFES_DTCO.DFC_MoFTrqCmpMin_C DFES_DTCO.DFC_MoFVarPostBldSel_C DFES_DTCO.DFC_MoXEMMHwLTMCUFW_C DFES_DTCO.DFC_MoXEMMHwLTMonBIST_C DFES_DTCO.DFC_MoXEMMHwLTRegMonTest_C DFES_DTCO.DFC_MoXEMMHwLTStbySMUAlvTest_C DFES_DTCO.DFC_MoXEMMHwLTTempSens_C DFES_DTCO.DFC_MoXEMMHwLTUCBCfg_C DFES_DTCO.DFC_NWSEmax_C DFES_DTCO.DFC_NWSmax_C DFES_DTCO.DFC_OCWDAABEActv_C DFES_DTCO.DFC_OCWDACom_C DFES_DTCO.DFC_OCWDAErrPin_C DFES_DTCO.DFC_OCWDAOvrVltg_C DFES_DTCO.DFC_ORAmax_C DFES_DTCO.DFC_ORAmin_C DFES_DTCO.DFC_OilPPlaus_C DFES_DTCO.DFC_PLLSUmax_C DFES_DTCO.DFC_PLLSUmin_C DFES_DTCO.DFC_PSR1max_C DFES_DTCO.DFC_PSRBmax_C DFES_DTCO.DFC_PSRBmin_C DFES_DTCO.DFC_PSRPmax_C DFES_DTCO.DFC_PSRPmin_C DFES_DTCO.DFC_PSRPsig_C DFES_DTCO.DFC_PSRmax_C DFES_DTCO.DFC_PUmax_C DFES_DTCO.DFC_P_VSE11_OL_C DFES_DTCO.DFC_P_VSE11_SCB_C DFES_DTCO.DFC_P_VSE11_SCG_C DFES_DTCO.DFC_PhyHighAPP1_C DFES_DTCO.DFC_PhyHighAPP2_C DFES_DTCO.DFC_PhyLowAPP1_C DFES_DTCO.DFC_PhyLowAPP2_C DFES_DTCO.DFC_SRCHighAPP1_C DFES_DTCO.DFC_SRCHighAPP2_C DFES_DTCO.DFC_SRCLowAPP1_C DFES_DTCO.DFC_SRCLowAPP2_C DFES_DTCO.DFC_SSpMon2_C DFES_DTCO.DFC_STHDRmax_C DFES_DTCO.DFC_SWReset_0_C DFES_DTCO.DFC_SWReset_1_C DFES_DTCO.DFC_SWReset_2_C DFES_DTCO.DFC_SyncAPP_C DFES_DTCO.DFC_TANKLnpl_C DFES_DTCO.DFC_TAmax_Dummy_C DFES_DTCO.DFC_TESFmax_C DFES_DTCO.DFC_TESGmax_C DFES_DTCO.DFC_TKAEmax_C DFES_DTCO.DFC_TKAEmin_C DFES_DTCO.DFC_TKARmax_C DFES_DTCO.DFC_TKARnpl_C DFES_DTCO.DFC_TMmax_Dummy_C DFES_DTCO.DFC_TUMmax_Dummy_C DFES_DTCO.DFC_TWCDPriCatB1_C DFES_DTCO.DFC_ThrVlvClsdPosnFirstOffsLrnImpoB1_C DFES_DTCO.DFC_ThrVlvClsdPosnOffsLrnImpoB1_C DFES_DTCO.DFC_ThrVlvClsdPosnOffsLrnMaxB1_C DFES_DTCO.DFC_ThrVlvClsdPosnOffsLrnMinB1_C DFES_DTCO.DFC_ThrVlvCtrlDeB1_C DFES_DTCO.DFC_ThrVlvDycB1_C DFES_DTCO.DFC_ThrVlvLimpAirPosnMaxAbsltDriftB1_C DFES_DTCO.DFC_ThrVlvLimpAirPosnMaxB1_C DFES_DTCO.DFC_ThrVlvLimpAirPosnMaxRelDriftB1_C DFES_DTCO.DFC_ThrVlvLimpAirPosnMinB1_C DFES_DTCO.DFC_ThrVlvOpenLoadB1_C DFES_DTCO.DFC_ThrVlvOpenSprgB1_C DFES_DTCO.DFC_ThrVlvOpenSprgSprdB1_C DFES_DTCO.DFC_ThrVlvOpenSprgTwnB1_C DFES_DTCO.DFC_ThrVlvOverTB1_C DFES_DTCO.DFC_ThrVlvRetSprgB1_C DFES_DTCO.DFC_ThrVlvRetSprgSprdB1_C DFES_DTCO.DFC_ThrVlvRetSprgTwnB1_C DFES_DTCO.DFC_ThrVlvSens1MaxB1_C DFES_DTCO.DFC_ThrVlvSens1NplB1_C DFES_DTCO.DFC_ThrVlvSens2MaxB1_C DFES_DTCO.DFC_ThrVlvSens2MinB1_C DFES_DTCO.DFC_ThrVlvSens2NplB1_C DFES_DTCO.DFC_ThrVlvShoCircB1_C DFES_DTCO.DFC_ThrVlvSpiErrB1_C DFES_DTCO.DFC_ThrvlvSens1MinB1_C DFES_DTCO.DFC_TiOffTBasdChkFast_C DFES_DTCO.DFC_TiOffTBasdChkSlow_C DFES_DTCO.DFC_UEGOSnsrMntdS1B1_C DFES_DTCO.DFC_VehVSig_C DFES_DTCO.DFC_VlvLftFbSwtIntk11SpclFail_C DFES_DTCO.DFC_VlvLftFbSwtIntk11StdFail_C DFES_Env.xSet1_CA DFES_Env.xSet2_CA DFES_EnvRef.DFC_Unused_C DFES_EnvRef.DFC_AAVEmax_C DFES_EnvRef.DFC_AAVEmin_C DFES_EnvRef.DFC_AAVEsig_C DFES_EnvRef.DFC_AltIOACGFailr_C DFES_EnvRef.DFC_AltIOACGHiVltg_C DFES_EnvRef.DFC_AltIOACGLoVltg_C DFES_EnvRef.DFC_AltIOACGTHi_C DFES_EnvRef.DFC_AltIODConnACG_C DFES_EnvRef.DFC_BGOELWAF_C DFES_EnvRef.DFC_BattUHiFailr_C DFES_EnvRef.DFC_BattULoFailr_C DFES_EnvRef.DFC_BrkBstPDriftHiErr_C DFES_EnvRef.DFC_BrkBstPDriftLoErr_C DFES_EnvRef.DFC_BrkBstPSnsrStuck_C DFES_EnvRef.DFC_BrkMnSwtContOn_C DFES_EnvRef.DFC_BrkMnSwtNotStp_C DFES_EnvRef.DFC_BrkNpl_C DFES_EnvRef.DFC_BrkRdntSwtContOn_C DFES_EnvRef.DFC_BrkRdntSwtNotStp_C DFES_EnvRef.DFC_Clth3ONStuck_C DFES_EnvRef.DFC_Clth4OFFStuck_C DFES_EnvRef.DFC_ClthOFFStuck_C DFES_EnvRef.DFC_ClthONStuck_C DFES_EnvRef.DFC_ClthStkFailInfo_C DFES_EnvRef.DFC_ComACFailInfo_C DFES_EnvRef.DFC_ComATFTValErr_C DFES_EnvRef.DFC_ComATMILReq_C DFES_EnvRef.DFC_ComAYCAChksum_C DFES_EnvRef.DFC_ComAYCARingCnt_C DFES_EnvRef.DFC_ComAYCATOut_C DFES_EnvRef.DFC_ComAYCDChkSum_C DFES_EnvRef.DFC_ComAYCDTOut_C DFES_EnvRef.DFC_ComAYCFChksum_C DFES_EnvRef.DFC_ComAYCFRingCnt_C DFES_EnvRef.DFC_ComAYCFTOut_C DFES_EnvRef.DFC_ComAYCGChksum_C DFES_EnvRef.DFC_ComAYCGRingCnt_C DFES_EnvRef.DFC_ComAYCGTOut_C DFES_EnvRef.DFC_ComAYCIChkSum_C DFES_EnvRef.DFC_ComAYCIRingCnt_C DFES_EnvRef.DFC_ComAYCITOut_C DFES_EnvRef.DFC_ComBCM1ChkSum_C DFES_EnvRef.DFC_ComBCM1RingCnt_C DFES_EnvRef.DFC_ComBCM1TOut_C DFES_EnvRef.DFC_ComCANABusOffErr_C DFES_EnvRef.DFC_ComCANBBusOffErr_C DFES_EnvRef.DFC_ComCANCBusOffErr_C DFES_EnvRef.DFC_ComCGW1ChkSum_C DFES_EnvRef.DFC_ComCGW1RingCnt_C DFES_EnvRef.DFC_ComCGW1TOut_C DFES_EnvRef.DFC_ComConvBoostErr_C DFES_EnvRef.DFC_ComConvSlipErr_C DFES_EnvRef.DFC_ComDCDCPrfmncErr_C DFES_EnvRef.DFC_ComDCDCTempWarn_C DFES_EnvRef.DFC_ComEAT10Chksum_C DFES_EnvRef.DFC_ComEAT10RingCnt_C DFES_EnvRef.DFC_ComEAT10TOut_C DFES_EnvRef.DFC_ComEAT11ChkSum_C DFES_EnvRef.DFC_ComEAT11RingCnt_C DFES_EnvRef.DFC_ComEAT11TOut_C DFES_EnvRef.DFC_ComEAT12ChkSum_C DFES_EnvRef.DFC_ComEAT12RingCnt_C DFES_EnvRef.DFC_ComEAT12TOut_C DFES_EnvRef.DFC_ComEAT13ChkSum_C DFES_EnvRef.DFC_ComEAT13RingCnt_C DFES_EnvRef.DFC_ComEAT13TOut_C DFES_EnvRef.DFC_ComEAT1Chksum_C DFES_EnvRef.DFC_ComEAT1RingCnt_C DFES_EnvRef.DFC_ComEAT1TOut_C DFES_EnvRef.DFC_ComEAT2ChkSum_C DFES_EnvRef.DFC_ComEAT2RingCnt_C DFES_EnvRef.DFC_ComEAT2TOut_C DFES_EnvRef.DFC_ComEAT4ChkSum_C DFES_EnvRef.DFC_ComEAT4RingCnt_C DFES_EnvRef.DFC_ComEAT4TOut_C DFES_EnvRef.DFC_ComEAT6Chksum_C DFES_EnvRef.DFC_ComEAT6RingCnt_C DFES_EnvRef.DFC_ComEAT6TOut_C DFES_EnvRef.DFC_ComEAT7Chksum_C DFES_EnvRef.DFC_ComEAT7RingCnt_C DFES_EnvRef.DFC_ComEAT7TOut_C DFES_EnvRef.DFC_ComEAT8Chksum_C DFES_EnvRef.DFC_ComEAT8RingCnt_C DFES_EnvRef.DFC_ComEAT8TOut_C DFES_EnvRef.DFC_ComEATAChksum_C DFES_EnvRef.DFC_ComEATARingCnt_C DFES_EnvRef.DFC_ComEATATOut_C DFES_EnvRef.DFC_ComEATBChkSum_C DFES_EnvRef.DFC_ComEATBRingCnt_C DFES_EnvRef.DFC_ComEATBTOut_C DFES_EnvRef.DFC_ComEATCChksum_C DFES_EnvRef.DFC_ComEATCRingCnt_C DFES_EnvRef.DFC_ComEATCTOut_C DFES_EnvRef.DFC_ComEPBBChkSum_C DFES_EnvRef.DFC_ComEPBBRingCnt_C DFES_EnvRef.DFC_ComEPBBTOut_C DFES_EnvRef.DFC_ComEPBChksum_C DFES_EnvRef.DFC_ComEPBTOut_C DFES_EnvRef.DFC_ComEPBctRing_C DFES_EnvRef.DFC_ComEPS1Chksum_C DFES_EnvRef.DFC_ComEPS1RingCnt_C DFES_EnvRef.DFC_ComEPS1TOut_C DFES_EnvRef.DFC_ComEngCanRxErr_C DFES_EnvRef.DFC_ComGrvySnsrErr_C DFES_EnvRef.DFC_ComGwIMG1ChkSum_C DFES_EnvRef.DFC_ComGwIMG1RingCnt_C DFES_EnvRef.DFC_ComGwIMG1TOut_C DFES_EnvRef.DFC_ComGwIMG3ChkSum_C DFES_EnvRef.DFC_ComGwIMG3RingCnt_C DFES_EnvRef.DFC_ComGwIMG3TOut_C DFES_EnvRef.DFC_ComGwIMG4ChkSum_C DFES_EnvRef.DFC_ComGwIMG4RingCnt_C DFES_EnvRef.DFC_ComGwIMG4TOut_C DFES_EnvRef.DFC_ComGwIMG5ChkSum_C DFES_EnvRef.DFC_ComGwIMG5RingCnt_C DFES_EnvRef.DFC_ComGwIMG5TOut_C DFES_EnvRef.DFC_ComGwIMG6ChkSum_C DFES_EnvRef.DFC_ComGwIMG6RingCnt_C DFES_EnvRef.DFC_ComGwIMG6TOut_C DFES_EnvRef.DFC_ComIDASBChksum_C DFES_EnvRef.DFC_ComIDASBRingCnt_C DFES_EnvRef.DFC_ComIDASBTOut_C DFES_EnvRef.DFC_ComIMGMILReq_C DFES_EnvRef.DFC_ComISSPrms_C DFES_EnvRef.DFC_ComMETAChksum_C DFES_EnvRef.DFC_ComMETAChksumPstDrv_C DFES_EnvRef.DFC_ComMETARingCnt_C DFES_EnvRef.DFC_ComMETARingCntPstDrv_C DFES_EnvRef.DFC_ComMETATOut_C DFES_EnvRef.DFC_ComMETATOutPstDrv_C DFES_EnvRef.DFC_ComMETCChksum_C DFES_EnvRef.DFC_ComMETCRingCnt_C DFES_EnvRef.DFC_ComMETCTOut_C DFES_EnvRef.DFC_ComMETDChksum_C DFES_EnvRef.DFC_ComMETDRingCnt_C DFES_EnvRef.DFC_ComMETDTOut_C DFES_EnvRef.DFC_ComMETE2Chksum_C DFES_EnvRef.DFC_ComMETE2RingCnt_C DFES_EnvRef.DFC_ComMETE2TOut_C DFES_EnvRef.DFC_ComMETFChksum_C DFES_EnvRef.DFC_ComMETFRingCnt_C DFES_EnvRef.DFC_ComMETFTOut_C DFES_EnvRef.DFC_ComMETGChksum_C DFES_EnvRef.DFC_ComMETGRingCnt_C DFES_EnvRef.DFC_ComMETGTOut_C DFES_EnvRef.DFC_ComMETH2Chksum_C DFES_EnvRef.DFC_ComMETH2RingCnt_C DFES_EnvRef.DFC_ComMETH2TOut_C DFES_EnvRef.DFC_ComMETHChksum_C DFES_EnvRef.DFC_ComMETHRingCnt_C DFES_EnvRef.DFC_ComMETHTOut_C DFES_EnvRef.DFC_ComMETIChksum_C DFES_EnvRef.DFC_ComMETIRingCnt_C DFES_EnvRef.DFC_ComMETITOut_C DFES_EnvRef.DFC_ComMETKChksum_C DFES_EnvRef.DFC_ComMETKRingCnt_C DFES_EnvRef.DFC_ComMETKTOut_C DFES_EnvRef.DFC_ComMETLChksum_C DFES_EnvRef.DFC_ComMETLRingCnt_C DFES_EnvRef.DFC_ComMETLTOut_C DFES_EnvRef.DFC_ComMETMChksum_C DFES_EnvRef.DFC_ComMETMRingCnt_C DFES_EnvRef.DFC_ComMETMTOut_C DFES_EnvRef.DFC_ComMETNChksum_C DFES_EnvRef.DFC_ComMETNRingCnt_C DFES_EnvRef.DFC_ComMETNTOut_C DFES_EnvRef.DFC_ComMtrCom_C DFES_EnvRef.DFC_ComPCUChkSum_C DFES_EnvRef.DFC_ComPCURingCnt_C DFES_EnvRef.DFC_ComPCUTOut_C DFES_EnvRef.DFC_ComSRSAChksum_C DFES_EnvRef.DFC_ComSRSARingCnt_C DFES_EnvRef.DFC_ComSRSATOut_C DFES_EnvRef.DFC_ComSRSBChksum_C DFES_EnvRef.DFC_ComSRSBRingCnt_C DFES_EnvRef.DFC_ComSRSBTOut_C DFES_EnvRef.DFC_ComSRSChksum_C DFES_EnvRef.DFC_ComSRSErr_C DFES_EnvRef.DFC_ComSRSRingCnt_C DFES_EnvRef.DFC_ComSRSTOut_C DFES_EnvRef.DFC_ComVehSpdPndFltTCU_C /end DEF_CHARACTERISTIC
 FUNCTION_VERSION "30000.73.0_2.0.0" /end FUNCTION
/begin COMPU_METHOD DFES_EnvTabVerb "" TAB_VERB "%6.3" "-" COMPU_TAB_REF DFES_EnvTabVerb /end COMPU_METHOD
/begin COMPU_VTAB DFES_EnvTabVerb "" TAB_VERB 2 0 "xSet1" 1 "xSet2" DEFAULT_VALUE "---" /end COMPU_VTAB
/begin COMPU_METHOD DFES_OneToOne "" RAT_FUNC "%6.2" "-" COEFFS 0 1 0 0 0 1 /end COMPU_METHOD
/begin COMPU_METHOD Signals_IntSigNumVerb "" TAB_VERB "%6.3" "" COMPU_TAB_REF Signals_IntSigNumVerb /end COMPU_METHOD
/begin COMPU_VTAB Signals_IntSigNumVerb "" TAB_VERB 1169 0 "SIGNALS_Signals_Default" 1 "SIGNALS_APP_rUnFlt" 2 "SIGNALS_APP_r_sig" 3 "SIGNALS_APP_r_signal" 4 "SIGNALS_APP_uRaw1_signal" 5 "SIGNALS_APP_uRaw2_signal" 6 "SIGNALS_AbsLdCom8Bit_PID43h" 7 "SIGNALS_AccPed_tqMapBasd_BENG_signal" 8 "SIGNALS_AccPed_tqMapBasd_TRQB_signal" 9 "SIGNALS_ActMod_trqInr_signal" 10 "SIGNALS_AirC_uAnaRawClnt_signal" 11 "SIGNALS_Alt_iExctLim_signal" 12 "SIGNALS_Alt_rAltExct_signal" 13 "SIGNALS_Alt_uFinalDes_signal" 14 "SIGNALS_BattU_u" 15 "SIGNALS_BattU_uSens1_signal" 16 "SIGNALS_BattU_uSens2_s" 17 "SIGNALS_BattU_uSens_signal" 18 "SIGNALS_Batt_lMaxCnsChk_signal" 19 "SIGNALS_Batt_lMinCnsChk_signal" 20 "SIGNALS_Batt_qCnsChkAH_signal" 21 "SIGNALS_Brk_st" 22 "SIGNALS_Brk_stRed" 23 "SIGNALS_CEngDsT_uRaw_s" 24 "SIGNALS_CEngDsT_uRaw_signal" 25 "SIGNALS_CEngUsT_t_signal" 26 "SIGNALS_CEngUsT_uSnsr_s" 27 "SIGNALS_CoEng_tiCranking_signal" 28 "SIGNALS_CoVeh_trqAcs_s" 29 "SIGNALS_ComEBS_BattID_signal" 30 "SIGNALS_ComEBS_rBattSensCh_signal" 31 "SIGNALS_ComEBS_rBattStrat_signal" 32 "SIGNALS_ComEBS_uBattSens_signal" 33 "SIGNALS_ComEBS_uBattUCO_signal" 34 "SIGNALS_Com_iBattEBS_signal" 35 "SIGNALS_Com_lDst_signal" 36 "SIGNALS_Com_rMeasdBattREbs_signal" 37 "SIGNALS_Com_stI_signal" 38 "SIGNALS_Com_stT_signal" 39 "SIGNALS_Com_stU_signal" 40 "SIGNALS_Com_tBattEBS_signal" 41 "SIGNALS_Com_trqAYCFDes_signal" 42 "SIGNALS_Com_uPeak_signal" 43 "SIGNALS_CrCtl_stShutOffCode0_signal" 44 "SIGNALS_CrCtl_stShutOffCode1_signal" 45 "SIGNALS_CrCtl_stShutOffCode2_signal" 46 "SIGNALS_CrCtl_stShutOffCode3_signal" 47 "SIGNALS_CrCtl_stShutOffCode4_signal" 48 "SIGNALS_CrCtl_stShutOffCode5_signal" 49 "SIGNALS_CrCtl_stShutOffCode6_signal" 50 "SIGNALS_CrCtl_stShutOffCode7_signal" 51 "SIGNALS_CrCtl_stShutOffCode8_signal" 52 "SIGNALS_CrCtl_stShutOffCode9_signal" 53 "SIGNALS_DIUMPR_ctGenDenom_signal" 54 "SIGNALS_DIUMPR_ctIgn_signal" 55 "SIGNALS_DRIVE_numDTCFrz_s" 56 "SIGNALS_DRIVE_stCurTrgMode_signal" 57 "SIGNALS_DRIVE_stHardToStrt_s" 58 "SIGNALS_DSM_tiMICumCont" 59 "SIGNALS_DcmDspUDS_rdbi_2612Byte10_signal" 60 "SIGNALS_DcmDspUDS_rdbi_2612Byte11_signal" 61 "SIGNALS_DcmDspUDS_rdbi_fixed_signal" 62 "SIGNALS_DcmDspUDS_rdbi_reserved0_signal_s" 63 "SIGNALS_DcmDspUDS_rdbi_reserved0_signal_w_s" 64 "SIGNALS_DcmDspUDS_rdbi_reserved1_signal" 65 "SIGNALS_Dspl_stCrsSwtInfo_signal" 66 "SIGNALS_Ebs_qBliChrg_signal" 67 "SIGNALS_Ebs_qBliDchaTotDcyc_0_signal" 68 "SIGNALS_Ebs_qBliDchaTotDcyc_1_signal" 69 "SIGNALS_Ebs_qBliDchaTotDcyc_2_signal" 70 "SIGNALS_Ebs_qBliDchaTotDcyc_3_signal" 71 "SIGNALS_Ebs_qBliDchaTotDcyc_4_signal" 72 "SIGNALS_Ebs_qBliDcha_signal" 73 "SIGNALS_Ebs_stStbIEBSByt0_0_signal" 74 "SIGNALS_Ebs_stStbIEBSByt0_1_signal" 75 "SIGNALS_Ebs_stStbIEBSByt0_2_signal" 76 "SIGNALS_Ebs_stStbIEBSByt0_3_signal" 77 "SIGNALS_Ebs_stStbIEBSByt0_4_signal" 78 "SIGNALS_Ebs_stStbIEBSByt1_0_signal" 79 "SIGNALS_Ebs_stStbIEBSByt1_1_signal" 80 "SIGNALS_Ebs_stStbIEBSByt1_2_signal" 81 "SIGNALS_Ebs_stStbIEBSByt1_3_signal" 82 "SIGNALS_Ebs_stStbIEBSByt1_4_signal" 83 "SIGNALS_Ebs_stStbIEBSByt2_0_signal" 84 "SIGNALS_Ebs_stStbIEBSByt2_1_signal" 85 "SIGNALS_Ebs_stStbIEBSByt2_2_signal" 86 "SIGNALS_Ebs_stStbIEBSByt2_3_signal" 87 "SIGNALS_Ebs_stStbIEBSByt2_4_signal" 88 "SIGNALS_Ebs_stStbIEBSByt3_0_signal" 89 "SIGNALS_Ebs_stStbIEBSByt3_1_signal" 90 "SIGNALS_Ebs_stStbIEBSByt3_2_signal" 91 "SIGNALS_Ebs_stStbIEBSByt3_3_signal" 92 "SIGNALS_Ebs_stStbIEBSByt3_4_signal" 93 "SIGNALS_Ebs_stStbIEBSByt4_0_signal" 94 "SIGNALS_Ebs_stStbIEBSByt4_1_signal" 95 "SIGNALS_Ebs_stStbIEBSByt4_2_signal" 96 "SIGNALS_Ebs_stStbIEBSByt4_3_signal" 97 "SIGNALS_Ebs_stStbIEBSByt4_4_signal" 98 "SIGNALS_EngTrqPtd_trqLead_s" 99 "SIGNALS_EngTrqPtd_trqLead_signal" 100 "SIGNALS_EngTrqPtd_trqSet_s" 101 "SIGNALS_EngTrqPtd_trqSet_signal" 102 "SIGNALS_EpmCaS_ctErrSig_signal" 103 "SIGNALS_EpmCaS_ctNoSig_signal" 104 "SIGNALS_EpmCaS_phiDiffCal2AdapEqAvg_0" 105 "SIGNALS_EpmCaS_phiOfsCorr" 106 "SIGNALS_Epm_nEngAct" 107 "SIGNALS_Epm_nEngRaw_s" 108 "SIGNALS_Epm_nEngRaw_signal" 109 "SIGNALS_Epm_stOpMode" 110 "SIGNALS_Epm_stSync" 111 "SIGNALS_FuPHi_uHiResl_signal" 112 "SIGNALS_GEVlv_ratPhaIntkB1_signal" 113 "SIGNALS_GlbDa_lenTotDstDcycHiResl_signal" 114 "SIGNALS_HEGO_uS2B1Extd_s" 115 "SIGNALS_HEGO_uS2B1HiRes_signal" 116 "SIGNALS_I14229CoEng_tiNormalOBDPrevDcyc_s" 117 "SIGNALS_I14229EpmCaS_ctErrSig1_signal" 118 "SIGNALS_I14229EpmCaS_ctNoSig1_signal" 119 "SIGNALS_I14229GlbDa_lTotDstDCHiReslPrevDcyc_s" 120 "SIGNALS_I14229IntkAirT_tSnsrTstrMax_s" 121 "SIGNALS_I14229IntkAirT_tSnsrTstrMin_s" 122 "SIGNALS_I14229RDBI_nOvrSpd_signal" 123 "SIGNALS_I14229RDBI_tiOvrSpd_signal" 124 "SIGNALS_I14229_AirC_pAnaClnt_signal" 125 "SIGNALS_I14229_ElecLd_iEPSLoadOnly_signal" 126 "SIGNALS_I14229_EpmCaS_ctErrSig2_signal" 127 "SIGNALS_I14229_EpmCaS_ctNoSig2_signal" 128 "SIGNALS_I14229_EpmCrS_ctCaSRev_signal" 129 "SIGNALS_I14229_EpmCrS_ctErrSig_signal" 130 "SIGNALS_I14229_GEVCtl_agMaxAdpdIntk_signal" 131 "SIGNALS_I14229_Gbx_uAna1NPosRaw_signal" 132 "SIGNALS_I14229_Gbx_uAna2NPosRaw_signal" 133 "SIGNALS_I14229_ivzabg_w_signal" 134 "SIGNALS_I14229_lDst_signal" 135 "SIGNALS_I14229_nstat_signal" 136 "SIGNALS_I14229_numDTCFrzFrmHi_signal" 137 "SIGNALS_I14229_numDTCFrzFrmLo_signal" 138 "SIGNALS_I14229_numDTCFrzFrmMid_signal" 139 "SIGNALS_I14229_ps_w_signal" 140 "SIGNALS_I14229_rTrqPT_signal" 141 "SIGNALS_I14229_stTURBODV_signal" 142 "SIGNALS_I14229_tSnsrFild1_signal" 143 "SIGNALS_I14229_tiInj1On_signal" 144 "SIGNALS_I14229_tiOilFlowCompl_signal" 145 "SIGNALS_I14229_tiSia_signal" 146 "SIGNALS_I14229_tkaMax_s" 147 "SIGNALS_I14229_tkaMin_s" 148 "SIGNALS_I14229_tka_signal" 149 "SIGNALS_I14229_tmotMaxCurrDcyc_s" 150 "SIGNALS_I14229_tmotMaxPrevDcyc_s" 151 "SIGNALS_I14229_tmotMinCurrDcyc_s" 152 "SIGNALS_I14229_tmotMinPrevDcyc_s" 153 "SIGNALS_I14229_ubsq_signal" 154 "SIGNALS_I14229_umsrln_w_signal" 155 "SIGNALS_I14229_wdks_w_signal" 156 "SIGNALS_I14229_wped1_signal" 157 "SIGNALS_I14229_wped2_signal" 158 "SIGNALS_I14229_zwist_signal" 159 "SIGNALS_I14229iocpMDA_numABV_signal" 160 "SIGNALS_I14229iocpMDA_numACGC_signal" 161 "SIGNALS_I14229iocpMDA_numAPS_signal" 162 "SIGNALS_I14229iocpMDA_numPSC_signal" 163 "SIGNALS_I14229iocpMDA_numRFAN_signal" 164 "SIGNALS_I14229iocpMDA_numRvsLck_signal" 165 "SIGNALS_I14229iocpMDA_numVTEC_signal" 166 "SIGNALS_I14229iocp_numCtlSt_s" 167 "SIGNALS_I14229iocp_numEXE_signal" 168 "SIGNALS_I14229iocp_numREQ_s" 169 "SIGNALS_I14229iocp_stSFTRJC_s" 170 "SIGNALS_I15031_PID1Dh" 171 "SIGNALS_I15031_PID65Ah" 172 "SIGNALS_I15031_PID66Ah" 173 "SIGNALS_I15031_PID69Ah" 174 "SIGNALS_I15031_PID6AAh" 175 "SIGNALS_I15031_PID6BAh" 176 "SIGNALS_I15031_PID6CAh" 177 "SIGNALS_I15031_PID6DAh" 178 "SIGNALS_I15031_PID6EAh" 179 "SIGNALS_I15031_PID6FAh" 180 "SIGNALS_I15031_PID70Ah" 181 "SIGNALS_I15031_PID71Ah" 182 "SIGNALS_I15031_PID72Ah" 183 "SIGNALS_I15031_PID73Ah" 184 "SIGNALS_I15031_PID74Ah" 185 "SIGNALS_I15031_PID75Ah" 186 "SIGNALS_I15031_PID76Ah" 187 "SIGNALS_I15031_PID77Ah" 188 "SIGNALS_I15031_PID78Ah" 189 "SIGNALS_I15031_PID79Ah" 190 "SIGNALS_I15031_PID7AAh" 191 "SIGNALS_I15031_PID7BAh" 192 "SIGNALS_I15031_PID7CAh" 193 "SIGNALS_I15031_PID7FAh" 194 "SIGNALS_I15031_PID81Ah" 195 "SIGNALS_I15031_PID82Ah" 196 "SIGNALS_I15031_PID85Ah" 197 "SIGNALS_I15031_PID86Ah" 198 "SIGNALS_I15031_PID87Ah" 199 "SIGNALS_I15031_PID89Ah" 200 "SIGNALS_I15031_PID8AAh" 201 "SIGNALS_I15031_PID8FAh" 202 "SIGNALS_I15031_PID92Ah" 203 "SIGNALS_I15031_PID93Ah" 204 "SIGNALS_I15031_PID94Ah" 205 "SIGNALS_I15031_PID98Ah" 206 "SIGNALS_I15031_PID99Ah" 207 "SIGNALS_I15031_PID9CAh" 208 "SIGNALS_I15031_PIDA3Ah" 209 "SIGNALS_I15031_PIDA4Ah" 210 "SIGNALS_I15031_PIDA5Ah" 211 "SIGNALS_I15031_PIDA9Ah" 212 "SIGNALS_I15031_PIDACAh" 213 "SIGNALS_IKCtl_agKnkAvrg_s8_signal" 214 "SIGNALS_InjSys_volFuConsDrvCycCAN_s" 215 "SIGNALS_IntkAirT_tSnsr2_signal" 216 "SIGNALS_IntkAirT_uSnsr1Exprt_signal" 217 "SIGNALS_IntkAirT_uSnsr3CrssSwtLoc_s" 218 "SIGNALS_MoF_rTrqInrAct_s" 219 "SIGNALS_MoF_rTrqPtdFlt_s" 220 "SIGNALS_OBD_ITID_InjSys_volFuConsDrvgCycTstrSrv" 221 "SIGNALS_OilSwmpT_uSnsrRaw_s" 222 "SIGNALS_Oil_pSensPSwmp_signal" 223 "SIGNALS_Oil_uRawPSwmp_signal" 224 "SIGNALS_PID01h" 225 "SIGNALS_PID03h_0" 226 "SIGNALS_PID03h_1" 227 "SIGNALS_PID04h" 228 "SIGNALS_PID05h" 229 "SIGNALS_PID06h_0" 230 "SIGNALS_PID07h_0" 231 "SIGNALS_PID0Ch_Epm_nEng" 232 "SIGNALS_PID0D_VehV_vSens" 233 "SIGNALS_PID0Eh" 234 "SIGNALS_PID0Fh" 235 "SIGNALS_PID0bh_PIntkVUs_pRawObd" 236 "SIGNALS_PID10h" 237 "SIGNALS_PID11h_ThrVlv_ratActSens1AbsltB1_u8" 238 "SIGNALS_PID13h" 239 "SIGNALS_PID15h_0" 240 "SIGNALS_PID15h_1" 241 "SIGNALS_PID1Ch" 242 "SIGNALS_PID1Fh_TiScneEngStrt" 243 "SIGNALS_PID21h" 244 "SIGNALS_PID23h" 245 "SIGNALS_PID2Ch_EGRVlv_rCmdNrm" 246 "SIGNALS_PID2Dh_EGRVlv_rGovDvtNrm" 247 "SIGNALS_PID2Eh" 248 "SIGNALS_PID2Fh" 249 "SIGNALS_PID30h" 250 "SIGNALS_PID31h" 251 "SIGNALS_PID33h_PEnv_pRaw" 252 "SIGNALS_PID34h_0" 253 "SIGNALS_PID34h_1" 254 "SIGNALS_PID3Ch" 255 "SIGNALS_PID41h" 256 "SIGNALS_PID42_BattU_uSens" 257 "SIGNALS_PID43h" 258 "SIGNALS_PID44h" 259 "SIGNALS_PID45h_ThrVlv_ratActSens1RelB1_u8" 260 "SIGNALS_PID46h" 261 "SIGNALS_PID47h_ThrVlv_ratActSens2AbsltB1_u8" 262 "SIGNALS_PID49_APP_uRaw1unLim" 263 "SIGNALS_PID4A_APP_uRaw2unLim" 264 "SIGNALS_PID4Ch_wdks_msg" 265 "SIGNALS_PID4FAh" 266 "SIGNALS_PID4FBh" 267 "SIGNALS_PID4FCh" 268 "SIGNALS_PID4FDh" 269 "SIGNALS_PID50Ah" 270 "SIGNALS_PID50Bh" 271 "SIGNALS_PID50Ch" 272 "SIGNALS_PID50Dh" 273 "SIGNALS_PID51h_PID51_stFuTyp" 274 "SIGNALS_PID52h" 275 "SIGNALS_PID56h_0" 276 "SIGNALS_PID5A_APP_rOBDPID5A" 277 "SIGNALS_PID5Eh_InjSys_volEngFuCnsPerHr" 278 "SIGNALS_PID5Fh" 279 "SIGNALS_PID62h_TME_ratActEngPercTqPrmIdH62" 280 "SIGNALS_IntFloat_PID63h_TqEngRef" 281 "SIGNALS_PID67h_ects2sva_msg" 282 "SIGNALS_PID67h_ects2svb_msg" 283 "SIGNALS_PID67h_ects2svc_msg" 284 "SIGNALS_PID68h_iats2sva" 285 "SIGNALS_PID68h_iats2svb" 286 "SIGNALS_PID68h_iats2svc" 287 "SIGNALS_PID68h_iats2svd" 288 "SIGNALS_PID68h_iats2sve" 289 "SIGNALS_PID68h_iats2svf" 290 "SIGNALS_PID68h_iats2svg" 291 "SIGNALS_PID69h_EGRVlv_rActNrm" 292 "SIGNALS_PID69h_EGRVlv_rCmdNrm" 293 "SIGNALS_PID69h_EGRVlv_rGovDvtNrm" 294 "SIGNALS_PID7Fh_RTId_TotRt" 295 "SIGNALS_PID7Fh_RtId_TotIdleRt" 296 "SIGNALS_PID7Fh_RtId_TotPtoRt" 297 "SIGNALS_PID87h_PIntkVUs_pRawObd" 298 "SIGNALS_PID8BAh" 299 "SIGNALS_PID8CAh" 300 "SIGNALS_PID8Eh_TME_ratEngFricPercTqPrmIdH8E" 301 "SIGNALS_PID93BCh" 302 "SIGNALS_PID9AAh" 303 "SIGNALS_PID9Dh_InjSys_mfEngFuRate" 304 "SIGNALS_PID9Dh_InjSys_mfVehFuRate" 305 "SIGNALS_PID9FAh" 306 "SIGNALS_PIDA6h_lTotDst" 307 "SIGNALS_PID_FILLSIG_1BIT" 308 "SIGNALS_PID_FILLSIG_1BITNZ" 309 "SIGNALS_PID_FILLSIG_1BYTE" 310 "SIGNALS_PID_FILLSIG_1BYTENZ" 311 "SIGNALS_PID_FILLSIG_2BIT" 312 "SIGNALS_PID_FILLSIG_2BITNZ" 313 "SIGNALS_PID_FILLSIG_2BYTE" 314 "SIGNALS_PID_FILLSIG_2BYTENZ" 315 "SIGNALS_PID_FILLSIG_3BIT" 316 "SIGNALS_PID_FILLSIG_3BITNZ" 317 "SIGNALS_PID_FILLSIG_4BIT" 318 "SIGNALS_PID_FILLSIG_4BITNZ" 319 "SIGNALS_PID_FILLSIG_4BYTE" 320 "SIGNALS_PID_FILLSIG_4BYTENZ" 321 "SIGNALS_PID_FILLSIG_5BIT" 322 "SIGNALS_PID_FILLSIG_5BITNZ" 323 "SIGNALS_PID_FILLSIG_6BIT" 324 "SIGNALS_PID_FILLSIG_6BITNZ" 325 "SIGNALS_PID_FILLSIG_7BIT" 326 "SIGNALS_PID_FILLSIG_7BITNZ" 327 "SIGNALS_PIntkVUs_uRawUnFlt_signal" 328 "SIGNALS_PT_rGrip_signal" 329 "SIGNALS_PT_trqLos_signal" 330 "SIGNALS_PThrVlvUs_uRawB1_signal" 331 "SIGNALS_PthLead_trqInrNoMon_s" 332 "SIGNALS_PthLead_trqInrNoMon_signal" 333 "SIGNALS_PthSet_trqInrIABef_s" 334 "SIGNALS_PthSet_trqInrLtd_s" 335 "SIGNALS_RngMod_trqDiffAdap_signal" 336 "SIGNALS_RngMod_trqDiffAdap_signal_s" 337 "SIGNALS_RngMod_trqInrBs_s" 338 "SIGNALS_SIGNAL_GEVlv_agSumSpCsersDeIntkB1" 339 "SIGNALS_Strt_uStrtMonDia_signal" 340 "SIGNALS_TWCD_numMeasB1_s" 341 "SIGNALS_TWCD_rOSCAvrgPriB1_s" 342 "SIGNALS_TWCD_rOSCAvrgPriB1_signal" 343 "SIGNALS_ThrVlv_uRawSens1B1_signal" 344 "SIGNALS_ThrVlv_uRawSens2B1_signal" 345 "SIGNALS_TiEngOff_ti_s" 346 "SIGNALS_VehStc_lDstCityEco_signal" 347 "SIGNALS_VehStc_lDstCity_signal" 348 "SIGNALS_VehStc_lDstHighWayEco_signal" 349 "SIGNALS_VehStc_lDstHighWay_signal" 350 "SIGNALS_VehStc_numFuDiagRecA_0_s" 351 "SIGNALS_VehStc_numFuDiagRecA_10_s" 352 "SIGNALS_VehStc_numFuDiagRecA_11_s" 353 "SIGNALS_VehStc_numFuDiagRecA_12_s" 354 "SIGNALS_VehStc_numFuDiagRecA_13_s" 355 "SIGNALS_VehStc_numFuDiagRecA_14_s" 356 "SIGNALS_VehStc_numFuDiagRecA_15_s" 357 "SIGNALS_VehStc_numFuDiagRecA_16_s" 358 "SIGNALS_VehStc_numFuDiagRecA_17_s" 359 "SIGNALS_VehStc_numFuDiagRecA_18_s" 360 "SIGNALS_VehStc_numFuDiagRecA_19_s" 361 "SIGNALS_VehStc_numFuDiagRecA_1_s" 362 "SIGNALS_VehStc_numFuDiagRecA_20_s" 363 "SIGNALS_VehStc_numFuDiagRecA_2_s" 364 "SIGNALS_VehStc_numFuDiagRecA_3_s" 365 "SIGNALS_VehStc_numFuDiagRecA_4_s" 366 "SIGNALS_VehStc_numFuDiagRecA_5_s" 367 "SIGNALS_VehStc_numFuDiagRecA_6_s" 368 "SIGNALS_VehStc_numFuDiagRecA_7_s" 369 "SIGNALS_VehStc_numFuDiagRecA_8_s" 370 "SIGNALS_VehStc_numFuDiagRecA_9_s" 371 "SIGNALS_VehStc_numMisfDetnHiEctA_0_s" 372 "SIGNALS_VehStc_numMisfDetnHiEctA_10_s" 373 "SIGNALS_VehStc_numMisfDetnHiEctA_11_s" 374 "SIGNALS_VehStc_numMisfDetnHiEctA_12_s" 375 "SIGNALS_VehStc_numMisfDetnHiEctA_13_s" 376 "SIGNALS_VehStc_numMisfDetnHiEctA_14_s" 377 "SIGNALS_VehStc_numMisfDetnHiEctA_15_s" 378 "SIGNALS_VehStc_numMisfDetnHiEctA_16_s" 379 "SIGNALS_VehStc_numMisfDetnHiEctA_17_s" 380 "SIGNALS_VehStc_numMisfDetnHiEctA_18_s" 381 "SIGNALS_VehStc_numMisfDetnHiEctA_19_s" 382 "SIGNALS_VehStc_numMisfDetnHiEctA_1_s" 383 "SIGNALS_VehStc_numMisfDetnHiEctA_20_s" 384 "SIGNALS_VehStc_numMisfDetnHiEctA_2_s" 385 "SIGNALS_VehStc_numMisfDetnHiEctA_3_s" 386 "SIGNALS_VehStc_numMisfDetnHiEctA_4_s" 387 "SIGNALS_VehStc_numMisfDetnHiEctA_5_s" 388 "SIGNALS_VehStc_numMisfDetnHiEctA_6_s" 389 "SIGNALS_VehStc_numMisfDetnHiEctA_7_s" 390 "SIGNALS_VehStc_numMisfDetnHiEctA_8_s" 391 "SIGNALS_VehStc_numMisfDetnHiEctA_9_s" 392 "SIGNALS_VehStc_numMisfDetnLoEctA_0_s" 393 "SIGNALS_VehStc_numMisfDetnLoEctA_10_s" 394 "SIGNALS_VehStc_numMisfDetnLoEctA_11_s" 395 "SIGNALS_VehStc_numMisfDetnLoEctA_12_s" 396 "SIGNALS_VehStc_numMisfDetnLoEctA_13_s" 397 "SIGNALS_VehStc_numMisfDetnLoEctA_14_s" 398 "SIGNALS_VehStc_numMisfDetnLoEctA_15_s" 399 "SIGNALS_VehStc_numMisfDetnLoEctA_16_s" 400 "SIGNALS_VehStc_numMisfDetnLoEctA_17_s" 401 "SIGNALS_VehStc_numMisfDetnLoEctA_18_s" 402 "SIGNALS_VehStc_numMisfDetnLoEctA_19_s" 403 "SIGNALS_VehStc_numMisfDetnLoEctA_1_s" 404 "SIGNALS_VehStc_numMisfDetnLoEctA_20_s" 405 "SIGNALS_VehStc_numMisfDetnLoEctA_2_s" 406 "SIGNALS_VehStc_numMisfDetnLoEctA_3_s" 407 "SIGNALS_VehStc_numMisfDetnLoEctA_4_s" 408 "SIGNALS_VehStc_numMisfDetnLoEctA_5_s" 409 "SIGNALS_VehStc_numMisfDetnLoEctA_6_s" 410 "SIGNALS_VehStc_numMisfDetnLoEctA_7_s" 411 "SIGNALS_VehStc_numMisfDetnLoEctA_8_s" 412 "SIGNALS_VehStc_numMisfDetnLoEctA_9_s" 413 "SIGNALS_VehStc_numMisfDetnNormA_0_s" 414 "SIGNALS_VehStc_numMisfDetnNormA_10_s" 415 "SIGNALS_VehStc_numMisfDetnNormA_11_s" 416 "SIGNALS_VehStc_numMisfDetnNormA_12_s" 417 "SIGNALS_VehStc_numMisfDetnNormA_13_s" 418 "SIGNALS_VehStc_numMisfDetnNormA_14_s" 419 "SIGNALS_VehStc_numMisfDetnNormA_15_s" 420 "SIGNALS_VehStc_numMisfDetnNormA_16_s" 421 "SIGNALS_VehStc_numMisfDetnNormA_17_s" 422 "SIGNALS_VehStc_numMisfDetnNormA_18_s" 423 "SIGNALS_VehStc_numMisfDetnNormA_19_s" 424 "SIGNALS_VehStc_numMisfDetnNormA_1_s" 425 "SIGNALS_VehStc_numMisfDetnNormA_20_s" 426 "SIGNALS_VehStc_numMisfDetnNormA_2_s" 427 "SIGNALS_VehStc_numMisfDetnNormA_3_s" 428 "SIGNALS_VehStc_numMisfDetnNormA_4_s" 429 "SIGNALS_VehStc_numMisfDetnNormA_5_s" 430 "SIGNALS_VehStc_numMisfDetnNormA_6_s" 431 "SIGNALS_VehStc_numMisfDetnNormA_7_s" 432 "SIGNALS_VehStc_numMisfDetnNormA_8_s" 433 "SIGNALS_VehStc_numMisfDetnNormA_9_s" 434 "SIGNALS_VehStc_rDiagRsltB1A_0_s" 435 "SIGNALS_VehStc_rDiagRsltB1A_1_s" 436 "SIGNALS_VehStc_rDiagRsltB1A_2_s" 437 "SIGNALS_VehStc_rDiagRsltB1A_3_s" 438 "SIGNALS_VehStc_rDiagRsltB1A_4_s" 439 "SIGNALS_VehStc_tiRtCityEco_signal" 440 "SIGNALS_VehStc_tiRtCity_signal" 441 "SIGNALS_VehStc_tiRtHighWayEco_signal" 442 "SIGNALS_VehStc_tiRtHighWay_signal" 443 "SIGNALS_VehStc_tiRtStop_signal" 444 "SIGNALS_VehStc_volCnsCityDcyc_signal" 445 "SIGNALS_VehStc_volCnsCityEcoDcyc_signal" 446 "SIGNALS_VehStc_volCnsHighWayDcyc_signal" 447 "SIGNALS_VehStc_volCnsHighWayEcoDcyc_signal" 448 "SIGNALS_VehStc_volCnsStopDcyc_signal" 449 "SIGNALS_VehV_a" 450 "SIGNALS_VehV_v" 451 "SIGNALS_VehV_vSens_signal" 452 "SIGNALS_fra_w_msg_signal" 453 "SIGNALS_fra_w_s" 454 "SIGNALS_ftead_w_msg_s" 455 "SIGNALS_ftead_w_si" 456 "SIGNALS_ftead_w_signal" 457 "SIGNALS_i14229_agIntkB1GEVlv_2Byte_signal" 458 "SIGNALS_i14229_agIntkB1GEVlv_signal" 459 "SIGNALS_i14229_agSpIntkB1GevCtl_2Byte_signal" 460 "SIGNALS_i14229_agSpIntkB1GevCtl_signal" 461 "SIGNALS_lutskzyl_w_0_signal" 462 "SIGNALS_lutskzyl_w_1_signal" 463 "SIGNALS_lutskzyl_w_2_signal" 464 "SIGNALS_lutskzyl_w_3_signal" 465 "SIGNALS_lutskzyl_w_msg_0_signal" 466 "SIGNALS_mshfmst_w_signal" 467 "SIGNALS_ofmsndkh1_w_msg_signal" 468 "SIGNALS_ofmsndkh2_w_msg_signal" 469 "SIGNALS_prsoll_w_msg_s" 470 "SIGNALS_tateout_w_signal" 471 "SIGNALS_tatesoll_w_msg_signal" 472 "SIGNALS_thdev_msg_signal" 473 "SIGNALS_tmst_signal" 474 "SIGNALS_wkratst_signal" 475 "SIGNALS_PID83h_A_BitCombineSignal" 476 "SIGNALS_PID9Bh_A_BitCombineSignal" 477 "SIGNALS_PIDA1h_A_BitCombineSignal" 478 "SIGNALS_PIDA7h_A_BitCombineSignal" 479 "SIGNALS_PIDA8h_A_BitCombineSignal" 480 "SIGNALS_Virtual_DcmDspUDS_2600Byte06_signal" 481 "SIGNALS_Virtual_DcmDspUDS_2610Byte00_signal" 482 "SIGNALS_Virtual_DcmDspUDS_2610Byte01_signal" 483 "SIGNALS_Virtual_DcmDspUDS_2610Byte02_signal" 484 "SIGNALS_Virtual_DcmDspUDS_2610Byte03_signal" 485 "SIGNALS_Virtual_DcmDspUDS_2610Byte04_signal" 486 "SIGNALS_Virtual_DcmDspUDS_2610Byte05_signal" 487 "SIGNALS_Virtual_DcmDspUDS_2610Byte0D_signal" 488 "SIGNALS_Virtual_DcmDspUDS_2610Byte0F_signal" 489 "SIGNALS_Virtual_DcmDspUDS_2610Byte10_signal" 490 "SIGNALS_Virtual_DcmDspUDS_2610Byte1A_signal" 491 "SIGNALS_Virtual_DcmDspUDS_2610Byte1B_signal" 492 "SIGNALS_Virtual_DcmDspUDS_2610Byte1C_signal" 493 "SIGNALS_Virtual_DcmDspUDS_2610Byte1D_signal" 494 "SIGNALS_Virtual_DcmDspUDS_2610Byte1F_signal" 495 "SIGNALS_Virtual_DcmDspUDS_2610Byte20_signal" 496 "SIGNALS_Virtual_DcmDspUDS_2610Byte21_signal" 497 "SIGNALS_Virtual_DcmDspUDS_2610Byte22to23_signal" 498 "SIGNALS_Virtual_DcmDspUDS_2610Byte29_signal" 499 "SIGNALS_Virtual_DcmDspUDS_2610Byte2A_signal" 500 "SIGNALS_Virtual_DcmDspUDS_2611Byte00_signal" 501 "SIGNALS_Virtual_DcmDspUDS_2611Byte01_signal" 502 "SIGNALS_Virtual_DcmDspUDS_2611Byte02_signal" 503 "SIGNALS_Virtual_DcmDspUDS_2611Byte03_signal" 504 "SIGNALS_Virtual_DcmDspUDS_2611Byte04_signal" 505 "SIGNALS_Virtual_DcmDspUDS_2611Byte05_signal" 506 "SIGNALS_Virtual_DcmDspUDS_2611Byte06_07_signal" 507 "SIGNALS_Virtual_DcmDspUDS_2611Byte08to09_signal" 508 "SIGNALS_Virtual_DcmDspUDS_2611Byte0A_signal" 509 "SIGNALS_Virtual_DcmDspUDS_2611Byte0B_signal" 510 "SIGNALS_Virtual_DcmDspUDS_2611Byte0Cto0D_signal" 511 "SIGNALS_Virtual_DcmDspUDS_2611Byte0E_signal" 512 "SIGNALS_Virtual_DcmDspUDS_2611Byte2A_signal" 513 "SIGNALS_Virtual_DcmDspUDS_2611Byte2B_signal" 514 "SIGNALS_Virtual_DcmDspUDS_2611Byte30_signal" 515 "SIGNALS_Virtual_DcmDspUDS_2611Byte31_signal" 516 "SIGNALS_Virtual_DcmDspUDS_2611Byte32_signal" 517 "SIGNALS_Virtual_DcmDspUDS_2611Byte33_signal" 518 "SIGNALS_Virtual_DcmDspUDS_2612Byte00_signal" 519 "SIGNALS_Virtual_DcmDspUDS_2612Byte01_signal" 520 "SIGNALS_Virtual_DcmDspUDS_2612Byte02_signal" 521 "SIGNALS_Virtual_DcmDspUDS_2612Byte03_signal" 522 "SIGNALS_Virtual_DcmDspUDS_2612Byte04_signal" 523 "SIGNALS_Virtual_DcmDspUDS_2612Byte05_signal" 524 "SIGNALS_Virtual_DcmDspUDS_2612Byte0B_0C_signal" 525 "SIGNALS_Virtual_DcmDspUDS_2612Byte14_signal" 526 "SIGNALS_Virtual_DcmDspUDS_2612Byte15_signal" 527 "SIGNALS_Virtual_DcmDspUDS_2612Byte16_signal" 528 "SIGNALS_Virtual_DcmDspUDS_2612Byte17_signal" 529 "SIGNALS_Virtual_DcmDspUDS_2612Byte1F_signal" 530 "SIGNALS_Virtual_DcmDspUDS_2612Byte20_signal" 531 "SIGNALS_Virtual_DcmDspUDS_2612Byte2A_signal" 532 "SIGNALS_Virtual_DcmDspUDS_2612Byte2B_signal" 533 "SIGNALS_Virtual_DcmDspUDS_2613Byte00_signal" 534 "SIGNALS_Virtual_DcmDspUDS_2613Byte01_signal" 535 "SIGNALS_Virtual_DcmDspUDS_2613Byte02_signal" 536 "SIGNALS_Virtual_DcmDspUDS_2613Byte03_signal" 537 "SIGNALS_Virtual_DcmDspUDS_2613Byte04_signal" 538 "SIGNALS_Virtual_DcmDspUDS_2613Byte05_signal" 539 "SIGNALS_Virtual_DcmDspUDS_2613Byte08_signal" 540 "SIGNALS_Virtual_DcmDspUDS_2613Byte09_signal" 541 "SIGNALS_Virtual_DcmDspUDS_2615Byte00_signal" 542 "SIGNALS_Virtual_DcmDspUDS_2615Byte01_signal" 543 "SIGNALS_Virtual_DcmDspUDS_2615Byte02_signal" 544 "SIGNALS_Virtual_DcmDspUDS_2615Byte03_signal" 545 "SIGNALS_Virtual_DcmDspUDS_2615Byte04_signal" 546 "SIGNALS_Virtual_DcmDspUDS_2615Byte05_signal" 547 "SIGNALS_Virtual_DcmDspUDS_2615Byte10_signal" 548 "SIGNALS_Virtual_DcmDspUDS_2615Byte26_signal" 549 "SIGNALS_Virtual_DcmDspUDS_2615Byte27_signal" 550 "SIGNALS_Virtual_DcmDspUDS_2617Byte00_signal" 551 "SIGNALS_Virtual_DcmDspUDS_2617Byte01_signal" 552 "SIGNALS_Virtual_DcmDspUDS_2617Byte02_signal" 553 "SIGNALS_Virtual_DcmDspUDS_2617Byte03_signal" 554 "SIGNALS_Virtual_DcmDspUDS_2617Byte04_signal" 555 "SIGNALS_Virtual_DcmDspUDS_2617Byte05_signal" 556 "SIGNALS_Virtual_DcmDspUDS_261AByte00_signal" 557 "SIGNALS_Virtual_DcmDspUDS_261AByte01_signal" 558 "SIGNALS_Virtual_DcmDspUDS_261AByte02_signal" 559 "SIGNALS_Virtual_DcmDspUDS_261AByte03_signal" 560 "SIGNALS_Virtual_DcmDspUDS_261AByte04_signal" 561 "SIGNALS_Virtual_DcmDspUDS_261AByte05_signal" 562 "SIGNALS_Virtual_DcmDspUDS_261AByte07_signal" 563 "SIGNALS_Virtual_DcmDspUDS_261AByte0A_signal" 564 "SIGNALS_Virtual_DcmDspUDS_261AByte0B_signal" 565 "SIGNALS_Virtual_DcmDspUDS_261AByte0C_signal" 566 "SIGNALS_Virtual_DcmDspUDS_261AByte0D_signal" 567 "SIGNALS_Virtual_DcmDspUDS_261AByte0E_signal" 568 "SIGNALS_Virtual_DcmDspUDS_2620Byte00_signal" 569 "SIGNALS_Virtual_DcmDspUDS_2620Byte01_signal" 570 "SIGNALS_Virtual_DcmDspUDS_2620Byte02_signal" 571 "SIGNALS_Virtual_DcmDspUDS_2620Byte03_signal" 572 "SIGNALS_Virtual_DcmDspUDS_2620Byte04_signal" 573 "SIGNALS_Virtual_DcmDspUDS_2620Byte05_signal" 574 "SIGNALS_Virtual_DcmDspUDS_2621Byte00_signal" 575 "SIGNALS_Virtual_DcmDspUDS_2621Byte01_signal" 576 "SIGNALS_Virtual_DcmDspUDS_2621Byte02_signal" 577 "SIGNALS_Virtual_DcmDspUDS_2621Byte03_signal" 578 "SIGNALS_Virtual_DcmDspUDS_2621Byte04_signal" 579 "SIGNALS_Virtual_DcmDspUDS_2621Byte05_signal" 580 "SIGNALS_Virtual_DcmDspUDS_2622Byte00_signal" 581 "SIGNALS_Virtual_DcmDspUDS_2622Byte01_signal" 582 "SIGNALS_Virtual_DcmDspUDS_2622Byte02_signal" 583 "SIGNALS_Virtual_DcmDspUDS_2622Byte03_signal" 584 "SIGNALS_Virtual_DcmDspUDS_2622Byte04_signal" 585 "SIGNALS_Virtual_DcmDspUDS_2622Byte05_signal" 586 "SIGNALS_Virtual_DcmDspUDS_2623Byte00_signal" 587 "SIGNALS_Virtual_DcmDspUDS_2623Byte01_signal" 588 "SIGNALS_Virtual_DcmDspUDS_2623Byte02_signal" 589 "SIGNALS_Virtual_DcmDspUDS_2623Byte03_signal" 590 "SIGNALS_Virtual_DcmDspUDS_2623Byte04_signal" 591 "SIGNALS_Virtual_DcmDspUDS_2623Byte05_signal" 592 "SIGNALS_Virtual_DcmDspUDS_2625Byte00_signal" 593 "SIGNALS_Virtual_DcmDspUDS_2625Byte01_signal" 594 "SIGNALS_Virtual_DcmDspUDS_2625Byte02_signal" 595 "SIGNALS_Virtual_DcmDspUDS_2625Byte03_signal" 596 "SIGNALS_Virtual_DcmDspUDS_2625Byte04_signal" 597 "SIGNALS_Virtual_DcmDspUDS_2625Byte05_signal" 598 "SIGNALS_Virtual_DcmDspUDS_2627Byte00_signal" 599 "SIGNALS_Virtual_DcmDspUDS_2627Byte01_signal" 600 "SIGNALS_Virtual_DcmDspUDS_2627Byte02_signal" 601 "SIGNALS_Virtual_DcmDspUDS_2627Byte03_signal" 602 "SIGNALS_Virtual_DcmDspUDS_2627Byte04_signal" 603 "SIGNALS_Virtual_DcmDspUDS_2627Byte05_signal" 604 "SIGNALS_Virtual_DcmDspUDS_262AByte00_signal" 605 "SIGNALS_Virtual_DcmDspUDS_262AByte01_signal" 606 "SIGNALS_Virtual_DcmDspUDS_262AByte02_signal" 607 "SIGNALS_Virtual_DcmDspUDS_262AByte03_signal" 608 "SIGNALS_Virtual_DcmDspUDS_262AByte04_signal" 609 "SIGNALS_Virtual_DcmDspUDS_262AByte05_signal" 610 "SIGNALS_Virtual_DcmDspUDS_2660Byte0_signal" 611 "SIGNALS_Virtual_DcmDspUDS_2660Byte11to12_signal" 612 "SIGNALS_Virtual_DcmDspUDS_2660Byte13to14_signal" 613 "SIGNALS_Virtual_DcmDspUDS_2660Byte15_signal" 614 "SIGNALS_Virtual_DcmDspUDS_2660Byte16_signal" 615 "SIGNALS_Virtual_DcmDspUDS_2660Byte17_signal" 616 "SIGNALS_Virtual_DcmDspUDS_2660Byte18_signal" 617 "SIGNALS_Virtual_DcmDspUDS_2660Byte19_signal" 618 "SIGNALS_Virtual_DcmDspUDS_2660Byte1A_signal" 619 "SIGNALS_Virtual_DcmDspUDS_2660Byte1B_signal" 620 "SIGNALS_Virtual_DcmDspUDS_2660Byte1C_signal" 621 "SIGNALS_Virtual_DcmDspUDS_2660Byte1D_signal" 622 "SIGNALS_Virtual_DcmDspUDS_2660Byte1E_signal" 623 "SIGNALS_Virtual_DcmDspUDS_2660Byte1_signal" 624 "SIGNALS_Virtual_DcmDspUDS_2660Byte26to27_signal" 625 "SIGNALS_Virtual_DcmDspUDS_2660Byte2A_signal" 626 "SIGNALS_Virtual_DcmDspUDS_2660Byte2Eto2F_signal" 627 "SIGNALS_Virtual_DcmDspUDS_2660Byte2_signal" 628 "SIGNALS_Virtual_DcmDspUDS_2660Byte3_signal" 629 "SIGNALS_Virtual_DcmDspUDS_2660Byte4_signal" 630 "SIGNALS_Virtual_DcmDspUDS_2660Byte5_signal" 631 "SIGNALS_Virtual_DcmDspUDS_2660Byte6_signal" 632 "SIGNALS_Virtual_DcmDspUDS_2661Byte0A_signal" 633 "SIGNALS_Virtual_DcmDspUDS_2661Byte0B_signal" 634 "SIGNALS_Virtual_DcmDspUDS_2661Byte0C_signal" 635 "SIGNALS_Virtual_DcmDspUDS_2661Byte0D_signal" 636 "SIGNALS_Virtual_DcmDspUDS_2661Byte0E_signal" 637 "SIGNALS_Virtual_DcmDspUDS_2661Byte0F_signal" 638 "SIGNALS_Virtual_DcmDspUDS_2661Byte0_signal" 639 "SIGNALS_Virtual_DcmDspUDS_2661Byte1_signal" 640 "SIGNALS_Virtual_DcmDspUDS_2661Byte2D_signal" 641 "SIGNALS_Virtual_DcmDspUDS_2661Byte2E_signal" 642 "SIGNALS_Virtual_DcmDspUDS_2661Byte2F_signal" 643 "SIGNALS_Virtual_DcmDspUDS_2661Byte2_signal" 644 "SIGNALS_Virtual_DcmDspUDS_2661Byte30_signal" 645 "SIGNALS_Virtual_DcmDspUDS_2661Byte31_signal" 646 "SIGNALS_Virtual_DcmDspUDS_2661Byte32_signal" 647 "SIGNALS_Virtual_DcmDspUDS_2661Byte3_signal" 648 "SIGNALS_Virtual_DcmDspUDS_2661Byte4_signal" 649 "SIGNALS_Virtual_DcmDspUDS_2661Byte5_signal" 650 "SIGNALS_Virtual_DcmDspUDS_2661Byte6_signal" 651 "SIGNALS_Virtual_DcmDspUDS_2661Byte7_signal" 652 "SIGNALS_Virtual_DcmDspUDS_2661Byte8_signal" 653 "SIGNALS_Virtual_DcmDspUDS_2661Byte9_signal" 654 "SIGNALS_Virtual_DcmDspUDS_2662Byte0Cto0D_signal" 655 "SIGNALS_Virtual_DcmDspUDS_2662Byte0_signal" 656 "SIGNALS_Virtual_DcmDspUDS_2662Byte18_signal" 657 "SIGNALS_Virtual_DcmDspUDS_2662Byte19_signal" 658 "SIGNALS_Virtual_DcmDspUDS_2662Byte1_signal" 659 "SIGNALS_Virtual_DcmDspUDS_2662Byte2_signal" 660 "SIGNALS_Virtual_DcmDspUDS_2662Byte3_signal" 661 "SIGNALS_Virtual_DcmDspUDS_2662Byte4_signal" 662 "SIGNALS_Virtual_DcmDspUDS_2662Byte5_signal" 663 "SIGNALS_Virtual_DcmDspUDS_2663Byte0_signal" 664 "SIGNALS_Virtual_DcmDspUDS_2663Byte14Byte15_signal" 665 "SIGNALS_Virtual_DcmDspUDS_2663Byte16Byte17_signal" 666 "SIGNALS_Virtual_DcmDspUDS_2663Byte18Byte19_signal" 667 "SIGNALS_Virtual_DcmDspUDS_2663Byte1AByte1B_signal" 668 "SIGNALS_Virtual_DcmDspUDS_2663Byte1_signal" 669 "SIGNALS_Virtual_DcmDspUDS_2663Byte2_signal" 670 "SIGNALS_Virtual_DcmDspUDS_2663Byte3_signal" 671 "SIGNALS_Virtual_DcmDspUDS_2663Byte4_signal" 672 "SIGNALS_Virtual_DcmDspUDS_2663Byte5_signal" 673 "SIGNALS_Virtual_DcmDspUDS_2664Byte0_signal" 674 "SIGNALS_Virtual_DcmDspUDS_2664Byte1_signal" 675 "SIGNALS_Virtual_DcmDspUDS_2664Byte25_signal" 676 "SIGNALS_Virtual_DcmDspUDS_2664Byte26_signal" 677 "SIGNALS_Virtual_DcmDspUDS_2664Byte2_signal" 678 "SIGNALS_Virtual_DcmDspUDS_2664Byte3_signal" 679 "SIGNALS_Virtual_DcmDspUDS_2664Byte4_signal" 680 "SIGNALS_Virtual_DcmDspUDS_2664Byte5_signal" 681 "SIGNALS_Virtual_DcmDspUDS_2664Byte6_signal" 682 "SIGNALS_Virtual_DcmDspUDS_2664Byte7_signal" 683 "SIGNALS_Virtual_DcmDspUDS_2665Byte0_signal" 684 "SIGNALS_Virtual_DcmDspUDS_2665Byte1_signal" 685 "SIGNALS_Virtual_DcmDspUDS_2665Byte2_signal" 686 "SIGNALS_Virtual_DcmDspUDS_2665Byte3_signal" 687 "SIGNALS_Virtual_DcmDspUDS_2665Byte4_signal" 688 "SIGNALS_Virtual_DcmDspUDS_2665Byte5_signal" 689 "SIGNALS_Virtual_DcmDspUDS_2666Byte0_signal" 690 "SIGNALS_Virtual_DcmDspUDS_2666Byte1_signal" 691 "SIGNALS_Virtual_DcmDspUDS_2666Byte2_signal" 692 "SIGNALS_Virtual_DcmDspUDS_2666Byte3_signal" 693 "SIGNALS_Virtual_DcmDspUDS_2666Byte4_signal" 694 "SIGNALS_Virtual_DcmDspUDS_2666Byte5_signal" 695 "SIGNALS_Virtual_DcmDspUDS_2668Byte0_signal" 696 "SIGNALS_Virtual_DcmDspUDS_2668Byte1_signal" 697 "SIGNALS_Virtual_DcmDspUDS_2668Byte2_signal" 698 "SIGNALS_Virtual_DcmDspUDS_2668Byte3_signal" 699 "SIGNALS_Virtual_DcmDspUDS_2668Byte4_signal" 700 "SIGNALS_Virtual_DcmDspUDS_2668Byte5_signal" 701 "SIGNALS_Virtual_DcmDspUDS_266CByte0_signal" 702 "SIGNALS_Virtual_DcmDspUDS_266CByte1_signal" 703 "SIGNALS_Virtual_DcmDspUDS_266CByte26_signal" 704 "SIGNALS_Virtual_DcmDspUDS_266CByte27_signal" 705 "SIGNALS_Virtual_DcmDspUDS_266CByte2_signal" 706 "SIGNALS_Virtual_DcmDspUDS_266CByte3_signal" 707 "SIGNALS_Virtual_DcmDspUDS_266CByte4_signal" 708 "SIGNALS_Virtual_DcmDspUDS_266CByte5_signal" 709 "SIGNALS_Virtual_DcmDspUDS_266CByte6_signal" 710 "SIGNALS_Virtual_DcmDspUDS_266CByte7_signal" 711 "SIGNALS_Virtual_DcmDspUDS_266CByte8_signal" 712 "SIGNALS_Virtual_DcmDspUDS_266CByte9_signal" 713 "SIGNALS_Virtual_DcmDspUDS_266DByte0_signal" 714 "SIGNALS_Virtual_DcmDspUDS_266DByte1_signal" 715 "SIGNALS_Virtual_DcmDspUDS_266DByte2_signal" 716 "SIGNALS_Virtual_DcmDspUDS_266DByte3_signal" 717 "SIGNALS_Virtual_DcmDspUDS_266DByte4_signal" 718 "SIGNALS_Virtual_DcmDspUDS_266DByte5_signal" 719 "SIGNALS_Virtual_DcmDspUDS_266FByte0_signal" 720 "SIGNALS_Virtual_DcmDspUDS_266FByte1_signal" 721 "SIGNALS_Virtual_DcmDspUDS_266FByte2_signal" 722 "SIGNALS_Virtual_DcmDspUDS_266FByte3_signal" 723 "SIGNALS_Virtual_DcmDspUDS_2673Byte0A_signal" 724 "SIGNALS_Virtual_DcmDspUDS_2673Byte0B_signal" 725 "SIGNALS_Virtual_DcmDspUDS_2673Byte0_signal" 726 "SIGNALS_Virtual_DcmDspUDS_2673Byte12_signal" 727 "SIGNALS_Virtual_DcmDspUDS_2673Byte13_signal" 728 "SIGNALS_Virtual_DcmDspUDS_2673Byte16_signal" 729 "SIGNALS_Virtual_DcmDspUDS_2673Byte17_signal" 730 "SIGNALS_Virtual_DcmDspUDS_2673Byte1E_signal" 731 "SIGNALS_Virtual_DcmDspUDS_2673Byte1F_signal" 732 "SIGNALS_Virtual_DcmDspUDS_2673Byte1_signal" 733 "SIGNALS_Virtual_DcmDspUDS_2673Byte2_signal" 734 "SIGNALS_Virtual_DcmDspUDS_2673Byte3_signal" 735 "SIGNALS_Virtual_DcmDspUDS_2673Byte4_signal" 736 "SIGNALS_Virtual_DcmDspUDS_2673Byte5_signal" 737 "SIGNALS_Virtual_DcmDspUDS_2673Byte6_signal" 738 "SIGNALS_Virtual_DcmDspUDS_2673Byte7_signal" 739 "SIGNALS_Virtual_DcmDspUDS_2676Byte0_signal" 740 "SIGNALS_Virtual_DcmDspUDS_2676Byte1_signal" 741 "SIGNALS_Virtual_DcmDspUDS_2676Byte2E_signal" 742 "SIGNALS_Virtual_DcmDspUDS_2676Byte2F_signal" 743 "SIGNALS_Virtual_DcmDspUDS_2676Byte2_signal" 744 "SIGNALS_Virtual_DcmDspUDS_2676Byte3_signal" 745 "SIGNALS_Virtual_DcmDspUDS_2676Byte4_signal" 746 "SIGNALS_Virtual_DcmDspUDS_2676Byte5_signal" 747 "SIGNALS_Virtual_DcmDspUDS_2676Byte6_signal" 748 "SIGNALS_Virtual_DcmDspUDS_2676Byte7_signal" 749 "SIGNALS_Virtual_DcmDspUDS_267BByte0_signal" 750 "SIGNALS_Virtual_DcmDspUDS_267BByte1_signal" 751 "SIGNALS_Virtual_DcmDspUDS_267BByte2_signal" 752 "SIGNALS_Virtual_DcmDspUDS_267BByte3_signal" 753 "SIGNALS_Virtual_DcmDspUDS_267BByte4_signal" 754 "SIGNALS_Virtual_DcmDspUDS_267BByte5_signal" 755 "SIGNALS_Virtual_DcmDspUDS_267EByte0_signal" 756 "SIGNALS_Virtual_DcmDspUDS_267EByte1_signal" 757 "SIGNALS_Virtual_DcmDspUDS_267EByte22_signal" 758 "SIGNALS_Virtual_DcmDspUDS_267EByte2_signal" 759 "SIGNALS_Virtual_DcmDspUDS_2680Byte00_signal" 760 "SIGNALS_Virtual_DcmDspUDS_2680Byte01_signal" 761 "SIGNALS_Virtual_DcmDspUDS_2680Byte02_signal" 762 "SIGNALS_Virtual_DcmDspUDS_2680Byte03_signal" 763 "SIGNALS_Virtual_DcmDspUDS_2680Byte04_signal" 764 "SIGNALS_Virtual_DcmDspUDS_2680Byte05_signal" 765 "SIGNALS_Virtual_DcmDspUDS_2680Byte08_signal" 766 "SIGNALS_Virtual_DcmDspUDS_2680Byte09_signal" 767 "SIGNALS_Virtual_DcmDspUDS_2680Byte0E_signal" 768 "SIGNALS_Virtual_DcmDspUDS_2680Byte0F_signal" 769 "SIGNALS_Virtual_DcmDspUDS_2681Byte00_signal" 770 "SIGNALS_Virtual_DcmDspUDS_2681Byte01_signal" 771 "SIGNALS_Virtual_DcmDspUDS_2681Byte02_signal" 772 "SIGNALS_Virtual_DcmDspUDS_2681Byte03_signal" 773 "SIGNALS_Virtual_DcmDspUDS_2681Byte04_signal" 774 "SIGNALS_Virtual_DcmDspUDS_2681Byte05_signal" 775 "SIGNALS_Virtual_DcmDspUDS_2681Byte0F_signal" 776 "SIGNALS_Virtual_DcmDspUDS_2681Byte10_signal" 777 "SIGNALS_Virtual_DcmDspUDS_2681Byte13_signal" 778 "SIGNALS_Virtual_DcmDspUDS_2681Byte14_signal" 779 "SIGNALS_Virtual_DcmDspUDS_2681Byte1D_signal" 780 "SIGNALS_Virtual_DcmDspUDS_2681Byte1E_signal" 781 "SIGNALS_Virtual_DcmDspUDS_2682Byte00_signal" 782 "SIGNALS_Virtual_DcmDspUDS_2682Byte01_signal" 783 "SIGNALS_Virtual_DcmDspUDS_2682Byte02_signal" 784 "SIGNALS_Virtual_DcmDspUDS_2682Byte03_signal" 785 "SIGNALS_Virtual_DcmDspUDS_2682Byte04_signal" 786 "SIGNALS_Virtual_DcmDspUDS_2682Byte05_signal" 787 "SIGNALS_Virtual_DcmDspUDS_2682Byte06_07_signal" 788 "SIGNALS_Virtual_DcmDspUDS_2682Byte08_09_signal" 789 "SIGNALS_Virtual_DcmDspUDS_2682Byte0E_signal" 790 "SIGNALS_Virtual_DcmDspUDS_2682Byte11_12_signal" 791 "SIGNALS_Virtual_DcmDspUDS_2682Byte13_14_signal" 792 "SIGNALS_Virtual_DcmDspUDS_2682Byte15_16_signal" 793 "SIGNALS_Virtual_DcmDspUDS_2682Byte18_19_signal" 794 "SIGNALS_Virtual_DcmDspUDS_2682Byte1B_signal" 795 "SIGNALS_Virtual_DcmDspUDS_2682Byte1C_signal" 796 "SIGNALS_Virtual_DcmDspUDS_2683Byte00_signal" 797 "SIGNALS_Virtual_DcmDspUDS_2683Byte01_signal" 798 "SIGNALS_Virtual_DcmDspUDS_2683Byte02_signal" 799 "SIGNALS_Virtual_DcmDspUDS_2683Byte03_signal" 800 "SIGNALS_Virtual_DcmDspUDS_2683Byte04_signal" 801 "SIGNALS_Virtual_DcmDspUDS_2683Byte05_signal" 802 "SIGNALS_Virtual_DcmDspUDS_2684Byte00_signal" 803 "SIGNALS_Virtual_DcmDspUDS_2684Byte01_signal" 804 "SIGNALS_Virtual_DcmDspUDS_2684Byte02_signal" 805 "SIGNALS_Virtual_DcmDspUDS_2684Byte03_signal" 806 "SIGNALS_Virtual_DcmDspUDS_2684Byte04_signal" 807 "SIGNALS_Virtual_DcmDspUDS_2684Byte05_signal" 808 "SIGNALS_Virtual_DcmDspUDS_2688Byte00_signal" 809 "SIGNALS_Virtual_DcmDspUDS_2688Byte01_signal" 810 "SIGNALS_Virtual_DcmDspUDS_2688Byte02_signal" 811 "SIGNALS_Virtual_DcmDspUDS_2688Byte03_signal" 812 "SIGNALS_Virtual_DcmDspUDS_2688Byte04_signal" 813 "SIGNALS_Virtual_DcmDspUDS_2688Byte05_signal" 814 "SIGNALS_Virtual_DcmDspUDS_2689Byte00_signal" 815 "SIGNALS_Virtual_DcmDspUDS_2689Byte01_signal" 816 "SIGNALS_Virtual_DcmDspUDS_2689Byte02_signal" 817 "SIGNALS_Virtual_DcmDspUDS_2689Byte03_signal" 818 "SIGNALS_Virtual_DcmDspUDS_2689Byte04_signal" 819 "SIGNALS_Virtual_DcmDspUDS_2689Byte05_signal" 820 "SIGNALS_Virtual_DcmDspUDS_2689Byte06to09_signal" 821 "SIGNALS_Virtual_DcmDspUDS_2689Byte0Eto11_signal" 822 "SIGNALS_Virtual_DcmDspUDS_2689Byte12to15_signal" 823 "SIGNALS_Virtual_DcmDspUDS_2689Byte16to19_signal" 824 "SIGNALS_Virtual_DcmDspUDS_2689Byte1Ato1D_signal" 825 "SIGNALS_Virtual_DcmDspUDS_2689Byte1Eto21_signal" 826 "SIGNALS_Virtual_DcmDspUDS_2689Byte22to25_signal" 827 "SIGNALS_Virtual_DcmDspUDS_2689Byte26to29_signal" 828 "SIGNALS_Virtual_DcmDspUDS_2689Byte2Ato2D_signal" 829 "SIGNALS_Virtual_DcmDspUDS_2689Byte2Eto31_signal" 830 "SIGNALS_Virtual_DcmDspUDS_268BByte00_signal" 831 "SIGNALS_Virtual_DcmDspUDS_268BByte01_signal" 832 "SIGNALS_Virtual_DcmDspUDS_268BByte02_signal" 833 "SIGNALS_Virtual_DcmDspUDS_268BByte03_signal" 834 "SIGNALS_Virtual_DcmDspUDS_268BByte04_signal" 835 "SIGNALS_Virtual_DcmDspUDS_268BByte05_signal" 836 "SIGNALS_Virtual_DcmDspUDS_268BByte06_signal" 837 "SIGNALS_Virtual_DcmDspUDS_268BByte07_signal" 838 "SIGNALS_Virtual_DcmDspUDS_268BByte08_signal" 839 "SIGNALS_Virtual_DcmDspUDS_268BByte09_signal" 840 "SIGNALS_Virtual_DcmDspUDS_268BByte0A_signal" 841 "SIGNALS_Virtual_DcmDspUDS_268BByte0B_signal" 842 "SIGNALS_Virtual_DcmDspUDS_268BByte0C_signal" 843 "SIGNALS_Virtual_DcmDspUDS_268BByte0D_signal" 844 "SIGNALS_Virtual_DcmDspUDS_268CByte00_signal" 845 "SIGNALS_Virtual_DcmDspUDS_268CByte01_signal" 846 "SIGNALS_Virtual_DcmDspUDS_268CByte02_signal" 847 "SIGNALS_Virtual_DcmDspUDS_268CByte03_signal" 848 "SIGNALS_Virtual_DcmDspUDS_268CByte04_signal" 849 "SIGNALS_Virtual_DcmDspUDS_268CByte05_signal" 850 "SIGNALS_Virtual_DcmDspUDS_268CByte06_signal" 851 "SIGNALS_Virtual_DcmDspUDS_268CByte07_signal" 852 "SIGNALS_Virtual_DcmDspUDS_268CByte08_signal" 853 "SIGNALS_Virtual_DcmDspUDS_268CByte09_signal" 854 "SIGNALS_Virtual_DcmDspUDS_268CByte0A_signal" 855 "SIGNALS_Virtual_DcmDspUDS_268CByte2E_signal" 856 "SIGNALS_Virtual_DcmDspUDS_268CByte2F_signal" 857 "SIGNALS_Virtual_DcmDspUDS_268CByte30_signal" 858 "SIGNALS_Virtual_DcmDspUDS_268CByte31_signal" 859 "SIGNALS_Virtual_DcmDspUDS_268CByte32_signal" 860 "SIGNALS_Virtual_DcmDspUDS_268CByte33_signal" 861 "SIGNALS_Virtual_DcmDspUDS_268EByte00_signal" 862 "SIGNALS_Virtual_DcmDspUDS_268EByte01_signal" 863 "SIGNALS_Virtual_DcmDspUDS_268EByte02_signal" 864 "SIGNALS_Virtual_DcmDspUDS_268EByte03_signal" 865 "SIGNALS_Virtual_DcmDspUDS_268EByte04_signal" 866 "SIGNALS_Virtual_DcmDspUDS_268EByte05_signal" 867 "SIGNALS_Virtual_DcmDspUDS_268EByte08to09_signal" 868 "SIGNALS_Virtual_DcmDspUDS_268EByte0A_signal" 869 "SIGNALS_Virtual_DcmDspUDS_268EByte0B_signal" 870 "SIGNALS_Virtual_DcmDspUDS_268FByte00_signal" 871 "SIGNALS_Virtual_DcmDspUDS_268FByte01_signal" 872 "SIGNALS_Virtual_DcmDspUDS_268FByte02_signal" 873 "SIGNALS_Virtual_DcmDspUDS_268FByte03_signal" 874 "SIGNALS_Virtual_DcmDspUDS_268FByte04_signal" 875 "SIGNALS_Virtual_DcmDspUDS_268FByte05_signal" 876 "SIGNALS_Virtual_DcmDspUDS_268FByte0A_signal" 877 "SIGNALS_Virtual_DcmDspUDS_268FByte0B_signal" 878 "SIGNALS_Virtual_DcmDspUDS_268FByte16_17_signal" 879 "SIGNALS_Virtual_DcmDspUDS_268FByte18_19_signal" 880 "SIGNALS_Virtual_DcmDspUDS_268FByte1A_1B_signal" 881 "SIGNALS_Virtual_DcmDspUDS_2699Byte00_signal" 882 "SIGNALS_Virtual_DcmDspUDS_2699Byte01_signal" 883 "SIGNALS_Virtual_DcmDspUDS_2699Byte02_signal" 884 "SIGNALS_Virtual_DcmDspUDS_2699Byte03_signal" 885 "SIGNALS_Virtual_DcmDspUDS_2699Byte04_signal" 886 "SIGNALS_Virtual_DcmDspUDS_2699Byte05_signal" 887 "SIGNALS_Virtual_DcmDspUDS_2699Byte06_signal" 888 "SIGNALS_Virtual_DcmDspUDS_2699Byte07_signal" 889 "SIGNALS_Virtual_DcmDspUDS_2699Byte0B_0C_signal" 890 "SIGNALS_Virtual_DcmDspUDS_2699Byte16_signal" 891 "SIGNALS_Virtual_DcmDspUDS_2699Byte17_signal" 892 "SIGNALS_Virtual_DcmDspUDS_2699Byte26_27_signal" 893 "SIGNALS_Virtual_DcmDspUDS_2699Byte28_29_signal" 894 "SIGNALS_Virtual_DcmDspUDS_2699Byte2A_2B_signal" 895 "SIGNALS_Virtual_DcmDspUDS_2699Byte2E_signal" 896 "SIGNALS_Virtual_DcmDspUDS_2699Byte2F_30_signal" 897 "SIGNALS_Virtual_DcmDspUDS_269AByte00_signal" 898 "SIGNALS_Virtual_DcmDspUDS_269AByte01_signal" 899 "SIGNALS_Virtual_DcmDspUDS_269AByte02_signal" 900 "SIGNALS_Virtual_DcmDspUDS_269AByte03_signal" 901 "SIGNALS_Virtual_DcmDspUDS_269AByte04_signal" 902 "SIGNALS_Virtual_DcmDspUDS_269AByte05_signal" 903 "SIGNALS_Virtual_DcmDspUDS_269BByte00_signal" 904 "SIGNALS_Virtual_DcmDspUDS_269BByte01_signal" 905 "SIGNALS_Virtual_DcmDspUDS_269BByte02_signal" 906 "SIGNALS_Virtual_DcmDspUDS_269BByte03_signal" 907 "SIGNALS_Virtual_DcmDspUDS_269BByte04_signal" 908 "SIGNALS_Virtual_DcmDspUDS_269BByte05_signal" 909 "SIGNALS_Virtual_DcmDspUDS_269EByte00_signal" 910 "SIGNALS_Virtual_DcmDspUDS_269EByte01_signal" 911 "SIGNALS_Virtual_DcmDspUDS_269EByte02_signal" 912 "SIGNALS_Virtual_DcmDspUDS_269EByte03_signal" 913 "SIGNALS_Virtual_DcmDspUDS_269EByte04_signal" 914 "SIGNALS_Virtual_DcmDspUDS_269EByte05_signal" 915 "SIGNALS_Virtual_DcmDspUDS_26A0Byte00_signal" 916 "SIGNALS_Virtual_DcmDspUDS_26A0Byte01_signal" 917 "SIGNALS_Virtual_DcmDspUDS_26A0Byte02_signal" 918 "SIGNALS_Virtual_DcmDspUDS_26A0Byte03_signal" 919 "SIGNALS_Virtual_DcmDspUDS_26A0Byte04_signal" 920 "SIGNALS_Virtual_DcmDspUDS_26A0Byte05_signal" 921 "SIGNALS_Virtual_DcmDspUDS_26A0Byte06_signal" 922 "SIGNALS_Virtual_DcmDspUDS_26A0Byte07_signal" 923 "SIGNALS_Virtual_DcmDspUDS_26A0Byte08_signal" 924 "SIGNALS_Virtual_DcmDspUDS_26A0Byte09_signal" 925 "SIGNALS_Virtual_DcmDspUDS_26A0Byte0A_signal" 926 "SIGNALS_Virtual_DcmDspUDS_26A0Byte0B_signal" 927 "SIGNALS_Virtual_DcmDspUDS_26A0Byte0C_signal" 928 "SIGNALS_Virtual_DcmDspUDS_26A0Byte0D_signal" 929 "SIGNALS_Virtual_DcmDspUDS_26A0Byte0E_signal" 930 "SIGNALS_Virtual_DcmDspUDS_26A0Byte0F_signal" 931 "SIGNALS_Virtual_DcmDspUDS_26A0Byte10_signal" 932 "SIGNALS_Virtual_DcmDspUDS_26A0Byte11_signal" 933 "SIGNALS_Virtual_DcmDspUDS_26A0Byte12_signal" 934 "SIGNALS_Virtual_DcmDspUDS_26A0Byte13_signal" 935 "SIGNALS_Virtual_DcmDspUDS_26A0Byte14_signal" 936 "SIGNALS_Virtual_DcmDspUDS_26A0Byte15_signal" 937 "SIGNALS_Virtual_DcmDspUDS_26A0Byte16_signal" 938 "SIGNALS_Virtual_DcmDspUDS_26A0Byte17_signal" 939 "SIGNALS_Virtual_DcmDspUDS_26A0Byte18_signal" 940 "SIGNALS_Virtual_DcmDspUDS_26A0Byte19_signal" 941 "SIGNALS_Virtual_DcmDspUDS_26A0Byte1A_signal" 942 "SIGNALS_Virtual_DcmDspUDS_26A0Byte4E_signal" 943 "SIGNALS_Virtual_DcmDspUDS_26A0Byte52_53_signal" 944 "SIGNALS_Virtual_DcmDspUDS_26A0Byte54_55_signal" 945 "SIGNALS_Virtual_DcmDspUDS_26A0Byte56_57_signal" 946 "SIGNALS_Virtual_DcmDspUDS_26A0Byte66_signal" 947 "SIGNALS_Virtual_DcmDspUDS_26A0Byte67_signal" 948 "SIGNALS_Virtual_DcmDspUDS_26A0Byte68_signal" 949 "SIGNALS_Virtual_DcmDspUDS_26A0Byte69_signal" 950 "SIGNALS_Virtual_DcmDspUDS_26A0Byte6A_signal" 951 "SIGNALS_Virtual_DcmDspUDS_26A0Byte6B_signal" 952 "SIGNALS_Virtual_DcmDspUDS_26A0Byte6C_signal" 953 "SIGNALS_Virtual_DcmDspUDS_26A0Byte6D_signal" 954 "SIGNALS_Virtual_DcmDspUDS_26A0Byte7F_80_signal" 955 "SIGNALS_Virtual_DcmDspUDS_26A0Byte81_82_signal" 956 "SIGNALS_Virtual_DcmDspUDS_26A0Byte83_84_signal" 957 "SIGNALS_Virtual_DcmDspUDS_26A0Byte85_86_signal" 958 "SIGNALS_Virtual_DcmDspUDS_26A0Byte87_88_signal" 959 "SIGNALS_Virtual_DcmDspUDS_26A0Byte89_8A_signal" 960 "SIGNALS_Virtual_DcmDspUDS_26A0Byte8B_8C_signal" 961 "SIGNALS_Virtual_DcmDspUDS_26A0Byte8D_8E_signal" 962 "SIGNALS_Virtual_DcmDspUDS_26A0Byte8F_90_signal" 963 "SIGNALS_Virtual_DcmDspUDS_26A0Byte91_92_signal" 964 "SIGNALS_Virtual_DcmDspUDS_26A0Byte93_94_signal" 965 "SIGNALS_Virtual_DcmDspUDS_26A0Byte95_96_signal" 966 "SIGNALS_Virtual_DcmDspUDS_26A0Byte97_98_signal" 967 "SIGNALS_Virtual_DcmDspUDS_26A0Byte99_9A_signal" 968 "SIGNALS_Virtual_DcmDspUDS_26A0Byte9B_9C_signal" 969 "SIGNALS_Virtual_DcmDspUDS_26A0Byte9D_9E_signal" 970 "SIGNALS_Virtual_DcmDspUDS_26A0Byte9F_A0_signal" 971 "SIGNALS_Virtual_DcmDspUDS_26A0ByteA1_A2_signal" 972 "SIGNALS_Virtual_DcmDspUDS_26A0ByteA3_A4_signal" 973 "SIGNALS_Virtual_DcmDspUDS_26A0ByteA5_A6_signal" 974 "SIGNALS_Virtual_DcmDspUDS_26A0ByteA7_A8_signal" 975 "SIGNALS_Virtual_DcmDspUDS_26A0ByteA9_AA_signal" 976 "SIGNALS_Virtual_DcmDspUDS_26A0ByteAB_AC_signal" 977 "SIGNALS_Virtual_DcmDspUDS_26A0ByteAD_AE_signal" 978 "SIGNALS_Virtual_DcmDspUDS_26A0ByteAF_B0_signal" 979 "SIGNALS_Virtual_DcmDspUDS_26A0ByteB1_B2_signal" 980 "SIGNALS_Virtual_DcmDspUDS_26A0ByteB3_B4_signal" 981 "SIGNALS_Virtual_DcmDspUDS_26A0ByteB5_B6_signal" 982 "SIGNALS_Virtual_DcmDspUDS_26A0ByteB7_B8_signal" 983 "SIGNALS_Virtual_DcmDspUDS_26A0ByteB9_BA_signal" 984 "SIGNALS_Virtual_DcmDspUDS_26A0ByteBB_BC_signal" 985 "SIGNALS_Virtual_DcmDspUDS_26A0ByteBD_BE_signal" 986 "SIGNALS_Virtual_DcmDspUDS_26A0ByteBF_C0_signal" 987 "SIGNALS_Virtual_DcmDspUDS_26A0ByteC1_C2_signal" 988 "SIGNALS_Virtual_DcmDspUDS_26A0ByteC3_C4_signal" 989 "SIGNALS_Virtual_DcmDspUDS_26A0ByteC5_C6_signal" 990 "SIGNALS_Virtual_DcmDspUDS_26A0ByteC7_C8_signal" 991 "SIGNALS_Virtual_DcmDspUDS_26A0ByteC9_CA_signal" 992 "SIGNALS_Virtual_DcmDspUDS_26A0ByteCB_CC_signal" 993 "SIGNALS_Virtual_DcmDspUDS_26A0ByteCD_CE_signal" 994 "SIGNALS_Virtual_DcmDspUDS_26A0ByteCF_D0_signal" 995 "SIGNALS_Virtual_DcmDspUDS_26A0ByteD1_D2_signal" 996 "SIGNALS_Virtual_DcmDspUDS_26A0ByteD3_D4_signal" 997 "SIGNALS_Virtual_DcmDspUDS_26A0ByteD5_D6_signal" 998 "SIGNALS_Virtual_DcmDspUDS_26A0ByteD7_D8_signal" 999 "SIGNALS_Virtual_DcmDspUDS_26A0ByteD9_DA_signal" 1000 "SIGNALS_Virtual_DcmDspUDS_26A0ByteDB_DC_signal" 1001 "SIGNALS_Virtual_DcmDspUDS_26A0ByteDD_DE_signal" 1002 "SIGNALS_Virtual_DcmDspUDS_26A0ByteDF_E0_signal" 1003 "SIGNALS_Virtual_DcmDspUDS_26A0ByteE1_E2_signal" 1004 "SIGNALS_Virtual_DcmDspUDS_26A0ByteE3_E4_signal" 1005 "SIGNALS_Virtual_DcmDspUDS_26A0ByteE5_E6_signal" 1006 "SIGNALS_Virtual_DcmDspUDS_26A0ByteE7_E8_signal" 1007 "SIGNALS_Virtual_DcmDspUDS_26A0ByteE9_EA_signal" 1008 "SIGNALS_Virtual_DcmDspUDS_26A0ByteEB_EC_signal" 1009 "SIGNALS_Virtual_DcmDspUDS_26A0ByteED_EE_signal" 1010 "SIGNALS_Virtual_DcmDspUDS_26A0ByteEF_F0_signal" 1011 "SIGNALS_Virtual_DcmDspUDS_26A0ByteF1_F2_signal" 1012 "SIGNALS_Virtual_DcmDspUDS_26A1Byte00_signal" 1013 "SIGNALS_Virtual_DcmDspUDS_26A1Byte01_signal" 1014 "SIGNALS_Virtual_DcmDspUDS_26A1Byte02_signal" 1015 "SIGNALS_Virtual_DcmDspUDS_26A1Byte03_signal" 1016 "SIGNALS_Virtual_DcmDspUDS_26A1Byte04_signal" 1017 "SIGNALS_Virtual_DcmDspUDS_26A1Byte05_signal" 1018 "SIGNALS_Virtual_DcmDspUDS_26A1Byte06_signal" 1019 "SIGNALS_Virtual_DcmDspUDS_26A1Byte07_signal" 1020 "SIGNALS_Virtual_DcmDspUDS_26A1Byte08_signal" 1021 "SIGNALS_Virtual_DcmDspUDS_26A1Byte09_signal" 1022 "SIGNALS_Virtual_DcmDspUDS_26A1Byte0A_signal" 1023 "SIGNALS_Virtual_DcmDspUDS_26A1Byte0B_signal" 1024 "SIGNALS_Virtual_DcmDspUDS_26A1Byte0C_signal" 1025 "SIGNALS_Virtual_DcmDspUDS_26A1Byte0D_signal" 1026 "SIGNALS_Virtual_DcmDspUDS_26A1Byte0E_signal" 1027 "SIGNALS_Virtual_DcmDspUDS_26A1Byte0F_signal" 1028 "SIGNALS_Virtual_DcmDspUDS_26A1Byte10_signal" 1029 "SIGNALS_Virtual_DcmDspUDS_26A1Byte11_signal" 1030 "SIGNALS_Virtual_DcmDspUDS_26A1Byte12_signal" 1031 "SIGNALS_Virtual_DcmDspUDS_26A1Byte13_signal" 1032 "SIGNALS_Virtual_DcmDspUDS_26A1Byte14_signal" 1033 "SIGNALS_Virtual_DcmDspUDS_26A1Byte15_signal" 1034 "SIGNALS_Virtual_DcmDspUDS_26A1Byte16_signal" 1035 "SIGNALS_Virtual_DcmDspUDS_26A1Byte17_signal" 1036 "SIGNALS_Virtual_DcmDspUDS_26A1Byte18_signal" 1037 "SIGNALS_Virtual_DcmDspUDS_26A1Byte19_signal" 1038 "SIGNALS_Virtual_DcmDspUDS_26A1Byte1A_signal" 1039 "SIGNALS_Virtual_DcmDspUDS_26A1Byte1B_1C_signal" 1040 "SIGNALS_Virtual_DcmDspUDS_26A1Byte1D_1E_signal" 1041 "SIGNALS_Virtual_DcmDspUDS_26A1Byte1F_20_signal" 1042 "SIGNALS_Virtual_DcmDspUDS_26A1Byte21_22_signal" 1043 "SIGNALS_Virtual_DcmDspUDS_26A1Byte23_24_signal" 1044 "SIGNALS_Virtual_DcmDspUDS_26A1Byte25_signal" 1045 "SIGNALS_Virtual_DcmDspUDS_26A1Byte26_signal" 1046 "SIGNALS_Virtual_DcmDspUDS_26A1Byte27_signal" 1047 "SIGNALS_Virtual_DcmDspUDS_26A1Byte28_signal" 1048 "SIGNALS_Virtual_DcmDspUDS_26A1Byte29_signal" 1049 "SIGNALS_Virtual_DcmDspUDS_26A1Byte2A_signal" 1050 "SIGNALS_Virtual_DcmDspUDS_26A1Byte2B_signal" 1051 "SIGNALS_Virtual_DcmDspUDS_26A1Byte2C_signal" 1052 "SIGNALS_Virtual_DcmDspUDS_26A1Byte2D_signal" 1053 "SIGNALS_Virtual_DcmDspUDS_26A1Byte2E_signal" 1054 "SIGNALS_Virtual_DcmDspUDS_26A1Byte2F_signal" 1055 "SIGNALS_Virtual_DcmDspUDS_26A1Byte30_signal" 1056 "SIGNALS_Virtual_DcmDspUDS_26A1Byte31_signal" 1057 "SIGNALS_Virtual_DcmDspUDS_26A1Byte32_signal" 1058 "SIGNALS_Virtual_DcmDspUDS_26A1Byte33_signal" 1059 "SIGNALS_Virtual_DcmDspUDS_26A1Byte34_signal" 1060 "SIGNALS_Virtual_DcmDspUDS_26A1Byte35_signal" 1061 "SIGNALS_Virtual_DcmDspUDS_26A1Byte36_signal" 1062 "SIGNALS_Virtual_DcmDspUDS_26A1Byte37_signal" 1063 "SIGNALS_Virtual_DcmDspUDS_26A1Byte38_signal" 1064 "SIGNALS_Virtual_DcmDspUDS_26A1Byte39_signal" 1065 "SIGNALS_Virtual_DcmDspUDS_26A1Byte6F_70_signal" 1066 "SIGNALS_Virtual_DcmDspUDS_26A1Byte71_72_signal" 1067 "SIGNALS_Virtual_DcmDspUDS_26A1Byte73_74_signal" 1068 "SIGNALS_Virtual_DcmDspUDS_26A1Byte75_76_signal" 1069 "SIGNALS_Virtual_DcmDspUDS_26A1Byte77_78_signal" 1070 "SIGNALS_Virtual_DcmDspUDS_26A1Byte79_signal" 1071 "SIGNALS_Virtual_DcmDspUDS_26A1Byte7B_signal" 1072 "SIGNALS_Virtual_DcmDspUDS_26A2Byte00_signal" 1073 "SIGNALS_Virtual_DcmDspUDS_26A2Byte01_signal" 1074 "SIGNALS_Virtual_DcmDspUDS_26A2Byte02_signal" 1075 "SIGNALS_Virtual_DcmDspUDS_26A2Byte03_signal" 1076 "SIGNALS_Virtual_DcmDspUDS_26A2Byte04_signal" 1077 "SIGNALS_Virtual_DcmDspUDS_26A2Byte05_signal" 1078 "SIGNALS_Virtual_DcmDspUDS_26A2Byte12_13_signal" 1079 "SIGNALS_Virtual_DcmDspUDS_26A2Byte1C_signal" 1080 "SIGNALS_Virtual_DcmDspUDS_26A2Byte1D_signal" 1081 "SIGNALS_Virtual_DcmDspUDS_26A2Byte21_signal" 1082 "SIGNALS_Virtual_DcmDspUDS_26A2Byte22_signal" 1083 "SIGNALS_Virtual_DcmDspUDS_Acm_fzabgs_w_signal" 1084 "SIGNALS_Virtual_DcmDspUDS_DID_2613Byte2Eto2F_signal_VirtFunc_s" 1085 "SIGNALS_Virtual_DcmDspUDS_DID_261AByte08_signal" 1086 "SIGNALS_Virtual_DcmDspUDS_DID_261AByte09_signal" 1087 "SIGNALS_Virtual_DcmDspUDS_DID_E402Byte00_signal" 1088 "SIGNALS_Virtual_DcmDspUDS_DID_E402Byte01_signal" 1089 "SIGNALS_Virtual_DcmDspUDS_DID_E402Byte07to08_signal" 1090 "SIGNALS_Virtual_DcmDspUDS_DID_E402Byte10to11_signal" 1091 "SIGNALS_Virtual_DcmDspUDS_DID_E402Byte19to1A_signal" 1092 "SIGNALS_Virtual_DcmDspUDS_DID_E402Byte22to23_signal" 1093 "SIGNALS_Virtual_DcmDspUDS_DID_E402Byte2Bto2C_signal" 1094 "SIGNALS_Virtual_DcmDspUDS_DID_F110Byte0_3_signal" 1095 "SIGNALS_Virtual_DcmDspUDS_DID_F110Byte12_15_signal" 1096 "SIGNALS_Virtual_DcmDspUDS_DID_F110Byte16_signal" 1097 "SIGNALS_Virtual_DcmDspUDS_DID_F110Byte4_7_signal" 1098 "SIGNALS_Virtual_DcmDspUDS_DID_F110Byte8_11_signal" 1099 "SIGNALS_Virtual_DcmDspUDS_DID_F112Byte0_3_signal" 1100 "SIGNALS_Virtual_DcmDspUDS_DID_F112Byte12_15_signal" 1101 "SIGNALS_Virtual_DcmDspUDS_DID_F112Byte16_19_signal" 1102 "SIGNALS_Virtual_DcmDspUDS_DID_F112Byte20_23_signal" 1103 "SIGNALS_Virtual_DcmDspUDS_DID_F112Byte24_27_signal" 1104 "SIGNALS_Virtual_DcmDspUDS_DID_F112Byte28_29_signal" 1105 "SIGNALS_Virtual_DcmDspUDS_DID_F112Byte30_signal" 1106 "SIGNALS_Virtual_DcmDspUDS_DID_F112Byte4_7_signal" 1107 "SIGNALS_Virtual_DcmDspUDS_DID_F112Byte8_11_signal" 1108 "SIGNALS_Virtual_DcmDspUDS_E602Byte2_signal" 1109 "SIGNALS_Virtual_DcmDspUDS_F181Byte0_3_signal" 1110 "SIGNALS_Virtual_DcmDspUDS_F181Byte12_15_signal" 1111 "SIGNALS_Virtual_DcmDspUDS_F181Byte4_7_signal" 1112 "SIGNALS_Virtual_DcmDspUDS_F181Byte8_11_signal" 1113 "SIGNALS_Virtual_DcmDspUDS_fzabgs_w_signal" 1114 "SIGNALS_Virtual_DcmDspUDS_numReWrECUID1_signal" 1115 "SIGNALS_Virtual_DcmDspUDS_numReWrECUID2_signal" 1116 "SIGNALS_Virtual_I14229B9_0490_FrNo09_signal" 1117 "SIGNALS_Virtual_I14229B9_0490_FrNo10_signal" 1118 "SIGNALS_Virtual_I14229B9_04B1_FrNo16_signal" 1119 "SIGNALS_Virtual_I14229B9_04B1_FrNo17_signal" 1120 "SIGNALS_Virtual_I14229B9_04B1_FrNo20_signal" 1121 "SIGNALS_Virtual_I14229B9_04B1_FrNo21_signal" 1122 "SIGNALS_Virtual_I14229B9_04B1_FrNo22_signal" 1123 "SIGNALS_Virtual_I14229B9_04B1_FrNo23_signal" 1124 "SIGNALS_Virtual_I14229B9_04C2_FrNo2021_signal" 1125 "SIGNALS_Virtual_I14229B9_04D2_FrNo24_signal" 1126 "SIGNALS_Virtual_I14229B9_04D2_FrNo25_signal" 1127 "SIGNALS_Virtual_I14229B9_0520_FrNo15_signal" 1128 "SIGNALS_Virtual_I14229B9_0520_FrNo16_signal" 1129 "SIGNALS_Virtual_I14229B9_0523_FrNo42_signal" 1130 "SIGNALS_Virtual_I14229B9_0523_FrNo43_signal" 1131 "SIGNALS_Virtual_I14229B9_0524_FrNo09_signal" 1132 "SIGNALS_Virtual_I14229B9_0524_FrNo10_signal" 1133 "SIGNALS_Virtual_I14229B9_0550_FrNo09_signal" 1134 "SIGNALS_Virtual_I14229B9_0550_FrNo10_signal" 1135 "SIGNALS_Virtual_I14229B9_0553_FrNo13_signal" 1136 "SIGNALS_Virtual_I14229B9_0553_FrNo14_signal" 1137 "SIGNALS_Virtual_I14229B9_056A_FrNo8_signal" 1138 "SIGNALS_Virtual_I14229B9_056A_FrNo9_signal" 1139 "SIGNALS_Virtual_I14229B9_0588_FrNo15_signal" 1140 "SIGNALS_Virtual_I14229B9_0588_FrNo16_signal" 1141 "SIGNALS_Virtual_I14229B9_05A0_FrNo40_signal" 1142 "SIGNALS_Virtual_I14229B9_05A0_FrNo41_signal" 1143 "SIGNALS_Virtual_I14229B9_05B0_FrNo13_signal" 1144 "SIGNALS_Virtual_I14229B9_05B0_FrNo14_signal" 1145 "SIGNALS_Virtual_I14229B9_05C0_FrNo12_signal" 1146 "SIGNALS_Virtual_I14229B9_05C0_FrNo13_signal" 1147 "SIGNALS_Virtual_I14229B9_05E0_FrNo19_signal" 1148 "SIGNALS_Virtual_I14229B9_05E0_FrNo20_signal" 1149 "SIGNALS_Virtual_I14229B9_05E0_FrNo21_signal" 1150 "SIGNALS_Virtual_I14229B9_05E0_FrNo22_signal" 1151 "SIGNALS_Virtual_I14229B9_05E0_FrNo23_signal" 1152 "SIGNALS_Virtual_I14229B9_05E0_FrNo24_signal" 1153 "SIGNALS_Virtual_I14229B9_1208_FrNo34_signal" 1154 "SIGNALS_Virtual_I14229B9_1208_FrNo35_signal" 1155 "SIGNALS_Virtual_I14229B9_1208_FrNo36_signal" 1156 "SIGNALS_Virtual_I14229B9_1208_FrNo37_signal" 1157 "SIGNALS_Virtual_I14229B9_120A_FrNo09_signal" 1158 "SIGNALS_Virtual_I14229B9_120A_FrNo10_signal" 1159 "SIGNALS_Virtual_I14229B9_120B_FrNo09_signal" 1160 "SIGNALS_Virtual_I14229B9_120B_FrNo10_signal" 1161 "SIGNALS_Virtual_I14229_Com_aLgtG_signal" 1162 "SIGNALS_Virtual_I14229_pEngSrtMin_signal" 1163 "SIGNALS_Virtual_IKCtl_agAdpnCurr_s16_signal" 1164 "SIGNALS_Virtual_IKCtl_wIntgRef_au32_0__s" 1165 "SIGNALS_Virtual_PtCoornDyn_tqCluDes_signal" 1166 "SIGNALS_Virtual_PtCoornDyn_tqCluLeadTrsmIntv_signal" 1167 "SIGNALS_Virtual_Tra_numGear_signal" 1168 "SIGNALS_Virtual_i14229_agIntkB1GEVlvSig_signal" /end COMPU_VTAB
/begin RECORD_LAYOUT ValA_Wu16 FNC_VALUES 1 UWORD COLUMN_DIR DIRECT /end RECORD_LAYOUT
/begin RECORD_LAYOUT Val_Wu16 FNC_VALUES 1 UWORD COLUMN_DIR DIRECT /end RECORD_LAYOUT
/begin RECORD_LAYOUT Val_Wu8 FNC_VALUES 1 UBYTE COLUMN_DIR DIRECT /end RECORD_LAYOUT
/end MODULE
/end PROJECT
