ASAP2_VERSION 1 60
/begin PROJECT MG1CS022 "MG1CS022"
/begin HEADER "" VERSION "MG1CS022_62XSC_V036_TPROT" PROJECT_NO MG1CS022 /end HEADER
/begin MODULE DIM ""
/begin MOD_COMMON "" BYTE_ORDER MSB_LAST ALIGNMENT_BYTE 1 ALIGNMENT_WORD 2 ALIGNMENT_LONG 4 ALIGNMENT_INT64 4 ALIGNMENT_FLOAT32_IEEE 4 ALIGNMENT_FLOAT64_IEEE 4 DATA_SIZE 32 /end MOD_COMMON
/begin CHARACTERISTIC CoETM_facAftRun2_C "calculate the second after run time by scaling down the initial after run time" VALUE 0x8052767C RB_Val_Ws16 7.999878 Fact -4.000000 3.999878 FORMAT "%8.6" /end CHARACTERISTIC
/begin CHARACTERISTIC CoETM_facClgAftRunTEnv_CUR "Factor for cooling after run Environment Temperatuer" CURVE 0x8052767E RB_Curve_S16_S16 511.9922 Fact1 -256.0000 255.9922 FORMAT "%8.4"
 /begin AXIS_DESCR STD_AXIS GlbDa_tEnv Temp_Cels 3 -3549.940 3003.560 FORMAT "%8.3" DEPOSIT ABSOLUTE /end AXIS_DESCR
/end CHARACTERISTIC
/begin CHARACTERISTIC CoETM_facClgAftRun_CUR "Factor for fading duty cycle during afterun" CURVE 0x8052768C RB_Curve_S16_S16 7.999878 Fact -4.000000 3.999878 FORMAT "%8.6"
 /begin AXIS_DESCR STD_AXIS CoETM_tiClgAftRun_mp Time_s 5 -327.6800 327.6700 FORMAT "%8.4" DEPOSIT ABSOLUTE /end AXIS_DESCR
/end CHARACTERISTIC
/begin CHARACTERISTIC CoETM_rClgAftRun_MAP "Determinaton of thermal capacity in the afterrun" MAP 0x805276A2 RB_Map_S16S16_S16 799.9878 Prc -400.0000 399.9878 FORMAT "%8.4"
 /begin AXIS_DESCR STD_AXIS CoETM_tClntEngOut_mp Temp_Cels 3 -3549.940 3003.560 FORMAT "%8.3" DEPOSIT ABSOLUTE /end AXIS_DESCR
 /begin AXIS_DESCR STD_AXIS GlbDa_tEnv Temp_Cels 3 -3549.940 3003.560 FORMAT "%8.3" DEPOSIT ABSOLUTE /end AXIS_DESCR
/end CHARACTERISTIC
/begin CHARACTERISTIC CoETM_rClgDemFan_CUR "cooling demand for Fan" CURVE 0x805276C4 RB_Curve_S16_S16 799.9878 Prc -400.0000 399.9878 FORMAT "%8.4"
 /begin AXIS_DESCR STD_AXIS CoETM_rClgDemLim_mp Prc 5 -400.0000 399.9878 FORMAT "%8.4" DEPOSIT ABSOLUTE /end AXIS_DESCR
/end CHARACTERISTIC
/begin CHARACTERISTIC CoETM_rClgDemMax_C "max. required cooling power" VALUE 0x805276DA RB_Val_Ws16 799.9878 Prc -400.0000 399.9878 FORMAT "%8.4" /end CHARACTERISTIC
/begin CHARACTERISTIC CoETM_rClgDemMin_C "min. required cooling power" VALUE 0x805276DC RB_Val_Ws16 799.9878 Prc -400.0000 399.9878 FORMAT "%8.4" /end CHARACTERISTIC
/begin CHARACTERISTIC CoETM_rClgIntegMax_C "max. integral part of cooling power" VALUE 0x805276DE RB_Val_Ws16 799.9878 Prc -400.0000 399.9878 FORMAT "%8.4" /end CHARACTERISTIC
/begin CHARACTERISTIC CoETM_rClgIntegMin_C "min. integral part of cooling power" VALUE 0x805276E0 RB_Val_Ws16 799.9878 Prc -400.0000 399.9878 FORMAT "%8.4" /end CHARACTERISTIC
/begin CHARACTERISTIC CoETM_rClgKi_CUR "gain factor for integral controller for ETM_rClgDem" CURVE 0x805276E2 RB_Curve_S16_S16 799.9878 Prc -400.0000 399.9878 FORMAT "%8.4"
 /begin AXIS_DESCR STD_AXIS CoETM_tDvt_mp TempDiff_Kelv 3 -3276.800 3276.700 FORMAT "%8.3" DEPOSIT ABSOLUTE /end AXIS_DESCR
/end CHARACTERISTIC
/begin CHARACTERISTIC CoETM_rClgKp_CUR "gain factor for proportional controller for ETM_rClgDem" CURVE 0x805276F0 RB_Curve_S16_S16 799.9878 Prc -400.0000 399.9878 FORMAT "%8.4"
 /begin AXIS_DESCR STD_AXIS CoETM_tDvt_mp TempDiff_Kelv 3 -3276.800 3276.700 FORMAT "%8.3" DEPOSIT ABSOLUTE /end AXIS_DESCR
/end CHARACTERISTIC
/begin CHARACTERISTIC CoETM_swtSrc_C "switch for source of calculation of desired temperature" VALUE 0x805276FE RB_Val_Wu8 255.0 OneToOne 0.00 255.0 FORMAT "%5.1" /end CHARACTERISTIC
/begin CHARACTERISTIC CoETM_tAftRunAbrt_C "Time constant for aborting after-run phase 2" VALUE 0x80527700 RB_Val_Ws16 3276.700 Temp_Cels -273.140 3003.560 FORMAT "%8.3" EXTENDED_LIMITS -3549.940 3003.560 /end CHARACTERISTIC
/begin CHARACTERISTIC CoETM_tClntEngOutStg1Max_C "maximal temperaturelevel stage1" VALUE 0x80527702 RB_Val_Ws16 6553.500 Temp_Cels -3549.940 3003.560 FORMAT "%8.3" /end CHARACTERISTIC
/begin CHARACTERISTIC CoETM_tClntEngOutStg1Min_C "minimal temperaturelevel stage1" VALUE 0x80527704 RB_Val_Ws16 6553.500 Temp_Cels -3549.940 3003.560 FORMAT "%8.3" /end CHARACTERISTIC
/begin CHARACTERISTIC CoETM_tClntEngOutStg2Max_C "maximal temperaturelevel stage2" VALUE 0x80527706 RB_Val_Ws16 6553.500 Temp_Cels -3549.940 3003.560 FORMAT "%8.3" /end CHARACTERISTIC
/begin CHARACTERISTIC CoETM_tClntEngOutStg2Min_C "minimal temperaturelevel stage2" VALUE 0x80527708 RB_Val_Ws16 6553.500 Temp_Cels -3549.940 3003.560 FORMAT "%8.3" /end CHARACTERISTIC
/begin CHARACTERISTIC CoETM_tDvtMax_C "max. deviation coolant temp. to calculate I-part" VALUE 0x8052770A RB_Val_Ws16 6553.500 TempDiff_Kelv -3276.800 3276.700 FORMAT "%8.3" /end CHARACTERISTIC
/begin CHARACTERISTIC CoETM_tDvtMin_C "min. deviation coolant temp. to calculate I-part" VALUE 0x8052770C RB_Val_Ws16 6553.500 TempDiff_Kelv -3276.800 3276.700 FORMAT "%8.3" /end CHARACTERISTIC
/begin CHARACTERISTIC CoETM_tDvtStg0_C "deviation to activate fan stage 0" VALUE 0x8052770E RB_Val_Ws16 6553.500 TempDiff_Kelv -3276.800 3276.700 FORMAT "%8.3" /end CHARACTERISTIC
/begin CHARACTERISTIC CoETM_tDvtStg1_C "deviation to activate fan stage 1" VALUE 0x80527710 RB_Val_Ws16 6553.500 TempDiff_Kelv -3276.800 3276.700 FORMAT "%8.3" /end CHARACTERISTIC
/begin CHARACTERISTIC CoETM_tDvtStg2_C "deviation to activate fan stage 2" VALUE 0x80527712 RB_Val_Ws16 6553.500 TempDiff_Kelv -3276.800 3276.700 FORMAT "%8.3" /end CHARACTERISTIC
/begin CHARACTERISTIC CoETM_tEngOutSubsOff_C "Substitute value of coolant temp. at engine outlet after engine stop" VALUE 0x80527714 RB_Val_Ws16 6553.500 Temp_Cels -3549.940 3003.560 FORMAT "%8.3" /end CHARACTERISTIC
/begin CHARACTERISTIC CoETM_tiClgAftRun2_MAP "delivers second after run time" MAP 0x80527716 RB_Map_S16S16_U16 327.6700 Time_s 0.00 327.6700 FORMAT "%8.4" EXTENDED_LIMITS 0.00 655.3500
 /begin AXIS_DESCR STD_AXIS CoETM_tEngOutOff_mp Temp_Cels 3 -3549.940 3003.560 FORMAT "%8.3" DEPOSIT ABSOLUTE /end AXIS_DESCR
 /begin AXIS_DESCR STD_AXIS GlbDa_tEnv Temp_Cels 3 -3549.940 3003.560 FORMAT "%8.3" DEPOSIT ABSOLUTE /end AXIS_DESCR
/end CHARACTERISTIC
/begin CHARACTERISTIC CoETM_tiClgAftRunCons_MAP "Determining after-run time depending on fuel consumption" MAP 0x80527738 RB_Map_S16S16_U16 655.3500 Time_s 0.00 655.3500 FORMAT "%8.4"
 /begin AXIS_DESCR STD_AXIS CoETM_tEngOutOff_mp Temp_Cels 3 -3549.940 3003.560 FORMAT "%8.3" DEPOSIT ABSOLUTE /end AXIS_DESCR
 /begin AXIS_DESCR STD_AXIS FlSys_dvolFlCons FlConsum_l_h 3 -327.6800 327.6700 FORMAT "%8.4" DEPOSIT ABSOLUTE /end AXIS_DESCR
/end CHARACTERISTIC
/begin CHARACTERISTIC CoETM_tiClgAftRunOil_CUR "Determining after-run time depending on oil temperature" CURVE 0x8052775A RB_Curve_S16_S16 327.6700 Time_s 0.00 327.6700 FORMAT "%8.4" EXTENDED_LIMITS -327.6800 327.6700
 /begin AXIS_DESCR STD_AXIS Oil_tSwmp Temp_Cels 3 -3549.940 3003.560 FORMAT "%8.3" DEPOSIT ABSOLUTE /end AXIS_DESCR
/end CHARACTERISTIC
/begin CHARACTERISTIC CoETM_tiClgAftRun_MAP "delivers after run time" MAP 0x80527768 RB_Map_S16S16_U16 655.3500 Time_s 0.00 655.3500 FORMAT "%8.4"
 /begin AXIS_DESCR STD_AXIS CoETM_tEngOutOff_mp Temp_Cels 3 -3549.940 3003.560 FORMAT "%8.3" DEPOSIT ABSOLUTE /end AXIS_DESCR
 /begin AXIS_DESCR STD_AXIS GlbDa_tEnv Temp_Cels 3 -3549.940 3003.560 FORMAT "%8.3" DEPOSIT ABSOLUTE /end AXIS_DESCR
/end CHARACTERISTIC
/begin CHARACTERISTIC CoETM_tiClgIntegT1_C "time factor for integral controller" VALUE 0x8052778C RB_Val_Ws32 4294.9672940000000 TimeDelay_s 0.0000020000000 4294.9672959999998 FORMAT "%19.14" EXTENDED_LIMITS 0.000002000000001 4294.9672959999998 /end CHARACTERISTIC
/begin CHARACTERISTIC CoETS_bFltDemLeadEnf_C "Calibration to enforce demand for torque in lead path" VALUE 0x80527790 RB_Val_Wboolean 1.00000000000 B_TRUE 0.00 1.00000000000 FORMAT "%13.11" /end CHARACTERISTIC
/begin CHARACTERISTIC CoETS_flgActvMaxTqActMod_C "The flag indicates the filtered desired lead torque or the maximum torque value to determine the engine operating mode." VALUE 0x80527796 RB_Val_Wboolean 1.00000000000 B_TRUE 0.00 1.00000000000 FORMAT "%13.11" /end CHARACTERISTIC
/begin CHARACTERISTIC CoETS_nTrqRatMin_C "Threshold for calculation of torque ratio" VALUE 0x80527794 RB_Val_Ws16 32767.50 EngN -16384.00 16383.50 FORMAT "%8.2" /end CHARACTERISTIC
/begin CHARACTERISTIC CoETS_stFltIntvEnd_CW "Calibration: Request of filtering the end of an intervention by the driveability filter." VALUE 0x80527792 RB_Val_Wu16 65535.00 dez 0.00 65535.00 FORMAT "%8.2" /end CHARACTERISTIC
/begin CHARACTERISTIC CoETS_stTqInpCfg_C "Parameter to select necessary torque" VALUE 0x80527797 RB_Val_Wboolean 1.00000000000 B_TRUE 0.00 1.00000000000 FORMAT "%13.11" /end CHARACTERISTIC
/begin CHARACTERISTIC CoETS_tiLpT1_C "Time constant for the Low pass filter1 with desired lead torque as input" VALUE 0x80527798 RB_Val_Wu16 655.34999985 zk10msxs_uw_b655p36 0.01000015 655.36000000 FORMAT "%12.8" EXTENDED_LIMITS 0.010000152590 655.36000000 /end CHARACTERISTIC
/begin CHARACTERISTIC CoETS_tiLpT2_C "Time constant for the Low pass filter2 with desired lead torque as input" VALUE 0x8052779A RB_Val_Wu16 655.34999985 zk10msxs_uw_b655p36 0.01000015 655.36000000 FORMAT "%12.8" EXTENDED_LIMITS 0.010000152590 655.36000000 /end CHARACTERISTIC
/begin CHARACTERISTIC ComEBS_chNomCapBattSens_C "Initalize physical value of nominal capacity of battery" VALUE 0x80532E14 RB_Val_Ws16 65535.00 AmpHrs_Ah -32768.00 32767.00 FORMAT "%8.2" /end CHARACTERISTIC
/begin CHARACTERISTIC ComEBS_rBattSensCh_C "Initalize value for status Of Charge" VALUE 0x80532E16 RB_Val_Ws16 799.9878 Prc -400.0000 399.9878 FORMAT "%8.4" /end CHARACTERISTIC
/begin CHARACTERISTIC ComEBS_rBattSensSOH_C "Slope of state of health of EBS" VALUE 0x80532E18 RB_Val_Ws16 799.9878 Prc -400.0000 399.9878 FORMAT "%8.4" /end CHARACTERISTIC
/begin CHARACTERISTIC ComEBS_stBattCrntRng_C "Init value for 2 bits Battery Current Range value Received from EBS" VALUE 0x80532E1A RB_Val_Wu8 255.0 OneToOne 0.00 255.0 FORMAT "%5.1" /end CHARACTERISTIC
/begin CHARACTERISTIC ComEBS_stBattSensFlagIni_C "Battery state flag init value" VALUE 0x80532E1B RB_Val_Wu8 255.0 OneToOne 0.00 255.0 FORMAT "%5.1" /end CHARACTERISTIC
/begin CHARACTERISTIC ComEBS_stEBSInvld_C "Initalize for Error flag from EBS sensor indicating the COM communication problem with ECU" VALUE 0x80532E1C RB_Val_Wu8 255.0 OneToOne 0.00 255.0 FORMAT "%5.1" /end CHARACTERISTIC
/begin CHARACTERISTIC ComEBS_stLinRespErr_C "Init value for COM sensor signals response error" VALUE 0x80532E1D RB_Val_Wu8 255.0 OneToOne 0.00 255.0 FORMAT "%5.1" /end CHARACTERISTIC
/begin CHARACTERISTIC ComEBS_tBattSens_C "Init value for Battery temperature received from EBS" VALUE 0x80532E1E RB_Val_Wu16 32767.50 Temp_Fatc -40.00 32727.50 FORMAT "%8.2" /end CHARACTERISTIC
/begin CHARACTERISTIC ComEBS_uBattSensSOF_C "Slope of state of function of EBS" VALUE 0x80532E20 RB_Val_Ws16 65.53500 spg_q0p001 -32.76800 32.76700 FORMAT "%8.5" /end CHARACTERISTIC
/begin CHARACTERISTIC ComEBS_uBattSens_C "Init value for 14 bits Battery Voltage Received from EBS" VALUE 0x80532E22 RB_Val_Ws16 65.53500 spg_q0p001 -32.76800 32.76700 FORMAT "%8.5" /end CHARACTERISTIC
/begin AXIS_PTS CoME_calEngSpeed_AXIS "Axis for CoME group curves" 0x80528220 Epm_nEng RB_Axis_S16 32767.50 EngN 5 -16384.00 16383.50 FORMAT "%8.2" DEPOSIT ABSOLUTE /end AXIS_PTS
/begin CHARACTERISTIC CoME_drPedHi_C "Gradient of maximum accelerator pedal value (lower hysteresis value)" VALUE 0x8052822C RB_Val_Ws16 39999.39 PrcPerSec -20000.00 19999.39 FORMAT "%8.2" /end CHARACTERISTIC
/begin CHARACTERISTIC CoME_drPedLo_C "Gradient of maximum accelerator pedal value (lower hysteresis value)" VALUE 0x8052822E RB_Val_Ws16 39999.39 PrcPerSec -20000.00 19999.39 FORMAT "%8.2" /end CHARACTERISTIC
/begin CHARACTERISTIC CoME_nEng1Hi_C "Minimum engine speed (upper hysteresis value - 1)" VALUE 0x80528230 RB_Val_Ws16 32767.50 EngN -16384.00 16383.50 FORMAT "%8.2" /end CHARACTERISTIC
/begin CHARACTERISTIC CoME_nEng1Lo_C "Minimum engine speed (lower hysteresis value - 1)" VALUE 0x80528232 RB_Val_Ws16 32767.50 EngN -16384.00 16383.50 FORMAT "%8.2" /end CHARACTERISTIC
/begin CHARACTERISTIC CoME_nEng2Hi_C "Minimum engine speed (lower hysteresis value - 2)" VALUE 0x80528234 RB_Val_Ws16 32767.50 EngN -16384.00 16383.50 FORMAT "%8.2" /end CHARACTERISTIC
/begin CHARACTERISTIC CoME_nEng2Lo_C "Minimum engine speed (lower hysteresis value - 2)" VALUE 0x80528236 RB_Val_Ws16 32767.50 EngN -16384.00 16383.50 FORMAT "%8.2" /end CHARACTERISTIC
/begin CHARACTERISTIC CoME_nMinRrDfog_C "Min. engine speed request for Rear Defogger" VALUE 0x80528218 RB_Val_Ws16 32767.50 EngN -16384.00 16383.50 FORMAT "%8.2" /end CHARACTERISTIC
/begin CHARACTERISTIC CoME_numTraGearMax_C "Minimum gear number" VALUE 0x80528238 RB_Val_Wu8 255.0 OneToOne 0.00 255.0 FORMAT "%5.1" /end CHARACTERISTIC
/begin CHARACTERISTIC CoME_pEnv1Hi_C "Minimum environmental pressure (upper hysteresis value - 1)" VALUE 0x8052823A RB_Val_Ws16 65535.00 Pres_hPa -32768.00 32767.00 FORMAT "%8.2" /end CHARACTERISTIC
/begin CHARACTERISTIC CoME_pEnv1Lo_C "Minimum environmental pressure (lower hysteresis value - 1)" VALUE 0x8052823C RB_Val_Ws16 65535.00 Pres_hPa -32768.00 32767.00 FORMAT "%8.2" /end CHARACTERISTIC
/begin CHARACTERISTIC CoME_pEnv2Hi_C "Minimum environmental pressure (upper hysteresis value - 2)" VALUE 0x8052823E RB_Val_Ws16 65535.00 Pres_hPa -32768.00 32767.00 FORMAT "%8.2" /end CHARACTERISTIC
/begin CHARACTERISTIC CoME_pEnv2Lo_C "Minimum environmental pressure (lower hysteresis value - 2)" VALUE 0x80528240 RB_Val_Ws16 65535.00 Pres_hPa -32768.00 32767.00 FORMAT "%8.2" /end CHARACTERISTIC
/begin CHARACTERISTIC CoME_rPedHi_C "Maximum accelerator pedal value (upper hysteresis value)" VALUE 0x80528242 RB_Val_Ws16 799.9878 Prc -400.0000 399.9878 FORMAT "%8.4" /end CHARACTERISTIC
/begin CHARACTERISTIC CoME_rPedLo_C "Maximum accelerator pedal value (lower hysteresis value)" VALUE 0x80528244 RB_Val_Ws16 799.9878 Prc -400.0000 399.9878 FORMAT "%8.4" /end CHARACTERISTIC
/begin CHARACTERISTIC CoME_stAlt_CW "Status: Alternator shut-off conditions" VALUE 0x80528246 RB_Val_Wu8 255.0 OneToOne 0.00 255.0 FORMAT "%5.1" /end CHARACTERISTIC
/begin CHARACTERISTIC CoME_stEEM_C "Status: Electrical energy management" VALUE 0x80528247 RB_Val_Wu8 1.00000000000 B_TRUE 0.00 1.00000000000 FORMAT "%13.11" /end CHARACTERISTIC
/begin CHARACTERISTIC CoME_stFan_CW "Status: Fan switch-off conditions" VALUE 0x80528248 RB_Val_Wu8 255.0 OneToOne 0.00 255.0 FORMAT "%5.1" /end CHARACTERISTIC
/begin CHARACTERISTIC CoME_stNReqESS_C "Status of the speed demand for Minimum engine speed request from Electrical Supply System" VALUE 0x8052821A RB_Val_Wu8 255.0 OneToOne 0.00 255.0 FORMAT "%5.1" /end CHARACTERISTIC
/begin CHARACTERISTIC CoME_stNReqRrDfog_C "Status of Engine speed demand for Rear Defogger" VALUE 0x8052821B RB_Val_Wu8 255.0 OneToOne 0.00 255.0 FORMAT "%5.1" /end CHARACTERISTIC
/begin CHARACTERISTIC CoME_stNReqTSAC_C "Status of the idle speed demand request" VALUE 0x8052821C RB_Val_Wu8 255.0 OneToOne 0.00 255.0 FORMAT "%5.1" /end CHARACTERISTIC
/begin CHARACTERISTIC CoME_stNReqTS_C "Status of the speed demand for Lowest engine speed requested by the thermal system" VALUE 0x8052821D RB_Val_Wu8 255.0 OneToOne 0.00 255.0 FORMAT "%5.1" /end CHARACTERISTIC
/begin CHARACTERISTIC CoME_stNReqVehMot_C "Status of the speed demand for Minimum engine speed demand by Vehicle accessories" VALUE 0x8052821E RB_Val_Wu8 255.0 OneToOne 0.00 255.0 FORMAT "%5.1" /end CHARACTERISTIC
/begin CHARACTERISTIC CoME_tEnvAir1Hi_C "Minimum environmental air temperature (upper hysteresis value - 1)" VALUE 0x8052824A RB_Val_Ws16 6553.500 Temp_Cels -3549.940 3003.560 FORMAT "%8.3" /end CHARACTERISTIC
/begin CHARACTERISTIC CoME_tEnvAir1Lo_C "Maximum environmental air temperature (lower hysteresis value - 1)" VALUE 0x8052824C RB_Val_Ws16 6553.500 Temp_Cels -3549.940 3003.560 FORMAT "%8.3" /end CHARACTERISTIC
/begin CHARACTERISTIC CoME_tEnvAir2Hi_C "Maximum environmental air temperature (upper hysteresis value - 2)" VALUE 0x8052824E RB_Val_Ws16 6553.500 Temp_Cels -3549.940 3003.560 FORMAT "%8.3" /end CHARACTERISTIC
/begin CHARACTERISTIC CoME_tEnvAir2Lo_C "Maximum environmental air temperature (lower hysteresis value - 2)" VALUE 0x80528250 RB_Val_Ws16 6553.500 Temp_Cels -3549.940 3003.560 FORMAT "%8.3" /end CHARACTERISTIC
/begin CHARACTERISTIC CoME_tiBattVltgOff_C "Minimum switch-off time because of low battery voltage" VALUE 0x80528252 RB_Val_Ws16 655.3500 Time_s -327.6800 327.6700 FORMAT "%8.4" /end CHARACTERISTIC
/begin CHARACTERISTIC CoME_tiDrvOn_C "Minimum switch-on time after switch-off because of driveaway or acceleration" VALUE 0x80528254 RB_Val_Ws16 655.3500 Time_s -327.6800 327.6700 FORMAT "%8.4" /end CHARACTERISTIC
/begin CHARACTERISTIC CoME_tiMaxOffAcc_CUR "Maximum switch-off time during acceleration" CURVE 0x80528256 RB_CurveGroup_S16 655.3500 Time_s -327.6800 327.6700 FORMAT "%8.4"
 /begin AXIS_DESCR COM_AXIS Epm_nEng EngN 5 -16384.00 16383.50 FORMAT "%8.2" AXIS_PTS_REF CoME_calEngSpeed_AXIS /end AXIS_DESCR
/end CHARACTERISTIC
/begin CHARACTERISTIC CoME_tiMaxOffDrvOff_CUR "Maximum switch-off time during drive-off" CURVE 0x80528260 RB_CurveGroup_S16 655.3500 Time_s -327.6800 327.6700 FORMAT "%8.4"
 /begin AXIS_DESCR COM_AXIS Epm_nEng EngN 5 -16384.00 16383.50 FORMAT "%8.2" AXIS_PTS_REF CoME_calEngSpeed_AXIS /end AXIS_DESCR
/end CHARACTERISTIC
/begin CHARACTERISTIC CoME_tiMinOffAcc_CUR "Minimum switch-off time during acceleration" CURVE 0x8052826A RB_CurveGroup_S16 655.3500 Time_s -327.6800 327.6700 FORMAT "%8.4"
 /begin AXIS_DESCR COM_AXIS Epm_nEng EngN 5 -16384.00 16383.50 FORMAT "%8.2" AXIS_PTS_REF CoME_calEngSpeed_AXIS /end AXIS_DESCR
/end CHARACTERISTIC
/begin CHARACTERISTIC CoME_tiMinOffDrvOff_CUR "Minimum switch-off time during drive-off" CURVE 0x80528274 RB_CurveGroup_S16 655.3500 Time_s -327.6800 327.6700 FORMAT "%8.4"
 /begin AXIS_DESCR COM_AXIS Epm_nEng EngN 5 -16384.00 16383.50 FORMAT "%8.2" AXIS_PTS_REF CoME_calEngSpeed_AXIS /end AXIS_DESCR
/end CHARACTERISTIC
/begin CHARACTERISTIC CoME_tiOffStopAC_C "Turn-off delay for leaving vehicle state STOP (for AC)" VALUE 0x8052827E RB_Val_Wu16 655.3500 Time_s 0.00 655.3500 FORMAT "%8.4" /end CHARACTERISTIC
/begin CHARACTERISTIC CoME_tiOffStopAlt_C "Turn-off delay for leaving vehicle state STOP (for alternator)" VALUE 0x80528280 RB_Val_Wu16 655.3500 Time_s 0.00 655.3500 FORMAT "%8.4" /end CHARACTERISTIC
/begin CHARACTERISTIC CoME_tiOffStopFan_C "Turn-off delay for leaving vehicle state STOP (for fan)" VALUE 0x80528282 RB_Val_Wu16 655.3500 Time_s 0.00 655.3500 FORMAT "%8.4" /end CHARACTERISTIC
/begin CHARACTERISTIC CoME_tiOffStrtAC_C "Debouncing time after engine start" VALUE 0x80528284 RB_Val_Ws16 655.3500 Time_s -327.6800 327.6700 FORMAT "%8.4" /end CHARACTERISTIC
/begin CHARACTERISTIC CoME_tiOffStrtAlt_C "Debouncing time after engine start" VALUE 0x80528286 RB_Val_Ws16 655.3500 Time_s -327.6800 327.6700 FORMAT "%8.4" /end CHARACTERISTIC
/begin CHARACTERISTIC CoME_trqAcc_C "Permissible torque consumption for AC during acceleration" VALUE 0x80528288 RB_Val_Ws16 6553.500 Trq -3276.800 3276.700 FORMAT "%8.3" /end CHARACTERISTIC
/begin CHARACTERISTIC CoME_trqACMax_C "maximum torque of AC compressor" VALUE 0x8052828A RB_Val_Ws16 6553.500 Trq -3276.800 3276.700 FORMAT "%8.3" /end CHARACTERISTIC
/begin CHARACTERISTIC CoME_trqBattVltg_C "Permissible torque consumption for AC during low battery voltage" VALUE 0x8052828C RB_Val_Ws16 6553.500 Trq -3276.800 3276.700 FORMAT "%8.3" /end CHARACTERISTIC
/begin CHARACTERISTIC CoME_trqDrvOff_C "Maximum allowed A/C torque during drive-off" VALUE 0x8052828E RB_Val_Ws16 6553.500 Trq -3276.800 3276.700 FORMAT "%8.3" /end CHARACTERISTIC
/begin CHARACTERISTIC CoME_trqStop_C "Maximum allowed AC torque during engine stop" VALUE 0x80528290 RB_Val_Ws16 6553.500 Trq -3276.800 3276.700 FORMAT "%8.3" /end CHARACTERISTIC
/begin CHARACTERISTIC CoME_trqStrt_C "Maximum allowed A/C torque during engine start" VALUE 0x80528292 RB_Val_Ws16 6553.500 Trq -3276.800 3276.700 FORMAT "%8.3" /end CHARACTERISTIC
/begin CHARACTERISTIC CoME_uBattMinHi_C "Minimum battery voltage (upper hysteresis value)" VALUE 0x80528294 RB_Val_Ws16 1310700. Volt_Batt -655360.0 655340.0 FORMAT "%8.1" /end CHARACTERISTIC
/begin CHARACTERISTIC CoME_uBattMinLo_C "Minimum battery voltage (lower hysteresis value)" VALUE 0x80528296 RB_Val_Ws16 1310700. Volt_Batt -655360.0 655340.0 FORMAT "%8.1" /end CHARACTERISTIC
/begin CHARACTERISTIC CoME_vX1Hi_C "Minimum vehicle speed (upper hysteresis value - 1)" VALUE 0x80528298 RB_Val_Ws16 655.3500 Vel -327.6800 327.6700 FORMAT "%8.4" /end CHARACTERISTIC
/begin CHARACTERISTIC CoME_vX1Lo_C "Minimum vehicle speed (lower hysteresis value - 1)" VALUE 0x8052829A RB_Val_Ws16 655.3500 Vel -327.6800 327.6700 FORMAT "%8.4" /end CHARACTERISTIC
/begin CHARACTERISTIC CoME_vX2Hi_C "Minimum vehicle speed (upper hysteresis value - 2)" VALUE 0x8052829C RB_Val_Ws16 655.3500 Vel -327.6800 327.6700 FORMAT "%8.4" /end CHARACTERISTIC
/begin CHARACTERISTIC CoME_vX2Lo_C "Minimum vehicle speed (lower hysteresis value - 2)" VALUE 0x8052829E RB_Val_Ws16 655.3500 Vel -327.6800 327.6700 FORMAT "%8.4" /end CHARACTERISTIC
/begin CHARACTERISTIC Com_cwEepSpasRst_C "Codeword to reset the SPAS autodetection status in EEPROM." VALUE 0x80532E24 RB_Val_Wu8 255.0 OneToOne 0.00 255.0 FORMAT "%5.1" /end CHARACTERISTIC
/begin CHARACTERISTIC Com_cwSpasDiagCfg_C "Codeword to configure diagnosis for SPAS" VALUE 0x80532E25 RB_Val_Wu8 255.0 OneToOne 0.00 255.0 FORMAT "%5.1" /end CHARACTERISTIC
/begin CHARACTERISTIC Com_rConvFlLvl_CUR "Curve to convert raw voltage value of fuel level to its corresponding ratio" CURVE 0x80532E26 Cur_Xs16Ws16 100.0000 Prc 0.00 100.0000 FORMAT "%8.4" EXTENDED_LIMITS -400.0000 399.9878
 /begin AXIS_DESCR STD_AXIS Com_uFlLvlRaw spg_uw_b5 6 0.00 5.000000 FORMAT "%8.6" EXTENDED_LIMITS -160.0000 159.9951 DEPOSIT ABSOLUTE /end AXIS_DESCR
/end CHARACTERISTIC
/begin CHARACTERISTIC Com_rFlLvlDfl_C "fuel level default value" VALUE 0x80532E40 Val_Ws16 799.9878 Prc -400.0000 399.9878 FORMAT "%8.4" /end CHARACTERISTIC
/begin CHARACTERISTIC Com_stFrmRxEna_CA "Enable mask for receive frames" VAL_BLK 0x80532E42 ValA_Wu8 255.0 OneToOne 0.00 255.0 FORMAT "%5.1" NUMBER 7 /end CHARACTERISTIC
/begin CHARACTERISTIC Com_stFrmRxPstDrvEna_CA "Post Drive Enable mask for receive frames" VAL_BLK 0x80532E49 ValA_Wu8 255.0 OneToOne 0.00 255.0 FORMAT "%5.1" NUMBER 7 /end CHARACTERISTIC
/begin CHARACTERISTIC Com_stFrmTxEna_CA "Enable mask for transmit frames" VAL_BLK 0x80532E50 ValA_Wu8 255.0 OneToOne 0.00 255.0 FORMAT "%5.1" NUMBER 6 /end CHARACTERISTIC
/begin CHARACTERISTIC Com_stFrmTxPstDrvEna_CA "Posr Drive Enable mask for transmit frames" VAL_BLK 0x80532E56 ValA_Wu8 255.0 OneToOne 0.00 255.0 FORMAT "%5.1" NUMBER 6 /end CHARACTERISTIC
/begin CHARACTERISTIC Com_stIMGDrvModCnvn_CA "Calibration array for IMG Drive mode" VAL_BLK 0x8058A9A8 ValA_Wu8 255.0 OneToOne 0.00 255.0 FORMAT "%5.1" NUMBER 16 /end CHARACTERISTIC
/begin CHARACTERISTIC Com_stswtBrkOper_C "Parameter to select VSA_DRV_BRKTRQ" VALUE 0x80532E5C RB_Val_Wu8 255.0 OneToOne 0.00 255.0 FORMAT "%5.1" /end CHARACTERISTIC
/begin CHARACTERISTIC Com_stSwtISABAct_C "Calibration selection for ISAB operation status" VALUE 0x80532E5D RB_Val_Wu8 255.0 OneToOne 0.00 255.0 FORMAT "%5.1" /end CHARACTERISTIC
/begin CHARACTERISTIC Com_stSwtISABEna_C "Calibration selection for ISAB permission status" VALUE 0x80532E5E RB_Val_Wu8 255.0 OneToOne 0.00 255.0 FORMAT "%5.1" /end CHARACTERISTIC
/begin CHARACTERISTIC Com_stswtVirtAPPSelSig_C "Selection switch send the virtual acc pedal ratio and virtual acc pedal ratio learned" VALUE 0x80532E5F Val_Wu8 255.0 OneToOne 0.00 255.0 FORMAT "%5.1" /end CHARACTERISTIC
/begin CHARACTERISTIC Com_stSyncSpasDetn_C "Thereshold for state of synchronization to enable SPAS diagnosis" VALUE 0x80532E60 RB_Val_Wu8 30.0000000000 Epm_stSync_State_t 0.00 30.0000000000 FORMAT "%13.10" /end CHARACTERISTIC
/begin CHARACTERISTIC Com_stVSAFIdErrWghtFac_CA "Calibration array for communicating the error value for each module" VAL_BLK 0x80532E61 ValA_Wu8 255.0 OneToOne 0.00 255.0 FORMAT "%5.1" NUMBER 28 /end CHARACTERISTIC
/begin CHARACTERISTIC Com_stVSASumTrqErrESP_C "Calibartion for ESP module for comapring the total ERROR weight value for VSA" VALUE 0x80532E7E Val_Wu16 65535.00 OneToOne 0.00 65535.00 FORMAT "%8.2" /end CHARACTERISTIC
/begin CHARACTERISTIC Com_swtACEVAMtrSwtInfo_C "Switching to AC EVA temperature from diffrent module." VALUE 0x80532E80 Val_Wu8 255.0 OneToOne 0.00 255.0 FORMAT "%5.1" /end CHARACTERISTIC
/begin CHARACTERISTIC Com_swtCANVer_C "Calibration to select the CAN generation" VALUE 0x80532E82 RB_Val_Wu16 2.000000 OneToOne 1.000000 3.000000 FORMAT "%8.6" EXTENDED_LIMITS 0.00 65535.00 /end CHARACTERISTIC
/begin CHARACTERISTIC Com_swtEnaChksAlvCntrGbxEATA_C "swich to enable check sum and alive counter of EATA" VALUE 0x80532EA0 RB_Val_Wu8 1.00000000000 B_TRUE 0.00 1.00000000000 FORMAT "%13.11" /end CHARACTERISTIC
/begin CHARACTERISTIC Com_swtEnvT_C "Switch to Select the Outside Air Temperature" VALUE 0x80532E84 Val_Wu8 255.0 OneToOne 0.00 255.0 FORMAT "%5.1" /end CHARACTERISTIC
/begin CHARACTERISTIC Com_swtSelAPPENGA_C "Selection of accelerator pedal position for ENGA frame" VALUE 0x80532E85 ValA_Wu8 255.0 OneToOne 0.00 255.0 FORMAT "%5.1" /end CHARACTERISTIC
/begin CHARACTERISTIC Com_swtSelAPPENGT_C "Selection of accelerator pedal position for ENGT frame" VALUE 0x80532E86 Val_Wu8 255.0 OneToOne 0.00 255.0 FORMAT "%5.1" /end CHARACTERISTIC
/begin CHARACTERISTIC Com_swtUnitMonEna_C "Calibration for Switch Unit Monitoring Enable" VALUE 0x80532E87 Val_Wu8 255.0 OneToOne 0.00 255.0 FORMAT "%5.1" /end CHARACTERISTIC
/begin CHARACTERISTIC Com_tiFlLvlPT1_C "Filter time constant for fuel level ratio" VALUE 0x80532E88 Val_Ws32 4294.9672940000000 TimeDelay_s 0.0000020000000 4294.9672959999998 FORMAT "%19.14" EXTENDED_LIMITS 0.000002000000001 4294.9672959999998 /end CHARACTERISTIC
/begin CHARACTERISTIC Com_tiIgnSpasDetnDly_C "Delay time to enable the SPAS diagnosis activation after ignition ON" VALUE 0x80532E8C RB_Val_Ws16 655.3500 Time_s -327.6800 327.6700 FORMAT "%8.4" /end CHARACTERISTIC
/begin CHARACTERISTIC Com_tiMonBatt_C "Delay time for monitoring of send and receive frames after battery voltage exceeds the threshold value" VALUE 0x80532E8E RB_Val_Ws16 655350.0 Time_ms -327680.0 327670.0 FORMAT "%8.1" /end CHARACTERISTIC
/begin CHARACTERISTIC Com_tiMonStrt_C "Delay time for monitoring of send and receive frames after T15 On" VALUE 0x80532E90 RB_Val_Ws16 655350.0 Time_ms -327680.0 327670.0 FORMAT "%8.1" /end CHARACTERISTIC
/begin CHARACTERISTIC Com_tiSpas2DetnThd_C "Threshold time to confirm the presence of SPAS by monitoring SPAS2 frame reception status." VALUE 0x80532E92 RB_Val_Ws16 655350.0 Time_ms -327680.0 327670.0 FORMAT "%8.1" /end CHARACTERISTIC
/begin CHARACTERISTIC Com_tiSpasDetnDly_C "Delay time for the completion of SPAS autodetection after the diagnosis enable conditions are met." VALUE 0x80532E94 RB_Val_Ws16 655.3500 Time_s -327.6800 327.6700 FORMAT "%8.4" /end CHARACTERISTIC
/begin CHARACTERISTIC Com_uBattSpasMax_C "Max threshold of battery voltage for general diagnosis condition for SPAS" VALUE 0x80532E96 RB_Val_Ws16 1310700. Volt_Batt -655360.0 655340.0 FORMAT "%8.1" /end CHARACTERISTIC
/begin CHARACTERISTIC Com_uBattSpasMin_C "Min threshold of battery voltage for general diagnosis condition for SPAS" VALUE 0x80532E98 RB_Val_Ws16 1310700. Volt_Batt -655360.0 655340.0 FORMAT "%8.1" /end CHARACTERISTIC
/begin CHARACTERISTIC Com_uMonBatt_C "Threshold for battery voltage to enable monitoring" VALUE 0x80532E9A RB_Val_Ws16 1310700. Volt_Batt -655360.0 655340.0 FORMAT "%8.1" /end CHARACTERISTIC
/begin CHARACTERISTIC Conv_facDepNTrbnNStat_CUR "Factor dependant of the turbine speed and the stationary engine speed." CURVE 0x80532EA4 RB_Curve_S16_S16 7.999878 Fact -4.000000 3.999878 FORMAT "%8.6"
 /begin AXIS_DESCR STD_AXIS Conv_rNTrbnNStat_mp TransR 6 -327.6800 327.6700 FORMAT "%8.4" DEPOSIT ABSOLUTE /end AXIS_DESCR
/end CHARACTERISTIC
/begin CHARACTERISTIC Conv_facDeptNTrbnNStat_M "Factor dependant of the turbine speed, stationary engine speed and Oil Temperature." MAP 0x80532EBE RB_Map_S16S16_S16 7.999878 Fact -4.000000 3.999878 FORMAT "%8.6"
 /begin AXIS_DESCR STD_AXIS Conv_tOil Temp_Cels 10 -3549.940 3003.560 FORMAT "%8.3" DEPOSIT ABSOLUTE /end AXIS_DESCR
 /begin AXIS_DESCR STD_AXIS Conv_rNTrbnNStat_mp TransR 10 -327.6800 327.6700 FORMAT "%8.4" DEPOSIT ABSOLUTE /end AXIS_DESCR
/end CHARACTERISTIC
/begin CHARACTERISTIC Conv_facGnTrqHiInc_C "Calibration factor for large torque increase" VALUE 0x80532FB2 Val_Ws16 511.9922 Fact1 -256.0000 255.9922 FORMAT "%8.4" /end CHARACTERISTIC
/begin CHARACTERISTIC Conv_facGnTrqResv_C "Intensity factor for the calculation of the torque reserve" VALUE 0x80532FB4 Val_Ws16 7.999878 Fact -4.000000 3.999878 FORMAT "%8.6" /end CHARACTERISTIC
/begin CHARACTERISTIC Conv_facNTrbnCorr_C "Correction factor for turbine speed" VALUE 0x80532FB6 Val_Ws16 511.9922 Fact1 -256.0000 255.9922 FORMAT "%8.4" /end CHARACTERISTIC
/begin CHARACTERISTIC Conv_facRedCnvrLoad_C "The base factor to convert torque" VALUE 0x80532FB8 Val_Ws16 1.000000 RBPtCel_fac_0p01_1 0.00 1.000000 FORMAT "%8.6" EXTENDED_LIMITS -327.6800 327.6700 /end CHARACTERISTIC
/begin CHARACTERISTIC Conv_facVelErr_C "Calibration factor for vehicle speed error" VALUE 0x80532FBA Val_Ws16 7.999878 Fact -4.000000 3.999878 FORMAT "%8.6" /end CHARACTERISTIC
/begin CHARACTERISTIC Conv_facVelNoErr_C "Calibration factor for no vehicle speed error" VALUE 0x80532FBC Val_Ws16 7.999878 Fact -4.000000 3.999878 FORMAT "%8.6" /end CHARACTERISTIC
/begin CHARACTERISTIC Conv_flgDecelTqAPSeln_C "Flag of AP status selection of torque deceleration offset" VALUE 0x80532FBE RB_Val_Wboolean 1.000 OneToOne 0.00 1.000 FORMAT "%5.3" EXTENDED_LIMITS 0.00 255.0 /end CHARACTERISTIC
/begin CHARACTERISTIC Conv_flgEnaTqResvShiftLvr_C "Flag for enabling reserve torque depending on shift lever status" VALUE 0x80532FBF Val_Wu8 1.000 OneToOne 0.00 1.000 FORMAT "%5.3" EXTENDED_LIMITS 0.00 255.0 /end CHARACTERISTIC
/begin CHARACTERISTIC Conv_flgSwtGearLvrNoGrip_C "Flag for enabling reserve torque depending on shift lever status" VALUE 0x80532FC0 Val_Wu8 1.000 OneToOne 0.00 1.000 FORMAT "%5.3" EXTENDED_LIMITS 0.00 255.0 /end CHARACTERISTIC
/begin CHARACTERISTIC Conv_flgSwtInGearSeln_C "Flag for selecting in gear information to control torque reserve end timing." VALUE 0x80532FC1 Val_Wu8 1.000 OneToOne 0.00 1.000 FORMAT "%5.3" EXTENDED_LIMITS 0.00 255.0 /end CHARACTERISTIC
/begin CHARACTERISTIC Conv_flgSwtOutGearSeln_C "Flag for selecting out gear information to control torque reserve end timing." VALUE 0x80532FC2 Val_Wu8 1.000 OneToOne 0.00 1.000 FORMAT "%5.3" EXTENDED_LIMITS 0.00 255.0 /end CHARACTERISTIC
/begin CHARACTERISTIC Conv_flgSwtSelnCURM_C "Flag for selecting Curve or Map in the calculation of converter load torque." VALUE 0x80532FC3 Val_Wu8 1.000 OneToOne 0.00 1.000 FORMAT "%5.3" EXTENDED_LIMITS 0.00 255.0 /end CHARACTERISTIC
/begin CHARACTERISTIC Conv_flgTrbnSpdDifSeln_C "Flag of turbine speed change (difference) selection of torque deceleration offset" VALUE 0x80532FC4 RB_Val_Wboolean 1.000 OneToOne 0.00 1.000 FORMAT "%5.3" EXTENDED_LIMITS 0.00 255.0 /end CHARACTERISTIC
/begin CHARACTERISTIC Conv_LvrOffDebP.tiHiLo_C "Debounce time of lever in D or R with a standing vehicle (Tra_numGear ==0) / Time for a High to Low transition" VALUE 0x8058A9B8 Kw_Ws16 65535.00 OneToOne -32768.00 32767.00 FORMAT "%8.2" /end CHARACTERISTIC
/begin CHARACTERISTIC Conv_LvrOffDebP.tiLoHi_C "Debounce time of lever in D or R with a standing vehicle (Tra_numGear ==0) / Time for a Low to High transition" VALUE 0x8058A9BA Kw_Ws16 65535.00 OneToOne -32768.00 32767.00 FORMAT "%8.2" /end CHARACTERISTIC
/begin CHARACTERISTIC Conv_LvrPosChgDRDebT.tiHiLo_C "Structure pointing to the debounce parameter of gear lever shift from drive to reverse / Time for a High to Low transition" VALUE 0x8058A9BC Kw_Ws16 65535.00 OneToOne -32768.00 32767.00 FORMAT "%8.2" /end CHARACTERISTIC
/begin CHARACTERISTIC Conv_LvrPosChgDRDebT.tiLoHi_C "Structure pointing to the debounce parameter of gear lever shift from drive to reverse / Time for a Low to High transition" VALUE 0x8058A9BE Kw_Ws16 65535.00 OneToOne -32768.00 32767.00 FORMAT "%8.2" /end CHARACTERISTIC
/begin CHARACTERISTIC Conv_LvrPosChgRDDebT.tiHiLo_C "Structure pointing to the debounce parameter of gear lever shift from reverse to drive / Time for a High to Low transition" VALUE 0x8058A9C0 Kw_Ws16 65535.00 OneToOne -32768.00 32767.00 FORMAT "%8.2" /end CHARACTERISTIC
/begin CHARACTERISTIC Conv_LvrPosChgRDDebT.tiLoHi_C "Structure pointing to the debounce parameter of gear lever shift from reverse to drive / Time for a Low to High transition" VALUE 0x8058A9C2 Kw_Ws16 65535.00 OneToOne -32768.00 32767.00 FORMAT "%8.2" /end CHARACTERISTIC
/begin CHARACTERISTIC Conv_LvrPosOffDebP.tiHiLo_C "Structure pointing to the debounce parameter / Time for a High to Low transition" VALUE 0x8058A9C4 Kw_Ws16 65535.00 OneToOne -32768.00 32767.00 FORMAT "%8.2" /end CHARACTERISTIC
/begin CHARACTERISTIC Conv_LvrPosOffDebP.tiLoHi_C "Structure pointing to the debounce parameter / Time for a Low to High transition" VALUE 0x8058A9C6 Kw_Ws16 65535.00 OneToOne -32768.00 32767.00 FORMAT "%8.2" /end CHARACTERISTIC
/begin CHARACTERISTIC Conv_nDecelTqDifThdHi_C "Turbine speed change (difference) high threshold between turbine speed and engine speed of torque deceleration offset" VALUE 0x80532FC6 RB_Val_Ws16 32767.50 EngN -16384.00 16383.50 FORMAT "%8.2" /end CHARACTERISTIC
/begin CHARACTERISTIC Conv_nDecelTqDifThdLo_C "Turbine speed change (difference) low threshold between turbine speed and engine speed of torque deceleration offset" VALUE 0x80532FC8 RB_Val_Ws16 32767.50 EngN -16384.00 16383.50 FORMAT "%8.2" /end CHARACTERISTIC
/begin CHARACTERISTIC Conv_nDecelTqThdHi_C "High difference threshold between turbine speed and engine speed of torque deceleration offset" VALUE 0x80532FCA RB_Val_Ws16 32767.50 EngN -16384.00 16383.50 FORMAT "%8.2" /end CHARACTERISTIC
/begin CHARACTERISTIC Conv_nDecelTqThdLo_C "Low difference threshold between turbine speed and engine speed of torque deceleration offset" VALUE 0x80532FCC RB_Val_Ws16 32767.50 EngN -16384.00 16383.50 FORMAT "%8.2" /end CHARACTERISTIC
/begin CHARACTERISTIC Conv_nrTrbAvrg_C "The number of raster turbine speed Average change is calculated from (1-16)" VALUE 0x80532FCE RB_Val_Wu8 255.0 OneToOne 0.00 255.0 FORMAT "%5.1" /end CHARACTERISTIC
/begin CHARACTERISTIC Conv_nTrbnLoLim_C "Lower limit turbine speed" VALUE 0x80532FD0 Val_Ws16 32767.50 EngN -16384.00 16383.50 FORMAT "%8.2" /end CHARACTERISTIC
/begin CHARACTERISTIC Conv_nTrbnMinCorrVal_C "minimum correction factor for turbine speed" VALUE 0x80532FD2 Val_Ws16 32767.50 EngN -16384.00 16383.50 FORMAT "%8.2" /end CHARACTERISTIC
/begin CHARACTERISTIC Conv_nTrbn_C "Turbine speed" VALUE 0x80532FD4 Val_Ws16 32767.50 EngN -16384.00 16383.50 FORMAT "%8.2" /end CHARACTERISTIC
/begin CHARACTERISTIC Conv_numLvrPosFwdGear_C "Lever position number of the drive gear" VALUE 0x80532FD6 Val_Wu8 255.0 OneToOne 0.00 255.0 FORMAT "%5.1" /end CHARACTERISTIC
/begin CHARACTERISTIC Conv_numLvrPosNeut_C "Lever position of the Neutral gear (dependent on the allocation of the gear lever information TT TYPE=VARIABLEGbx_stGearLvrTT)" VALUE 0x80532FD7 Val_Wu8 255.0 OneToOne 0.00 255.0 FORMAT "%5.1" /end CHARACTERISTIC
/begin CHARACTERISTIC Conv_numLvrPosPark_C "Lever position of the Parking (dependent on the allocation of the gear lever information TT TYPE=VARIABLEGbx_stGearLvrTT)" VALUE 0x80532FD8 Val_Wu8 255.0 OneToOne 0.00 255.0 FORMAT "%5.1" /end CHARACTERISTIC
/begin CHARACTERISTIC Conv_numLvrPosRevGear_C "Lever position number of the reverse gear" VALUE 0x80532FD9 Val_Wu8 255.0 OneToOne 0.00 255.0 FORMAT "%5.1" /end CHARACTERISTIC
/begin CHARACTERISTIC Conv_rDecelTqThd_C "Transmission ratio threshold of torque deceleration offset" VALUE 0x80532FDA RB_Val_Ws16 655.3500 TransR -327.6800 327.6700 FORMAT "%8.4" /end CHARACTERISTIC
/begin CHARACTERISTIC Conv_stCalcNTrbnNStat_C "status of static turbine" VALUE 0x80532FDC Val_Wu8 255.0 OneToOne 0.00 255.0 FORMAT "%5.1" /end CHARACTERISTIC
/begin CHARACTERISTIC Conv_stDecelTqBrk_C "Brake status of torque deceleration offset" VALUE 0x80532FDD RB_Val_Wu8 255.0 OneToOne 0.00 255.0 FORMAT "%5.1" /end CHARACTERISTIC
/begin CHARACTERISTIC Conv_stSwtRedCnvrLoad_C "The switch to choose the velocity factor" VALUE 0x80532FDE Val_Wu8 1.000 OneToOne 0.00 1.000 FORMAT "%5.3" EXTENDED_LIMITS 0.00 255.0 /end CHARACTERISTIC
/begin CHARACTERISTIC Conv_stTqResvDrvRevEna_C "Enable status of gear lever shift from Drive to Reverse and vice versa" VALUE 0x80532FDF Val_Wu8 1.000 OneToOne 0.00 1.000 FORMAT "%5.3" EXTENDED_LIMITS 0.00 255.0 /end CHARACTERISTIC
/begin CHARACTERISTIC Conv_swtOilCoolrOfsSel_C "Converter oil cooler offset select switch" VALUE 0x80532FE0 Val_Wu8 255.0 OneToOne 0.00 255.0 FORMAT "%5.1" /end CHARACTERISTIC
/begin CHARACTERISTIC Conv_swtOilPmpLoss_C "Oil pump loss torque selection switch" VALUE 0x80532FE1 Val_Wu8 1.000 OneToOne 0.00 1.000 FORMAT "%5.3" EXTENDED_LIMITS 0.00 255.0 /end CHARACTERISTIC
/begin CHARACTERISTIC Conv_tiDecelTqMax_C "Maximum time of torque deceleration offset" VALUE 0x80532FE2 RB_Val_Ws16 655350.0 Time_ms -327680.0 327670.0 FORMAT "%8.1" /end CHARACTERISTIC
/begin CHARACTERISTIC Conv_tiDecelTqToffd_C "Turn off delay time of torque deceleration offset" VALUE 0x80532FE4 RB_Val_Ws16 655350.0 Time_ms -327680.0 327670.0 FORMAT "%8.1" /end CHARACTERISTIC
/begin CHARACTERISTIC Conv_tiDwnRglPT1_GCUR "Filter time during the transistion of the gear selector lever from D to NP" CURVE 0x80532FE6 RB_CurveGroup_S16 10.00015 TimeDelay_s_Lin_16 -5.000153 5.000000 FORMAT "%8.6"
 /begin AXIS_DESCR COM_AXIS Conv_tOil Temp_Cels 10 -3549.940 3003.560 FORMAT "%8.3" AXIS_PTS_REF Conv_tOil_DST /end AXIS_DESCR
/end CHARACTERISTIC
/begin CHARACTERISTIC Conv_tiGearChgDRPT1_GCUR "Filter time during the transistion of the gear selector lever from D to R and vice versa" CURVE 0x80532FFA RB_CurveGroup_S16 5.000000 TimeDelay_s_Lin_16 0.00 5.000000 FORMAT "%8.6" EXTENDED_LIMITS -5.000153 5.000000
 /begin AXIS_DESCR COM_AXIS Conv_tOil Temp_Cels 10 -3549.940 3003.560 FORMAT "%8.3" AXIS_PTS_REF Conv_tOil_DST /end AXIS_DESCR
/end CHARACTERISTIC
/begin CHARACTERISTIC Conv_tiGearChgDR_C "Turn on delay time when gear lever shift from drive to reverse" VALUE 0x8053300E Val_Ws16 655350.0 Time_ms -327680.0 327670.0 FORMAT "%8.1" /end CHARACTERISTIC
/begin CHARACTERISTIC Conv_tiGearChgRD_C "Turn on delay time when gear lever shift from reverse to drive" VALUE 0x80533010 Val_Ws16 655350.0 Time_ms -327680.0 327670.0 FORMAT "%8.1" /end CHARACTERISTIC
/begin CHARACTERISTIC Conv_tiNCtrlPT1_GCUR "Filter time for N Control Curve" CURVE 0x80533012 RB_CurveGroup_S16 10.00015 TimeDelay_s_Lin_16 -5.000153 5.000000 FORMAT "%8.6"
 /begin AXIS_DESCR COM_AXIS Conv_tOil Temp_Cels 10 -3549.940 3003.560 FORMAT "%8.3" AXIS_PTS_REF Conv_tOil_DST /end AXIS_DESCR
/end CHARACTERISTIC
/begin CHARACTERISTIC Conv_tiRTraGearPT1_C "Filter time constants for turbine speed" VALUE 0x80533028 Val_Ws32 4294.9672940000000 TimeDelay_s 0.0000020000000 4294.9672959999998 FORMAT "%19.14" EXTENDED_LIMITS 0.000002000000001 4294.9672959999998 /end CHARACTERISTIC
/begin CHARACTERISTIC Conv_tiTrqLdPT1_C "Filter time constants for torque load" VALUE 0x8053302C Val_Ws32 4294.9672940000000 TimeDelay_s 0.0000020000000 4294.9672959999998 FORMAT "%19.14" EXTENDED_LIMITS 0.000002000000001 4294.9672959999998 /end CHARACTERISTIC
/begin CHARACTERISTIC Conv_tiTrqResvPT1_GCUR "Filter time constants for torque reserve" CURVE 0x80533030 RB_CurveGroup_S16 10.00015 TimeDelay_s_Lin_16 -5.000153 5.000000 FORMAT "%8.6"
 /begin AXIS_DESCR COM_AXIS Conv_tOil Temp_Cels 10 -3549.940 3003.560 FORMAT "%8.3" AXIS_PTS_REF Conv_tOil_DST /end AXIS_DESCR
/end CHARACTERISTIC
/begin CHARACTERISTIC Conv_tiUpRglPT1_GCUR "Filter time during the transistion of the gear selector lever from NP to D" CURVE 0x80533044 RB_CurveGroup_S16 10.00015 TimeDelay_s_Lin_16 -5.000153 5.000000 FORMAT "%8.6"
 /begin AXIS_DESCR COM_AXIS Conv_tOil Temp_Cels 10 -3549.940 3003.560 FORMAT "%8.3" AXIS_PTS_REF Conv_tOil_DST /end AXIS_DESCR
/end CHARACTERISTIC
/begin AXIS_PTS Conv_tOil_DST "group axis points converter oil temperature" 0x80533058 Conv_tOil RB_Axis_S16 6553.500 Temp_Cels 10 -3549.940 3003.560 FORMAT "%8.3" DEPOSIT ABSOLUTE /end AXIS_PTS
/begin CHARACTERISTIC Conv_tqDecelOffsRedn_C "Reduction amount of torque deceleration offset" VALUE 0x8053306E RB_Val_Ws16 6553.500 Trq -3276.800 3276.700 FORMAT "%8.3" /end CHARACTERISTIC
/begin CHARACTERISTIC Conv_tqDecelOffs_M "Torque map for deceleration offset" MAP 0x80533070 RB_Map_S16S16_S16 6553.500 Trq -3276.800 3276.700 FORMAT "%8.3"
 /begin AXIS_DESCR STD_AXIS NO_INPUT_QUANTITY EngN 10 -16384.00 16383.50 FORMAT "%8.2" DEPOSIT ABSOLUTE /end AXIS_DESCR
 /begin AXIS_DESCR STD_AXIS Conv_tOil Temp_Cels 6 -3549.940 3003.560 FORMAT "%8.3" DEPOSIT ABSOLUTE /end AXIS_DESCR
/end CHARACTERISTIC
/begin CHARACTERISTIC Conv_trqLdGnFacHysDec_C "Offset for the reduction of the torque load" VALUE 0x8053310C Val_Ws16 6553.500 Trq -3276.800 3276.700 FORMAT "%8.3" /end CHARACTERISTIC
/begin CHARACTERISTIC Conv_trqLdMaxLim_MAP "Limitation of the torque load by CAN" MAP 0x8053310E RB_Map_S16S16_S16 6553.500 Trq -3276.800 3276.700 FORMAT "%8.3"
 /begin AXIS_DESCR STD_AXIS GlbDa_vXFlt Vel 10 -327.6800 327.6700 FORMAT "%8.4" DEPOSIT ABSOLUTE /end AXIS_DESCR
 /begin AXIS_DESCR STD_AXIS TS_tClntEngOut Temp_Cels 10 -3549.940 3003.560 FORMAT "%8.3" DEPOSIT ABSOLUTE /end AXIS_DESCR
/end CHARACTERISTIC
/begin CHARACTERISTIC Conv_trqLdReplCan_C "Substitution of the torque load in case of an error" VALUE 0x80533202 Val_Ws16 6553.500 Trq -3276.800 3276.700 FORMAT "%8.3" /end CHARACTERISTIC
/begin CHARACTERISTIC Conv_TrqResvDebP.tiHiLo_C "Timer für CAN-Zulässigkeit / Time for a High to Low transition" VALUE 0x8058A9C8 Kw_Ws16 65535.00 OneToOne -32768.00 32767.00 FORMAT "%8.2" /end CHARACTERISTIC
/begin CHARACTERISTIC Conv_TrqResvDebP.tiLoHi_C "Timer für CAN-Zulässigkeit / Time for a Low to High transition" VALUE 0x8058A9CA Kw_Ws16 65535.00 OneToOne -32768.00 32767.00 FORMAT "%8.2" /end CHARACTERISTIC
/begin CHARACTERISTIC Conv_trqResvLoLim_C "minimum value of the torque reserve" VALUE 0x80533204 Val_Ws16 6553.500 Trq -3276.800 3276.700 FORMAT "%8.3" /end CHARACTERISTIC
/begin CHARACTERISTIC Conv_trqResvMaxLim_C "Limitation of the torque reserve" VALUE 0x80533206 Val_Ws16 6553.500 Trq -3276.800 3276.700 FORMAT "%8.3" /end CHARACTERISTIC
/begin CHARACTERISTIC Conv_trqResvMinLim_C "Limitation of the torque reserve" VALUE 0x80533208 Val_Ws16 6553.500 Trq -3276.800 3276.700 FORMAT "%8.3" /end CHARACTERISTIC
/begin CHARACTERISTIC Conv_trqResvNeutrLvrPos_C "minimum value of the moment reserve if the selector level position is neutral" VALUE 0x8053320A Val_Ws16 6553.500 Trq -3276.800 3276.700 FORMAT "%8.3" /end CHARACTERISTIC
/begin CHARACTERISTIC Conv_trqResvPreFlt_C "pre-filtered value of the torque load for additional torque reserve" VALUE 0x8053320C Val_Ws16 6553.500 Trq -3276.800 3276.700 FORMAT "%8.3" /end CHARACTERISTIC
/begin CHARACTERISTIC Conv_trqResvRepl_C "Subsitution of the torque reserve" VALUE 0x8053320E Val_Ws16 6553.500 Trq -3276.800 3276.700 FORMAT "%8.3" /end CHARACTERISTIC
/begin CHARACTERISTIC Conv_trqStatSqLvrPosNeutr_C "Pump torque if the selector level position is neutral" VALUE 0x80533210 Val_Ws16 6553.500 Trq -3276.800 3276.700 FORMAT "%8.3" /end CHARACTERISTIC
/begin CHARACTERISTIC Conv_vDecelTqThdHi_C "Vehicle velocity high threshold of torque deceleration offset" VALUE 0x80533212 RB_Val_Ws16 655.3500 Vel -327.6800 327.6700 FORMAT "%8.4" /end CHARACTERISTIC
/begin CHARACTERISTIC Conv_vDecelTqThdLo_C "Vehicle velocity low threshold of torque deceleration offset" VALUE 0x80533214 RB_Val_Ws16 655.3500 Vel -327.6800 327.6700 FORMAT "%8.4" /end CHARACTERISTIC
/begin CHARACTERISTIC Gbx_stNCtrl_CW "Gearbox N Control selection parameter" VALUE 0x80533216 Val_Wu8 255.0 OneToOne 0.00 255.0 FORMAT "%5.1" /end CHARACTERISTIC
/begin CHARACTERISTIC Gbx_stOilPmpFlt_CW "Oil pump load filter selection parameter" VALUE 0x80533217 Val_Wu8 255.0 OneToOne 0.00 255.0 FORMAT "%5.1" /end CHARACTERISTIC
/begin CHARACTERISTIC Gbx_stOilPmp_CW "Oil pump load selection parameter" VALUE 0x80533218 Val_Wu8 255.0 OneToOne 0.00 255.0 FORMAT "%5.1" /end CHARACTERISTIC
/begin CHARACTERISTIC Gbx_tiOilPmpTrq_C "Oil pump load filter timing parameter" VALUE 0x8053321C Val_Ws32 4294.9672940000000 TimeDelay_s 0.0000020000000 4294.9672959999998 FORMAT "%19.14" EXTENDED_LIMITS 0.000002000000001 4294.9672959999998 /end CHARACTERISTIC
/begin CHARACTERISTIC Lin_uOCV_C "Init value for last open circuit voltage of battery" VALUE 0x80532E9C RB_Val_Wu16 65.53500 spg_q0p001_op10_V 10.00000 75.53500 FORMAT "%8.5" /end CHARACTERISTIC
/begin MEASUREMENT ACC_bBrkReq "Brake status for Adaptive Cruise Control" UBYTE B_TRUE 1 100 0.00 1.00000000000 BIT_MASK 0x1 FORMAT "%13.11" ECU_ADDRESS 0x70000C59 /end MEASUREMENT
/begin MEASUREMENT CoETM_flgAftRun_mp "Status of Afterrun" UBYTE B_TRUE 1 100 0.00 1.00000000000 BIT_MASK 0x1 FORMAT "%13.11" ECU_ADDRESS 0x7000A7AC /end MEASUREMENT
/begin MEASUREMENT CoETM_rClgDemLim_mp "Necessary cooling requirement through engine fan" SWORD Prc 1 100 -400.0000 399.9878 FORMAT "%8.4" ECU_ADDRESS 0x7000A7AA /end MEASUREMENT
/begin MEASUREMENT CoETM_rClgIntegLim_mp "limited integral part for ETM_rClgDem" SWORD Prc 1 100 -400.0000 399.9878 FORMAT "%8.4" ECU_ADDRESS 0x7000A7A8 /end MEASUREMENT
/begin MEASUREMENT CoETM_rClgProp_mp "proportional part of ETM_rClgDem" SWORD Prc 1 100 -400.0000 399.9878 FORMAT "%8.4" ECU_ADDRESS 0x7000A7A6 /end MEASUREMENT
/begin MEASUREMENT CoETM_tClntEngOut_mp "Coolant temperature at engine outlet" SWORD Temp_Cels 1 100 -3549.940 3003.560 FORMAT "%8.3" ECU_ADDRESS 0x7000A7A4 /end MEASUREMENT
/begin MEASUREMENT CoETM_tDvt_mp "deviation coolant temp." SWORD TempDiff_Kelv 1 100 -3276.800 3276.700 FORMAT "%8.3" ECU_ADDRESS 0x7000A7A2 /end MEASUREMENT
/begin MEASUREMENT CoETM_tEngOutOff_mp "coolant temperature at engine outlet after engine stop" SWORD Temp_Cels 1 100 -3549.940 3003.560 FORMAT "%8.3" ECU_ADDRESS 0x7000A7A0 /end MEASUREMENT
/begin MEASUREMENT CoETM_tiClgAftRun2_mp "second after run time" SWORD Time_s 1 100 0.00 327.6700 FORMAT "%8.4" ECU_ADDRESS 0x7000A79E /end MEASUREMENT
/begin MEASUREMENT CoETM_tiClgAftRunMax2_mp "max. remain after run time to calculate second after run time" SWORD Time_s 1 100 0.00 327.6700 FORMAT "%8.4" ECU_ADDRESS 0x7000A79C /end MEASUREMENT
/begin MEASUREMENT CoETM_tiClgAftRunOpt_mp "Optional after-run time" SWORD Time_s 1 100 0.00 327.6700 FORMAT "%8.4" ECU_ADDRESS 0x7000A79A /end MEASUREMENT
/begin MEASUREMENT CoETM_tiClgAftRun_mp "time to require an rel. cooling power during after run" SWORD Time_s 1 100 0.00 327.6700 FORMAT "%8.4" ECU_ADDRESS 0x7000A798 /end MEASUREMENT
/begin MEASUREMENT CoETS_bDecrIntvLead "Decreasing torque intervention on lead path active" UBYTE B_TRUE 1 100 0.00 1.00000000000 BIT_MASK 0x1 FORMAT "%13.11" ECU_ADDRESS 0x6000E869 /end MEASUREMENT
/begin MEASUREMENT CoETS_bEngLimActvLead "Engine limitation on lead-path active" UBYTE B_TRUE 1 100 0.00 1.00000000000 BIT_MASK 0x1 FORMAT "%13.11" ECU_ADDRESS 0x6000F8E8 /end MEASUREMENT
/begin MEASUREMENT CoETS_bFltDemLead "Demand for torque filtering in lead path" UBYTE B_TRUE 1 100 0.00 1.00000000000 BIT_MASK 0x1 FORMAT "%13.11" ECU_ADDRESS 0x6000F8E7 /end MEASUREMENT
/begin MEASUREMENT CoETS_bFltDemSet "Demand for torque filtering in set path" UBYTE B_TRUE 1 100 0.00 1.00000000000 BIT_MASK 0x1 FORMAT "%13.11" ECU_ADDRESS 0x6000F8E6 /end MEASUREMENT
/begin MEASUREMENT CoETS_bFltIntvEnd "Filtering by ASDrf of the end of the torque intervention demanded." UBYTE B_TRUE 1 100 0.00 1.00000000000 BIT_MASK 0x1 FORMAT "%13.11" ECU_ADDRESS 0x6000E868 /end MEASUREMENT
/begin MEASUREMENT CoETS_bIncrIntvLead "Increasing torque intervention on lead path active" UBYTE B_TRUE 1 100 0.00 1.00000000000 BIT_MASK 0x1 FORMAT "%13.11" ECU_ADDRESS 0x6000E867 /end MEASUREMENT
/begin MEASUREMENT CoETS_bIntvActvDes "Torque intervention on set path" UBYTE B_TRUE 1 100 0.00 1.00000000000 BIT_MASK 0x1 FORMAT "%13.11" ECU_ADDRESS 0x6000F8E5 /end MEASUREMENT
/begin MEASUREMENT CoETS_bIntvActvLead "Torque intervention on lead path active" UBYTE B_TRUE 1 100 0.00 1.00000000000 BIT_MASK 0x1 FORMAT "%13.11" ECU_ADDRESS 0x6000F1CD /end MEASUREMENT
/begin MEASUREMENT CoETS_bTraIntvActv "Status transmission intervention active." UBYTE B_TRUE 1 100 0.00 1.00000000000 BIT_MASK 0x1 FORMAT "%13.11" ECU_ADDRESS 0x6000F8E4 /end MEASUREMENT
/begin MEASUREMENT CoETS_rTrq "Calculated load value" SWORD Prc 1 100 0.00 399.9878 FORMAT "%8.4" ECU_ADDRESS 0x6000933A /end MEASUREMENT
/begin MEASUREMENT CoETS_trqInrCurrLim "current lowest limitation torque (inner engine torque)" SWORD Trq 1 100 0.00 3276.700 FORMAT "%8.3" ECU_ADDRESS 0x60013E16 /end MEASUREMENT
/begin MEASUREMENT CoETS_trqInrDetMode "coordinated torque demand for determination of operating mode" SWORD md_q0p1 1 100 0.00 3276.700 FORMAT "%8.3" ECU_ADDRESS 0x60013E18 /end MEASUREMENT
/begin MEASUREMENT CoETS_trqInrDetModeFild "coordinated filtered torque demand for determination of operating mode" SWORD md_q0p1 1 100 0.00 3276.700 FORMAT "%8.3" ECU_ADDRESS 0x60013E1A /end MEASUREMENT
/begin MEASUREMENT CoETS_trqInrLeadCo "Torque demand for lead path with engine sided coordination" SWORD Trq 1 100 0.00 3276.700 FORMAT "%8.3" ECU_ADDRESS 0x60013E1C /end MEASUREMENT
/begin MEASUREMENT CoETS_trqInrLeadPOp "Propulsion lead torque incl. DCS-intervention, increasing, for operation mode (inner torque)" SWORD Trq 1 100 0.00 3276.700 FORMAT "%8.3" ECU_ADDRESS 0x60013E1E /end MEASUREMENT
/begin MEASUREMENT CoETS_trqInrLeadWoCo "Torque demand for lead path without coordination" SWORD Trq 1 100 0.00 3276.700 FORMAT "%8.3" ECU_ADDRESS 0x60013E20 /end MEASUREMENT
/begin MEASUREMENT CoETS_trqInrLimLead "Coordinated limitation of lead path" SWORD Trq 1 100 0.00 3276.700 FORMAT "%8.3" ECU_ADDRESS 0x50005C34 /end MEASUREMENT
/begin MEASUREMENT CoETS_trqInrLimSet "Limitation torque without the part of the speed governor" SWORD Trq 1 100 0.00 3276.700 FORMAT "%8.3" ECU_ADDRESS 0x60013E22 /end MEASUREMENT
/begin MEASUREMENT CoETS_trqInrSetCo "Coordinated torque demand for set path" SWORD Trq 1 100 0.00 3276.700 FORMAT "%8.3" ECU_ADDRESS 0x50005C38 /end MEASUREMENT
/begin MEASUREMENT CoETS_trqInrSetWoCo "Torque demand for set path without coordination" SWORD Trq 1 100 0.00 3276.700 FORMAT "%8.3" ECU_ADDRESS 0x60013E24 /end MEASUREMENT
/begin MEASUREMENT CoETS_trqInrTgtCo "Coordinated target torque for set path" SWORD Trq 1 100 0.00 3276.700 FORMAT "%8.3" ECU_ADDRESS 0x60009334 /end MEASUREMENT
/begin MEASUREMENT CoETS_trqInrTgtWoCo "Target torque for set path without coordination" SWORD Trq 1 100 0.00 3276.700 FORMAT "%8.3" ECU_ADDRESS 0x60009332 /end MEASUREMENT
/begin MEASUREMENT CoETS_trqInrVehLimMin_mp "coordinated limitation torque of vehicle functions (inner torque)" SWORD Trq 1 100 0.00 3276.700 FORMAT "%8.3" ECU_ADDRESS 0x7000A796 /end MEASUREMENT
/begin MEASUREMENT CoETS_trqLimLead "Coordinated limitation on lead path" SWORD Trq 1 100 0.00 3276.700 FORMAT "%8.3" ECU_ADDRESS 0x60013E26 /end MEASUREMENT
/begin MEASUREMENT CoME_flgAcc "Status: acceleration" UBYTE B_TRUE 1 100 0.00 1.00000000000 BIT_MASK 0x1 FORMAT "%13.11" ECU_ADDRESS 0x6000F1C3 /end MEASUREMENT
/begin MEASUREMENT CoME_flgAccMax "AC status: maximum time off in case of acceleration" UBYTE B_TRUE 1 100 0.00 1.00000000000 BIT_MASK 0x1 FORMAT "%13.11" ECU_ADDRESS 0x6000F1C2 /end MEASUREMENT
/begin MEASUREMENT CoME_flgAccMin "AC status: minimal time off in case of acceleration" UBYTE B_TRUE 1 100 0.00 1.00000000000 BIT_MASK 0x1 FORMAT "%13.11" ECU_ADDRESS 0x6000F1C1 /end MEASUREMENT
/begin MEASUREMENT CoME_flgAccTmr "status: acceleration after timer" UBYTE B_TRUE 1 100 0.00 1.00000000000 BIT_MASK 0x1 FORMAT "%13.11" ECU_ADDRESS 0x6000F1C0 /end MEASUREMENT
/begin MEASUREMENT CoME_flgBattVltg "status: low battery voltage" UBYTE B_TRUE 1 100 0.00 1.00000000000 BIT_MASK 0x1 FORMAT "%13.11" ECU_ADDRESS 0x6000F1BF /end MEASUREMENT
/begin MEASUREMENT CoME_flgBattVltgTmr "status: low battery voltage after timer" UBYTE B_TRUE 1 100 0.00 1.00000000000 BIT_MASK 0x1 FORMAT "%13.11" ECU_ADDRESS 0x6000F1BE /end MEASUREMENT
/begin MEASUREMENT CoME_flgDrvOff "status: drive off" UBYTE B_TRUE 1 100 0.00 1.00000000000 BIT_MASK 0x1 FORMAT "%13.11" ECU_ADDRESS 0x6000F1BD /end MEASUREMENT
/begin MEASUREMENT CoME_flgDrvOffMax "AC status: maximal time off in case of drive off" UBYTE B_TRUE 1 100 0.00 1.00000000000 BIT_MASK 0x1 FORMAT "%13.11" ECU_ADDRESS 0x6000F1BC /end MEASUREMENT
/begin MEASUREMENT CoME_flgDrvOffMin "AC status: minimum time off in case of drive off" UBYTE B_TRUE 1 100 0.00 1.00000000000 BIT_MASK 0x1 FORMAT "%13.11" ECU_ADDRESS 0x6000F1BB /end MEASUREMENT
/begin MEASUREMENT CoME_flgDrvOffTmr "status: drive off after timer" UBYTE B_TRUE 1 100 0.00 1.00000000000 BIT_MASK 0x1 FORMAT "%13.11" ECU_ADDRESS 0x6000F1BA /end MEASUREMENT
/begin MEASUREMENT CoME_flgDrvTmr "Status: Drive Timer" UBYTE B_TRUE 1 100 0.00 1.00000000000 BIT_MASK 0x1 FORMAT "%13.11" ECU_ADDRESS 0x6000F1B9 /end MEASUREMENT
/begin MEASUREMENT CoME_flgOffAcc "Reset: Acc" UBYTE B_TRUE 1 100 0.00 1.00000000000 BIT_MASK 0x1 FORMAT "%13.11" ECU_ADDRESS 0x6000F1B8 /end MEASUREMENT
/begin MEASUREMENT CoME_flgOffDrvOff "Reset: Drive Off" UBYTE B_TRUE 1 100 0.00 1.00000000000 BIT_MASK 0x1 FORMAT "%13.11" ECU_ADDRESS 0x6000F1B7 /end MEASUREMENT
/begin MEASUREMENT CoME_flgStop "Vehicle state STOP (Stopping or Auto Stopping)" UBYTE B_TRUE 1 100 0.00 1.00000000000 BIT_MASK 0x1 FORMAT "%13.11" ECU_ADDRESS 0x6000F1B6 /end MEASUREMENT
/begin MEASUREMENT CoME_flgStrt "status: start" UBYTE B_TRUE 1 100 0.00 1.00000000000 BIT_MASK 0x1 FORMAT "%13.11" ECU_ADDRESS 0x6000F1B5 /end MEASUREMENT
/begin MEASUREMENT CoME_flgStrtTmrAC "status: engine start after timer" UBYTE B_TRUE 1 100 0.00 1.00000000000 BIT_MASK 0x1 FORMAT "%13.11" ECU_ADDRESS 0x6000F1B4 /end MEASUREMENT
/begin MEASUREMENT CoME_nMax "Maximum engine speed limit of accessories" SWORD EngN 1 100 -16384.00 16383.50 FORMAT "%8.2" ECU_ADDRESS 0x60009328 /end MEASUREMENT
/begin MEASUREMENT CoME_nMin "Minimum low-idle speed requirement of accessories" SWORD EngN 1 100 -16384.00 16383.50 FORMAT "%8.2" ECU_ADDRESS 0x60009326 /end MEASUREMENT
/begin MEASUREMENT CoME_nMinTemp "The maximum of unfiltered and Tip in behaviour speed demand" SWORD EngN 1 100 -16384.00 16383.50 FORMAT "%8.2" ECU_ADDRESS 0x600076B6 /end MEASUREMENT
/begin MEASUREMENT CoME_nMinTipIn "The current minimal speed demand for Tip in behaviour" SWORD EngN 1 100 -16384.00 16383.50 FORMAT "%8.2" ECU_ADDRESS 0x600076B4 /end MEASUREMENT
/begin MEASUREMENT CoME_nMinUnFlt "The current minimal unfiltered speed demand" SWORD EngN 1 100 -16384.00 16383.50 FORMAT "%8.2" ECU_ADDRESS 0x600076B2 /end MEASUREMENT
/begin MEASUREMENT CoME_stNSetP "Status: Nature of low-idle speed increase" UBYTE OneToOne 1 100 0.00 255.0 FORMAT "%5.1" ECU_ADDRESS 0x6000F734 /end MEASUREMENT
/begin MEASUREMENT CoME_tiMaxOffAcc "Maximal shutoff time by ACC" SWORD Time_s 1 100 -327.6800 327.6700 FORMAT "%8.4" ECU_ADDRESS 0x60009324 /end MEASUREMENT
/begin MEASUREMENT CoME_tiMaxOffDrvOff "Maximal shutoff time by Drive off" SWORD Time_s 1 100 -327.6800 327.6700 FORMAT "%8.4" ECU_ADDRESS 0x60009322 /end MEASUREMENT
/begin MEASUREMENT CoME_tiMinOffAcc "Minimal shutoff time by ACC" SWORD Time_s 1 100 -327.6800 327.6700 FORMAT "%8.4" ECU_ADDRESS 0x60009320 /end MEASUREMENT
/begin MEASUREMENT CoME_tiMinOffDrvOff "Minimal shutoff time by Drive Off" SWORD Time_s 1 100 -327.6800 327.6700 FORMAT "%8.4" ECU_ADDRESS 0x6000931E /end MEASUREMENT
/begin MEASUREMENT CoME_tqAcsy "Accessories torque request from thermal system, electrical system and hydrualic power steering" SWORD Trq 1 100 -3276.800 3276.700 FORMAT "%8.3" ECU_ADDRESS 0x600076B0 /end MEASUREMENT
/begin MEASUREMENT CoME_trqDesComp "Application parameter for Torque demand of mechanical co-ordinator" SWORD Trq 1 100 -3276.800 3276.700 FORMAT "%8.3" ECU_ADDRESS 0x6000931C /end MEASUREMENT
/begin MEASUREMENT CoME_trqResv "Reserve torque demand of mechanical co-ordinator" SWORD Trq 1 100 -3276.800 3276.700 FORMAT "%8.3" ECU_ADDRESS 0x6000931A /end MEASUREMENT
/begin MEASUREMENT Com_aLatGA "Lattitude_G information" UWORD Com_aLgtG_Compu 1 100 -24.500 3111.446 FORMAT "%8.3" ECU_ADDRESS 0x60008D2C /end MEASUREMENT
/begin MEASUREMENT Com_aLgtG "Vehicle Acceleration information related to Longitudinal_G sensor" UWORD Com_aLgtG_Compu 1 100 -24.500 3111.446 FORMAT "%8.3" ECU_ADDRESS 0x60008D2A /end MEASUREMENT
/begin MEASUREMENT Com_bAYCCond "Received AYC active condition status" UBYTE OneToOne 1 100 0.00 255.0 FORMAT "%5.1" ECU_ADDRESS 0x6000F6E6 /end MEASUREMENT
/begin MEASUREMENT Com_bAYCReWr "VSA unit re-writing status" UBYTE OneToOne 1 100 0.00 255.0 FORMAT "%5.1" ECU_ADDRESS 0x6000F6E5 /end MEASUREMENT
/begin MEASUREMENT Com_bDeIce "Front de-ice status" UBYTE OneToOne 1 100 0.00 255.0 FORMAT "%5.1" ECU_ADDRESS 0x6000F021 /end MEASUREMENT
/begin MEASUREMENT Com_bDigMtrUnit "Speed Meter display unit" UBYTE OneToOne 1 100 0.00 255.0 FORMAT "%5.1" ECU_ADDRESS 0x6000F6E2 /end MEASUREMENT
/begin MEASUREMENT Com_bMicuInfo "MICU information" UBYTE OneToOne 1 100 0.00 255.0 FORMAT "%5.1" ECU_ADDRESS 0x6000F020 /end MEASUREMENT
/begin MEASUREMENT Com_bReDEFOutCdn "Rear DEF output condition (A/C output)" UBYTE OneToOne 1 100 0.00 255.0 FORMAT "%5.1" ECU_ADDRESS 0x6000F01B /end MEASUREMENT
/begin MEASUREMENT Com_bReDEFSwCdn "Rear DEF SW condition" UBYTE OneToOne 1 100 0.00 255.0 FORMAT "%5.1" ECU_ADDRESS 0x6000F01A /end MEASUREMENT
/begin MEASUREMENT Com_bRMDRLKCInfo "KC DRL information" UBYTE OneToOne 1 100 0.00 255.0 FORMAT "%5.1" ECU_ADDRESS 0x6000F01F /end MEASUREMENT
/begin MEASUREMENT Com_bRMHLHiRly "High headlight lighting" UBYTE OneToOne 1 100 0.00 255.0 FORMAT "%5.1" ECU_ADDRESS 0x6000F01E /end MEASUREMENT
/begin MEASUREMENT Com_bRMHLLoRly "Low headlight lighting" UBYTE OneToOne 1 100 0.00 255.0 FORMAT "%5.1" ECU_ADDRESS 0x6000F01D /end MEASUREMENT
/begin MEASUREMENT Com_bRMILLSml "Small light lighting" UBYTE OneToOne 1 100 0.00 255.0 FORMAT "%5.1" ECU_ADDRESS 0x6000F01C /end MEASUREMENT
/begin MEASUREMENT Com_bTSCIntvSlow "Transmission requested torque down - Control Mode for Air" UBYTE OneToOne 1 100 0.00 255.0 FORMAT "%5.1" ECU_ADDRESS 0x6000F6E0 /end MEASUREMENT
/begin MEASUREMENT Com_ctCRingAYCA "Ring counter for frame AYCA" UBYTE OneToOne 1 100 0.00 255.0 FORMAT "%5.1" ECU_ADDRESS 0x6000F6DE /end MEASUREMENT
/begin MEASUREMENT Com_ctCRingAYCF "AYCF frame Ring counter message" UBYTE OneToOne 1 100 0.00 255.0 FORMAT "%5.1" ECU_ADDRESS 0x7000372A /end MEASUREMENT
/begin MEASUREMENT Com_ctCRingAYCG "Ring counter for AYCG frame" UBYTE OneToOne 1 100 0.00 255.0 FORMAT "%5.1" ECU_ADDRESS 0x6000093C /end MEASUREMENT
/begin MEASUREMENT Com_ctCRingAYCI "Ring counter for AYCI frame" UBYTE OneToOne 1 100 0.00 255.0 FORMAT "%5.1" ECU_ADDRESS 0x70003729 /end MEASUREMENT
/begin MEASUREMENT Com_ctCRingBCM1 "Ring Counter for the BCM1 Frame" UBYTE OneToOne 1 100 0.00 255.0 FORMAT "%5.1" ECU_ADDRESS 0x6000093D /end MEASUREMENT
/begin MEASUREMENT Com_ctCRingCGW1 "CGW1 Ring Counter" UBYTE OneToOne 1 100 0.00 255.0 FORMAT "%5.1" ECU_ADDRESS 0x6000F6DD /end MEASUREMENT
/begin MEASUREMENT Com_ctCRingEAT1 "Can Ring counter for EAT1 frame" UBYTE OneToOne 1 100 0.00 255.0 FORMAT "%5.1" ECU_ADDRESS 0x70003728 /end MEASUREMENT
/begin MEASUREMENT Com_ctCRingEAT10 "CAN Ring counter for EAT10 frame" UBYTE OneToOne 1 100 0.00 255.0 FORMAT "%5.1" ECU_ADDRESS 0x6000F6DC /end MEASUREMENT
/begin MEASUREMENT Com_ctCRingEAT11 "Can Ring counter for EAT11 frame" UBYTE OneToOne 1 100 0.00 255.0 FORMAT "%5.1" ECU_ADDRESS 0x6000F6DB /end MEASUREMENT
/begin MEASUREMENT Com_ctCRingEAT12 "EAT12 Ring counter" UBYTE OneToOne 1 100 0.00 255.0 FORMAT "%5.1" ECU_ADDRESS 0x6000F6DA /end MEASUREMENT
/begin MEASUREMENT Com_ctCRingEAT13 "EAT13 Ring counter" UBYTE OneToOne 1 100 0.00 255.0 FORMAT "%5.1" ECU_ADDRESS 0x6000F6D9 /end MEASUREMENT
/begin MEASUREMENT Com_ctCRingEAT2 "Ring Counter for frame EAT2" UBYTE OneToOne 1 100 0.00 255.0 FORMAT "%5.1" ECU_ADDRESS 0x70003727 /end MEASUREMENT
/begin MEASUREMENT Com_ctCRingEAT4 "Ring counter for EAT4 frame" UBYTE OneToOne 1 100 0.00 255.0 FORMAT "%5.1" ECU_ADDRESS 0x6000F6D8 /end MEASUREMENT
/begin MEASUREMENT Com_ctCRingEAT6 "Can Ring counter for EAT6 frame" UBYTE OneToOne 1 100 0.00 255.0 FORMAT "%5.1" ECU_ADDRESS 0x6000F6D7 /end MEASUREMENT
/begin MEASUREMENT Com_ctCRingEAT7 "Can Ring counter for EAT7 frame" UBYTE OneToOne 1 100 0.00 255.0 FORMAT "%5.1" ECU_ADDRESS 0x6000F6D6 /end MEASUREMENT
/begin MEASUREMENT Com_ctCRingEAT8 "Can Ring counter for EAT8 frame" UBYTE OneToOne 1 100 0.00 255.0 FORMAT "%5.1" ECU_ADDRESS 0x6000F6D5 /end MEASUREMENT
/begin MEASUREMENT Com_ctCRingEATA "Ring counter for frame EATA" UBYTE OneToOne 1 100 0.00 255.0 FORMAT "%5.1" ECU_ADDRESS 0x6000F6D4 /end MEASUREMENT
/begin MEASUREMENT Com_ctCRingEATB "ring counter for EATB frame" UBYTE OneToOne 1 100 0.00 255.0 FORMAT "%5.1" ECU_ADDRESS 0x6000F6D3 /end MEASUREMENT
/begin MEASUREMENT Com_ctCRingEATC "Ring Counter for EATC" UBYTE OneToOne 1 100 0.00 255.0 FORMAT "%5.1" ECU_ADDRESS 0x6000F6D2 /end MEASUREMENT
/begin MEASUREMENT Com_ctCRingEPB "Ring Counter for EPB frame" UBYTE OneToOne 1 100 0.00 255.0 FORMAT "%5.1" ECU_ADDRESS 0x6000F6B8 /end MEASUREMENT
/begin MEASUREMENT Com_ctCRingEPBB "EPBB frame Ring Counter message" UBYTE OneToOne 1 100 0.00 3.000 FORMAT "%5.3" ECU_ADDRESS 0x6000F6B7 /end MEASUREMENT
/begin MEASUREMENT Com_ctCRingEPS1 "Ring counter for EPS1 frame" UBYTE OneToOne 1 100 0.00 255.0 FORMAT "%5.1" ECU_ADDRESS 0x6000F6B6 /end MEASUREMENT
/begin MEASUREMENT Com_ctCRingGwIMG1 "Ring Counter for GWIMG1 frame" UBYTE OneToOne 1 100 0.00 255.0 FORMAT "%5.1" ECU_ADDRESS 0x6000093E /end MEASUREMENT
/begin MEASUREMENT Com_ctCRingGwIMG3 "Ring Counter for GWIMG3 frame" UBYTE OneToOne 1 100 0.00 3.000 FORMAT "%5.3" ECU_ADDRESS 0x6000F6B5 /end MEASUREMENT
/begin MEASUREMENT Com_ctCRingGwIMG4 "Ring Counter for GWIMG4 frame" UBYTE OneToOne 1 100 0.00 255.0 FORMAT "%5.1" ECU_ADDRESS 0x70003726 /end MEASUREMENT
/begin MEASUREMENT Com_ctCRingGwIMG5 "Ring counter for IMG5 frame" UBYTE OneToOne 1 100 0.00 255.0 FORMAT "%5.1" ECU_ADDRESS 0x6000F6B4 /end MEASUREMENT
/begin MEASUREMENT Com_ctCRingGwIMG6 "Ring counter for frame GwIMG6" UBYTE OneToOne 1 100 0.00 255.0 FORMAT "%5.1" ECU_ADDRESS 0x6000F6B3 /end MEASUREMENT
/begin MEASUREMENT Com_ctCRingIDASB "Ringcounter value of IDASB frame" UBYTE OneToOne 1 100 0.00 255.0 FORMAT "%5.1" ECU_ADDRESS 0x6000F6B2 /end MEASUREMENT
/begin MEASUREMENT Com_ctCRingMETA "Ring counter for META frame" UBYTE OneToOne 1 100 0.00 255.0 FORMAT "%5.1" ECU_ADDRESS 0x6000F6B1 /end MEASUREMENT
/begin MEASUREMENT Com_ctCRingMETC "Ring counter for frame METC" UBYTE OneToOne 1 100 0.00 255.0 FORMAT "%5.1" ECU_ADDRESS 0x6000F6B0 /end MEASUREMENT
/begin MEASUREMENT Com_ctCRingMETD "Ring counter for the frame METD" UBYTE OneToOne 1 100 0.00 255.0 FORMAT "%5.1" ECU_ADDRESS 0x6000F6AF /end MEASUREMENT
/begin MEASUREMENT Com_ctCRingMETE2 "Ring counter message for METE2 frame" UBYTE OneToOne 1 100 0.00 255.0 FORMAT "%5.1" ECU_ADDRESS 0x6000F6AE /end MEASUREMENT
/begin MEASUREMENT Com_ctCRingMETF "Ring counter for METF frame" UBYTE OneToOne 1 100 0.00 255.0 FORMAT "%5.1" ECU_ADDRESS 0x6000F6AD /end MEASUREMENT
/begin MEASUREMENT Com_ctCRingMETG "CAN ring counter for METG frame" UBYTE OneToOne 1 100 0.00 255.0 FORMAT "%5.1" ECU_ADDRESS 0x6000F6AC /end MEASUREMENT
/begin MEASUREMENT Com_ctCRingMETH "Ring counter for METH frame" UBYTE OneToOne 1 100 0.00 255.0 FORMAT "%5.1" ECU_ADDRESS 0x6000F6AA /end MEASUREMENT
/begin MEASUREMENT Com_ctCRingMETH2 "Ring Counter of METH2 Frame" UBYTE OneToOne 1 100 0.00 255.0 FORMAT "%5.1" ECU_ADDRESS 0x6000F6AB /end MEASUREMENT
/begin MEASUREMENT Com_ctCRingMETI "Ringcounter value of METI frame" UBYTE OneToOne 1 100 0.00 255.0 FORMAT "%5.1" ECU_ADDRESS 0x6000F00C /end MEASUREMENT
/begin MEASUREMENT Com_ctCRingMETK "Ring counter for METK frame" UBYTE OneToOne 1 100 0.00 255.0 FORMAT "%5.1" ECU_ADDRESS 0x6000F00B /end MEASUREMENT
/begin MEASUREMENT Com_ctCRingMETL "Ring counter for METL frame" UBYTE OneToOne 1 100 0.00 255.0 FORMAT "%5.1" ECU_ADDRESS 0x6000F6A9 /end MEASUREMENT
/begin MEASUREMENT Com_ctCRingMETM "Ringcounter value of METM frame" UBYTE OneToOne 1 100 0.00 255.0 FORMAT "%5.1" ECU_ADDRESS 0x6000F6A8 /end MEASUREMENT
/begin MEASUREMENT Com_ctCRingMETN "Ringcounter value of METN frame" UBYTE OneToOne 1 100 0.00 255.0 FORMAT "%5.1" ECU_ADDRESS 0x6000F6A7 /end MEASUREMENT
/begin MEASUREMENT Com_ctCRingPCU "Ring counter for PCU frame" UBYTE OneToOne 1 100 0.00 255.0 FORMAT "%5.1" ECU_ADDRESS 0x6000F6A6 /end MEASUREMENT
/begin MEASUREMENT Com_ctCRingSRS "Ring counter message for SRS frame." UBYTE OneToOne 1 100 0.00 255.0 FORMAT "%5.1" ECU_ADDRESS 0x70003725 /end MEASUREMENT
/begin MEASUREMENT Com_ctCRingSRSA "Engine ECU Receive SRSA frame Counter" UBYTE OneToOne 1 100 0.00 255.0 FORMAT "%5.1" ECU_ADDRESS 0x6000F6A5 /end MEASUREMENT
/begin MEASUREMENT Com_ctCRingSRSB "Ring counter message for SRSB frame." UBYTE OneToOne 1 100 0.00 255.0 FORMAT "%5.1" ECU_ADDRESS 0x6000F6A4 /end MEASUREMENT
/begin MEASUREMENT Com_ctReIni10msComCIL_Co "The counter of ReInit Proc for ComCIL_Co" UBYTE OneToOne 1 100 0.00 255.0 FORMAT "%5.1" ECU_ADDRESS 0x6000E866 /end MEASUREMENT
/begin MEASUREMENT Com_ctReIni10msComCIL_Mon "The counter of ReInit Proc for ComCIL_Mon" UBYTE OneToOne 1 100 0.00 255.0 FORMAT "%5.1" ECU_ADDRESS 0x6000E865 /end MEASUREMENT
/begin MEASUREMENT Com_flgACCutDurgAtCvt "AC cut demand" UBYTE B_TRUE 1 100 0.00 1.00000000000 BIT_MASK 0x1 FORMAT "%13.11" ECU_ADDRESS 0x6000F698 /end MEASUREMENT
/begin MEASUREMENT Com_flgCvtFcoPrms "Transmission deceleration fuel cutoff approved" UBYTE OneToOne 1 100 0.00 255.0 FORMAT "%5.1" ECU_ADDRESS 0x6000F694 /end MEASUREMENT
/begin MEASUREMENT Com_flgExecdManMod "Manual mode execution flag" UBYTE OneToOne 1 100 0.00 255.0 FORMAT "%5.1" ECU_ADDRESS 0x6000F691 /end MEASUREMENT
/begin MEASUREMENT Com_flgVehSpdLimrDisp "Status of Speed Limiter Upward display" UBYTE B_TRUE 1 100 0.00 1.00000000000 BIT_MASK 0x1 FORMAT "%13.11" ECU_ADDRESS 0x6000F68D /end MEASUREMENT
/begin MEASUREMENT Com_iACCmprHiByte "Air Conditioner variable capacity compressor control current Higher byte" UBYTE i_q1_mA 1 100 0.00 255.0 FORMAT "%5.1" ECU_ADDRESS 0x6000F68B /end MEASUREMENT
/begin MEASUREMENT Com_iACCmprLoByte "Air Conditioner variable capacity compressor control current Lower byte" UBYTE i_q1_mA 1 100 0.00 255.0 FORMAT "%5.1" ECU_ADDRESS 0x6000F68A /end MEASUREMENT
/begin MEASUREMENT Com_iElecLd "EPS load current" SWORD Curr_A 1 100 -327.6800 327.6700 FORMAT "%8.4" ECU_ADDRESS 0x600092B2 /end MEASUREMENT
/begin MEASUREMENT Com_iEPS1ElecLd "EPS Load Current" SWORD Curr_A 1 100 -327.6800 327.6700 FORMAT "%8.4" ECU_ADDRESS 0x600092B4 /end MEASUREMENT
/begin MEASUREMENT Com_lDstMETKRaw "Coverage distance Raw" SLONG OneToOne 1 100 -2147483648.00 2147483647.00 FORMAT "%13.2" ECU_ADDRESS 0x600037A0 /end MEASUREMENT
/begin MEASUREMENT Com_lTotRingEATA "Travelled distance" ULONG Length 1 100 0.00 4294967295.00 FORMAT "%13.2" ECU_ADDRESS 0x50004DA4 /end MEASUREMENT
/begin MEASUREMENT Com_nIdlDes "Engine Speed Request" SWORD EngN 1 100 -16384.00 16383.50 FORMAT "%8.2" ECU_ADDRESS 0x600092A6 /end MEASUREMENT
/begin MEASUREMENT Com_nrActPtcActv "Actual number of activated PTC elements" UBYTE OneToOne 1 100 0.00 255.0 FORMAT "%5.1" ECU_ADDRESS 0x6000F689 /end MEASUREMENT
/begin MEASUREMENT Com_nTrbn "CAN message for Turbine Speed" UWORD DFES_nPID0C 1 100 0.00 16383.75 FORMAT "%8.2" ECU_ADDRESS 0x60008D14 /end MEASUREMENT
/begin MEASUREMENT Com_nTrsmMaiShaft "Transmission main shaft speed" SLONG EngN 1 100 -1073741824.00 1073741823.50 FORMAT "%13.2" ECU_ADDRESS 0x600039AC /end MEASUREMENT
/begin MEASUREMENT Com_numCsumAYCA "Checksum message for frame AYCA" UBYTE OneToOne 1 100 0.00 255.0 FORMAT "%5.1" ECU_ADDRESS 0x6000F681 /end MEASUREMENT
/begin MEASUREMENT Com_numCsumAYCD "Checksum for AYCD frame" UBYTE OneToOne 1 100 0.00 255.0 FORMAT "%5.1" ECU_ADDRESS 0x70003724 /end MEASUREMENT
/begin MEASUREMENT Com_numCsumAYCF "Checksum message for frame AYCF" UBYTE OneToOne 1 100 0.00 255.0 FORMAT "%5.1" ECU_ADDRESS 0x6000093F /end MEASUREMENT
/begin MEASUREMENT Com_numCsumAYCG "Checksum message for AYCG frame" UBYTE OneToOne 1 100 0.00 255.0 FORMAT "%5.1" ECU_ADDRESS 0x70003723 /end MEASUREMENT
/begin MEASUREMENT Com_numCsumAYCI "Checksum for AYCI frame" UBYTE OneToOne 1 100 0.00 255.0 FORMAT "%5.1" ECU_ADDRESS 0x60000940 /end MEASUREMENT
/begin MEASUREMENT Com_numCsumBCM1 "CheckSum for BCM1 Frame" UBYTE OneToOne 1 100 0.00 255.0 FORMAT "%5.1" ECU_ADDRESS 0x60000941 /end MEASUREMENT
/begin MEASUREMENT Com_numCsumCGW1 "CGW1 Checksum" UBYTE OneToOne 1 100 0.00 255.0 FORMAT "%5.1" ECU_ADDRESS 0x6000F680 /end MEASUREMENT
/begin MEASUREMENT Com_numCsumEAT1 "Checksum message for frame EAT1" UBYTE OneToOne 1 100 0.00 255.0 FORMAT "%5.1" ECU_ADDRESS 0x70003722 /end MEASUREMENT
/begin MEASUREMENT Com_numCsumEAT10 "Check sum for EAT10 frame" UBYTE OneToOne 1 100 0.00 255.0 FORMAT "%5.1" ECU_ADDRESS 0x6000F67F /end MEASUREMENT
/begin MEASUREMENT Com_numCsumEAT11 "Check sum for EAT11 frame" UBYTE OneToOne 1 100 0.00 255.0 FORMAT "%5.1" ECU_ADDRESS 0x6000F67E /end MEASUREMENT
/begin MEASUREMENT Com_numCsumEAT12 "EAT12 checksum" UBYTE OneToOne 1 100 0.00 255.0 FORMAT "%5.1" ECU_ADDRESS 0x6000F67D /end MEASUREMENT
/begin MEASUREMENT Com_numCsumEAT13 "EAT13 Checksum" UBYTE OneToOne 1 100 0.00 255.0 FORMAT "%5.1" ECU_ADDRESS 0x6000F67C /end MEASUREMENT
/begin MEASUREMENT Com_numCsumEAT2 "Checksum message for frame EAT2" UBYTE OneToOne 1 100 0.00 255.0 FORMAT "%5.1" ECU_ADDRESS 0x70003721 /end MEASUREMENT
/begin MEASUREMENT Com_numCsumEAT4 "Checksum message for EAT4 frame" UBYTE OneToOne 1 100 0.00 255.0 FORMAT "%5.1" ECU_ADDRESS 0x6000F67B /end MEASUREMENT
/begin MEASUREMENT Com_numCsumEAT6 "Check sum for EAT6 frame" UBYTE OneToOne 1 100 0.00 255.0 FORMAT "%5.1" ECU_ADDRESS 0x6000F67A /end MEASUREMENT
/begin MEASUREMENT Com_numCsumEAT7 "Check sum for EAT7 frame" UBYTE OneToOne 1 100 0.00 255.0 FORMAT "%5.1" ECU_ADDRESS 0x6000F679 /end MEASUREMENT
/begin MEASUREMENT Com_numCsumEAT8 "Check sum for EAT8 frame" UBYTE OneToOne 1 100 0.00 255.0 FORMAT "%5.1" ECU_ADDRESS 0x6000F678 /end MEASUREMENT
/begin MEASUREMENT Com_numCsumEATA "Checksum message for frame EATA" UBYTE OneToOne 1 100 0.00 255.0 FORMAT "%5.1" ECU_ADDRESS 0x6000F677 /end MEASUREMENT
/begin MEASUREMENT Com_numCsumEATB "checksum for EATB frame" UBYTE OneToOne 1 100 0.00 255.0 FORMAT "%5.1" ECU_ADDRESS 0x6000F676 /end MEASUREMENT
/begin MEASUREMENT Com_numCsumEATC "Checksum for EATC" UBYTE OneToOne 1 100 0.00 255.0 FORMAT "%5.1" ECU_ADDRESS 0x6000F675 /end MEASUREMENT
/begin MEASUREMENT Com_numCsumEPB "Checksum message for frame EPB" UBYTE OneToOne 1 100 0.00 255.0 FORMAT "%5.1" ECU_ADDRESS 0x6000F65C /end MEASUREMENT
/begin MEASUREMENT Com_numCsumEPBB "Checksum message for frame EPBB" UBYTE OneToOne 1 100 0.00 15.00 FORMAT "%5.2" ECU_ADDRESS 0x6000F65B /end MEASUREMENT
/begin MEASUREMENT Com_numCsumEPS1 "Checksum message for EPS1 frame" UBYTE OneToOne 1 100 0.00 255.0 FORMAT "%5.1" ECU_ADDRESS 0x6000F65A /end MEASUREMENT
/begin MEASUREMENT Com_numCsumGwIMG1 "Message for Checksum of GWIMG1 frame" UBYTE OneToOne 1 100 0.00 255.0 FORMAT "%5.1" ECU_ADDRESS 0x60000942 /end MEASUREMENT
/begin MEASUREMENT Com_numCsumGwIMG3 "Message for checksum of GWIMG3 frame" UBYTE OneToOne 1 100 0.00 15.00 FORMAT "%5.2" ECU_ADDRESS 0x6000F659 /end MEASUREMENT
/begin MEASUREMENT Com_numCsumGwIMG4 "Message for checksum of GWIMG4 frame" UBYTE OneToOne 1 100 0.00 255.0 FORMAT "%5.1" ECU_ADDRESS 0x60000943 /end MEASUREMENT
/begin MEASUREMENT Com_numCsumGwIMG5 "IMG5 checksum message" UBYTE OneToOne 1 100 0.00 255.0 FORMAT "%5.1" ECU_ADDRESS 0x6000F658 /end MEASUREMENT
/begin MEASUREMENT Com_numCsumGwIMG6 "Checksum message for frame GwIMG6" UBYTE OneToOne 1 100 0.00 255.0 FORMAT "%5.1" ECU_ADDRESS 0x6000F657 /end MEASUREMENT
/begin MEASUREMENT Com_numCsumIDASB "Checksum value of IDASB frame" UBYTE OneToOne 1 100 0.00 255.0 FORMAT "%5.1" ECU_ADDRESS 0x6000F656 /end MEASUREMENT
/begin MEASUREMENT Com_numCsumMETA "Checksum for META" UBYTE OneToOne 1 100 0.00 255.0 FORMAT "%5.1" ECU_ADDRESS 0x6000F655 /end MEASUREMENT
/begin MEASUREMENT Com_numCsumMETC "Checksum for frame METC" UBYTE OneToOne 1 100 0.00 255.0 FORMAT "%5.1" ECU_ADDRESS 0x6000F654 /end MEASUREMENT
/begin MEASUREMENT Com_numCsumMETD "Checksum for METD frame" UBYTE OneToOne 1 100 0.00 255.0 FORMAT "%5.1" ECU_ADDRESS 0x6000F653 /end MEASUREMENT
/begin MEASUREMENT Com_numCsumMETE2 "Period for METE2 frame." UBYTE OneToOne 1 100 0.00 255.0 FORMAT "%5.1" ECU_ADDRESS 0x6000F652 /end MEASUREMENT
/begin MEASUREMENT Com_numCsumMETF "Checksum message for frame METF" UBYTE OneToOne 1 100 0.00 255.0 FORMAT "%5.1" ECU_ADDRESS 0x6000F651 /end MEASUREMENT
/begin MEASUREMENT Com_numCsumMETG "CAN check sum for METG frame" UBYTE OneToOne 1 100 0.00 255.0 FORMAT "%5.1" ECU_ADDRESS 0x6000F650 /end MEASUREMENT
/begin MEASUREMENT Com_numCsumMETH "Checksum for METH frame." UBYTE OneToOne 1 100 0.00 255.0 FORMAT "%5.1" ECU_ADDRESS 0x6000F64E /end MEASUREMENT
/begin MEASUREMENT Com_numCsumMETH2 "Checksum of METH2 Frame" UBYTE OneToOne 1 100 0.00 255.0 FORMAT "%5.1" ECU_ADDRESS 0x6000F64F /end MEASUREMENT
/begin MEASUREMENT Com_numCsumMETI "Checksum value of METI frame" UBYTE OneToOne 1 100 0.00 255.0 FORMAT "%5.1" ECU_ADDRESS 0x6000EFE2 /end MEASUREMENT
/begin MEASUREMENT Com_numCsumMETK "Checksum for METK" UBYTE OneToOne 1 100 0.00 255.0 FORMAT "%5.1" ECU_ADDRESS 0x6000EFE1 /end MEASUREMENT
/begin MEASUREMENT Com_numCsumMETL "Checksum for METL" UBYTE OneToOne 1 100 0.00 255.0 FORMAT "%5.1" ECU_ADDRESS 0x6000F64D /end MEASUREMENT
/begin MEASUREMENT Com_numCsumMETM "Checksum value of METM frame" UBYTE OneToOne 1 100 0.00 255.0 FORMAT "%5.1" ECU_ADDRESS 0x6000F64C /end MEASUREMENT
/begin MEASUREMENT Com_numCsumMETN "Checksum value of METN frame" UBYTE OneToOne 1 100 0.00 255.0 FORMAT "%5.1" ECU_ADDRESS 0x6000F64B /end MEASUREMENT
/begin MEASUREMENT Com_numCsumPCU "" UBYTE OneToOne 1 100 0.00 255.0 FORMAT "%5.1" ECU_ADDRESS 0x6000F64A /end MEASUREMENT
/begin MEASUREMENT Com_numCsumSRS "Checksum message for SRS frame." UBYTE OneToOne 1 100 0.00 255.0 FORMAT "%5.1" ECU_ADDRESS 0x70003720 /end MEASUREMENT
/begin MEASUREMENT Com_numCsumSRSA "Engine ECU Receive SRSA frame Check sum" UBYTE OneToOne 1 100 0.00 255.0 FORMAT "%5.1" ECU_ADDRESS 0x6000F649 /end MEASUREMENT
/begin MEASUREMENT Com_numCsumSRSB "Checksum message for SRSB frame." UBYTE OneToOne 1 100 0.00 255.0 FORMAT "%5.1" ECU_ADDRESS 0x6000F648 /end MEASUREMENT
/begin MEASUREMENT Com_numCvtGearShiftMap "CVT cruise gear shift MAP No" UBYTE OneToOne 1 100 0.00 255.0 FORMAT "%5.1" ECU_ADDRESS 0x6000F647 /end MEASUREMENT
/begin MEASUREMENT Com_nYaw1UpprData "YAW1 Upper Data" UWORD YawRate_q0p2441_om125 1 100 -125.00 15874.76 FORMAT "%8.2" ECU_ADDRESS 0x60008D12 /end MEASUREMENT
/begin MEASUREMENT Com_pMstCyl "VSA master cylinder pressure" SWORD Pres_kPa_VSA 1 100 -785121.3 785097.3 FORMAT "%8.1" ECU_ADDRESS 0x6000929C /end MEASUREMENT
/begin MEASUREMENT Com_rAPPENGA "The acceleration pedal position for frame ENGA" SWORD Prc 1 100 -400.0000 399.9878 FORMAT "%8.4" ECU_ADDRESS 0x6000928E /end MEASUREMENT
/begin MEASUREMENT Com_rAPPENGT "Selection of accelerator pedal position for CAN tranmission(ENGT Frame)" SWORD Prc 1 100 -400.0000 399.9878 FORMAT "%8.4" ECU_ADDRESS 0x6000928C /end MEASUREMENT
/begin MEASUREMENT Com_rASLCCENGT "message for Accelerator pedal position value depending on ASL and CC" SWORD Prc 1 100 -400.0000 399.9878 FORMAT "%8.4" ECU_ADDRESS 0x6000928A /end MEASUREMENT
/begin MEASUREMENT Com_rClthStk "Quality Of Clutch Stroke" UBYTE Prc_EGR 1 100 0.00 100.0 FORMAT "%5.1" ECU_ADDRESS 0x6000F643 /end MEASUREMENT
/begin MEASUREMENT Com_rConvBoostRaw "raw message for torque converter boost information" UWORD Com_Fact_b0p00006 1 100 0.00 3.999939 FORMAT "%8.6" ECU_ADDRESS 0x70003986 /end MEASUREMENT
/begin MEASUREMENT Com_rConvSlip "Torque convertor slip ratio information recievend oner CAN" UWORD CrCtlSlipRat 1 100 0.00 327.6750 FORMAT "%8.4" ECU_ADDRESS 0x60008D0A /end MEASUREMENT
/begin MEASUREMENT Com_rCVTAct "Current CVT ratio" SWORD TransR_COMPU 1 100 -512.0000 511.9844 FORMAT "%8.4" ECU_ADDRESS 0x60009288 /end MEASUREMENT
/begin MEASUREMENT Com_rFlLvlFlt "Ratio of fuel level value after PT1 filtering" SWORD Prc 1 100 -400.0000 399.9878 FORMAT "%8.4" ECU_ADDRESS 0x60009284 /end MEASUREMENT
/begin MEASUREMENT Com_rFlLvl_mp "Ratio of fuel level corresponding to its raw voltage value" SWORD Prc 1 100 -400.0000 399.9878 FORMAT "%8.4" ECU_ADDRESS 0x600095EA /end MEASUREMENT
/begin MEASUREMENT Com_rTarPllyEAT7 "Target pulley ratio" UBYTE TransR_COMPU 1 100 0.00 3.984 FORMAT "%5.3" ECU_ADDRESS 0x6000F641 /end MEASUREMENT
/begin MEASUREMENT Com_rTrsmTotFild "Filtered T/M overall ratio" UWORD Fact_2pwr11 1 100 0.00 31.99951 FORMAT "%8.5" ECU_ADDRESS 0x60008D04 /end MEASUREMENT
/begin MEASUREMENT Com_rVirtAPP "Accelerator pedal position (PT demand)" SWORD Prc 1 100 -400.0000 399.9878 FORMAT "%8.4" ECU_ADDRESS 0x6000927C /end MEASUREMENT
/begin MEASUREMENT Com_stAbnormCpu "Information about failure determines in CPU(microcomputer)" UBYTE OneToOne 1 100 0.00 255.0 FORMAT "%5.1" ECU_ADDRESS 0x6000F624 /end MEASUREMENT
/begin MEASUREMENT Com_stAbnormVcc "Information about Abnormal Supply voltage(IG) of Longitudinal_G sensor" UBYTE OneToOne 1 100 0.00 255.0 FORMAT "%5.1" ECU_ADDRESS 0x6000F623 /end MEASUREMENT
/begin MEASUREMENT Com_stABSCtrl "ABS control" UBYTE OneToOne 1 100 0.00 255.0 FORMAT "%5.1" ECU_ADDRESS 0x6000F63F /end MEASUREMENT
/begin MEASUREMENT Com_stABSEBDFailr "ABS, EBD failure status" UBYTE OneToOne 1 100 0.00 255.0 FORMAT "%5.1" ECU_ADDRESS 0x6000F63E /end MEASUREMENT
/begin MEASUREMENT Com_stABSWrn "ABS warning status from VSA" UBYTE OneToOne 1 100 0.00 255.0 FORMAT "%5.1" ECU_ADDRESS 0x6000F63D /end MEASUREMENT
/begin MEASUREMENT Com_stAC "Air Conditioner(AC) State" UBYTE OneToOne 1 100 0.00 255.0 FORMAT "%5.1" ECU_ADDRESS 0x6000F63C /end MEASUREMENT
/begin MEASUREMENT Com_stACCActv "IDAS ACC active status" UBYTE OneToOne 1 100 0.00 255.0 FORMAT "%5.1" ECU_ADDRESS 0x6000F63A /end MEASUREMENT
/begin MEASUREMENT Com_stACCBrk "Automatic brake actuated by VSA" UBYTE OneToOne 1 100 0.00 255.0 FORMAT "%5.1" ECU_ADDRESS 0x6000F638 /end MEASUREMENT
/begin MEASUREMENT Com_stACCut "Permission of Air Conditioner Cut" UBYTE OneToOne 1 100 0.00 255.0 FORMAT "%5.1" ECU_ADDRESS 0x6000F634 /end MEASUREMENT
/begin MEASUREMENT Com_stACFailInfo "Alternating current failure status" UBYTE OneToOne 1 100 0.00 255.0 FORMAT "%5.1" ECU_ADDRESS 0x6000EFDE /end MEASUREMENT
/begin MEASUREMENT Com_stACGUpReq "Status of ACG power generation request (14.5V fixed demand) from AC" UBYTE OneToOne 1 100 0.00 255.0 FORMAT "%5.1" ECU_ADDRESS 0x6000F633 /end MEASUREMENT
/begin MEASUREMENT Com_stAcInfo "A/C info" UBYTE OneToOne 1 100 0.00 255.0 FORMAT "%5.1" ECU_ADDRESS 0x6000EFDA /end MEASUREMENT
/begin MEASUREMENT Com_stACISSInhbReqRes "request to inhibit stop engine" UBYTE OneToOne 1 100 0.00 255.0 FORMAT "%5.1" ECU_ADDRESS 0x6000F632 /end MEASUREMENT
/begin MEASUREMENT Com_stACMETG "Ac Status in METG Frame" UBYTE OneToOne 1 100 0.00 255.0 FORMAT "%5.1" ECU_ADDRESS 0x6000F631 /end MEASUREMENT
/begin MEASUREMENT Com_stActABSEBD "VSA ABS plus EBD activation status" UBYTE OneToOne 1 100 0.00 255.0 FORMAT "%5.1" ECU_ADDRESS 0x6000F622 /end MEASUREMENT
/begin MEASUREMENT Com_stActHSA "VSA HSA activation status" UBYTE OneToOne 1 100 0.00 255.0 FORMAT "%5.1" ECU_ADDRESS 0x6000F621 /end MEASUREMENT
/begin MEASUREMENT Com_stAirCdnr "Message from air conditioner" UBYTE OneToOne 1 100 0.00 255.0 FORMAT "%5.1" ECU_ADDRESS 0x6000F620 /end MEASUREMENT
/begin MEASUREMENT Com_stAmbLmpPrms "Ambient display: ECON OK signal via CAN" UBYTE OneToOne 1 100 0.00 255.0 FORMAT "%5.1" ECU_ADDRESS 0x6000F61E /end MEASUREMENT
/begin MEASUREMENT Com_stAPPFailrDetInfo "status of Accel pedal position sensor failure confirmed" UBYTE B_TRUE 1 100 0.00 1.00000000000 BIT_MASK 0x1 FORMAT "%13.11" ECU_ADDRESS 0x6000EE78 /end MEASUREMENT
/begin MEASUREMENT Com_stAPPNormDetInfo "status of Accel pedal position sensor normal confirmed" UBYTE B_TRUE 1 100 0.00 1.00000000000 BIT_MASK 0x1 FORMAT "%13.11" ECU_ADDRESS 0x6000EE77 /end MEASUREMENT
/begin MEASUREMENT Com_stAPPSensFail "Status message to indicate Accelerator Pedal Sensor failure" UBYTE OneToOne 1 100 0.00 255.0 FORMAT "%5.1" ECU_ADDRESS 0x6000F62F /end MEASUREMENT
/begin MEASUREMENT Com_stATFTVal "Status for ATF Temperature value" UBYTE OneToOne 1 100 0.00 255.0 FORMAT "%5.1" ECU_ADDRESS 0x6000F62C /end MEASUREMENT
/begin MEASUREMENT Com_stATMILReq "MIL request recieved from ACC ECU" UBYTE OneToOne 1 100 0.00 255.0 BIT_MASK 0x1 FORMAT "%5.1" ECU_ADDRESS 0x6000F169 /end MEASUREMENT
/begin MEASUREMENT Com_stATMILReqEAT8 "Status of MIL request from AT unit for EAT8" UBYTE OneToOne 1 100 0.00 1.000 BIT_MASK 0x1 FORMAT "%5.3" ECU_ADDRESS 0x70000C65 /end MEASUREMENT
/begin MEASUREMENT Com_stAYCF "VSA shift control request" UBYTE OneToOne 1 100 0.00 255.0 FORMAT "%5.1" ECU_ADDRESS 0x60000944 /end MEASUREMENT
/begin MEASUREMENT Com_stAYCFShiftReq "VSA shift control request" UBYTE OneToOne 1 100 0.00 255.0 FORMAT "%5.1" ECU_ADDRESS 0x60000945 /end MEASUREMENT
/begin MEASUREMENT Com_stBCANInfo "status of B-CAN information" UBYTE OneToOne 1 100 0.00 255.0 FORMAT "%5.1" ECU_ADDRESS 0x6000EFD9 /end MEASUREMENT
/begin MEASUREMENT Com_stBCANReprogm "status of BCAN reprogramming" UBYTE OneToOne 1 100 0.00 255.0 FORMAT "%5.1" ECU_ADDRESS 0x6000F168 /end MEASUREMENT
/begin MEASUREMENT Com_stBrkHldStby "Status of Brake hold system standby" UBYTE OneToOne 1 100 0.00 255.0 FORMAT "%5.1" ECU_ADDRESS 0x6000F615 /end MEASUREMENT
/begin MEASUREMENT Com_stBrkHldSys "Brake Hold System Active status" UBYTE OneToOne 1 100 0.00 255.0 FORMAT "%5.1" ECU_ADDRESS 0x6000F614 /end MEASUREMENT
/begin MEASUREMENT Com_stCalCmplLatG "Lateral_G calibration complete" UBYTE OneToOne 1 100 0.00 255.0 FORMAT "%5.1" ECU_ADDRESS 0x6000F60C /end MEASUREMENT
/begin MEASUREMENT Com_stCalCmplLgtG "Information about Calibration complete of Longitudinal_G sensor" UBYTE OneToOne 1 100 0.00 255.0 FORMAT "%5.1" ECU_ADDRESS 0x6000F60B /end MEASUREMENT
/begin MEASUREMENT Com_stCANANoBusOff "F1-CAN Bus Off Error status" UBYTE OneToOne 1 100 0.00 255.0 FORMAT "%5.1" ECU_ADDRESS 0x6000F612 /end MEASUREMENT
/begin MEASUREMENT Com_stCANBNoBusOff "CAN_B Bussoff status." UBYTE OneToOne 1 100 0.00 255.0 FORMAT "%5.1" ECU_ADDRESS 0x6000F611 /end MEASUREMENT
/begin MEASUREMENT Com_stCANCNoBusOff "P CAN Bus Off error status" UBYTE OneToOne 1 100 0.00 255.0 FORMAT "%5.1" ECU_ADDRESS 0x6000F610 /end MEASUREMENT
/begin MEASUREMENT Com_stCarAcsSysActv "Car acess sysytem active" UBYTE OneToOne 1 100 0.00 255.0 FORMAT "%5.1" ECU_ADDRESS 0x6000F608 /end MEASUREMENT
/begin MEASUREMENT Com_stCarAcsSysPtdOper "Car acess system operation" UBYTE OneToOne 1 100 0.00 255.0 FORMAT "%5.1" ECU_ADDRESS 0x6000F607 /end MEASUREMENT
/begin MEASUREMENT Com_stCfmdNPosn "Confirmed N Position" UBYTE OneToOne 1 100 0.00 255.0 FORMAT "%5.1" ECU_ADDRESS 0x6000F606 /end MEASUREMENT
/begin MEASUREMENT Com_stCfmdPPosn "Confirmed Park-Position" UBYTE OneToOne 1 100 0.00 255.0 FORMAT "%5.1" ECU_ADDRESS 0x6000F605 /end MEASUREMENT
/begin MEASUREMENT Com_stCfmdPPosnFCAN "F-CAN confirmed P position" UBYTE OneToOne 1 100 0.00 255.0 FORMAT "%5.1" ECU_ADDRESS 0x6000F604 /end MEASUREMENT
/begin MEASUREMENT Com_stCfmdPPosnPTCAN "PT-CAN Parking postion" UBYTE OneToOne 1 100 0.00 255.0 FORMAT "%5.1" ECU_ADDRESS 0x6000F603 /end MEASUREMENT
/begin MEASUREMENT Com_stCllsnDetn "Collision detection functionality" UBYTE OneToOne 1 100 0.00 255.0 FORMAT "%5.1" ECU_ADDRESS 0x6000F601 /end MEASUREMENT
/begin MEASUREMENT Com_stClrCmplInfoVINRegst "IMG request clear status" UBYTE OneToOne 1 100 0.00 255.0 FORMAT "%5.1" ECU_ADDRESS 0x6000F600 /end MEASUREMENT
/begin MEASUREMENT Com_stClthPedlFailDet "Clutch Pedal Fault Detection inofrmation" UBYTE OneToOne 1 100 0.00 255.0 FORMAT "%5.1" ECU_ADDRESS 0x6000F5FF /end MEASUREMENT
/begin MEASUREMENT Com_stClthStkFailInfo "Failure Information of Clutch Stroke Sensor" UBYTE OneToOne 1 100 0.00 255.0 FORMAT "%5.1" ECU_ADDRESS 0x6000F5FE /end MEASUREMENT
/begin MEASUREMENT Com_stCombUnitFailInfo "Status of COMB unit fail information from B-CAN" UBYTE OneToOne 1 100 0.00 255.0 FORMAT "%5.1" ECU_ADDRESS 0x6000EFD5 /end MEASUREMENT
/begin MEASUREMENT Com_stComVSA "Inhibit error information from VSA" UBYTE OneToOne 1 100 0.00 255.0 FORMAT "%5.1" ECU_ADDRESS 0x6000F5FC /end MEASUREMENT
/begin MEASUREMENT Com_stCVTEngmtInfo "Drive train engagement information for ISAB ( CVT PT engagement information )" UBYTE OneToOne 1 100 0.00 255.0 FORMAT "%5.1" ECU_ADDRESS 0x7000371F /end MEASUREMENT
/begin MEASUREMENT Com_stCVTFailrInfo "CVT failure information" UBYTE OneToOne 1 100 0.00 255.0 FORMAT "%5.1" ECU_ADDRESS 0x6000F60E /end MEASUREMENT
/begin MEASUREMENT Com_stCvtPosnPrms "Select lever position for CC for CVT" UBYTE OneToOne 1 100 0.00 255.0 FORMAT "%5.1" ECU_ADDRESS 0x6000F5F9 /end MEASUREMENT
/begin MEASUREMENT Com_stCVTShiftActv "CVT Shift Active status" UBYTE OneToOne 1 100 0.00 255.0 FORMAT "%5.1" ECU_ADDRESS 0x6000F60D /end MEASUREMENT
/begin MEASUREMENT Com_stDCSPlusAYCF "Positive torque request" UBYTE OneToOne 1 100 0.00 255.0 FORMAT "%5.1" ECU_ADDRESS 0x60000946 /end MEASUREMENT
/begin MEASUREMENT Com_stDrvModSwt "Status of Drive Mode Switch" UBYTE OneToOne 1 100 0.00 255.0 FORMAT "%5.1" ECU_ADDRESS 0x6000EFD3 /end MEASUREMENT
/begin MEASUREMENT Com_stDstMETK "Status of total meter distance" UBYTE OneToOne 1 100 0.00 255.0 FORMAT "%5.1" ECU_ADDRESS 0x6000EFD2 /end MEASUREMENT
/begin MEASUREMENT Com_stECON "Status of ECON lamp" UBYTE OneToOne 1 100 0.00 255.0 FORMAT "%5.1" ECU_ADDRESS 0x6000F5E5 /end MEASUREMENT
/begin MEASUREMENT Com_stEGRVlvErr "status of EGR Valve failure" UBYTE OneToOne 1 100 0.00 255.0 FORMAT "%5.1" ECU_ADDRESS 0x6000F5E4 /end MEASUREMENT
/begin MEASUREMENT Com_stEngCanRxErr "Information of CAN recieve error status" UBYTE OneToOne 1 100 0.00 255.0 BIT_MASK 0x1 FORMAT "%5.1" ECU_ADDRESS 0x60000947 /end MEASUREMENT
/begin MEASUREMENT Com_stEngHoodOpn "Engine Hood status" UBYTE OneToOne 1 100 0.00 255.0 FORMAT "%5.1" ECU_ADDRESS 0x6000F5C8 /end MEASUREMENT
/begin MEASUREMENT Com_stEngRun "Engine run status" UBYTE OneToOne 1 100 0.00 255.0 FORMAT "%5.1" ECU_ADDRESS 0x6000F5C2 /end MEASUREMENT
/begin MEASUREMENT Com_stEnvT "Error status of environmental temperature" UBYTE OneToOne 1 100 0.00 255.0 FORMAT "%5.1" ECU_ADDRESS 0x6000F5BE /end MEASUREMENT
/begin MEASUREMENT Com_stEPBAppld_Raw "Raw value of EPB operation" UBYTE OneToOne 1 100 0.00 1.000 FORMAT "%5.3" ECU_ADDRESS 0x6000F5DD /end MEASUREMENT
/begin MEASUREMENT Com_stEPBFailrInfo_Raw "Raw value of EPB Failure Information" UBYTE OneToOne 1 100 0.00 1.000 FORMAT "%5.3" ECU_ADDRESS 0x6000F5DB /end MEASUREMENT
/begin MEASUREMENT Com_stEPBInhbAct_Raw "Raw value of EPB Inhibit condition" UBYTE OneToOne 1 100 0.00 1.000 FORMAT "%5.3" ECU_ADDRESS 0x6000F5D9 /end MEASUREMENT
/begin MEASUREMENT Com_stEPBInhbBrk "EPB brake inihibition status" UBYTE OneToOne 1 100 0.00 255.0 FORMAT "%5.1" ECU_ADDRESS 0x6000F5D8 /end MEASUREMENT
/begin MEASUREMENT Com_stEPBPlaSftyMod_Raw "Raw value of EPB safety mode" UBYTE OneToOne 1 100 0.00 1.000 FORMAT "%5.3" ECU_ADDRESS 0x6000F5D6 /end MEASUREMENT
/begin MEASUREMENT Com_stEPBStInfo_Raw "Raw value of EPB State Information" UBYTE OneToOne 1 100 0.00 15.00 FORMAT "%5.2" ECU_ADDRESS 0x6000F5D4 /end MEASUREMENT
/begin MEASUREMENT Com_stEPS1ISSRelsReq "Idle Stop Release Request" UBYTE OneToOne 1 100 0.00 255.0 FORMAT "%5.1" ECU_ADDRESS 0x6000F5D3 /end MEASUREMENT
/begin MEASUREMENT Com_stEPSISSInhbReq "ISS inhibit Request from EPS" UBYTE OneToOne 1 100 0.00 255.0 FORMAT "%5.1" ECU_ADDRESS 0x6000F5D2 /end MEASUREMENT
/begin MEASUREMENT Com_stEPSMidReq "Grow lights WLP status" UBYTE OneToOne 1 100 0.00 255.0 FORMAT "%5.1" ECU_ADDRESS 0x6000F5D0 /end MEASUREMENT
/begin MEASUREMENT Com_stEthnlSErr "status of Ethanol sensor error" UBYTE OneToOne 1 100 0.00 255.0 FORMAT "%5.1" ECU_ADDRESS 0x6000F5BC /end MEASUREMENT
/begin MEASUREMENT Com_stFailMstCylPSnsr "VSA brake master cylinder pressure sensor fail status" UBYTE OneToOne 1 100 0.00 255.0 FORMAT "%5.1" ECU_ADDRESS 0x6000F5BB /end MEASUREMENT
/begin MEASUREMENT Com_stFailrLatG "Lateral_G failure" UBYTE OneToOne 1 100 0.00 255.0 FORMAT "%5.1" ECU_ADDRESS 0x6000F5B9 /end MEASUREMENT
/begin MEASUREMENT Com_stFailrLgtG "Information about failure of Longitudinal_G sensor" UBYTE OneToOne 1 100 0.00 255.0 FORMAT "%5.1" ECU_ADDRESS 0x6000F5B8 /end MEASUREMENT
/begin MEASUREMENT Com_stFrmRxEna "Receive Frame enable switch" UBYTE OneToOne 1 100 0.00 255.0 FORMAT "%5.1" ARRAY_SIZE 7 ECU_ADDRESS 0x6000F5B1 /end MEASUREMENT
/begin MEASUREMENT Com_stFrmTxEna "enable status of transmit frames" UBYTE OneToOne 1 100 0.00 255.0 FORMAT "%5.1" ARRAY_SIZE 6 ECU_ADDRESS 0x6000F5AB /end MEASUREMENT
/begin MEASUREMENT Com_stFrntDfrstSwtInfoRes "front side defroster switch status" UBYTE OneToOne 1 100 0.00 255.0 FORMAT "%5.1" ECU_ADDRESS 0x6000F5AA /end MEASUREMENT
/begin MEASUREMENT Com_stFrntLeWhlSpdSnsrErr "Front Left wheel speed sensor error status" UBYTE OneToOne 1 100 0.00 1.000 BIT_MASK 0x1 FORMAT "%5.3" ECU_ADDRESS 0x70000C64 /end MEASUREMENT
/begin MEASUREMENT Com_stFrntRiWhlSpdSnsrErr "Front right wheel speed sensor error status" UBYTE OneToOne 1 100 0.00 1.000 BIT_MASK 0x1 FORMAT "%5.3" ECU_ADDRESS 0x70000C63 /end MEASUREMENT
/begin MEASUREMENT Com_stFrtFog "Meter Front Fog Status" UBYTE OneToOne 1 100 0.00 255.0 FORMAT "%5.1" ECU_ADDRESS 0x6000F5A9 /end MEASUREMENT
/begin MEASUREMENT Com_stFuCtrlReq "Fuel control request signal" UBYTE OneToOne 1 100 0.00 255.0 FORMAT "%5.1" ECU_ADDRESS 0x6000F890 /end MEASUREMENT
/begin MEASUREMENT Com_stFuCtrlReqRaw "Raw value of Fuel control request signal" UBYTE OneToOne 1 100 0.00 255.0 FORMAT "%5.1" ECU_ADDRESS 0x60000948 /end MEASUREMENT
/begin MEASUREMENT Com_stFwdRvsCluInfo "Status of forward/reverse clutch fastened" UBYTE OneToOne 1 100 0.00 255.0 FORMAT "%5.1" ECU_ADDRESS 0x6000F5A7 /end MEASUREMENT
/begin MEASUREMENT Com_stGearChgCtrlMod "Value of Gear Change Control mode status" UBYTE OneToOne 1 100 0.00 255.0 FORMAT "%5.1" ECU_ADDRESS 0x6000F5A4 /end MEASUREMENT
/begin MEASUREMENT Com_stGearPPosnReqPTCAN "Request for Gear Position P" UBYTE OneToOne 1 100 0.00 255.0 FORMAT "%5.1" ECU_ADDRESS 0x6000F5A3 /end MEASUREMENT
/begin MEASUREMENT Com_stHvyDecelFlg "Judgement flag for rapid fastened" UBYTE OneToOne 1 100 0.00 255.0 FORMAT "%5.1" ECU_ADDRESS 0x6000F5A1 /end MEASUREMENT
/begin MEASUREMENT Com_stHydPCtrlOper "EPB brake status information" UBYTE OneToOne 1 100 0.00 255.0 FORMAT "%5.1" ECU_ADDRESS 0x6000F5A0 /end MEASUREMENT
/begin MEASUREMENT Com_stICUHoodErr "ICU Hood Communication status" UBYTE OneToOne 1 100 0.00 255.0 FORMAT "%5.1" ECU_ADDRESS 0x6000F59E /end MEASUREMENT
/begin MEASUREMENT Com_stIDASShftReq "Shift down request from IDAS" UBYTE OneToOne 1 100 0.00 255.0 FORMAT "%5.1" ECU_ADDRESS 0x6000F59B /end MEASUREMENT
/begin MEASUREMENT Com_stIDASTrqLowSel "Status of ASL control." UBYTE OneToOne 1 100 0.00 255.0 FORMAT "%5.1" ECU_ADDRESS 0x6000F59A /end MEASUREMENT
/begin MEASUREMENT Com_stIdleStrtStopDispFct "Idle startstop display function" UBYTE OneToOne 1 100 0.00 255.0 FORMAT "%5.1" ECU_ADDRESS 0x7000371E /end MEASUREMENT
/begin MEASUREMENT Com_stIMGACCBrkReq "IMG ACC Brake Request" UBYTE OneToOne 1 100 0.00 255.0 FORMAT "%5.1" ECU_ADDRESS 0x6000F599 /end MEASUREMENT
/begin MEASUREMENT Com_stIMGDrvTq "IMG drive arbiration status" UBYTE OneToOne 1 100 0.00 3.000 FORMAT "%5.3" ECU_ADDRESS 0x6000F598 /end MEASUREMENT
/begin MEASUREMENT Com_stIMGECUIG1 "IMG-ECU IG1 status" UBYTE OneToOne 1 100 0.00 255.0 FORMAT "%5.1" ECU_ADDRESS 0x6000F597 /end MEASUREMENT
/begin MEASUREMENT Com_stIMGIDSA12DrvMod "Group A12 Drive Mode Status" UBYTE OneToOne 1 100 0.00 15.00 FORMAT "%5.2" ECU_ADDRESS 0x6000F596 /end MEASUREMENT
/begin MEASUREMENT Com_stIMGIDSDrvMod "Group A5 Drive Mode Status" UBYTE OneToOne 1 100 0.00 255.0 FORMAT "%5.1" ECU_ADDRESS 0x60000949 /end MEASUREMENT
/begin MEASUREMENT Com_stIMGISBrkCntrADAS "IMG Idle Stop Brake Counter status" UBYTE OneToOne 1 100 0.00 1.000 FORMAT "%5.3" ECU_ADDRESS 0x6000F595 /end MEASUREMENT
/begin MEASUREMENT Com_stIMGISBrkHldActv "Message holds the Brake hold operation in progress information" UBYTE OneToOne 1 100 0.00 255.0 FORMAT "%5.1" ECU_ADDRESS 0x6000094A /end MEASUREMENT
/begin MEASUREMENT Com_stIMGISBrkHldStb "Message for Brake hold system standby information" UBYTE OneToOne 1 100 0.00 255.0 FORMAT "%5.1" ECU_ADDRESS 0x6000094B /end MEASUREMENT
/begin MEASUREMENT Com_stIMGISInhbBrk "Message for Idle stop control prohibition request by brake information" UBYTE OneToOne 1 100 0.00 255.0 FORMAT "%5.1" ECU_ADDRESS 0x6000094C /end MEASUREMENT
/begin MEASUREMENT Com_stIMGISRlsReq "Message fro IMG Idle stop Release Request status" UBYTE OneToOne 1 100 0.00 1.000 FORMAT "%5.3" ECU_ADDRESS 0x6000F594 /end MEASUREMENT
/begin MEASUREMENT Com_stIMGISRstrtInhbBrk "Message for Idle stop return control prohibition request by brake" UBYTE OneToOne 1 100 0.00 255.0 FORMAT "%5.1" ECU_ADDRESS 0x6000094D /end MEASUREMENT
/begin MEASUREMENT Com_stIMGISShiftInhbBrk "Message for Idle stop shift control prohibition request by brake" UBYTE OneToOne 1 100 0.00 255.0 FORMAT "%5.1" ECU_ADDRESS 0x6000094E /end MEASUREMENT
/begin MEASUREMENT Com_stIMGISSysOffBrk "Message for Idle stop system off request by brake information" UBYTE OneToOne 1 100 0.00 255.0 FORMAT "%5.1" ECU_ADDRESS 0x6000094F /end MEASUREMENT
/begin MEASUREMENT Com_stIMGLimTq "IMG suppression Torque Status" UBYTE OneToOne 1 100 0.00 7.000 FORMAT "%5.3" ECU_ADDRESS 0x6000F593 /end MEASUREMENT
/begin MEASUREMENT Com_stIMGMILReq "Status of MIL request from IMG unit" UBYTE B_TRUE 1 100 0.00 1.00000000000 BIT_MASK 0x1 FORMAT "%13.11" ECU_ADDRESS 0x6000F592 /end MEASUREMENT
/begin MEASUREMENT Com_stIMGShiftReq "IMG Shift Request" UBYTE OneToOne 1 100 0.00 255.0 FORMAT "%5.1" ECU_ADDRESS 0x6000F591 /end MEASUREMENT
/begin MEASUREMENT Com_stInhbMstCylPSnsr "VSA brake master cylinder pressure sensor inhibition status" UBYTE OneToOne 1 100 0.00 255.0 FORMAT "%5.1" ECU_ADDRESS 0x6000F588 /end MEASUREMENT
/begin MEASUREMENT Com_stISABAct "ISAB operation status" UBYTE OneToOne 1 100 0.00 255.0 FORMAT "%5.1" ECU_ADDRESS 0x6000F590 /end MEASUREMENT
/begin MEASUREMENT Com_stISABActAYCI "ISAB operation status from AYCI" UBYTE OneToOne 1 100 0.00 255.0 FORMAT "%5.1" ECU_ADDRESS 0x60000950 /end MEASUREMENT
/begin MEASUREMENT Com_stISABasSpd "ISA Base Speed Status" UBYTE OneToOne 1 100 0.00 255.0 FORMAT "%5.1" ECU_ADDRESS 0x6000F58E /end MEASUREMENT
/begin MEASUREMENT Com_stISABEna "ISAB permission status" UBYTE OneToOne 1 100 0.00 255.0 FORMAT "%5.1" ECU_ADDRESS 0x6000F58F /end MEASUREMENT
/begin MEASUREMENT Com_stISABEnaAYCI "ISAB permission status from AYCI" UBYTE OneToOne 1 100 0.00 255.0 FORMAT "%5.1" ECU_ADDRESS 0x60000951 /end MEASUREMENT
/begin MEASUREMENT Com_stISSInhbnSwt "Status of ISS ( Idle start/stop) inhibition switch received over CAN" UBYTE OneToOne 1 100 0.00 255.0 FORMAT "%5.1" ECU_ADDRESS 0x6000F58C /end MEASUREMENT
/begin MEASUREMENT Com_stKlsDoorLck "Keyless door lock information" UBYTE OneToOne 1 100 0.00 255.0 FORMAT "%5.1" ECU_ADDRESS 0x6000F587 /end MEASUREMENT
/begin MEASUREMENT Com_stLCInfo "L/C information recieved over CAN" UBYTE OneToOne 1 100 0.00 255.0 FORMAT "%5.1" ECU_ADDRESS 0x6000F586 /end MEASUREMENT
/begin MEASUREMENT Com_stLCZone "Lock up clutch Zone status" UBYTE OneToOne 1 100 0.00 255.0 FORMAT "%5.1" ECU_ADDRESS 0x60000952 /end MEASUREMENT
/begin MEASUREMENT Com_stLgtGASensErr "Longitudinal G Sensor error status" UBYTE OneToOne 1 100 0.00 255.0 FORMAT "%5.1" ECU_ADDRESS 0x70000C62 /end MEASUREMENT
/begin MEASUREMENT Com_stLgtGASensInh "Inhibition status of Longitudinal G sensor" UBYTE OneToOne 1 100 0.00 255.0 FORMAT "%5.1" ECU_ADDRESS 0x70000C61 /end MEASUREMENT
/begin MEASUREMENT Com_stLiSwtInfo "status of light switch information for MET2 frame" UBYTE OneToOne 1 100 0.00 255.0 FORMAT "%5.1" ECU_ADDRESS 0x6000F584 /end MEASUREMENT
/begin MEASUREMENT Com_stMETE2ACISSInhbReq "Idle stop inhibition flag" UBYTE OneToOne 1 100 0.00 255.0 FORMAT "%5.1" ECU_ADDRESS 0x6000F57E /end MEASUREMENT
/begin MEASUREMENT Com_stMETE2FrntDfrstSwtInfo "Status of Front Defroster switch information" UBYTE OneToOne 1 100 0.00 255.0 FORMAT "%5.1" ECU_ADDRESS 0x6000F57D /end MEASUREMENT
/begin MEASUREMENT Com_stMICUInfo "status of MICU information" UBYTE OneToOne 1 100 0.00 255.0 FORMAT "%5.1" ECU_ADDRESS 0x6000EFC6 /end MEASUREMENT
/begin MEASUREMENT Com_stMilLtgReq "MIL lighting request from transmission" UBYTE OneToOne 1 100 0.00 255.0 FORMAT "%5.1" ECU_ADDRESS 0x6000F57A /end MEASUREMENT
/begin MEASUREMENT Com_stMissSnsrFlg "Missing Sensor Flag" UBYTE OneToOne 1 100 0.00 255.0 FORMAT "%5.1" ECU_ADDRESS 0x6000F578 /end MEASUREMENT
/begin MEASUREMENT Com_stMon "Interface for enabling the monitoring conditions for CAN Frames" UBYTE OneToOne 1 100 0.00 255.0 FORMAT "%5.1" ECU_ADDRESS 0x6000F577 /end MEASUREMENT
/begin MEASUREMENT Com_stMonitor "Status for Eanbling the monitoring condition of CAN Frames" UBYTE OneToOne 1 100 0.00 255.0 FORMAT "%5.1" ECU_ADDRESS 0x6000F572 /end MEASUREMENT
/begin MEASUREMENT Com_stMtrCustDftReq "Customizing default demand" UBYTE OneToOne 1 100 0.00 255.0 FORMAT "%5.1" ECU_ADDRESS 0x6000F571 /end MEASUREMENT
/begin MEASUREMENT Com_stMtrCustFlg "Customizing function execution flag" UBYTE OneToOne 1 100 0.00 255.0 FORMAT "%5.1" ECU_ADDRESS 0x6000F570 /end MEASUREMENT
/begin MEASUREMENT Com_stMtrCustStReq "ECU mapped message for CAN signal METER_CUSTOM_STATUS" UBYTE OneToOne 1 100 0.00 255.0 FORMAT "%5.1" ECU_ADDRESS 0x6000F56F /end MEASUREMENT
/begin MEASUREMENT Com_stMtrEva "METER_EVA_TEMP" UBYTE OneToOne 1 100 0.00 255.0 FORMAT "%5.1" ECU_ADDRESS 0x6000F56E /end MEASUREMENT
/begin MEASUREMENT Com_stNotTxDrvgF "TM Free condition" UBYTE OneToOne 1 100 0.00 255.0 FORMAT "%5.1" ECU_ADDRESS 0x6000F56C /end MEASUREMENT
/begin MEASUREMENT Com_stNotTxDrvgFFCAN "F-CAN Driving force" UBYTE OneToOne 1 100 0.00 255.0 FORMAT "%5.1" ECU_ADDRESS 0x6000F56B /end MEASUREMENT
/begin MEASUREMENT Com_stNotTxDrvgFPTCAN "PT-CAN driving force information" UBYTE OneToOne 1 100 0.00 255.0 FORMAT "%5.1" ECU_ADDRESS 0x6000F56A /end MEASUREMENT
/begin MEASUREMENT Com_stPCUEngStrtInhb "The status of engine start inhibition flag" UBYTE OneToOne 1 100 0.00 255.0 FORMAT "%5.1" ECU_ADDRESS 0x6000F564 /end MEASUREMENT
/begin MEASUREMENT Com_stPreStop "Precondition for start-stop approved by CVT" UBYTE OneToOne 1 100 0.00 255.0 FORMAT "%5.1" ECU_ADDRESS 0x7000371D /end MEASUREMENT
/begin MEASUREMENT Com_stPrkgBrkSw "parking brake status" UBYTE OneToOne 1 100 0.00 255.0 FORMAT "%5.1" ECU_ADDRESS 0x6000F563 /end MEASUREMENT
/begin MEASUREMENT Com_stPrmntErrYaw1 "YAW1 Permanent Error" UBYTE OneToOne 1 100 0.00 255.0 FORMAT "%5.1" ECU_ADDRESS 0x6000F562 /end MEASUREMENT
/begin MEASUREMENT Com_stReLeWhlSpdSnsrErr "Rear Left wheel speed sensor error status" UBYTE OneToOne 1 100 0.00 1.000 BIT_MASK 0x1 FORMAT "%5.3" ECU_ADDRESS 0x70000C60 /end MEASUREMENT
/begin MEASUREMENT Com_stRemEngStrtr "Remote Engine Starter State" UBYTE OneToOne 1 100 0.00 1.000 BIT_MASK 0x1 FORMAT "%5.3" ECU_ADDRESS 0x70000C5E /end MEASUREMENT
/begin MEASUREMENT Com_stReRiWhlSpdSnsrErr "Rear Right wheel speed sensor error status" UBYTE OneToOne 1 100 0.00 1.000 BIT_MASK 0x1 FORMAT "%5.3" ECU_ADDRESS 0x70000C5F /end MEASUREMENT
/begin MEASUREMENT Com_stRrFog "Meter Rear Fog Status" UBYTE OneToOne 1 100 0.00 255.0 FORMAT "%5.1" ECU_ADDRESS 0x6000F561 /end MEASUREMENT
/begin MEASUREMENT Com_stRstReq "Reset switch data during engine oil change" UBYTE OneToOne 1 100 0.00 255.0 FORMAT "%5.1" ECU_ADDRESS 0x6000EFC5 /end MEASUREMENT
/begin MEASUREMENT Com_stRxEPBBChkSumOk "Staus of Checksum Error in EPBB frame" UBYTE OneToOne 1 100 0.00 255.0 FORMAT "%5.1" ECU_ADDRESS 0x6000F550 /end MEASUREMENT
/begin MEASUREMENT Com_stRxEPBBRingCntOk "Staus of Ring counter Error in EPBB frame" UBYTE OneToOne 1 100 0.00 255.0 FORMAT "%5.1" ECU_ADDRESS 0x6000F54D /end MEASUREMENT
/begin MEASUREMENT Com_stSeatBltInfo "Driver seat belt information received in SRS frame." UBYTE Com_stSeatBltInfo_COMPU_VERB 1 100 0.00 3.00000000000 FORMAT "%13.11" ECU_ADDRESS 0x60000953 /end MEASUREMENT
/begin MEASUREMENT Com_stShftInD "Actual transmission position for D-range" UBYTE OneToOne 1 100 0.00 255.0 FORMAT "%5.1" ECU_ADDRESS 0x6000F545 /end MEASUREMENT
/begin MEASUREMENT Com_stShftInL "Status of position L for shifting" UBYTE OneToOne 1 100 0.00 255.0 FORMAT "%5.1" ECU_ADDRESS 0x6000F544 /end MEASUREMENT
/begin MEASUREMENT Com_stShftInNeutr "Actual transmission position for N-range" UBYTE OneToOne 1 100 0.00 255.0 FORMAT "%5.1" ECU_ADDRESS 0x6000F543 /end MEASUREMENT
/begin MEASUREMENT Com_stShftInPark "Actual transmission position for P-range" UBYTE OneToOne 1 100 0.00 255.0 FORMAT "%5.1" ECU_ADDRESS 0x6000F542 /end MEASUREMENT
/begin MEASUREMENT Com_stShftInRev "Actual transmission position for R-range" UBYTE OneToOne 1 100 0.00 255.0 FORMAT "%5.1" ECU_ADDRESS 0x6000F541 /end MEASUREMENT
/begin MEASUREMENT Com_stShftInS "Actual transmission position for S-range" UBYTE OneToOne 1 100 0.00 255.0 FORMAT "%5.1" ECU_ADDRESS 0x6000F540 /end MEASUREMENT
/begin MEASUREMENT Com_stShiftDwnReco "Shift down recommendation for GSI" UBYTE OneToOne 1 100 0.00 255.0 FORMAT "%5.1" ECU_ADDRESS 0x6000F53D /end MEASUREMENT
/begin MEASUREMENT Com_stShiftUpReco "Shift up recommendation for GSI" UBYTE OneToOne 1 100 0.00 255.0 FORMAT "%5.1" ECU_ADDRESS 0x6000F53B /end MEASUREMENT
/begin MEASUREMENT Com_stSpdSnsrFailr "Speed Sensor Failure" UBYTE OneToOne 1 100 0.00 255.0 FORMAT "%5.1" ECU_ADDRESS 0x6000F536 /end MEASUREMENT
/begin MEASUREMENT Com_stSrvModDispReq "Engine Service Mode Information" UBYTE OneToOne 1 100 0.00 255.0 FORMAT "%5.1" ECU_ADDRESS 0x6000F535 /end MEASUREMENT
/begin MEASUREMENT Com_stStaActvReq "Starter Information over CAN" UBYTE OneToOne 1 100 0.00 255.0 BIT_MASK 0x1 FORMAT "%5.1" ECU_ADDRESS 0x6000F15C /end MEASUREMENT
/begin MEASUREMENT Com_stStrtupProc "Information about startup process(when the sensor output can not be guaranteed)" UBYTE OneToOne 1 100 0.00 255.0 FORMAT "%5.1" ECU_ADDRESS 0x6000F532 /end MEASUREMENT
/begin MEASUREMENT Com_stSwISInhbSts "Software Switch Status IS Inhibition" UBYTE OneToOne 1 100 0.00 255.0 FORMAT "%5.1" ECU_ADDRESS 0x6000F531 /end MEASUREMENT
/begin MEASUREMENT Com_stTarSpdDisp "Status of CCACC target speed display" UBYTE OneToOne 1 100 0.00 255.0 FORMAT "%5.1" ECU_ADDRESS 0x6000F529 /end MEASUREMENT
/begin MEASUREMENT Com_stTCUECUIG1 "TCU-ECU IG1 status" UBYTE OneToOne 1 100 0.00 255.0 FORMAT "%5.1" ECU_ADDRESS 0x6000F52D /end MEASUREMENT
/begin MEASUREMENT Com_stTempAbnormLatG "Temporarily abnormal Lateral-G" UBYTE OneToOne 1 100 0.00 255.0 FORMAT "%5.1" ECU_ADDRESS 0x6000F528 /end MEASUREMENT
/begin MEASUREMENT Com_stTempAbnormLgtG "Information about Temporarily abnormal of Longitudinal_G sensor" UBYTE OneToOne 1 100 0.00 255.0 FORMAT "%5.1" ECU_ADDRESS 0x6000F527 /end MEASUREMENT
/begin MEASUREMENT Com_stTmpErrYaw1 "YAW1 Temporary Error" UBYTE OneToOne 1 100 0.00 255.0 FORMAT "%5.1" ECU_ADDRESS 0x6000F525 /end MEASUREMENT
/begin MEASUREMENT Com_stTMTqDwnReq "TM torque down request" UBYTE OneToOne 1 100 0.00 255.0 FORMAT "%5.1" ECU_ADDRESS 0x6000F52B /end MEASUREMENT
/begin MEASUREMENT Com_stTranStop "Transition condition for start-stop approved by CVT" UBYTE OneToOne 1 100 0.00 255.0 FORMAT "%5.1" ECU_ADDRESS 0x7000371C /end MEASUREMENT
/begin MEASUREMENT Com_stTrsmFailMod "The status of transmission failure mode" UBYTE OneToOne 1 100 0.00 255.0 FORMAT "%5.1" ECU_ADDRESS 0x6000F520 /end MEASUREMENT
/begin MEASUREMENT Com_stVehSpdSensErr "Unplausibility condition from vehicle velocity sensor over CAN" UBYTE OneToOne 1 100 0.00 255.0 FORMAT "%5.1" ECU_ADDRESS 0x6000F502 /end MEASUREMENT
/begin MEASUREMENT Com_stVehSpdSnsr "CVT vehicle speed sensor" UBYTE OneToOne 1 100 0.00 255.0 FORMAT "%5.1" ECU_ADDRESS 0x6000F501 /end MEASUREMENT
/begin MEASUREMENT Com_stVINWrClrDone "VIN write clear done status" UBYTE OneToOne 1 100 0.00 255.0 BIT_MASK 0x1 FORMAT "%5.1" ECU_ADDRESS 0x6000F51C /end MEASUREMENT
/begin MEASUREMENT Com_stVINWriteClrDone "Clear process done flag" UBYTE OneToOne 1 100 0.00 255.0 FORMAT "%5.1" ECU_ADDRESS 0x6000F51B /end MEASUREMENT
/begin MEASUREMENT Com_stVSAAirPThrUsSnsrErr "Error weight value from Air pressure Throttle Upstream sensor module" UBYTE OneToOne 1 100 0.00 255.0 FORMAT "%5.1" ECU_ADDRESS 0x6000F519 /end MEASUREMENT
/begin MEASUREMENT Com_stVSAAPedlErr "error weight value from Ped module" UBYTE OneToOne 1 100 0.00 255.0 FORMAT "%5.1" ECU_ADDRESS 0x6000F51A /end MEASUREMENT
/begin MEASUREMENT Com_stVSABstCtrlErr "error weight value from clth module" UBYTE OneToOne 1 100 0.00 255.0 FORMAT "%5.1" ECU_ADDRESS 0x6000F518 /end MEASUREMENT
/begin MEASUREMENT Com_stVSACtrl "VSA control" UBYTE OneToOne 1 100 0.00 255.0 FORMAT "%5.1" ECU_ADDRESS 0x6000F517 /end MEASUREMENT
/begin MEASUREMENT Com_stVSADetrmAirMErr "error weight value from Air mass module" UBYTE OneToOne 1 100 0.00 255.0 FORMAT "%5.1" ECU_ADDRESS 0x6000F516 /end MEASUREMENT
/begin MEASUREMENT Com_stVSAECUHwErr "Error weight value from ECU hardware" UBYTE OneToOne 1 100 0.00 255.0 FORMAT "%5.1" ECU_ADDRESS 0x6000F515 /end MEASUREMENT
/begin MEASUREMENT Com_stVSAEngPosngErr "error weight value from Eng posng module" UBYTE OneToOne 1 100 0.00 255.0 FORMAT "%5.1" ECU_ADDRESS 0x6000F514 /end MEASUREMENT
/begin MEASUREMENT Com_stVSAEnvtlAirPSnsrErr "Error weight value from Environmental Air Pressure Sensor module" UBYTE OneToOne 1 100 0.00 255.0 FORMAT "%5.1" ECU_ADDRESS 0x6000F513 /end MEASUREMENT
/begin MEASUREMENT Com_stVSAFlSplyErr "error weight value from fuel supply module" UBYTE OneToOne 1 100 0.00 255.0 FORMAT "%5.1" ECU_ADDRESS 0x6000F512 /end MEASUREMENT
/begin MEASUREMENT Com_stVSAGEVCntrlErr "error weight value from fuel GevCntrl module" UBYTE OneToOne 1 100 0.00 255.0 FORMAT "%5.1" ECU_ADDRESS 0x6000F511 /end MEASUREMENT
/begin MEASUREMENT Com_stVSAHFMSnsrErr "Error weight value from HFM Sensor module" UBYTE OneToOne 1 100 0.00 255.0 FORMAT "%5.1" ECU_ADDRESS 0x6000F510 /end MEASUREMENT
/begin MEASUREMENT Com_stVSAIgnCtrlErr "error weight value from Ign control module" UBYTE OneToOne 1 100 0.00 255.0 FORMAT "%5.1" ECU_ADDRESS 0x6000F50F /end MEASUREMENT
/begin MEASUREMENT Com_stVSAInh "VSA inhibit from TM request status" UBYTE OneToOne 1 100 0.00 255.0 FORMAT "%5.1" ECU_ADDRESS 0x70000C5D /end MEASUREMENT
/begin MEASUREMENT Com_stVSAInhbInfo "Sum of all error weight for the VSA module" UBYTE OneToOne 1 100 0.00 255.0 FORMAT "%5.1" ECU_ADDRESS 0x6000F50E /end MEASUREMENT
/begin MEASUREMENT Com_stVSAInjCtrlErr "error weight value from Inj Control module" UBYTE OneToOne 1 100 0.00 255.0 FORMAT "%5.1" ECU_ADDRESS 0x6000F50D /end MEASUREMENT
/begin MEASUREMENT Com_stVSAIntkAirPSnsrErr "Error weight valu from Intake Air Pressure sensor module" UBYTE OneToOne 1 100 0.00 255.0 FORMAT "%5.1" ECU_ADDRESS 0x6000F50C /end MEASUREMENT
/begin MEASUREMENT Com_stVSALamCtrlErr "error weight value from Lam module" UBYTE OneToOne 1 100 0.00 255.0 FORMAT "%5.1" ECU_ADDRESS 0x6000F50B /end MEASUREMENT
/begin MEASUREMENT Com_stVSALampOff "VSA lamp off status" UBYTE OneToOne 1 100 0.00 255.0 FORMAT "%5.1" ECU_ADDRESS 0x6000F50A /end MEASUREMENT
/begin MEASUREMENT Com_stVSAMisfErr "error weight value from miss fire module" UBYTE OneToOne 1 100 0.00 255.0 FORMAT "%5.1" ECU_ADDRESS 0x6000F509 /end MEASUREMENT
/begin MEASUREMENT Com_stVSAMonErr "error weight value from monitoring module" UBYTE OneToOne 1 100 0.00 255.0 FORMAT "%5.1" ECU_ADDRESS 0x6000F508 /end MEASUREMENT
/begin MEASUREMENT Com_stVSASumTrqErr "Total Error Weight value for the VSA module." UWORD OneToOne 1 100 0.00 65535.00 FORMAT "%8.2" ECU_ADDRESS 0x60008D00 /end MEASUREMENT
/begin MEASUREMENT Com_stVSATCSFailr "VSA tcs failure information" UBYTE OneToOne 1 100 0.00 255.0 FORMAT "%5.1" ECU_ADDRESS 0x6000F507 /end MEASUREMENT
/begin MEASUREMENT Com_stVSAThrVlvErr "error weight value from thr vlv module" UBYTE OneToOne 1 100 0.00 255.0 FORMAT "%5.1" ECU_ADDRESS 0x6000F506 /end MEASUREMENT
/begin MEASUREMENT Com_stVSATrboChrgnErr "Error weight value from Turbo charging module" UBYTE OneToOne 1 100 0.00 255.0 FORMAT "%5.1" ECU_ADDRESS 0x6000F505 /end MEASUREMENT
/begin MEASUREMENT Com_stVSAVehSpdImpsErr "Error weight value from Vehicle speed plausibility check module." UBYTE OneToOne 1 100 0.00 255.0 FORMAT "%5.1" ECU_ADDRESS 0x6000F504 /end MEASUREMENT
/begin MEASUREMENT Com_stVSAVlvLftCtrlErr "error weight value from vlv control module" UBYTE OneToOne 1 100 0.00 255.0 FORMAT "%5.1" ECU_ADDRESS 0x6000F503 /end MEASUREMENT
/begin MEASUREMENT Com_stWipr "Wiper status" UBYTE OneToOne 1 100 0.00 255.0 FORMAT "%5.1" ECU_ADDRESS 0x6000F4FF /end MEASUREMENT
/begin MEASUREMENT Com_stWiprActvnCdn "Wiper activation condition" UBYTE OneToOne 1 100 0.00 255.0 FORMAT "%5.1" ECU_ADDRESS 0x6000EFC3 /end MEASUREMENT
/begin MEASUREMENT Com_stWiprMETC "Wiper status in METC Frame." UBYTE OneToOne 1 100 0.00 255.0 FORMAT "%5.1" ECU_ADDRESS 0x6000F4FE /end MEASUREMENT
/begin MEASUREMENT Com_stYawRateSnsrErr "Status of yaw rate sensor error" UBYTE OneToOne 1 100 0.00 1.000 BIT_MASK 0x1 FORMAT "%5.3" ECU_ADDRESS 0x70000C5C /end MEASUREMENT
/begin MEASUREMENT Com_stYawRateSnsrInhb "Yaw rate sensor temporary inhibition" UBYTE OneToOne 1 100 0.00 255.0 FORMAT "%5.1" ECU_ADDRESS 0x70000C5B /end MEASUREMENT
/begin MEASUREMENT Com_swtCANVer "Selected CAN generation (HMC GS)" UWORD OneToOne 1 100 0.00 3.000000 FORMAT "%8.6" ECU_ADDRESS 0x60008CFE /end MEASUREMENT
/begin MEASUREMENT Com_tACAirTOut "METER_AC_Out Air Temperature" UBYTE temp_q0p5_o30_degC 1 100 -30.00 97.50 FORMAT "%5.2" ECU_ADDRESS 0x6000F4FC /end MEASUREMENT
/begin MEASUREMENT Com_tACMtrEvaInfo "AC EVA temperature information" UBYTE temp_q0p5_o30_degC 1 100 -30.00 97.50 FORMAT "%5.2" ECU_ADDRESS 0x6000F4FB /end MEASUREMENT
/begin MEASUREMENT Com_tAirInsdCbn "Inside Cabin Air Temperature" SWORD Com_EvaTemp_Compu 1 100 -32798. 32737. FORMAT "%2.0" ECU_ADDRESS 0x60009274 /end MEASUREMENT
/begin MEASUREMENT Com_tAirOutside "Outside air temperature." SWORD Temp_Cels 1 100 -3549.940 3003.560 FORMAT "%8.3" ECU_ADDRESS 0x60009272 /end MEASUREMENT
/begin MEASUREMENT Com_tEnvT "Environment air temperature" SWORD Temp_Cels 1 100 -3549.940 3003.560 FORMAT "%8.3" ECU_ADDRESS 0x7000536C /end MEASUREMENT
/begin MEASUREMENT Com_tiISSPrms "Idle Stop Permission time" UBYTE Time_Second 1 100 0.00 255.0 FORMAT "%5.1" ECU_ADDRESS 0x6000F4F6 /end MEASUREMENT
/begin MEASUREMENT Com_tMETE2AirOutside "Outside Temperature" SWORD Temp_Cels 1 100 -3549.940 3003.560 FORMAT "%8.3" ECU_ADDRESS 0x60009266 /end MEASUREMENT
/begin MEASUREMENT Com_tMtrEva "The temperature of the evaporator" UBYTE Com_EvaTemp_Compu 1 100 -30. 225. FORMAT "%2.0" ECU_ADDRESS 0x6000F4F8 /end MEASUREMENT
/begin MEASUREMENT Com_tMtrEvaMETD "Evaporator temperature of AC" UBYTE Com_EvaTemp_Compu 1 100 -30. 225. FORMAT "%2.0" ECU_ADDRESS 0x6000F4F7 /end MEASUREMENT
/begin MEASUREMENT Com_tOutd "Information of outside indicated temperature" SWORD Temp_Cels 1 100 -3549.940 3003.560 FORMAT "%8.3" ECU_ADDRESS 0x60009264 /end MEASUREMENT
/begin MEASUREMENT Com_tqBrkOper "Brake operation torque (Driver input)" UWORD TrqPerSec 1 100 0.00 65535.00 FORMAT "%8.2" ECU_ADDRESS 0x60008CFA /end MEASUREMENT
/begin MEASUREMENT Com_tqBrkOperAYCG "Driver Input torque from AYCG frame" UWORD RBPtCel_tq_1p0_1 1 100 0.00 65535.00 FORMAT "%8.2" ECU_ADDRESS 0x70003984 /end MEASUREMENT
/begin MEASUREMENT Com_tqBrkOperAYCI "Driver Input torque from AYCI Frame" UWORD RBPtCel_tq_1p0_1 1 100 0.00 65535.00 FORMAT "%8.2" ECU_ADDRESS 0x60000686 /end MEASUREMENT
/begin MEASUREMENT Com_tqIDASTar "IDAS target torque" SWORD TrqPerSec 1 100 -32768.00 32767.00 FORMAT "%8.2" ECU_ADDRESS 0x60009260 /end MEASUREMENT
/begin MEASUREMENT Com_tqIMGReqDrv "Message for IMG drive request torque" SWORD TrqPerSec 1 100 -32768.00 32767.00 FORMAT "%8.2" ECU_ADDRESS 0x6000925E /end MEASUREMENT
/begin MEASUREMENT Com_tqIMGSuppReq "IMG Request Suppression Torque" SWORD Trq_float 1 100 -32768.00 32767.00 FORMAT "%8.2" ECU_ADDRESS 0x6000925C /end MEASUREMENT
/begin MEASUREMENT Com_trq2IDASTar "ASLISA cooperative operation required torque crankshaft torque" SWORD RBPtCel_tq_1p0_1 1 100 -32768.00 32767.00 FORMAT "%8.2" ECU_ADDRESS 0x60009256 /end MEASUREMENT
/begin MEASUREMENT Com_trqAYCFDes "Crankshaft torque" SLONG trq_q0p1 1 100 -214748364.800 214748364.700 FORMAT "%13.3" ECU_ADDRESS 0x600004B4 /end MEASUREMENT
/begin MEASUREMENT Com_trqEATReq "EAT request torque" SWORD Trq 1 100 -3276.800 3276.700 FORMAT "%8.3" ECU_ADDRESS 0x60009252 /end MEASUREMENT
/begin MEASUREMENT Com_uBattDetnIMGECU "Battery detection voltage of IMG ECU" UWORD q0p01_V 1 100 0.00 655.3500 FORMAT "%8.4" ECU_ADDRESS 0x60008CF6 /end MEASUREMENT
/begin MEASUREMENT Com_uBattDetnTCUECU "Battery detection voltage of TCU ECU" UWORD q0p01_V 1 100 0.00 655.3500 FORMAT "%8.4" ECU_ADDRESS 0x60008CF4 /end MEASUREMENT
/begin MEASUREMENT Com_uCPS1VoltEPB "Clutch stroke CPS1 voltage" UWORD spg_q0p00488 1 100 0.00 319.9951 FORMAT "%8.4" ECU_ADDRESS 0x60008CF2 /end MEASUREMENT
/begin MEASUREMENT Com_uCPS2VoltEPB "Clutch stroke CPS2 voltage" UWORD spg_q0p00488 1 100 0.00 319.9951 FORMAT "%8.4" ECU_ADDRESS 0x60008CF0 /end MEASUREMENT
/begin MEASUREMENT Com_uFlLvlRaw "8 bit A/D Raw value of the fuel level" SWORD spg_uw_b5 1 100 -160.0000 159.9951 FORMAT "%8.4" ECU_ADDRESS 0x6000924A /end MEASUREMENT
/begin MEASUREMENT Com_uFrntBlowrU "Target front Blower voltage" UBYTE Volt_q1 1 100 0.00 255.0 FORMAT "%5.1" ECU_ADDRESS 0x6000EFBF /end MEASUREMENT
/begin MEASUREMENT Com_uIG1DetnIMGECU "IG1 detection voltage value of IMG-ECU" UWORD q0p01_V 1 100 0.00 655.3500 FORMAT "%8.4" ECU_ADDRESS 0x60008CEC /end MEASUREMENT
/begin MEASUREMENT Com_uIG1DetnTCUECU "IG1 detection voltage value of TCU-ECU" UWORD q0p01_V 1 100 0.00 655.3500 FORMAT "%8.4" ECU_ADDRESS 0x60008CEA /end MEASUREMENT
/begin MEASUREMENT Com_uMICUTxBlowrU "MICU Tx blower voltage" UBYTE Volt_q1 1 100 0.00 255.0 FORMAT "%5.1" ECU_ADDRESS 0x6000EFBE /end MEASUREMENT
/begin MEASUREMENT Com_uRrBlowrU "Target rear Blower voltage" UBYTE Volt_q1 1 100 0.00 255.0 FORMAT "%5.1" ECU_ADDRESS 0x6000EFBD /end MEASUREMENT
/begin MEASUREMENT Com_vAnaVeh "Meter display speed" UWORD Vel 1 100 0.00 655.3500 FORMAT "%8.4" ECU_ADDRESS 0x60008CE8 /end MEASUREMENT
/begin MEASUREMENT Com_vDigVeh "Digital Speed Meter display target value(Hysteresis processing value for display)" UBYTE OneToOne 1 100 0.00 255.0 FORMAT "%5.1" ECU_ADDRESS 0x6000F4F5 /end MEASUREMENT
/begin MEASUREMENT Com_vDigVehRaw "Speed Meter display target value(Raw Value)" UWORD Vel 1 100 0.00 655.3500 FORMAT "%8.4" ECU_ADDRESS 0x60008CE6 /end MEASUREMENT
/begin MEASUREMENT Com_vFLWhlSpd "Front Left Wheel Speed value" SWORD Vel 1 100 -327.6800 327.6700 FORMAT "%8.4" ECU_ADDRESS 0x70003C0C /end MEASUREMENT
/begin MEASUREMENT Com_vFRWhlSpd "Front Right Wheel Speed value" SWORD Vel 1 100 -327.6800 327.6700 FORMAT "%8.4" ECU_ADDRESS 0x70003C0A /end MEASUREMENT
/begin MEASUREMENT Com_vRLWhlSpd "Rear Left Wheel Speed value" SWORD Vel 1 100 -327.6800 327.6700 FORMAT "%8.4" ECU_ADDRESS 0x70003C08 /end MEASUREMENT
/begin MEASUREMENT Com_vRRWhlSpd "Rear Right Wheel Speed value" SWORD Vel 1 100 -327.6800 327.6700 FORMAT "%8.4" ECU_ADDRESS 0x70003C06 /end MEASUREMENT
/begin MEASUREMENT Com_vVehCtl "Vehicle speed for control" SWORD Vel 1 100 -327.6800 327.6700 FORMAT "%8.4" ECU_ADDRESS 0x60009240 /end MEASUREMENT
/begin MEASUREMENT Com_vVehInstPnl "Vehicle speed for instrument panel" SWORD Vel 1 100 -327.6800 327.6700 FORMAT "%8.4" ECU_ADDRESS 0x6000923E /end MEASUREMENT
/begin MEASUREMENT Com_vVehSpdCVTCtrl "CVT control used vehicle speed" UWORD Vel_CrCtl 1 100 0.00 255.9961 FORMAT "%8.4" ECU_ADDRESS 0x6000068A /end MEASUREMENT
/begin MEASUREMENT Com_vVehTcu "vehicle speed from TCU2" UWORD Vel_CrCtl 1 100 0.00 255.9961 FORMAT "%8.4" ECU_ADDRESS 0x60008CE4 /end MEASUREMENT
/begin MEASUREMENT Conv_bCalcActv_mp "Flag for calculation active" UBYTE OneToOne 1 100 0.00 255.0 FORMAT "%5.1" ECU_ADDRESS 0x7000A794 /end MEASUREMENT
/begin MEASUREMENT Conv_bLvrPosDebRD_mp "Flag for debounced selector lever position (in R or D)" UBYTE OneToOne 1 100 0.00 255.0 FORMAT "%5.1" ECU_ADDRESS 0x7000A793 /end MEASUREMENT
/begin MEASUREMENT Conv_bLvrPosRD_mp "Flag for selector lever position (in R or D)" UBYTE OneToOne 1 100 0.00 255.0 FORMAT "%5.1" ECU_ADDRESS 0x7000A792 /end MEASUREMENT
/begin MEASUREMENT Conv_bRevLvrPos "Flag for reverse gear status" UBYTE OneToOne 1 100 0.00 255.0 FORMAT "%5.1" ECU_ADDRESS 0x6000F4F1 /end MEASUREMENT
/begin MEASUREMENT Conv_bTrqResv "Flag for ""building"" torque reserve" UBYTE OneToOne 1 100 0.00 255.0 FORMAT "%5.1" ECU_ADDRESS 0x6000F4F0 /end MEASUREMENT
/begin MEASUREMENT Conv_cntrPostDrvLve "Postdrive leave counter" UBYTE OneToOne 1 100 0.00 255.0 FORMAT "%5.1" ECU_ADDRESS 0x6000E862 /end MEASUREMENT
/begin MEASUREMENT Conv_facDepNTrbnNStat_mp "Factor for the conversion of turbine speed to stationary engine speed." SWORD Fact 1 100 -4.000000 3.999878 FORMAT "%8.6" ECU_ADDRESS 0x7000A790 /end MEASUREMENT
/begin MEASUREMENT Conv_facIntrpn "The interpolation factor in case low speed" SLONG RBPtCel_fac_0p01_1 1 100 -21474836.4800 21474836.4700 FORMAT "%13.4" ECU_ADDRESS 0x600030CC /end MEASUREMENT
/begin MEASUREMENT Conv_facRedCnvrLoad "The velocity factor during driver off" SWORD Fact 1 100 -4.000000 3.999878 FORMAT "%8.6" ECU_ADDRESS 0x600076AE /end MEASUREMENT
/begin MEASUREMENT Conv_flgDecelTq "Flag of Torque reserve offset in slow deceleration" UBYTE B_TRUE 1 100 0.00 1.00000000000 BIT_MASK 0x1 FORMAT "%13.11" ECU_ADDRESS 0x6000E861 /end MEASUREMENT
/begin MEASUREMENT Conv_flgDecelTqCdn "Flag of Torque reserve offset in slow deceleration condition satisfied" UBYTE B_TRUE 1 100 0.00 1.00000000000 BIT_MASK 0x1 FORMAT "%13.11" ECU_ADDRESS 0x6000E860 /end MEASUREMENT
/begin MEASUREMENT Conv_flgDRGearShift "The status of gear lever shift from drive to reverse" UBYTE B_TRUE 1 100 0.00 1.00000000000 BIT_MASK 0x1 FORMAT "%13.11" ECU_ADDRESS 0x6000F15B /end MEASUREMENT
/begin MEASUREMENT Conv_flgDRGearShiftDeb "The status of gear lever shift from drive to reverse after debouncing" UBYTE B_TRUE 1 100 0.00 1.00000000000 BIT_MASK 0x1 FORMAT "%13.11" ECU_ADDRESS 0x6000F15A /end MEASUREMENT
/begin MEASUREMENT Conv_flgRDGearShift "The status of gear lever shift from reverse to drive" UBYTE B_TRUE 1 100 0.00 1.00000000000 BIT_MASK 0x1 FORMAT "%13.11" ECU_ADDRESS 0x6000F159 /end MEASUREMENT
/begin MEASUREMENT Conv_flgRDGearShiftDeb "The status of gear lever shift from reverse to drive after debouncing" UBYTE B_TRUE 1 100 0.00 1.00000000000 BIT_MASK 0x1 FORMAT "%13.11" ECU_ADDRESS 0x6000F158 /end MEASUREMENT
/begin MEASUREMENT Conv_flgTqOffsTiMax "Flag of Torque reserve offset reaches maximum time" UBYTE B_TRUE 1 100 0.00 1.00000000000 BIT_MASK 0x1 FORMAT "%13.11" ECU_ADDRESS 0x6000E85F /end MEASUREMENT
/begin MEASUREMENT Conv_idxCurPosn "The current bit position in the array" UBYTE OneToOne 1 100 0.00 255.0 FORMAT "%5.1" ECU_ADDRESS 0x6000E85E /end MEASUREMENT
/begin MEASUREMENT Conv_nDifAvrg "The average Turbine speed change (difference)" SWORD EngN 1 100 -16384.00 16383.50 FORMAT "%8.2" ECU_ADDRESS 0x700041D0 /end MEASUREMENT
/begin MEASUREMENT Conv_nrPrevGear "The gear lever of previous driving cycle" UBYTE OneToOne 1 100 0.00 255.0 FORMAT "%5.1" ECU_ADDRESS 0x6000F4EF /end MEASUREMENT
/begin MEASUREMENT Conv_nrTrbAvrg "The number of raster turbine speed Average change is calculated from (1-16)" UBYTE OneToOne 1 100 0.00 255.0 FORMAT "%5.1" ECU_ADDRESS 0x6000E85D /end MEASUREMENT
/begin MEASUREMENT Conv_nTrbDifAry "Array of the Turbine speed change (difference) in the past" SWORD EngN 1 100 -16384.00 16383.50 FORMAT "%8.2" ARRAY_SIZE 16 ECU_ADDRESS 0x6000768E /end MEASUREMENT
/begin MEASUREMENT Conv_nTrbn "Turbine speed" SWORD EngN 1 100 -16384.00 16383.50 FORMAT "%8.2" ECU_ADDRESS 0x6000923C /end MEASUREMENT
/begin MEASUREMENT Conv_nTrbnCorrVal_mp "Value for the correction of the turbine speed" SWORD EngN 1 100 -16384.00 16383.50 FORMAT "%8.2" ECU_ADDRESS 0x7000A78E /end MEASUREMENT
/begin MEASUREMENT Conv_nTrbnDiff_mp "Turbine speed difference" SWORD EngN 1 100 -16384.00 16383.50 FORMAT "%8.2" ECU_ADDRESS 0x7000A78C /end MEASUREMENT
/begin MEASUREMENT Conv_nTrbnExp_mp "expected turbine speed" SWORD EngN 1 100 -16384.00 16383.50 FORMAT "%8.2" ECU_ADDRESS 0x7000A78A /end MEASUREMENT
/begin MEASUREMENT Conv_nTrbnMod "modelled turbine speed." SWORD EngN 1 100 -16384.00 16383.50 FORMAT "%8.2" ECU_ADDRESS 0x60013E60 /end MEASUREMENT
/begin MEASUREMENT Conv_nTrbnOld "old turbine speed" SWORD EngN 1 100 -16384.00 16383.50 FORMAT "%8.2" ECU_ADDRESS 0x60013E62 /end MEASUREMENT
/begin MEASUREMENT Conv_rNTrbnNStat_mp "Ratio of Turbine speed to stationary speed" SWORD TransR 1 100 -327.6800 327.6700 FORMAT "%8.4" ECU_ADDRESS 0x7000A788 /end MEASUREMENT
/begin MEASUREMENT Conv_tiDepLvrDeb "debounce time for gear lever position" SWORD TimeDeb 1 100 -327680.0 327670.0 FORMAT "%8.1" ECU_ADDRESS 0x6000923A /end MEASUREMENT
/begin MEASUREMENT Conv_tqDecelOffs "Torque reserve offset from converter for lost in slow deceleration" SWORD Trq 1 100 -3276.800 3276.700 FORMAT "%8.3" ECU_ADDRESS 0x6000768C /end MEASUREMENT
/begin MEASUREMENT Conv_tqEngTqDe "The base engine torque" SLONG Trq 1 100 -214748364.800 214748364.700 FORMAT "%13.3" ECU_ADDRESS 0x600030C8 /end MEASUREMENT
/begin MEASUREMENT Conv_tqPmpDrvOff "The pump torque during driver off" SLONG Trq 1 100 -214748364.800 214748364.700 FORMAT "%13.3" ECU_ADDRESS 0x600030C4 /end MEASUREMENT
/begin MEASUREMENT Conv_tqPmpHiSpd "The pump torque in case high speed" SLONG Trq 1 100 -214748364.800 214748364.700 FORMAT "%13.3" ECU_ADDRESS 0x600030C0 /end MEASUREMENT
/begin MEASUREMENT Conv_tqPmpHiSpdTmp "The temporary torque pump in case high speed" SLONG Trq 1 100 -214748364.800 214748364.700 FORMAT "%13.3" ECU_ADDRESS 0x600030BC /end MEASUREMENT
/begin MEASUREMENT Conv_tqPmpLoSpd "The torque pump in case low speed" SLONG Trq 1 100 -214748364.800 214748364.700 FORMAT "%13.3" ECU_ADDRESS 0x600030B8 /end MEASUREMENT
/begin MEASUREMENT Conv_tqPmpLoSpdTmp "The temporary torque pump in case low speed" SLONG Trq 1 100 -214748364.800 214748364.700 FORMAT "%13.3" ECU_ADDRESS 0x600030B4 /end MEASUREMENT
/begin MEASUREMENT Conv_tqPmpStat "The static torque pump" SLONG Trq 1 100 -214748364.800 214748364.700 FORMAT "%13.3" ECU_ADDRESS 0x600030B0 /end MEASUREMENT
/begin MEASUREMENT Conv_tqPmpStd "The standard for pump torque" SLONG Trq 1 100 -214748364.800 214748364.700 FORMAT "%13.3" ECU_ADDRESS 0x600030AC /end MEASUREMENT
/begin MEASUREMENT Conv_trqLd "Application parameter for Torque load from the converter" SWORD Trq 1 100 -3276.800 3276.700 FORMAT "%8.3" ECU_ADDRESS 0x60009238 /end MEASUREMENT
/begin MEASUREMENT Conv_trqLdBefLim_mp "Torque load before torque limitation" SWORD Trq 1 100 -3276.800 3276.700 FORMAT "%8.3" ECU_ADDRESS 0x7000A786 /end MEASUREMENT
/begin MEASUREMENT Conv_trqLdDiff_mp "Torque load difference" SWORD Trq 1 100 -3276.800 3276.700 FORMAT "%8.3" ECU_ADDRESS 0x7000A784 /end MEASUREMENT
/begin MEASUREMENT Conv_trqLdFlt "filtered torque load" SWORD Trq 1 100 -3276.800 3276.700 FORMAT "%8.3" ECU_ADDRESS 0x60013E6A /end MEASUREMENT
/begin MEASUREMENT Conv_trqLdFltRslt_mp "filtered torque load for the calculation of the torque reserve." SWORD Trq 1 100 -3276.800 3276.700 FORMAT "%8.3" ECU_ADDRESS 0x7000A782 /end MEASUREMENT
/begin MEASUREMENT Conv_trqLdMaxLim_mp "current limitation for the torque load by CAN." SWORD Trq 1 100 -3276.800 3276.700 FORMAT "%8.3" ECU_ADDRESS 0x7000A780 /end MEASUREMENT
/begin MEASUREMENT Conv_trqLdMod "modelled calculation of the torque load" SWORD Trq 1 100 -3276.800 3276.700 FORMAT "%8.3" ECU_ADDRESS 0x60013E6C /end MEASUREMENT
/begin MEASUREMENT Conv_trqLdOfs "Offset of the torque load" SWORD Trq 1 100 -3276.800 3276.700 FORMAT "%8.3" ECU_ADDRESS 0x6000768A /end MEASUREMENT
/begin MEASUREMENT Conv_trqLdOfs_mp "Offset of the torque load" SWORD Trq 1 100 -3276.800 3276.700 FORMAT "%8.3" ECU_ADDRESS 0x7000A77E /end MEASUREMENT
/begin MEASUREMENT Conv_trqLdPreFlt "Pre-filtered torque load" SWORD Trq 1 100 -3276.800 3276.700 FORMAT "%8.3" ECU_ADDRESS 0x60013E6E /end MEASUREMENT
/begin MEASUREMENT Conv_trqLdResvAdd_mp "additional torque reserve for engaged gear" SWORD Trq 1 100 -3276.800 3276.700 FORMAT "%8.3" ECU_ADDRESS 0x7000A77C /end MEASUREMENT
/begin MEASUREMENT Conv_trqLdResvFlt_mp "filtered additional torque reserve" SWORD Trq 1 100 -3276.800 3276.700 FORMAT "%8.3" ECU_ADDRESS 0x7000A77A /end MEASUREMENT
/begin MEASUREMENT Conv_trqLdTrqResvTotBuf_mp "Torque load buffer for the total of torque load and torque reserve" SWORD Trq 1 100 -3276.800 3276.700 FORMAT "%8.3" ECU_ADDRESS 0x7000A778 /end MEASUREMENT
/begin MEASUREMENT Conv_trqLosDfftl_mp "Differential torque losses" SWORD TrqPrpHigh 1 100 -3276.800 3276.700 FORMAT "%8.3" ECU_ADDRESS 0x7000A776 /end MEASUREMENT
/begin MEASUREMENT Conv_trqOilPmpLoss "Oil Pump Loss Torque" SWORD Trq 1 100 -3276.800 3276.700 FORMAT "%8.3" ECU_ADDRESS 0x60009232 /end MEASUREMENT
/begin MEASUREMENT Conv_trqPmpBuf_mp "Pump torque" SWORD Trq 1 100 -3276.800 3276.700 FORMAT "%8.3" ECU_ADDRESS 0x7000A774 /end MEASUREMENT
/begin MEASUREMENT Conv_trqResv "Torque reserve from the converter" SWORD Trq 1 100 -3276.800 3276.700 FORMAT "%8.3" ECU_ADDRESS 0x60013E72 /end MEASUREMENT
/begin MEASUREMENT Conv_trqResvHiInc_mp "Factor for additional torque reserve" SWORD Trq 1 100 -3276.800 3276.700 FORMAT "%8.3" ECU_ADDRESS 0x7000A772 /end MEASUREMENT
/begin MEASUREMENT Conv_trqStatSqBuf_mp "Buffer for pump torque" SWORD Trq 1 100 -3276.800 3276.700 FORMAT "%8.3" ECU_ADDRESS 0x7000A770 /end MEASUREMENT
/begin MEASUREMENT CoVeh_stAlt "Status: Alternator start-up" UBYTE B_TRUE 1 100 0.00 1.00000000000 BIT_MASK 0x1 FORMAT "%13.11" ECU_ADDRESS 0x6000F187 /end MEASUREMENT
/begin MEASUREMENT CoVeh_stFan "Status: Fan start-up" UBYTE B_TRUE 1 100 0.00 1.00000000000 BIT_MASK 0x1 FORMAT "%13.11" ECU_ADDRESS 0x6000F186 /end MEASUREMENT
/begin MEASUREMENT CoVeh_trqAcs "Torque demand of accessories" SWORD Trq 1 100 -3276.800 3276.700 FORMAT "%8.3" ECU_ADDRESS 0x50005C3E /end MEASUREMENT
/begin MEASUREMENT CoVeh_trqMaxAC "Maximum allowed AC torque consumption" SWORD Trq 1 100 -3276.800 3276.700 FORMAT "%8.3" ECU_ADDRESS 0x600092E8 /end MEASUREMENT
/begin MEASUREMENT Dspl_stACCASLSwtInfo "ACC / ASL Switch information" UBYTE OneToOne 1 100 0.00 255.0 FORMAT "%5.1" ECU_ADDRESS 0x6000F461 /end MEASUREMENT
/begin MEASUREMENT Dspl_stASLRxErr "ASL reception CAN frame error information" UBYTE OneToOne 1 100 0.00 255.0 FORMAT "%5.1" ECU_ADDRESS 0x6000EFB7 /end MEASUREMENT
/begin MEASUREMENT Dspl_stCrsMaiSwtInfo "Cruise Main Switch information" UBYTE OneToOne 1 100 0.00 255.0 FORMAT "%5.1" ECU_ADDRESS 0x6000F147 /end MEASUREMENT
/begin MEASUREMENT Dspl_stCrsSwtInfo "Cruise Switch Information" UBYTE OneToOne 1 100 0.00 255.0 FORMAT "%5.1" ECU_ADDRESS 0x6000F45F /end MEASUREMENT
/begin MEASUREMENT ETM_rClgDem "Relative fan cooling power required by engine cooling" SWORD Prc 1 100 -400.0000 399.9878 FORMAT "%8.4" ECU_ADDRESS 0x600089B4 /end MEASUREMENT
/begin MEASUREMENT Gbx_nMaxEngFco "Maximum engine speed limitation request(FuelCut Control)" SWORD EngN 1 100 -16384.00 16383.50 FORMAT "%8.2" ECU_ADDRESS 0x600090D8 /end MEASUREMENT
/begin MEASUREMENT Gbx_nMaxEngTrqLim "Maximum engine speed limitation request(Torque Control)" SWORD EngN 1 100 -16384.00 16383.50 FORMAT "%8.2" ECU_ADDRESS 0x600090D6 /end MEASUREMENT
/begin MEASUREMENT Gbx_tOilConv "Message for Oil Conversion temparature" SWORD Temp_Cels 1 100 -3549.940 3003.560 FORMAT "%8.3" ECU_ADDRESS 0x600090CA /end MEASUREMENT
/begin MEASUREMENT Gbx_trqOilPmpLos "Oil pump load torque" SWORD Trq 1 100 -3276.800 3276.700 FORMAT "%8.3" ECU_ADDRESS 0x600090C2 /end MEASUREMENT
/begin MEASUREMENT Gbx_trqTSCIntvSlow "Engine torque amount (by Air)" SWORD Trq 1 100 -3276.800 3276.700 FORMAT "%8.3" ECU_ADDRESS 0x600090BE /end MEASUREMENT
/begin MEASUREMENT GlbDa_trqCrSVehLimMin "current limitation torque from GlbDa on crankshaft torque level" SWORD Trq 1 100 -3276.800 3276.700 FORMAT "%8.3" ECU_ADDRESS 0x60013F70 /end MEASUREMENT
/begin MEASUREMENT GlbDa_trqVehLimMin "current limitation from GlbDa" SWORD Trq 1 100 -3276.800 3276.700 FORMAT "%8.3" ECU_ADDRESS 0x600090AE /end MEASUREMENT
/begin MEASUREMENT Lin_Alt_B_Signal_ACG_Temp_8_r_msg "" UBYTE OneToOne 1 100 0.00 255.0 FORMAT "%5.1" ECU_ADDRESS 0x6000F948 /end MEASUREMENT
/begin MEASUREMENT Lin_Alt_B_Signal_ComTOut_1_r_msg "" UBYTE OneToOne 1 100 0.00 255.0 FORMAT "%5.1" ECU_ADDRESS 0x6000F947 /end MEASUREMENT
/begin MEASUREMENT Lin_Alt_B_Signal_Com_1_r_msg "" UBYTE OneToOne 1 100 0.00 255.0 FORMAT "%5.1" ECU_ADDRESS 0x6000F946 /end MEASUREMENT
/begin MEASUREMENT Lin_Alt_B_Signal_Dyc_5_r_msg "" UBYTE OneToOne 1 100 0.00 255.0 FORMAT "%5.1" ECU_ADDRESS 0x6000F945 /end MEASUREMENT
/begin MEASUREMENT Lin_Alt_B_Signal_Elec_1_r_msg "" UBYTE OneToOne 1 100 0.00 255.0 FORMAT "%5.1" ECU_ADDRESS 0x6000F944 /end MEASUREMENT
/begin MEASUREMENT Lin_Alt_B_Signal_ExctCrnt_8_r_msg "" UBYTE OneToOne 1 100 0.00 255.0 FORMAT "%5.1" ECU_ADDRESS 0x6000F943 /end MEASUREMENT
/begin MEASUREMENT Lin_Alt_B_Signal_HiTemp_1_r_msg "" UBYTE OneToOne 1 100 0.00 255.0 FORMAT "%5.1" ECU_ADDRESS 0x6000F942 /end MEASUREMENT
/begin MEASUREMENT Lin_Alt_B_Signal_Mchn_1_r_msg "" UBYTE OneToOne 1 100 0.00 255.0 FORMAT "%5.1" ECU_ADDRESS 0x6000F941 /end MEASUREMENT
/begin MEASUREMENT Lin_BS_B_Signal_OCV_8_r_msg "Battery quiescent voltage receive from LIN raw value" UBYTE OneToOne 1 100 0.00 255.0 FORMAT "%5.1" ECU_ADDRESS 0x6000F940 /end MEASUREMENT
/begin MEASUREMENT Lin_BS_B_Signal_STBATTSENRST_1_r_msg "Status of battery sensor reset detection receive from LIN raw value" UBYTE OneToOne 1 100 0.00 255.0 FORMAT "%5.1" ECU_ADDRESS 0x6000F93F /end MEASUREMENT
/begin MEASUREMENT Lin_BS_B_Signal_TASIC_8_r_msg "Temperature of ASIC receive from LIN raw value" UBYTE OneToOne 1 100 0.00 255.0 FORMAT "%5.1" ECU_ADDRESS 0x6000F93E /end MEASUREMENT
/begin MEASUREMENT Lin_BS_B_Signal_tiDurAftIgnOff_16_r_msg "Duration in hours of the last LIN inactive phase receive from LIN raw value" UWORD OneToOne 1 100 0.00 65535.00 FORMAT "%8.2" ECU_ADDRESS 0x600095E8 /end MEASUREMENT
/begin MEASUREMENT Lin_BS_Signal_B_BATTCH_16_r_msg "Accumulated battery charge receive from LIN raw value" UWORD OneToOne 1 100 0.00 65535.00 FORMAT "%8.2" ECU_ADDRESS 0x600095E6 /end MEASUREMENT
/begin MEASUREMENT Lin_BS_Signal_B_BATTDCHA_16_r_msg "Accumulated battery discharge receive from LIN raw value" UWORD OneToOne 1 100 0.00 65535.00 FORMAT "%8.2" ECU_ADDRESS 0x600095E4 /end MEASUREMENT
/begin MEASUREMENT Lin_BS_Signal_B_BATT_REPLACE_1_r_msg "Battery exchange receive from LIN raw value" UBYTE OneToOne 1 100 0.00 255.0 FORMAT "%5.1" ECU_ADDRESS 0x6000F93D /end MEASUREMENT
/begin MEASUREMENT Lin_BS_Signal_B_BATT_SIZE_DETECT_1_r_msg "Battery Size detection receive from LIN raw value" UBYTE OneToOne 1 100 0.00 255.0 FORMAT "%5.1" ECU_ADDRESS 0x6000F93C /end MEASUREMENT
/begin MEASUREMENT Lin_BS_Signal_B_BATT_WARM_LEVEL_3_r_msg "Level of Low Charge State receive from LIN raw value" UBYTE OneToOne 1 100 0.00 255.0 FORMAT "%5.1" ECU_ADDRESS 0x6000F93B /end MEASUREMENT
/begin MEASUREMENT Lin_BS_Signal_B_BCF_1_r_msg "BCBD detection flag receive from LIN raw value" UBYTE OneToOne 1 100 0.00 255.0 FORMAT "%5.1" ECU_ADDRESS 0x6000F93A /end MEASUREMENT
/begin MEASUREMENT Lin_BS_Signal_B_CHARGE_LOW_1_r_msg "Charge Low receive from LIN raw value" UBYTE OneToOne 1 100 0.00 255.0 FORMAT "%5.1" ECU_ADDRESS 0x6000F939 /end MEASUREMENT
/begin MEASUREMENT Lin_BS_Signal_B_CTINTRESUPD_2_r_msg "Cranking Ri counter receive from LIN raw value" UBYTE OneToOne 1 100 0.00 255.0 FORMAT "%5.1" ECU_ADDRESS 0x6000F938 /end MEASUREMENT
/begin MEASUREMENT Lin_BS_Signal_B_DATA_FORMAT_8_r_msg "Data discernment receive from LIN raw value" UBYTE OneToOne 1 100 0.00 255.0 FORMAT "%5.1" ECU_ADDRESS 0x6000F937 /end MEASUREMENT
/begin MEASUREMENT Lin_BS_Signal_B_ERROR_RES_1_r_msg "Sensor recognition and communication conformity flag receive from LIN raw value" UBYTE OneToOne 1 100 0.00 255.0 FORMAT "%5.1" ECU_ADDRESS 0x6000F936 /end MEASUREMENT
/begin MEASUREMENT Lin_BS_Signal_B_HARNR_2_r_msg "Harness Resistance STATE receive from LIN raw value" UBYTE OneToOne 1 100 0.00 255.0 FORMAT "%5.1" ECU_ADDRESS 0x6000F935 /end MEASUREMENT
/begin MEASUREMENT Lin_BS_Signal_B_IBAT_16_r_msg "Battery Current receive from LIN raw value" UWORD OneToOne 1 100 0.00 65535.00 FORMAT "%8.2" ECU_ADDRESS 0x600095E2 /end MEASUREMENT
/begin MEASUREMENT Lin_BS_Signal_B_IBAT_8_r_msg "Battery Current receive from LIN raw value" UBYTE OneToOne 1 100 0.00 255.0 FORMAT "%5.1" ECU_ADDRESS 0x6000F934 /end MEASUREMENT
/begin MEASUREMENT Lin_BS_Signal_B_IOP_ERROR_1_r_msg "Abnormalities in external drive control receive from LIN raw value" UBYTE OneToOne 1 100 0.00 255.0 FORMAT "%5.1" ECU_ADDRESS 0x6000F933 /end MEASUREMENT
/begin MEASUREMENT Lin_BS_Signal_B_iStByCurrAft0h_10_r_msg "Battery current at transition to LIN off receive from LIN raw value" UWORD OneToOne 1 100 0.00 65535.00 FORMAT "%8.2" ECU_ADDRESS 0x600095DA /end MEASUREMENT
/begin MEASUREMENT Lin_BS_Signal_B_iStByCurrAft1h_10_r_msg "Battery current 1h after transition to LIN off receive from LIN raw value" UWORD OneToOne 1 100 0.00 65535.00 FORMAT "%8.2" ECU_ADDRESS 0x600095D8 /end MEASUREMENT
/begin MEASUREMENT Lin_BS_Signal_B_iStByCurrAft2h_10_r_msg "Battery current 2h after transition to LIN off receive from LIN raw value" UWORD OneToOne 1 100 0.00 65535.00 FORMAT "%8.2" ECU_ADDRESS 0x600095D6 /end MEASUREMENT
/begin MEASUREMENT Lin_BS_Signal_B_iStByCurrLst_10_r_msg "Battery current during the last hour before transition to LIN on receive from LIN raw value" UWORD OneToOne 1 100 0.00 65535.00 FORMAT "%8.2" ECU_ADDRESS 0x600095D4 /end MEASUREMENT
/begin MEASUREMENT Lin_BS_Signal_B_MEASDR_2_r_msg "Ri st other measured state flag receive from LIN raw value" UBYTE OneToOne 1 100 0.00 255.0 FORMAT "%5.1" ECU_ADDRESS 0x6000F932 /end MEASUREMENT
/begin MEASUREMENT Lin_BS_Signal_B_RESMEASDBATT_16_r_msg "Simplified actual battery resistance receive from LIN raw value" UWORD OneToOne 1 100 0.00 65535.00 FORMAT "%8.2" ECU_ADDRESS 0x600095E0 /end MEASUREMENT
/begin MEASUREMENT Lin_BS_Signal_B_RI_ST_OTHER_MEASURE_16_r_msg "Internal resistance (except a starter) receive from LIN raw value" UWORD OneToOne 1 100 0.00 65535.00 FORMAT "%8.2" ECU_ADDRESS 0x600095DE /end MEASUREMENT
/begin MEASUREMENT Lin_BS_Signal_B_SOC_8_r_msg "Status of charge receive from LIN raw value" UBYTE OneToOne 1 100 0.00 255.0 FORMAT "%5.1" ECU_ADDRESS 0x6000F931 /end MEASUREMENT
/begin MEASUREMENT Lin_BS_Signal_B_SOC_STATE_3_r_msg "Status of charge status receive from LIN raw value" UBYTE OneToOne 1 100 0.00 255.0 FORMAT "%5.1" ECU_ADDRESS 0x6000F930 /end MEASUREMENT
/begin MEASUREMENT Lin_BS_Signal_B_SOFV_RESTART_8_r_msg "Discharge voltage descent prediction receive from LIN raw value" UBYTE OneToOne 1 100 0.00 255.0 FORMAT "%5.1" ECU_ADDRESS 0x6000F92F /end MEASUREMENT
/begin MEASUREMENT Lin_BS_Signal_B_SOFV_RESTART_STATE_1_r_msg "Discharge voltage descent prediction signal receive from LIN raw value" UBYTE OneToOne 1 100 0.00 255.0 FORMAT "%5.1" ECU_ADDRESS 0x6000F92E /end MEASUREMENT
/begin MEASUREMENT Lin_BS_Signal_B_SOH_COR_8_r_msg "State of health (corrosion) receive from LIN raw value" UBYTE OneToOne 1 100 0.00 255.0 FORMAT "%5.1" ECU_ADDRESS 0x6000F92D /end MEASUREMENT
/begin MEASUREMENT Lin_BS_Signal_B_SOH_COR_STATE_1_r_msg "State of health (corrosion) Status receive from LIN raw value" UBYTE OneToOne 1 100 0.00 255.0 FORMAT "%5.1" ECU_ADDRESS 0x6000F92C /end MEASUREMENT
/begin MEASUREMENT Lin_BS_Signal_B_SOH_LAM_8_r_msg "Degradation rate receive from LIN raw value" UBYTE OneToOne 1 100 0.00 255.0 FORMAT "%5.1" ECU_ADDRESS 0x6000F92B /end MEASUREMENT
/begin MEASUREMENT Lin_BS_Signal_B_SOH_LAM_STATE_1_r_msg "Capacity degradation state signal receive from LIN raw value" UBYTE OneToOne 1 100 0.00 255.0 FORMAT "%5.1" ECU_ADDRESS 0x6000F92A /end MEASUREMENT
/begin MEASUREMENT Lin_BS_Signal_B_SOH_SUL_8_r_msg "max possible SOC,reduced by sulphation receive from LIN raw value" UBYTE OneToOne 1 100 0.00 255.0 FORMAT "%5.1" ECU_ADDRESS 0x6000F929 /end MEASUREMENT
/begin MEASUREMENT Lin_BS_Signal_B_SOH_SUL_STATE_1_r_msg "max possible SOC,reduced by sulphation Status receive from LIN raw value" UBYTE OneToOne 1 100 0.00 255.0 FORMAT "%5.1" ECU_ADDRESS 0x6000F928 /end MEASUREMENT
/begin MEASUREMENT Lin_BS_Signal_B_SUPPLIER_CODE_8_r_msg "Sensor Supplier Identification receive from LIN raw value" UBYTE OneToOne 1 100 0.00 255.0 FORMAT "%5.1" ECU_ADDRESS 0x6000F927 /end MEASUREMENT
/begin MEASUREMENT Lin_BS_Signal_B_TBAT_8_r_msg "Battery Temperature from LIN raw value" UBYTE OneToOne 1 100 0.00 255.0 FORMAT "%5.1" ECU_ADDRESS 0x6000F926 /end MEASUREMENT
/begin MEASUREMENT Lin_BS_Signal_B_UBAT_16_r_msg "Battery Voltage receive from LIN raw value" UWORD OneToOne 1 100 0.00 65535.00 FORMAT "%8.2" ECU_ADDRESS 0x600095DC /end MEASUREMENT
/begin MEASUREMENT Lin_BS_Signal_CHARERR_1_r_msg "Character Error flag receive from LIN raw value" UBYTE OneToOne 1 100 0.00 255.0 FORMAT "%5.1" ECU_ADDRESS 0x6000F925 /end MEASUREMENT
/begin MEASUREMENT Lin_BS_Signal_ERRCMN_1_r_msg "Sensor error flag receive from LIN raw value" UBYTE OneToOne 1 100 0.00 255.0 FORMAT "%5.1" ECU_ADDRESS 0x6000F924 /end MEASUREMENT
/begin MEASUREMENT Lin_BS_Signal_ERRST_1_r_msg "The status of Sensor error after ignition off receive from LIN raw value" UBYTE OneToOne 1 100 0.00 255.0 FORMAT "%5.1" ECU_ADDRESS 0x6000F923 /end MEASUREMENT
/begin MEASUREMENT Lin_BS_Signal_IBATTAVGLINOFF_8_r_msg "Average discharge current during LIN off receive from LIN raw value" UBYTE OneToOne 1 100 0.00 255.0 FORMAT "%5.1" ECU_ADDRESS 0x6000F922 /end MEASUREMENT
/begin MEASUREMENT Lin_DCDC_Signal_nrSwVers_3_r_msg "" UBYTE OneToOne 1 100 0.00 255.0 FORMAT "%5.1" ECU_ADDRESS 0x6000F921 /end MEASUREMENT
/begin MEASUREMENT Lin_DCDC_Signal_stBoosterErr_1_r_msg "" UBYTE OneToOne 1 100 0.00 255.0 FORMAT "%5.1" ECU_ADDRESS 0x6000F920 /end MEASUREMENT
/begin MEASUREMENT Lin_DCDC_Signal_stCSTErr_1_r_msg "" UBYTE OneToOne 1 100 0.00 255.0 FORMAT "%5.1" ECU_ADDRESS 0x6000F91F /end MEASUREMENT
/begin MEASUREMENT Lin_DCDC_Signal_stCSTHist_1_r_msg "" UBYTE OneToOne 1 100 0.00 255.0 FORMAT "%5.1" ECU_ADDRESS 0x6000F91E /end MEASUREMENT
/begin MEASUREMENT Lin_DCDC_Signal_stDCLinRVer_1_r_msg "" UBYTE OneToOne 1 100 0.00 255.0 FORMAT "%5.1" ECU_ADDRESS 0x6000F91D /end MEASUREMENT
/begin MEASUREMENT Lin_DCDC_Signal_stInpErr1_1_r_msg "" UBYTE OneToOne 1 100 0.00 255.0 FORMAT "%5.1" ECU_ADDRESS 0x6000F91C /end MEASUREMENT
/begin MEASUREMENT Lin_DCDC_Signal_stInpErr2_1_r_msg "" UBYTE OneToOne 1 100 0.00 255.0 FORMAT "%5.1" ECU_ADDRESS 0x6000F91B /end MEASUREMENT
/begin MEASUREMENT Lin_DCDC_Signal_stIntErr_1_r_msg "" UBYTE OneToOne 1 100 0.00 255.0 FORMAT "%5.1" ECU_ADDRESS 0x6000F91A /end MEASUREMENT
/begin MEASUREMENT Lin_DCDC_Signal_stMode_1_r_msg "" UBYTE OneToOne 1 100 0.00 255.0 FORMAT "%5.1" ECU_ADDRESS 0x6000F919 /end MEASUREMENT
/begin MEASUREMENT Lin_DCDC_Signal_stOutpErr1_1_r_msg "" UBYTE OneToOne 1 100 0.00 255.0 FORMAT "%5.1" ECU_ADDRESS 0x6000F918 /end MEASUREMENT
/begin MEASUREMENT Lin_DCDC_Signal_stOutpErr2_1_r_msg "" UBYTE OneToOne 1 100 0.00 255.0 FORMAT "%5.1" ECU_ADDRESS 0x6000F917 /end MEASUREMENT
/begin MEASUREMENT Lin_DCDC_Signal_stTempWarn1_1_r_msg "" UBYTE OneToOne 1 100 0.00 255.0 FORMAT "%5.1" ECU_ADDRESS 0x6000F916 /end MEASUREMENT
/begin MEASUREMENT Lin_DCDC_Signal_stTempWarn2_1_r_msg "" UBYTE OneToOne 1 100 0.00 255.0 FORMAT "%5.1" ECU_ADDRESS 0x6000F915 /end MEASUREMENT
/begin MEASUREMENT Lin_DCDC_Signal_stUnitSt_1_r_msg "" UBYTE OneToOne 1 100 0.00 255.0 FORMAT "%5.1" ECU_ADDRESS 0x6000F914 /end MEASUREMENT
/begin MEASUREMENT mien_w_msg "coordinated torque demand for determination of realizable modes" UWORD rel_uw_b100 1 100 0.00 99.99847 FORMAT "%8.5" ECU_ADDRESS 0x700053FA /end MEASUREMENT
/begin MEASUREMENT PT_stConvGrip "Grip status Clutch" UBYTE OneToOne 1 100 0.00 255.0 FORMAT "%5.1" ECU_ADDRESS 0x7000549E /end MEASUREMENT
/begin MEASUREMENT stAftRun "After run status used in calculation of cooling demand" UBYTE B_TRUE 1 100 0.00 1.00000000000 BIT_MASK 0x1 FORMAT "%13.11" ECU_ADDRESS 0x60036614 /end MEASUREMENT
/begin MEASUREMENT stOffAcc "AC compressor status: reset condition for switch off time due to acceleration" UBYTE B_TRUE 1 100 0.00 1.00000000000 BIT_MASK 0x1 FORMAT "%13.11" ECU_ADDRESS 0x6000E864 /end MEASUREMENT
/begin MEASUREMENT stOffDrvOff "AC compressor status: reset condition for switch off time due to drive off" UBYTE B_TRUE 1 100 0.00 1.00000000000 BIT_MASK 0x1 FORMAT "%13.11" ECU_ADDRESS 0x6000E863 /end MEASUREMENT
/begin MEASUREMENT tiClgAftRun "Final value for time for cooling after run used in calculation of cooling demand" SWORD Time_s 1 100 -327.6800 327.6700 FORMAT "%8.4" ECU_ADDRESS 0x60036612 /end MEASUREMENT
/begin MEASUREMENT tiClgAftRunMax2 "Time for cooling after run used in calculation of cooling demand" SWORD Time_s 1 100 0.00 327.6700 FORMAT "%8.4" ECU_ADDRESS 0x60036610 /end MEASUREMENT
/begin FUNCTION CoETM_ClgDem "2.4.0     Engine Thermal Management Cooling Demand"
 /begin DEF_CHARACTERISTIC CoETM_facAftRun2_C CoETM_facClgAftRunTEnv_CUR CoETM_facClgAftRun_CUR CoETM_rClgAftRun_MAP CoETM_rClgDemFan_CUR CoETM_rClgDemMax_C CoETM_rClgDemMin_C CoETM_rClgIntegMax_C CoETM_rClgIntegMin_C CoETM_rClgKi_CUR CoETM_rClgKp_CUR CoETM_swtSrc_C CoETM_tAftRunAbrt_C CoETM_tClntEngOutStg1Max_C CoETM_tClntEngOutStg1Min_C CoETM_tClntEngOutStg2Max_C CoETM_tClntEngOutStg2Min_C CoETM_tDvtMax_C CoETM_tDvtMin_C CoETM_tDvtStg0_C CoETM_tDvtStg1_C CoETM_tDvtStg2_C CoETM_tEngOutSubsOff_C CoETM_tiClgAftRun2_MAP CoETM_tiClgAftRunCons_MAP CoETM_tiClgAftRunOil_CUR CoETM_tiClgAftRun_MAP CoETM_tiClgIntegT1_C /end DEF_CHARACTERISTIC
 /begin IN_MEASUREMENT CoEng_st CoTS_tClntEngOutDes FlSys_dvolFlCons GlbDa_tEnv Oil_tSwmp TS_tClntEngOut /end IN_MEASUREMENT
 /begin OUT_MEASUREMENT ETM_rClgDem /end OUT_MEASUREMENT
 /begin LOC_MEASUREMENT CoETM_flgAftRun_mp CoETM_rClgDemLim_mp CoETM_rClgIntegLim_mp CoETM_rClgProp_mp CoETM_tClntEngOut_mp CoETM_tDvt_mp CoETM_tEngOutOff_mp CoETM_tiClgAftRun2_mp CoETM_tiClgAftRunMax2_mp CoETM_tiClgAftRunOpt_mp CoETM_tiClgAftRun_mp stAftRun tiClgAftRun tiClgAftRunMax2 /end LOC_MEASUREMENT
 FUNCTION_VERSION "2.4.0" /end FUNCTION
/begin FUNCTION CoETS2ME "1.4.0     Interface adapter CoETS to ME" /begin IN_MEASUREMENT CoETS_trqInrDetMode ftrq2mi_w_msg /end IN_MEASUREMENT /begin OUT_MEASUREMENT mien_w_msg /end OUT_MEASUREMENT FUNCTION_VERSION "1.4.0" /end FUNCTION
/begin FUNCTION CoETS_FltDem "7.2.0_1.3.0Filter demand for drivability filter" /begin DEF_CHARACTERISTIC CoETS_bFltDemLeadEnf_C CoETS_stFltIntvEnd_CW /end DEF_CHARACTERISTIC
 /begin IN_MEASUREMENT GlbDa_stTrqDem PtCoornDyn_stIntvDecLead PtCoornDyn_stIntvLead /end IN_MEASUREMENT
 /begin OUT_MEASUREMENT CoETS_bFltDemLead CoETS_bFltDemSet CoETS_bIntvActvDes CoETS_bIntvActvLead CoETS_bTraIntvActv /end OUT_MEASUREMENT
 /begin LOC_MEASUREMENT CoETS_bDecrIntvLead CoETS_bFltIntvEnd CoETS_bIncrIntvLead /end LOC_MEASUREMENT
 FUNCTION_VERSION "7.2.0_1.3.0" /end FUNCTION
/begin FUNCTION CoETS_StTrqLimCalc "24.2.0    Minimum Torque Limitation" /begin DEF_CHARACTERISTIC CoETS_nTrqRatMin_C /end DEF_CHARACTERISTIC
 /begin IN_MEASUREMENT ActMod_trqInr CoVeh_trqAcs EngDem_trqInrLim Epm_nEng PT_rTrq PT_trqLos PT_trqTraPrt RngMod_trqClthMin VehMot_trqPrtDfftl /end IN_MEASUREMENT
 /begin OUT_MEASUREMENT CoETS_rTrq CoETS_trqInrCurrLim GlbDa_trqCrSVehLimMin GlbDa_trqVehLimMin /end OUT_MEASUREMENT
 /begin LOC_MEASUREMENT CoETS_trqInrVehLimMin_mp /end LOC_MEASUREMENT
 FUNCTION_VERSION "24.2.0" /end FUNCTION
/begin FUNCTION CoETS_TrqCnv "8.0.0_159.0.0Torque conversion from engine input torque into inner torque"
 /begin IN_MEASUREMENT PtCoornDyn_tqCrksftLead PTDist_tqCrksftSet PT_trqCrSLeadPOp RngMod_trqCrSMin /end IN_MEASUREMENT
 /begin OUT_MEASUREMENT CoETS_trqInrLeadPOp CoETS_trqInrLeadWoCo CoETS_trqInrSetWoCo CoETS_trqInrTgtWoCo /end OUT_MEASUREMENT
 FUNCTION_VERSION "8.0.0_159.0.0" /end FUNCTION
/begin FUNCTION CoETS_TrqCoord "8.0.1     Torque-Coordination engine sided torque interventions"
 /begin IN_MEASUREMENT CoETS_trqInrLeadWoCo CoETS_trqInrSetWoCo CoETS_trqInrTgtWoCo EngDem_trqInrLim EngDem_trqInrLimLead /end IN_MEASUREMENT
 /begin OUT_MEASUREMENT CoETS_bEngLimActvLead CoETS_trqInrLeadCo CoETS_trqInrLimLead CoETS_trqInrLimSet CoETS_trqInrSetCo CoETS_trqInrTgtCo CoETS_trqLimLead /end OUT_MEASUREMENT
 FUNCTION_VERSION "8.0.1" /end FUNCTION
/begin FUNCTION CoETS_TrqOpMode "1.8.0_159.1.0Torque calculation for coordination engine operation modes"
 /begin DEF_CHARACTERISTIC CoETS_flgActvMaxTqActMod_C CoETS_stTqInpCfg_C CoETS_tiLpT1_C CoETS_tiLpT2_C /end DEF_CHARACTERISTIC
 /begin REF_CHARACTERISTIC CWMDAPP CWRLAPPL /end REF_CHARACTERISTIC
 /begin IN_MEASUREMENT ActMod_trqInr CoETS_trqInrLeadCo CoETS_trqInrLeadPOp CoPT_trqDesCompEng RngMod_trqInrBs SpdGov_trqFlt /end IN_MEASUREMENT
 /begin OUT_MEASUREMENT CoETS_trqInrDetMode CoETS_trqInrDetModeFild /end OUT_MEASUREMENT
 FUNCTION_VERSION "1.8.0_159.1.0" /end FUNCTION
/begin FUNCTION ComCIL_Co "319.34.0  coordinator of the frame manager"
 /begin DEF_CHARACTERISTIC ComEBS_chNomCapBattSens_C ComEBS_rBattSensCh_C ComEBS_rBattSensSOH_C ComEBS_stBattCrntRng_C ComEBS_stBattSensFlagIni_C ComEBS_stEBSInvld_C ComEBS_stLinRespErr_C ComEBS_tBattSens_C ComEBS_uBattSensSOF_C ComEBS_uBattSens_C Com_cwEepSpasRst_C Com_cwSpasDiagCfg_C Com_rConvFlLvl_CUR Com_rFlLvlDfl_C Com_stFrmRxEna_CA Com_stFrmRxPstDrvEna_CA Com_stFrmTxEna_CA Com_stFrmTxPstDrvEna_CA Com_stIMGDrvModCnvn_CA Com_stswtBrkOper_C Com_stSwtISABAct_C Com_stSwtISABEna_C Com_stswtVirtAPPSelSig_C Com_stSyncSpasDetn_C Com_stVSAFIdErrWghtFac_CA Com_stVSASumTrqErrESP_C Com_swtACEVAMtrSwtInfo_C Com_swtCANVer_C Com_swtEnvT_C Com_swtSelAPPENGA_C Com_swtSelAPPENGT_C Com_swtUnitMonEna_C Com_tiFlLvlPT1_C Com_tiIgnSpasDetnDly_C Com_tiMonBatt_C Com_tiMonStrt_C Com_tiSpas2DetnThd_C Com_tiSpasDetnDly_C Com_uBattSpasMax_C Com_uBattSpasMin_C Com_uMonBatt_C Lin_uOCV_C /end DEF_CHARACTERISTIC
 /begin IN_MEASUREMENT APP_bSRCHigh1 APP_bSRCHigh2 APP_bSRCLow1 APP_bSRCLow2 APP_bSync APP_r APP_rUnFlt APP_stSigSrc BattU_u BusDiag_flgAPPLBUSOFF BusDiag_flgCANCBUSOFF BusDiag_flgVEHICLEBUSOFF CoEng_st Com_flgEngAwkReq Com_flgLINShtDwnTiDlyExp Com_iElecLd Com_stACMETG Com_stATMILReqEAT8 Com_stAYCFFuCtrlReq Com_stCfmdPPosnFCAN Com_stCfmdPPosnPTCAN Com_stClrCmplInfoVINRegst Com_stEAT12RingCntChkSumErr Com_stEAT12TOutBusOffErr Com_stEAT13RingCntChkSumErr Com_stEAT13TOutBusOffErr Com_stIMGACCBrkReq Com_stIMGDrvTq Com_stIMGIDSDrvMod Com_stIMGLimTq Com_stIMGMILReq Com_stIMGShiftReq Com_stISABActAYCI Com_stISABEnaAYCI Com_stLiSwtInfoMETI Com_stMETAFrstRx Com_stMETDCanErr Com_stMETE2ACISSInhbReq Com_stMETE2FrntDfrstSwtInfo Com_stMETNCanErr Com_stMtrCustStReq Com_stNotTxDrvgFFCAN Com_stNotTxDrvgFPTCAN Com_stVINWrClrDone Com_stWiprMETC Com_tMETCEnvTRaw Com_tMETE2AirOutside Com_tMETEEnvTRaw Com_tMtrEvaMETD Com_tOutd Com_tqIMGReqDrv Com_tqIMGSuppReq Com_uFlLvlRaw I14229_stABSFailCnclActv I14229_stShipMod PT_stTraType StrtCtl_flgEngStrtSeq StrtCtl_flgEngStrtSeqCmpl Strt_st SyC_ctPostDrvLeave SysDiag_flgCModJdg T15_st VMD_rVirtAPP VMD_rVirtAPPLrn /end IN_MEASUREMENT
 /begin OUT_MEASUREMENT ACC_bBrkReq Com_iEPS1ElecLd Com_rAPPENGA Com_rAPPENGT Com_rASLCCENGT Com_rFlLvlFlt Com_rVirtAPP Com_stAC Com_stACCActv Com_stACISSInhbReqRes Com_stAPPFailrDetInfo Com_stAPPNormDetInfo Com_stAPPSensFail Com_stATMILReq Com_stCANANoBusOff Com_stCANBNoBusOff Com_stCANCNoBusOff Com_stCfmdPPosn Com_stComVSA Com_stDrvModSwt Com_stEGRVlvErr Com_stEngRun Com_stEnvT Com_stEthnlSErr Com_stFrmRxEna Com_stFrmTxEna Com_stFrntDfrstSwtInfoRes Com_stFuCtrlReq Com_stIDASShftReq Com_stIDASTrqLowSel Com_stISABAct Com_stISABEna Com_stLiSwtInfo Com_stMon Com_stMonitor Com_stMtrCustFlg Com_stMtrEva Com_stNotTxDrvgF Com_stSrvModDispReq Com_stStaActvReq Com_stVINWriteClrDone Com_stVSAAirPThrUsSnsrErr Com_stVSAAPedlErr Com_stVSABstCtrlErr Com_stVSADetrmAirMErr Com_stVSAECUHwErr Com_stVSAEngPosngErr Com_stVSAEnvtlAirPSnsrErr Com_stVSAFlSplyErr Com_stVSAGEVCntrlErr Com_stVSAHFMSnsrErr Com_stVSAIgnCtrlErr Com_stVSAInhbInfo Com_stVSAInjCtrlErr Com_stVSAIntkAirPSnsrErr Com_stVSALamCtrlErr Com_stVSAMisfErr Com_stVSAMonErr Com_stVSASumTrqErr Com_stVSAThrVlvErr Com_stVSATrboChrgnErr Com_stVSAVehSpdImpsErr Com_stVSAVlvLftCtrlErr Com_stWipr Com_swtCANVer Com_tAirOutside Com_tEnvT Com_tMtrEva Com_tqBrkOper Com_tqIDASTar Com_trq2IDASTar /end OUT_MEASUREMENT
 /begin LOC_MEASUREMENT Com_ctReIni10msComCIL_Co Com_ctReIni10msComCIL_Mon Com_rFlLvl_mp /end LOC_MEASUREMENT
 FUNCTION_VERSION "319.34.0" /end FUNCTION
/begin FUNCTION ComCo_Lyr "14.1.0_6SAAComCo Layer" FUNCTION_VERSION "14.1.0_6SAA" /end FUNCTION
/begin FUNCTION CoME_DemCoord "135.7.0   Mechanical energy Coordinator - Determination torque/engine speed request for accessories"
 /begin DEF_CHARACTERISTIC CoME_nMinRrDfog_C CoME_stNReqESS_C CoME_stNReqRrDfog_C CoME_stNReqTSAC_C CoME_stNReqTS_C CoME_stNReqVehMot_C /end DEF_CHARACTERISTIC
 /begin IN_MEASUREMENT Epm_nEng ESS_nMax ESS_nMin ESS_trqDesAcs ESS_trqResvAcs PT_trqLosComp PT_trqResv RrDfogSwt_stRawVal TS_nMax TS_nMin TS_nMinAC TS_trqDesAcs TS_trqResvAcs /end IN_MEASUREMENT
 /begin OUT_MEASUREMENT CoME_nMax CoME_nMin CoME_stNSetP CoME_trqDesComp CoME_trqResv CoVeh_trqAcs /end OUT_MEASUREMENT
 /begin LOC_MEASUREMENT CoME_nMinTemp CoME_nMinTipIn CoME_nMinUnFlt CoME_tqAcsy /end LOC_MEASUREMENT
 FUNCTION_VERSION "135.7.0" /end FUNCTION
/begin FUNCTION CoME_ShutOff "3.7.0     Mechanical energy Coordinator - Determination of shut off condition for accessories"
 /begin DEF_CHARACTERISTIC CoME_calEngSpeed_AXIS CoME_drPedHi_C CoME_drPedLo_C CoME_nEng1Hi_C CoME_nEng1Lo_C CoME_nEng2Hi_C CoME_nEng2Lo_C CoME_numTraGearMax_C CoME_pEnv1Hi_C CoME_pEnv1Lo_C CoME_pEnv2Hi_C CoME_pEnv2Lo_C CoME_rPedHi_C CoME_rPedLo_C CoME_stAlt_CW CoME_stEEM_C CoME_stFan_CW CoME_tEnvAir1Hi_C CoME_tEnvAir1Lo_C CoME_tEnvAir2Hi_C CoME_tEnvAir2Lo_C CoME_tiBattVltgOff_C CoME_tiDrvOn_C CoME_tiMaxOffAcc_CUR CoME_tiMaxOffDrvOff_CUR CoME_tiMinOffAcc_CUR CoME_tiMinOffDrvOff_CUR CoME_tiOffStopAC_C CoME_tiOffStopAlt_C CoME_tiOffStopFan_C CoME_tiOffStrtAC_C CoME_tiOffStrtAlt_C CoME_trqAcc_C CoME_trqACMax_C CoME_trqBattVltg_C CoME_trqDrvOff_C CoME_trqStop_C CoME_trqStrt_C CoME_uBattMinHi_C CoME_uBattMinLo_C CoME_vX1Hi_C CoME_vX1Lo_C CoME_vX2Hi_C CoME_vX2Lo_C /end DEF_CHARACTERISTIC
 /begin IN_MEASUREMENT CoEng_stMai Epm_nEng ESS_uBatt GlbDa_pEnv GlbDa_tEnv GlbDa_vX Tra_numGear VehMot_drAccPedUnFlt VehMot_rAccPedFlt /end IN_MEASUREMENT
 /begin OUT_MEASUREMENT CoME_flgAcc CoME_flgAccMax CoME_flgAccMin CoME_flgAccTmr CoME_flgBattVltg CoME_flgBattVltgTmr CoME_flgDrvOff CoME_flgDrvOffMax CoME_flgDrvOffMin CoME_flgDrvOffTmr CoME_flgDrvTmr CoME_flgOffAcc CoME_flgOffDrvOff CoME_flgStop CoME_flgStrt CoME_flgStrtTmrAC CoME_tiMaxOffAcc CoME_tiMaxOffDrvOff CoME_tiMinOffAcc CoME_tiMinOffDrvOff CoVeh_stAlt CoVeh_stFan CoVeh_trqMaxAC /end OUT_MEASUREMENT
 /begin LOC_MEASUREMENT stOffAcc stOffDrvOff /end LOC_MEASUREMENT
 FUNCTION_VERSION "3.7.0" /end FUNCTION
/begin FUNCTION Common "3.3.0     central header file" FUNCTION_VERSION "3.3.0" /end FUNCTION
/begin FUNCTION CommonCELPrj "30059.0.0 header file for CELPrj package" FUNCTION_VERSION "30059.0.0" /end FUNCTION
/begin FUNCTION ComScl_Appl "109.24.0  Application of ComScl Layer" /begin DEF_CHARACTERISTIC Com_swtEnaChksAlvCntrGbxEATA_C /end DEF_CHARACTERISTIC
 /begin REF_CHARACTERISTIC Com_dENG18SigSel_C Com_dENG19SigSel_C Com_dENG21SigSel_C Com_dENG25SigSel_C Com_dENG2SigSel_C Com_dENGASigSel_C Com_dENGBSigSel_C Com_dENGJ3SigSel_C Com_dENGK3SigSel_C Com_dENGLSigSel_C Com_dENGOSigSel_C Com_dENGQSigSel_C Com_dENGRSigSel_C Com_dENGT2SigSel_C Com_dENGUSigSel_C Com_dENGV2SigSel_C Com_dENGWSigSel_C Com_dENGYSigSel_C Com_dENGZSigSel_C /end REF_CHARACTERISTIC
 /begin OUT_MEASUREMENT Com_stRxEPBBChkSumOk Com_stRxEPBBRingCntOk /end OUT_MEASUREMENT
 FUNCTION_VERSION "109.24.0" /end FUNCTION
/begin FUNCTION ComScl_Bdy "16.2.0    Signal processing of frames from Body Control Module"
 /begin OUT_MEASUREMENT Com_aLatGA Com_aLgtG Com_ctCRingBCM1 Com_ctCRingSRS Com_ctCRingSRSA Com_ctCRingSRSB Com_numCsumBCM1 Com_numCsumSRS Com_numCsumSRSA Com_numCsumSRSB Com_nYaw1UpprData Com_stAbnormCpu Com_stAbnormVcc Com_stCalCmplLatG Com_stCalCmplLgtG Com_stCllsnDetn Com_stFailrLatG Com_stFailrLgtG Com_stPrmntErrYaw1 Com_stRemEngStrtr Com_stSeatBltInfo Com_stStrtupProc Com_stTempAbnormLatG Com_stTempAbnormLgtG Com_stTmpErrYaw1 /end OUT_MEASUREMENT
 FUNCTION_VERSION "16.2.0" /end FUNCTION
/begin FUNCTION ComScl_Dspl "28.11.0   Signal processing of frames from Display ECU"
 /begin OUT_MEASUREMENT Com_bDeIce Com_bDigMtrUnit Com_bMicuInfo Com_bReDEFOutCdn Com_bReDEFSwCdn Com_bRMDRLKCInfo Com_bRMHLHiRly Com_bRMHLLoRly Com_bRMILLSml Com_ctCRingMETA Com_ctCRingMETC Com_ctCRingMETD Com_ctCRingMETE2 Com_ctCRingMETF Com_ctCRingMETG Com_ctCRingMETH Com_ctCRingMETH2 Com_ctCRingMETI Com_ctCRingMETK Com_ctCRingMETL Com_ctCRingMETM Com_ctCRingMETN Com_flgVehSpdLimrDisp Com_iACCmprHiByte Com_iACCmprLoByte Com_lDstMETKRaw Com_nrActPtcActv Com_numCsumMETA Com_numCsumMETC Com_numCsumMETD Com_numCsumMETE2 Com_numCsumMETF Com_numCsumMETG Com_numCsumMETH Com_numCsumMETH2 Com_numCsumMETI Com_numCsumMETK Com_numCsumMETL Com_numCsumMETM Com_numCsumMETN Com_stACCut Com_stACFailInfo Com_stACGUpReq Com_stAcInfo Com_stACMETG Com_stAirCdnr Com_stBCANInfo Com_stBCANReprogm Com_stCombUnitFailInfo Com_stDstMETK Com_stECON Com_stEngHoodOpn Com_stFrtFog Com_stICUHoodErr Com_stISSInhbnSwt Com_stKlsDoorLck Com_stMETE2ACISSInhbReq Com_stMETE2FrntDfrstSwtInfo Com_stMICUInfo Com_stMtrCustDftReq Com_stMtrCustStReq Com_stPrkgBrkSw Com_stRrFog Com_stRstReq Com_stSwISInhbSts Com_stTarSpdDisp Com_stWiprActvnCdn Com_stWiprMETC Com_tACAirTOut Com_tACMtrEvaInfo Com_tAirInsdCbn Com_tiISSPrms Com_tMETE2AirOutside Com_tMtrEvaMETD Com_tOutd Com_uFlLvlRaw Com_uFrntBlowrU Com_uMICUTxBlowrU Com_uRrBlowrU Com_vAnaVeh Com_vDigVeh Com_vDigVehRaw Dspl_stACCASLSwtInfo Dspl_stASLRxErr Dspl_stCrsMaiSwtInfo Dspl_stCrsSwtInfo /end OUT_MEASUREMENT
 FUNCTION_VERSION "28.11.0" /end FUNCTION
/begin FUNCTION ComScl_Eng "65.25.0   Signal processing of frames from Engine ECU"
 /begin IN_MEASUREMENT AccPed_flgIDSDrvModFailr AccPed_flgIDSDrvModTmpInhb AccPed_flgVehSpedSigFailr ACCtl_flgACCutPrms ACCtl_iCmprDwnIReq ACEvpT_tAvg AC_trqDes AirC_stPsCmpr AirMod_ratRelAirM Alt_flgACGExctCmpl Alt_flgACGFailr Alt_flgLockUpCluExtnReq APP_uRaw1unLim Batt_flgDarkIAllwCondA Batt_flgDarkIAllwCondB BrkPed_flgISABReq BrkPed_tqIMGISABIdleStop Brk_stMnRaw Brk_stRedRaw Clth3_st Clth_stRaw CoDsplCtl_stOilLmp CoEng_nFco CoEng_nRstrt CoEng_tiNormalOBD Com_bCVTIdleStop Com_bCVTStopEna Com_ctEngData Com_ctFrmENGN Com_ctFrzSyn Com_dDTCRaw1 Com_dDTCRaw2 Com_dDTCRaw3 Com_dPhysAdr Com_dstOilLfTiRedMilg Com_flgACReq Com_flgCylIndFcoStrtd Com_flgEngAwkReq Com_flgEngStLimr Com_flgFcoRdy Com_flgISABReq Com_flgValFailJdg Com_flgValNormJdg Com_flgVehSpdLimr Com_flgVirtApp Com_lTotRing Com_nEngSpd Com_nISSEng Com_nrEngByte1 Com_nrEngByte2 Com_nrEngByte3 Com_nrEngByte4 Com_nrEngByte5 Com_nrEngByte6 Com_nSetPLo Com_numTraGearDisp Com_pClnt Com_pEngOil_temp Com_pEnvPRaw Com_pEnvPRawENGL Com_pforISABIdleStop Com_pIntkMnfAir Com_rAccrPedlPosn Com_rACCTxEstSlp Com_rAPPENGA Com_rDrvAccrPedlPosn Com_rOilLif Com_rThrVlvAct Com_rVirtAPP Com_stalchpct Com_stAltFail Com_stAPPFailrDetInfo Com_stAPPNormDetInfo Com_stAPPSensFail Com_stAutoStaInfo Com_stAutoStaInfoMtr Com_stAYCFErr Com_stCCClthSwt Com_stChkChgnSysInfo Com_stChrgnSys Com_stCmnCntCdnStart Com_stDcyc Com_stDrvModDisp Com_stDtcInhbClr Com_stDTCUpd Com_stEMTestModEna Com_stEngBrkApp Com_stEngBrkOvrdInfo Com_stEngBrkOvrdMtr Com_stEngCooltTFail Com_stEngCustRevMatchFct Com_stENGECUIG1 Com_stEngIntkAirFail Com_stEngRemSt Com_stEngRstrt Com_stEngRtMilUpd Com_stEngRun Com_stEngSpd30DegFail Com_stEngStop Com_stENGT2AYCAck Com_stENGT2NPos Com_stENGT2RvsPos Com_stEngWrmUp40CycWoFail Com_stErrLmp Com_stEstmTqNormJdg Com_stFailrDetn Com_stFrstStrtEnd Com_stFrzLvl Com_stFrzUpd Com_stGbxNPosSFailEngT2 Com_stIDASEngFail Com_stIDASInhb Com_stImsLmp Com_stISSRelsPreNotif Com_stLmp5AltIO Com_stLmp5AltIOENGO Com_stMILMul Com_stMilMultiSerios Com_stOBSUpd Com_stOilLmp Com_stOilLmpInfo Com_stOilLow Com_stPASensFail Com_stPBSensFail Com_stPrmntDenomCdnJdgStop Com_stSrvModDispReq Com_stStaActvReq Com_stStSpEngStop Com_stThrPosnFail Com_stTqRvsnEnaFlg Com_stTrqAccuracySlow Com_stTrqReqFast Com_stTrqReqSlow Com_stVINErrENGV2 Com_stVINUnRegENGV2 Com_stWarnOilLvl Com_swtDrvMod Com_tAirCACDs Com_tCEngDsT Com_tEngOil_temp Com_ThrVlvActSens1AbsltB1 Com_ThrVlvActSens1RelB1 Com_tiExptFcoStrt Com_tiHACCut Com_tiOilShlfLif Com_tqEstimdEngCrkLvl Com_tqMaxIDAS Com_tqMinIDAS Com_trqDesENGT1 Com_trqDesENGT2 Com_trqEngENG16 Com_trqEngENGT2 Com_trqEngEstimd Com_uBattDetnENGECU Com_uIG1DetnENGECU Com_vACCMemSpd Com_vhegfe Com_volFlConsAdd Com_vVeh CoVeh_flgPtcShtOff CrCtl_stACCAPPOn CrCtl_stActive CrCtl_stDR1Req CrCtl_stDR2Req CrCtl_stDRReqNo CrCtl_stFailCond CrCtl_stGuidDispNo CrCtl_stLmpOn CrCtl_stManCncl CrCUI_numGearPosnADAS CrCUI_stVehUn ects2svc_msg EnvP_p Epm_nEng Epm_nEngRaw Gbx_stAnaNPosBrkHld GSHDem_flgInhbnGSH HLSDem_nSetPHi I14229_stVINWriteClrReq I15031_PID1C LLim_flgASLCtrlTmpHalt LLim_flgASLOverSpd LLim_numMETAlrm LLim_numMETMemSpd LLim_stActvLmp LLim_stMetCCMode1 LLim_stMetCCMode2 LLim_stMETVehUn MFDspl_flgFuCapWarn OilLfT_stRstCmpl PIntkVUs_p RngMod_trqLos SrvCSwt_st SSEUI_stDrvrGuidInhb SSEUI_stISSInhbReas SSEUI_stISSLampReq SSEUI_stISSLampReqInfo SSEUI_stISSWarnReq SSEUI_stStrtClthReq StrtCtl_flgEBBShiftToPReq StrtCtl_flgEngStrtCmpl StrtCtl_flgEPBReq StrtCtl_flgPShiftLockReq StrtCtl_flgVehDrvInhb StrtCtl_flgVehDrvRdy ThrVlv_ratActSens1AbsltB1_u8 ThrVlv_ratActSens1RelB1_u8 tmottstr_w Tra_numStInd Tra_stAmbLmp Tra_stCrkNotCmpl Tra_stEcoLmpIdc VMD_rDasVirtAPP VMSI_stDCSPlusOK wdks_w_msg /end IN_MEASUREMENT
 FUNCTION_VERSION "65.25.0" /end FUNCTION
/begin FUNCTION ComScl_EngLin "15.3.0    Signal processing of frames from Engine ECU over Lin"
 /begin IN_MEASUREMENT Lin_Alt_Signal_AdjVltgDem_6_w_msg Lin_Alt_Signal_DbgInfoTx_3_w_msg Lin_Alt_Signal_DeMagCnclSpd_4_w_msg Lin_Alt_Signal_DeMagTime_4_w_msg Lin_Alt_Signal_MagCrntLim_8_w_msg Lin_BS_B_Signal_BattID_8_w_msg Lin_BS_B_Signal_BoostEnfDmd_1_w_msg Lin_BS_B_Signal_T15_st_1_w_msg /end IN_MEASUREMENT
 /begin OUT_MEASUREMENT Lin_Alt_B_Signal_ACG_Temp_8_r_msg Lin_Alt_B_Signal_ComTOut_1_r_msg Lin_Alt_B_Signal_Com_1_r_msg Lin_Alt_B_Signal_Dyc_5_r_msg Lin_Alt_B_Signal_Elec_1_r_msg Lin_Alt_B_Signal_ExctCrnt_8_r_msg Lin_Alt_B_Signal_HiTemp_1_r_msg Lin_Alt_B_Signal_Mchn_1_r_msg Lin_BS_B_Signal_OCV_8_r_msg Lin_BS_B_Signal_STBATTSENRST_1_r_msg Lin_BS_B_Signal_TASIC_8_r_msg Lin_BS_B_Signal_tiDurAftIgnOff_16_r_msg Lin_BS_Signal_B_BATTCH_16_r_msg Lin_BS_Signal_B_BATTDCHA_16_r_msg Lin_BS_Signal_B_BATT_REPLACE_1_r_msg Lin_BS_Signal_B_BATT_SIZE_DETECT_1_r_msg Lin_BS_Signal_B_BATT_WARM_LEVEL_3_r_msg Lin_BS_Signal_B_BCF_1_r_msg Lin_BS_Signal_B_CHARGE_LOW_1_r_msg Lin_BS_Signal_B_CTINTRESUPD_2_r_msg Lin_BS_Signal_B_DATA_FORMAT_8_r_msg Lin_BS_Signal_B_ERROR_RES_1_r_msg Lin_BS_Signal_B_HARNR_2_r_msg Lin_BS_Signal_B_IBAT_16_r_msg Lin_BS_Signal_B_IBAT_8_r_msg Lin_BS_Signal_B_IOP_ERROR_1_r_msg Lin_BS_Signal_B_iStByCurrAft0h_10_r_msg Lin_BS_Signal_B_iStByCurrAft1h_10_r_msg Lin_BS_Signal_B_iStByCurrAft2h_10_r_msg Lin_BS_Signal_B_iStByCurrLst_10_r_msg Lin_BS_Signal_B_MEASDR_2_r_msg Lin_BS_Signal_B_RESMEASDBATT_16_r_msg Lin_BS_Signal_B_RI_ST_OTHER_MEASURE_16_r_msg Lin_BS_Signal_B_SOC_8_r_msg Lin_BS_Signal_B_SOC_STATE_3_r_msg Lin_BS_Signal_B_SOFV_RESTART_8_r_msg Lin_BS_Signal_B_SOFV_RESTART_STATE_1_r_msg Lin_BS_Signal_B_SOH_COR_8_r_msg Lin_BS_Signal_B_SOH_COR_STATE_1_r_msg Lin_BS_Signal_B_SOH_LAM_8_r_msg Lin_BS_Signal_B_SOH_LAM_STATE_1_r_msg Lin_BS_Signal_B_SOH_SUL_8_r_msg Lin_BS_Signal_B_SOH_SUL_STATE_1_r_msg Lin_BS_Signal_B_SUPPLIER_CODE_8_r_msg Lin_BS_Signal_B_TBAT_8_r_msg Lin_BS_Signal_B_UBAT_16_r_msg Lin_BS_Signal_CHARERR_1_r_msg Lin_BS_Signal_ERRCMN_1_r_msg Lin_BS_Signal_ERRST_1_r_msg Lin_BS_Signal_IBATTAVGLINOFF_8_r_msg Lin_DCDC_Signal_nrSwVers_3_r_msg Lin_DCDC_Signal_stBoosterErr_1_r_msg Lin_DCDC_Signal_stCSTErr_1_r_msg Lin_DCDC_Signal_stCSTHist_1_r_msg Lin_DCDC_Signal_stDCLinRVer_1_r_msg Lin_DCDC_Signal_stInpErr1_1_r_msg Lin_DCDC_Signal_stInpErr2_1_r_msg Lin_DCDC_Signal_stIntErr_1_r_msg Lin_DCDC_Signal_stMode_1_r_msg Lin_DCDC_Signal_stOutpErr1_1_r_msg Lin_DCDC_Signal_stOutpErr2_1_r_msg Lin_DCDC_Signal_stTempWarn1_1_r_msg Lin_DCDC_Signal_stTempWarn2_1_r_msg Lin_DCDC_Signal_stUnitSt_1_r_msg /end OUT_MEASUREMENT
 FUNCTION_VERSION "15.3.0" /end FUNCTION
/begin FUNCTION ComScl_Gbx "22.10.0   Signal processing of frames from Gearbox ECU"
 /begin OUT_MEASUREMENT Com_bTSCIntvSlow Com_ctCRingEAT1 Com_ctCRingEAT10 Com_ctCRingEAT11 Com_ctCRingEAT12 Com_ctCRingEAT13 Com_ctCRingEAT2 Com_ctCRingEAT4 Com_ctCRingEAT6 Com_ctCRingEAT7 Com_ctCRingEAT8 Com_ctCRingEATA Com_ctCRingEATB Com_ctCRingEATC Com_flgACCutDurgAtCvt Com_flgCvtFcoPrms Com_flgExecdManMod Com_lTotRingEATA Com_nIdlDes Com_nTrbn Com_nTrsmMaiShaft Com_numCsumEAT1 Com_numCsumEAT10 Com_numCsumEAT11 Com_numCsumEAT12 Com_numCsumEAT13 Com_numCsumEAT2 Com_numCsumEAT4 Com_numCsumEAT6 Com_numCsumEAT7 Com_numCsumEAT8 Com_numCsumEATA Com_numCsumEATB Com_numCsumEATC Com_numCvtGearShiftMap Com_rConvBoostRaw Com_rConvSlip Com_rCVTAct Com_rTarPllyEAT7 Com_rTrsmTotFild Com_stAmbLmpPrms Com_stATFTVal Com_stATMILReqEAT8 Com_stCfmdNPosn Com_stCfmdPPosnFCAN Com_stCfmdPPosnPTCAN Com_stCVTEngmtInfo Com_stCVTFailrInfo Com_stCvtPosnPrms Com_stCVTShiftActv Com_stFwdRvsCluInfo Com_stGearChgCtrlMod Com_stGearPPosnReqPTCAN Com_stHvyDecelFlg Com_stIdleStrtStopDispFct Com_stLCInfo Com_stLCZone Com_stMilLtgReq Com_stMissSnsrFlg Com_stNotTxDrvgFFCAN Com_stNotTxDrvgFPTCAN Com_stPreStop Com_stShftInD Com_stShftInL Com_stShftInNeutr Com_stShftInPark Com_stShftInRev Com_stShftInS Com_stShiftDwnReco Com_stShiftUpReco Com_stSpdSnsrFailr Com_stTCUECUIG1 Com_stTMTqDwnReq Com_stTranStop Com_stTrsmFailMod Com_stVehSpdSensErr Com_stVehSpdSnsr Com_stVINWrClrDone Com_stVSAInh Com_trqEATReq Com_uBattDetnTCUECU Com_uIG1DetnTCUECU Com_vVehCtl Com_vVehInstPnl Com_vVehSpdCVTCtrl Com_vVehTcu Gbx_nMaxEngFco Gbx_nMaxEngTrqLim Gbx_tOilConv Gbx_trqOilPmpLos Gbx_trqTSCIntvSlow /end OUT_MEASUREMENT
 FUNCTION_VERSION "22.10.0" /end FUNCTION
/begin FUNCTION ComScl_Gw "17.5.0    Signal processing of frames from Gateway"
 /begin OUT_MEASUREMENT Com_ctCRingCGW1 Com_ctCRingGwIMG1 Com_ctCRingGwIMG3 Com_ctCRingGwIMG4 Com_ctCRingGwIMG5 Com_ctCRingGwIMG6 Com_numCsumCGW1 Com_numCsumGwIMG1 Com_numCsumGwIMG3 Com_numCsumGwIMG4 Com_numCsumGwIMG5 Com_numCsumGwIMG6 Com_stClrCmplInfoVINRegst Com_stEngCanRxErr Com_stIMGACCBrkReq Com_stIMGDrvTq Com_stIMGECUIG1 Com_stIMGIDSA12DrvMod Com_stIMGIDSDrvMod Com_stIMGISBrkCntrADAS Com_stIMGISBrkHldActv Com_stIMGISBrkHldStb Com_stIMGISInhbBrk Com_stIMGISRlsReq Com_stIMGISRstrtInhbBrk Com_stIMGISShiftInhbBrk Com_stIMGISSysOffBrk Com_stIMGLimTq Com_stIMGMILReq Com_stIMGShiftReq Com_tqIMGReqDrv Com_tqIMGSuppReq Com_uBattDetnIMGECU Com_uIG1DetnIMGECU /end OUT_MEASUREMENT
 FUNCTION_VERSION "17.5.0" /end FUNCTION
/begin FUNCTION ComScl_IDAS "1.0.0_6SAASignal processing of frames from IDAS (Intelligent Driver Assistance System)" /begin OUT_MEASUREMENT Com_ctCRingIDASB Com_numCsumIDASB Com_stISABasSpd /end OUT_MEASUREMENT FUNCTION_VERSION "1.0.0_6SAA" /end FUNCTION
/begin FUNCTION ComScl_PCU "5.1.0_6SAASignal processing of frames from Powermanagement ECU" /begin OUT_MEASUREMENT Com_ctCRingPCU Com_numCsumPCU Com_stPCUEngStrtInhb /end OUT_MEASUREMENT FUNCTION_VERSION "5.1.0_6SAA" /end FUNCTION
/begin FUNCTION ComScl_StbIntv "4.8.0     Signal processing of frames from Stability Intervention ECU"
 /begin OUT_MEASUREMENT Com_bAYCCond Com_bAYCReWr Com_ctCRingAYCA Com_ctCRingAYCF Com_ctCRingAYCG Com_ctCRingAYCI Com_ctCRingEPB Com_ctCRingEPBB Com_numCsumAYCA Com_numCsumAYCD Com_numCsumAYCF Com_numCsumAYCG Com_numCsumAYCI Com_numCsumEPB Com_numCsumEPBB Com_pMstCyl Com_rClthStk Com_stABSCtrl Com_stABSEBDFailr Com_stABSWrn Com_stACCBrk Com_stActABSEBD Com_stActHSA Com_stAYCF Com_stAYCFShiftReq Com_stBrkHldStby Com_stBrkHldSys Com_stCarAcsSysActv Com_stCarAcsSysPtdOper Com_stClthPedlFailDet Com_stClthStkFailInfo Com_stDCSPlusAYCF Com_stEPBAppld_Raw Com_stEPBFailrInfo_Raw Com_stEPBInhbAct_Raw Com_stEPBInhbBrk Com_stEPBPlaSftyMod_Raw Com_stEPBStInfo_Raw Com_stFailMstCylPSnsr Com_stFrntLeWhlSpdSnsrErr Com_stFrntRiWhlSpdSnsrErr Com_stFuCtrlReqRaw Com_stHydPCtrlOper Com_stInhbMstCylPSnsr Com_stISABActAYCI Com_stISABEnaAYCI Com_stLgtGASensErr Com_stLgtGASensInh Com_stReLeWhlSpdSnsrErr Com_stReRiWhlSpdSnsrErr Com_stVSACtrl Com_stVSALampOff Com_stVSATCSFailr Com_stYawRateSnsrErr Com_stYawRateSnsrInhb Com_tqBrkOperAYCG Com_tqBrkOperAYCI Com_trqAYCFDes Com_uCPS1VoltEPB Com_uCPS2VoltEPB Com_vFLWhlSpd Com_vFRWhlSpd Com_vRLWhlSpd Com_vRRWhlSpd /end OUT_MEASUREMENT
 FUNCTION_VERSION "4.8.0" /end FUNCTION
/begin FUNCTION ComScl_Strg "13.1.0_6SAASignal processing of frames from Steering Angle ECU"
 /begin OUT_MEASUREMENT Com_ctCRingEPS1 Com_iElecLd Com_numCsumEPS1 Com_stEPS1ISSRelsReq Com_stEPSISSInhbReq Com_stEPSMidReq /end OUT_MEASUREMENT
 FUNCTION_VERSION "13.1.0_6SAA" /end FUNCTION
/begin FUNCTION ConversionSpecial_CELPrj "30059.0.0 Conversion Formulas Special, which are migrated from GS" FUNCTION_VERSION "30059.0.0" /end FUNCTION
/begin FUNCTION Conversion_CELPrj "30059.0.0 Conversion Formulas, which are migrated from GS classic" FUNCTION_VERSION "30059.0.0" /end FUNCTION
/begin FUNCTION Conv_GripIntrlck "8.0.0     Converter Grip Interlock" /begin IN_MEASUREMENT Clth_st /end IN_MEASUREMENT /begin OUT_MEASUREMENT PT_stConvGrip /end OUT_MEASUREMENT FUNCTION_VERSION "8.0.0" /end FUNCTION
/begin FUNCTION Conv_LdCalc "41.4.0    Torque load converter calculation"
 /begin DEF_CHARACTERISTIC Conv_facDepNTrbnNStat_CUR Conv_facDeptNTrbnNStat_M Conv_facGnTrqHiInc_C Conv_facGnTrqResv_C Conv_facNTrbnCorr_C Conv_facRedCnvrLoad_C Conv_facVelErr_C Conv_facVelNoErr_C Conv_flgDecelTqAPSeln_C Conv_flgEnaTqResvShiftLvr_C Conv_flgSwtGearLvrNoGrip_C Conv_flgSwtInGearSeln_C Conv_flgSwtOutGearSeln_C Conv_flgSwtSelnCURM_C Conv_flgTrbnSpdDifSeln_C Conv_LvrOffDebP.tiHiLo_C Conv_LvrOffDebP.tiLoHi_C Conv_LvrPosChgDRDebT.tiHiLo_C Conv_LvrPosChgDRDebT.tiLoHi_C Conv_LvrPosChgRDDebT.tiHiLo_C Conv_LvrPosChgRDDebT.tiLoHi_C Conv_LvrPosOffDebP.tiHiLo_C Conv_LvrPosOffDebP.tiLoHi_C Conv_nDecelTqDifThdHi_C Conv_nDecelTqDifThdLo_C Conv_nDecelTqThdHi_C Conv_nDecelTqThdLo_C Conv_nrTrbAvrg_C Conv_nTrbnLoLim_C Conv_nTrbnMinCorrVal_C Conv_nTrbn_C Conv_numLvrPosFwdGear_C Conv_numLvrPosNeut_C Conv_numLvrPosPark_C Conv_numLvrPosRevGear_C Conv_rDecelTqThd_C Conv_stCalcNTrbnNStat_C Conv_stDecelTqBrk_C Conv_stSwtRedCnvrLoad_C Conv_stTqResvDrvRevEna_C Conv_swtOilCoolrOfsSel_C Conv_swtOilPmpLoss_C Conv_tiDecelTqMax_C Conv_tiDecelTqToffd_C Conv_tiDwnRglPT1_GCUR Conv_tiGearChgDRPT1_GCUR Conv_tiGearChgDR_C Conv_tiGearChgRD_C Conv_tiNCtrlPT1_GCUR Conv_tiRTraGearPT1_C Conv_tiTrqLdPT1_C Conv_tiTrqResvPT1_GCUR Conv_tiUpRglPT1_GCUR Conv_tOil_DST Conv_tqDecelOffsRedn_C Conv_tqDecelOffs_M Conv_trqLdGnFacHysDec_C Conv_trqLdMaxLim_MAP Conv_trqLdReplCan_C Conv_TrqResvDebP.tiHiLo_C Conv_TrqResvDebP.tiLoHi_C Conv_trqResvLoLim_C Conv_trqResvMaxLim_C Conv_trqResvMinLim_C Conv_trqResvNeutrLvrPos_C Conv_trqResvPreFlt_C Conv_trqResvRepl_C Conv_trqStatSqLvrPosNeutr_C Conv_vDecelTqThdHi_C Conv_vDecelTqThdLo_C Gbx_stNCtrl_CW Gbx_stOilPmpFlt_CW Gbx_stOilPmp_CW Gbx_tiOilPmpTrq_C /end DEF_CHARACTERISTIC
 /begin REF_CHARACTERISTIC Conv_trqDfl_C /end REF_CHARACTERISTIC
 /begin IN_MEASUREMENT AccPed_tqMapBasd Brk_st B_ll_msg Conv_bCalc Conv_bConvActv Conv_bGearOff Conv_bTrbnSpdCan Conv_bTrqLdCan Conv_bTrqLdFlt Conv_bTrqResvBrkEnd Conv_bTrqResvLvrOff Conv_facOilTempDepTrqPmp Conv_tiTDeptRevLvrDebNegNeut Conv_tiTDeptRevLvrDebNegPark Conv_tiTDpdtLvrDrvRevDebPos Conv_tiTDpdtLvrRevDrvDebPos Conv_tiTempDepLvrDebNeg Conv_tiTempDepLvrDebPos Conv_tiTempDepRevLvrDebPos Conv_tOil Conv_tqResvTDeptDrvRev Conv_trqLdLvrPosNeutr Conv_trqLdRevLvrPos Conv_trqLdTempDepLim Conv_trqLosDfftl Conv_trqOilCoolrPmp Conv_trqOilCoolrPmpRepl Conv_trqResvTempDep Epm_nEng Gbx_flgNCtrlImp Gbx_flgNCtrlRetStrt Gbx_nTrbn Gbx_ratOilCoolrPmp Gbx_stGearLvr Gbx_stPNPos Gbx_trqConvLos Gbx_trqOilPmpLos GlbDa_lWhlCirc GlbDa_vXFlt HLSDem_nSetPTrck PT_bConvSlipOpn PT_bNoGrip PT_rTraGear PT_rTrq PT_stTraType RngMod_trqCrSMinWoCtOff SpdGov_nSetPLo SyC_ctPostDrvLeave Tra_flgNeutPrkg Tra_numGear TS_tClntEngOut VehMot_rTrqDfftl VehMot_stBrkPed /end IN_MEASUREMENT
 /begin OUT_MEASUREMENT Conv_bRevLvrPos Conv_bTrqResv Conv_nTrbn Conv_nTrbnMod Conv_nTrbnOld Conv_trqLd Conv_trqLdFlt Conv_trqLdMod Conv_trqLdPreFlt Conv_trqOilPmpLoss Conv_trqResv /end OUT_MEASUREMENT
 /begin LOC_MEASUREMENT Conv_bCalcActv_mp Conv_bLvrPosDebRD_mp Conv_bLvrPosRD_mp Conv_cntrPostDrvLve Conv_facDepNTrbnNStat_mp Conv_facIntrpn Conv_facRedCnvrLoad Conv_flgDecelTq Conv_flgDecelTqCdn Conv_flgDRGearShift Conv_flgDRGearShiftDeb Conv_flgRDGearShift Conv_flgRDGearShiftDeb Conv_flgTqOffsTiMax Conv_idxCurPosn Conv_nDifAvrg Conv_nrPrevGear Conv_nrTrbAvrg Conv_nTrbDifAry Conv_nTrbnCorrVal_mp Conv_nTrbnDiff_mp Conv_nTrbnExp_mp Conv_rNTrbnNStat_mp Conv_tiDepLvrDeb Conv_tqDecelOffs Conv_tqEngTqDe Conv_tqPmpDrvOff Conv_tqPmpHiSpd Conv_tqPmpHiSpdTmp Conv_tqPmpLoSpd Conv_tqPmpLoSpdTmp Conv_tqPmpStat Conv_tqPmpStd Conv_trqLdBefLim_mp Conv_trqLdDiff_mp Conv_trqLdFltRslt_mp Conv_trqLdMaxLim_mp Conv_trqLdOfs Conv_trqLdOfs_mp Conv_trqLdResvAdd_mp Conv_trqLdResvFlt_mp Conv_trqLdTrqResvTotBuf_mp Conv_trqLosDfftl_mp Conv_trqPmpBuf_mp Conv_trqResvHiInc_mp Conv_trqStatSqBuf_mp /end LOC_MEASUREMENT
 FUNCTION_VERSION "41.4.0" /end FUNCTION
/begin COMPU_METHOD AmpHrs_Ah "" RAT_FUNC "%6.2" "Ah" COEFFS 0 1 0 0 0 1 /end COMPU_METHOD
/begin COMPU_METHOD B_TRUE "" TAB_VERB "%6.3" "" COMPU_TAB_REF B_TRUE /end COMPU_METHOD
/begin COMPU_VTAB B_TRUE "" TAB_VERB 2 0 "FALSE" 1 "TRUE" /end COMPU_VTAB
/begin COMPU_METHOD Com_aLgtG_Compu "" RAT_FUNC "%6.2" "Mtr_per_sec2" COEFFS 0 208980 5120000 0 0 10000 /end COMPU_METHOD
/begin COMPU_METHOD Com_EvaTemp_Compu "" RAT_FUNC "%1.0" "" COEFFS 0 1 30 0 0 1 /end COMPU_METHOD
/begin COMPU_METHOD Com_Fact_b0p00006 "" RAT_FUNC "%7.6" "-" COEFFS 0 16384 0 0 0 1 /end COMPU_METHOD
/begin COMPU_METHOD Com_stSeatBltInfo_COMPU_VERB "" TAB_VERB "%6.3" "" COMPU_TAB_REF Com_stSeatBltInfo_COMPU_VERB /end COMPU_METHOD
/begin COMPU_VTAB Com_stSeatBltInfo_COMPU_VERB "" TAB_VERB 4 0 "UNABLE_TO_CONFIRM" 1 "SEATBELT_NOT_WEARING" 2 "SEATBELT_WEARING" 3 "SEATBELT_BUCKLESW_ERROR" /end COMPU_VTAB
/begin COMPU_METHOD CrCtlSlipRat "" RAT_FUNC "%6.4" "%" COEFFS 0 200 0 0 0 1 /end COMPU_METHOD
/begin COMPU_METHOD Curr_A "" RAT_FUNC "%6.4" "A" COEFFS 0 100 0 0 0 1 /end COMPU_METHOD
/begin COMPU_METHOD dez "" RAT_FUNC "%6.2" "" COEFFS 0 1 0 0 0 1 /end COMPU_METHOD
/begin COMPU_METHOD DFES_nPID0C "" RAT_FUNC "%6.3" "rpm" COEFFS 0 4 0 0 0 1 /end COMPU_METHOD
/begin COMPU_METHOD DIAGADAPT_SC_Compu "" TAB_VERB "%6.3" "" COMPU_TAB_REF DIAGADAPT_SC_Compu /end COMPU_METHOD
/begin COMPU_VTAB DIAGADAPT_SC_Compu "" TAB_VERB 2 0 "False" 1 "True" /end COMPU_VTAB
/begin COMPU_METHOD DIAGCOM_CALCAN_SC_Compu "" TAB_VERB "%6.3" "" COMPU_TAB_REF DIAGCOM_CALCAN_SC_Compu /end COMPU_METHOD
/begin COMPU_VTAB DIAGCOM_CALCAN_SC_Compu "" TAB_VERB 2 0 "False" 1 "True" /end COMPU_VTAB
/begin COMPU_METHOD DIAGCOM_CANFD_SC_Compu "" TAB_VERB "%6.3" "" COMPU_TAB_REF DIAGCOM_CANFD_SC_Compu /end COMPU_METHOD
/begin COMPU_VTAB DIAGCOM_CANFD_SC_Compu "" TAB_VERB 2 0 "False" 1 "True" /end COMPU_VTAB
/begin COMPU_METHOD DIAGCOM_RDPI_SY_Compu "" TAB_VERB "%6.3" "" COMPU_TAB_REF DIAGCOM_RDPI_SY_Compu /end COMPU_METHOD
/begin COMPU_VTAB DIAGCOM_RDPI_SY_Compu "" TAB_VERB 2 0 "0" 1 "1" /end COMPU_VTAB
/begin COMPU_METHOD DIAGCOM_RESPONEVT_SY_Compu "" TAB_VERB "%6.3" "" COMPU_TAB_REF DIAGCOM_RESPONEVT_SY_Compu /end COMPU_METHOD
/begin COMPU_VTAB DIAGCOM_RESPONEVT_SY_Compu "" TAB_VERB 2 0 "FALSE" 1 "TRUE" /end COMPU_VTAB
/begin COMPU_METHOD DIAGCOM_RINGBUF_SY_Compu "" TAB_VERB "%6.3" "" COMPU_TAB_REF DIAGCOM_RINGBUF_SY_Compu /end COMPU_METHOD
/begin COMPU_VTAB DIAGCOM_RINGBUF_SY_Compu "" TAB_VERB 2 0 "False" 1 "True" /end COMPU_VTAB
/begin COMPU_METHOD DIAGCPV1CRSSCORRLNHILOAD_SC_Compu "" TAB_VERB "%6.3" "" COMPU_TAB_REF DIAGCPV1CRSSCORRLNHILOAD_SC_Compu /end COMPU_METHOD
/begin COMPU_VTAB DIAGCPV1CRSSCORRLNHILOAD_SC_Compu "" TAB_VERB 2 0 "False" 1 "True" /end COMPU_VTAB
/begin COMPU_METHOD DIAGCPV1CRSSCORRLNLOLOAD_SC_Compu "" TAB_VERB "%6.3" "" COMPU_TAB_REF DIAGCPV1CRSSCORRLNLOLOAD_SC_Compu /end COMPU_METHOD
/begin COMPU_VTAB DIAGCPV1CRSSCORRLNLOLOAD_SC_Compu "" TAB_VERB 2 0 "False" 1 "True" /end COMPU_VTAB
/begin COMPU_METHOD DIAGCPV1DMTLHILOAD_SC_Compu "" TAB_VERB "%6.3" "" COMPU_TAB_REF DIAGCPV1DMTLHILOAD_SC_Compu /end COMPU_METHOD
/begin COMPU_VTAB DIAGCPV1DMTLHILOAD_SC_Compu "" TAB_VERB 2 0 "False" 1 "True" /end COMPU_VTAB
/begin COMPU_METHOD DIAGCPV1DMTLLOLOAD_SC_Compu "" TAB_VERB "%6.3" "" COMPU_TAB_REF DIAGCPV1DMTLLOLOAD_SC_Compu /end COMPU_METHOD
/begin COMPU_VTAB DIAGCPV1DMTLLOLOAD_SC_Compu "" TAB_VERB 2 0 "False" 1 "True" /end COMPU_VTAB
/begin COMPU_METHOD DIAGCPV1DTESKLOLOAD_SC_Compu "" TAB_VERB "%6.3" "" COMPU_TAB_REF DIAGCPV1DTESKLOLOAD_SC_Compu /end COMPU_METHOD
/begin COMPU_VTAB DIAGCPV1DTESKLOLOAD_SC_Compu "" TAB_VERB 2 0 "False" 1 "True" /end COMPU_VTAB
/begin COMPU_METHOD DIAGCPV1INTKMNFLDPSNSRLOCKINLOLOAD_SC_Compu "" TAB_VERB "%6.3" "" COMPU_TAB_REF DIAGCPV1INTKMNFLDPSNSRLOCKINLOLOAD_SC_Compu /end COMPU_METHOD
/begin COMPU_VTAB DIAGCPV1INTKMNFLDPSNSRLOCKINLOLOAD_SC_Compu "" TAB_VERB 2 0 "False" 1 "True" /end COMPU_VTAB
/begin COMPU_METHOD DIAGCPV1PSNSRHILOAD_SC_Compu "" TAB_VERB "%6.3" "" COMPU_TAB_REF DIAGCPV1PSNSRHILOAD_SC_Compu /end COMPU_METHOD
/begin COMPU_VTAB DIAGCPV1PSNSRHILOAD_SC_Compu "" TAB_VERB 2 0 "False" 1 "True" /end COMPU_VTAB
/begin COMPU_METHOD DIAGCPV1PSNSRLOCKINLOLOAD_SC_Compu "" TAB_VERB "%6.3" "" COMPU_TAB_REF DIAGCPV1PSNSRLOCKINLOLOAD_SC_Compu /end COMPU_METHOD
/begin COMPU_VTAB DIAGCPV1PSNSRLOCKINLOLOAD_SC_Compu "" TAB_VERB 2 0 "False" 1 "True" /end COMPU_VTAB
/begin COMPU_METHOD DIAGCPV1PSNSRLOLOAD_SC_Compu "" TAB_VERB "%6.3" "" COMPU_TAB_REF DIAGCPV1PSNSRLOLOAD_SC_Compu /end COMPU_METHOD
/begin COMPU_VTAB DIAGCPV1PSNSRLOLOAD_SC_Compu "" TAB_VERB 2 0 "False" 1 "True" /end COMPU_VTAB
/begin COMPU_METHOD DIAGCPV1PSNSROBSVRHILOAD_SC_Compu "" TAB_VERB "%6.3" "" COMPU_TAB_REF DIAGCPV1PSNSROBSVRHILOAD_SC_Compu /end COMPU_METHOD
/begin COMPU_VTAB DIAGCPV1PSNSROBSVRHILOAD_SC_Compu "" TAB_VERB 2 0 "False" 1 "True" /end COMPU_VTAB
/begin COMPU_METHOD DIAGCPV1PSNSROBSVRLOLOAD_SC_Compu "" TAB_VERB "%6.3" "" COMPU_TAB_REF DIAGCPV1PSNSROBSVRLOLOAD_SC_Compu /end COMPU_METHOD
/begin COMPU_VTAB DIAGCPV1PSNSROBSVRLOLOAD_SC_Compu "" TAB_VERB 2 0 "False" 1 "True" /end COMPU_VTAB
/begin COMPU_METHOD DIAGCPV1PURGLINEPSNSRLOCKINLOLOAD_SC_Compu "" TAB_VERB "%6.3" "" COMPU_TAB_REF DIAGCPV1PURGLINEPSNSRLOCKINLOLOAD_SC_Compu /end COMPU_METHOD
/begin COMPU_VTAB DIAGCPV1PURGLINEPSNSRLOCKINLOLOAD_SC_Compu "" TAB_VERB 2 0 "False" 1 "True" /end COMPU_VTAB
/begin COMPU_METHOD DIAGCPV2CRSSCORRLNHILOAD_SC_Compu "" TAB_VERB "%6.3" "" COMPU_TAB_REF DIAGCPV2CRSSCORRLNHILOAD_SC_Compu /end COMPU_METHOD
/begin COMPU_VTAB DIAGCPV2CRSSCORRLNHILOAD_SC_Compu "" TAB_VERB 2 0 "False" 1 "True" /end COMPU_VTAB
/begin COMPU_METHOD DIAGCPV2CRSSCORRLNLOLOAD_SC_Compu "" TAB_VERB "%6.3" "" COMPU_TAB_REF DIAGCPV2CRSSCORRLNLOLOAD_SC_Compu /end COMPU_METHOD
/begin COMPU_VTAB DIAGCPV2CRSSCORRLNLOLOAD_SC_Compu "" TAB_VERB 2 0 "False" 1 "True" /end COMPU_VTAB
/begin COMPU_METHOD DIAGCPV2PSNSRHILOAD_SC_Compu "" TAB_VERB "%6.3" "" COMPU_TAB_REF DIAGCPV2PSNSRHILOAD_SC_Compu /end COMPU_METHOD
/begin COMPU_VTAB DIAGCPV2PSNSRHILOAD_SC_Compu "" TAB_VERB 2 0 "False" 1 "True" /end COMPU_VTAB
/begin COMPU_METHOD DIAGCPV2PSNSRLOCKINLOLOAD_SC_Compu "" TAB_VERB "%6.3" "" COMPU_TAB_REF DIAGCPV2PSNSRLOCKINLOLOAD_SC_Compu /end COMPU_METHOD
/begin COMPU_VTAB DIAGCPV2PSNSRLOCKINLOLOAD_SC_Compu "" TAB_VERB 2 0 "False" 1 "True" /end COMPU_VTAB
/begin COMPU_METHOD DIAGCPV2PSNSRLOLOAD_SC_Compu "" TAB_VERB "%6.3" "" COMPU_TAB_REF DIAGCPV2PSNSRLOLOAD_SC_Compu /end COMPU_METHOD
/begin COMPU_VTAB DIAGCPV2PSNSRLOLOAD_SC_Compu "" TAB_VERB 2 0 "False" 1 "True" /end COMPU_VTAB
/begin COMPU_METHOD DIAGCPV2PURGLINEPSNSRLOCKINLOLOAD_SC_Compu "" TAB_VERB "%6.3" "" COMPU_TAB_REF DIAGCPV2PURGLINEPSNSRLOCKINLOLOAD_SC_Compu /end COMPU_METHOD
/begin COMPU_VTAB DIAGCPV2PURGLINEPSNSRLOCKINLOLOAD_SC_Compu "" TAB_VERB 2 0 "False" 1 "True" /end COMPU_VTAB
/begin COMPU_METHOD DIAGCPVAVL_SC_Compu "" TAB_VERB "%6.3" "" COMPU_TAB_REF DIAGCPVAVL_SC_Compu /end COMPU_METHOD
/begin COMPU_VTAB DIAGCPVAVL_SC_Compu "" TAB_VERB 2 0 "False" 1 "True" /end COMPU_VTAB
/begin COMPU_METHOD DIAGCPVPSNSROBS_SC_Compu "" TAB_VERB "%6.3" "" COMPU_TAB_REF DIAGCPVPSNSROBS_SC_Compu /end COMPU_METHOD
/begin COMPU_VTAB DIAGCPVPSNSROBS_SC_Compu "" TAB_VERB 2 0 "False" 1 "True" /end COMPU_VTAB
/begin COMPU_METHOD DIAGCPVVERS_SC_Compu "" TAB_VERB "%6.3" "" COMPU_TAB_REF DIAGCPVVERS_SC_Compu /end COMPU_METHOD
/begin COMPU_VTAB DIAGCPVVERS_SC_Compu "" TAB_VERB 3 0 "NoCPVDiag" 1 "SY_DCPV" 2 "DIAGCPVxxx_SC" /end COMPU_VTAB
/begin COMPU_METHOD DIAGFUSPLYERRDEB_SC_Compu "" TAB_VERB "%6.3" "" COMPU_TAB_REF DIAGFUSPLYERRDEB_SC_Compu /end COMPU_METHOD
/begin COMPU_VTAB DIAGFUSPLYERRDEB_SC_Compu "" TAB_VERB 3 0 "0" 1 "1" 2 "2" /end COMPU_VTAB
/begin COMPU_METHOD DiagLeakDtesk_StMac_30201_sm_VERB "" TAB_VERB "%6.3" "" COMPU_TAB_REF DiagLeakDtesk_StMac_30201_sm_VERB /end COMPU_METHOD
/begin COMPU_VTAB DiagLeakDtesk_StMac_30201_sm_VERB "" TAB_VERB 14 0 "A_Bereit" 1 "A_Aavwarte" 10 "A_Udruck" 11 "A_Wartezeit" 12 "H_Aktiv" 13 "H_Aufbau" 2 "A_Einschw" 3 "A_Gkomp" 4 "A_Minimum" 5 "A_Psensor" 6 "A_Tevschuss" 7 "A_Tevzu" 8 "A_Udabbau" 9 "A_Udaufbau" /end COMPU_VTAB
/begin COMPU_METHOD DiagLeakEonv_StMacmac_sm_VERB "" TAB_VERB "%6.3" "" COMPU_TAB_REF DiagLeakEonv_StMacmac_sm_VERB /end COMPU_METHOD
/begin COMPU_VTAB DiagLeakEonv_StMacmac_sm_VERB "" TAB_VERB 4 0 "A_startend" 1 "A_cvsopen" 2 "A_pressmon" 3 "A_vacmon" /end COMPU_VTAB
/begin COMPU_METHOD DIASRV_INF78_SC_Compu "" TAB_VERB "%6.3" "" COMPU_TAB_REF DIASRV_INF78_SC_Compu /end COMPU_METHOD
/begin COMPU_VTAB DIASRV_INF78_SC_Compu "" TAB_VERB 2 0 "False" 1 "True" /end COMPU_VTAB
/begin COMPU_METHOD DIBOX_SY_Compu "" TAB_VERB "%6.3" "" COMPU_TAB_REF DIBOX_SY_Compu /end COMPU_METHOD
/begin COMPU_VTAB DIBOX_SY_Compu "" TAB_VERB 2 0 "False" 1 "True" /end COMPU_VTAB
/begin COMPU_METHOD DifCoef_COMPU "" RAT_FUNC "%6.2" "J/m/K/s" COEFFS 0 1 0 0 0 1 /end COMPU_METHOD
/begin COMPU_METHOD DifCoef_q0p0001_COMPU "" RAT_FUNC "%7.6" "J/m/K/s" COEFFS 0 10000 0 0 0 1 /end COMPU_METHOD
/begin COMPU_METHOD DIFFPRT_SY_Compu "" TAB_VERB "%6.3" "" COMPU_TAB_REF DIFFPRT_SY_Compu /end COMPU_METHOD
/begin COMPU_VTAB DIFFPRT_SY_Compu "" TAB_VERB 2 0 "FALSE" 1 "TRUE" /end COMPU_VTAB
/begin COMPU_METHOD DIFFRAT_SC_Compu "" TAB_VERB "%6.3" "" COMPU_TAB_REF DIFFRAT_SC_Compu /end COMPU_METHOD
/begin COMPU_VTAB DIFFRAT_SC_Compu "" TAB_VERB 2 0 "False" 1 "True" /end COMPU_VTAB
/begin COMPU_METHOD DINH_DEF25DEB0DI_SC_Compu "" TAB_VERB "%6.3" "" COMPU_TAB_REF DINH_DEF25DEB0DI_SC_Compu /end COMPU_METHOD
/begin COMPU_VTAB DINH_DEF25DEB0DI_SC_Compu "" TAB_VERB 2 0 "False" 1 "True" /end COMPU_VTAB
/begin COMPU_METHOD DINH_FID_VIEW_SC_Compu "" TAB_VERB "%6.3" "" COMPU_TAB_REF DINH_FID_VIEW_SC_Compu /end COMPU_METHOD
/begin COMPU_VTAB DINH_FID_VIEW_SC_Compu "" TAB_VERB 2 0 "False" 1 "True" /end COMPU_VTAB
/begin COMPU_METHOD DINH_NEWTRIPWITHFCMCLR_SC_Compu "" TAB_VERB "%6.3" "" COMPU_TAB_REF DINH_NEWTRIPWITHFCMCLR_SC_Compu /end COMPU_METHOD
/begin COMPU_VTAB DINH_NEWTRIPWITHFCMCLR_SC_Compu "" TAB_VERB 2 0 "False" 1 "True" /end COMPU_VTAB
/begin COMPU_METHOD DIPO_SY_Compu "" TAB_VERB "%6.3" "" COMPU_TAB_REF DIPO_SY_Compu /end COMPU_METHOD
/begin COMPU_VTAB DIPO_SY_Compu "" TAB_VERB 2 0 "0" 1 "1" /end COMPU_VTAB
/begin COMPU_METHOD DISTAB_SY_Compu "" TAB_VERB "%6.3" "" COMPU_TAB_REF DISTAB_SY_Compu /end COMPU_METHOD
/begin COMPU_VTAB DISTAB_SY_Compu "" TAB_VERB 2 0 "No Distab" 1 "Distab" /end COMPU_VTAB
/begin COMPU_METHOD DIUMPR_500MD_SY_Compu "" TAB_VERB "%6.3" "" COMPU_TAB_REF DIUMPR_500MD_SY_Compu /end COMPU_METHOD
/begin COMPU_VTAB DIUMPR_500MD_SY_Compu "" TAB_VERB 2 0 "0" 1 "1" /end COMPU_VTAB
/begin COMPU_METHOD DIUMPR_COLDSTARTDEN_SC_Compu "" TAB_VERB "%6.3" "" COMPU_TAB_REF DIUMPR_COLDSTARTDEN_SC_Compu /end COMPU_METHOD
/begin COMPU_VTAB DIUMPR_COLDSTARTDEN_SC_Compu "" TAB_VERB 2 0 "False" 1 "True" /end COMPU_VTAB
/begin COMPU_METHOD DIUMPR_DATAFROMCAN_SC_Compu "" TAB_VERB "%6.3" "" COMPU_TAB_REF DIUMPR_DATAFROMCAN_SC_Compu /end COMPU_METHOD
/begin COMPU_VTAB DIUMPR_DATAFROMCAN_SC_Compu "" TAB_VERB 2 0 "False" 1 "True" /end COMPU_VTAB
/begin COMPU_METHOD DIUMPR_DENOMCDN_SC_Compu "" TAB_VERB "%6.3" "" COMPU_TAB_REF DIUMPR_DENOMCDN_SC_Compu /end COMPU_METHOD
/begin COMPU_VTAB DIUMPR_DENOMCDN_SC_Compu "" TAB_VERB 3 0 "DenomConds_Local" 1 "DenomConds_DSMApl" 2 "DenomConds_AutosarApi" /end COMPU_VTAB
/begin COMPU_METHOD DIUMPR_DSTTRVLDSNCERST_SC_Compu "" TAB_VERB "%6.3" "" COMPU_TAB_REF DIUMPR_DSTTRVLDSNCERST_SC_Compu /end COMPU_METHOD
/begin COMPU_VTAB DIUMPR_DSTTRVLDSNCERST_SC_Compu "" TAB_VERB 2 0 "False" 1 "True" /end COMPU_VTAB
/begin COMPU_METHOD DIUMPR_EVAPDENOMTIPRPSYSOFF_SC_Compu "" TAB_VERB "%6.3" "" COMPU_TAB_REF DIUMPR_EVAPDENOMTIPRPSYSOFF_SC_Compu /end COMPU_METHOD
/begin COMPU_VTAB DIUMPR_EVAPDENOMTIPRPSYSOFF_SC_Compu "" TAB_VERB 2 0 "False" 1 "True" /end COMPU_VTAB
/begin COMPU_METHOD DIUMPR_EVAPDEN_SY_Compu "" TAB_VERB "%6.3" "" COMPU_TAB_REF DIUMPR_EVAPDEN_SY_Compu /end COMPU_METHOD
/begin COMPU_VTAB DIUMPR_EVAPDEN_SY_Compu "" TAB_VERB 2 0 "False" 1 "True" /end COMPU_VTAB
/begin COMPU_METHOD DIUMPR_FUENGOPERTI_SC_Compu "" TAB_VERB "%6.3" "" COMPU_TAB_REF DIUMPR_FUENGOPERTI_SC_Compu /end COMPU_METHOD
/begin COMPU_VTAB DIUMPR_FUENGOPERTI_SC_Compu "" TAB_VERB 2 0 "False" 1 "True" /end COMPU_VTAB
/begin COMPU_METHOD DIUMPR_IGNCYCTMR_SC_Compu "" TAB_VERB "%6.3" "" COMPU_TAB_REF DIUMPR_IGNCYCTMR_SC_Compu /end COMPU_METHOD
/begin COMPU_VTAB DIUMPR_IGNCYCTMR_SC_Compu "" TAB_VERB 2 0 "False" 1 "True" /end COMPU_VTAB
/begin COMPU_METHOD DIUMPR_NUMDENOMIDXGRP_SY_Compu "" TAB_VERB "%6.3" "" COMPU_TAB_REF DIUMPR_NUMDENOMIDXGRP_SY_Compu /end COMPU_METHOD
/begin COMPU_VTAB DIUMPR_NUMDENOMIDXGRP_SY_Compu "" TAB_VERB 2 0 "False" 1 "True" /end COMPU_VTAB
/begin COMPU_METHOD DKPROSG_SY_Compu "" TAB_VERB "%6.3" "" COMPU_TAB_REF DKPROSG_SY_Compu /end COMPU_METHOD
/begin COMPU_VTAB DKPROSG_SY_Compu "" TAB_VERB 4 0 "NODK" 1 "1DK" 2 "2DK" 3 "3DK" /end COMPU_VTAB
/begin COMPU_METHOD DKVSTDFC_SC_Compu "" TAB_VERB "%6.3" "" COMPU_TAB_REF DKVSTDFC_SC_Compu /end COMPU_METHOD
/begin COMPU_VTAB DKVSTDFC_SC_Compu "" TAB_VERB 2 0 "False" 1 "True" /end COMPU_VTAB
/begin COMPU_METHOD DLLR_CSERSACTV2_SC_Compu "" TAB_VERB "%6.3" "" COMPU_TAB_REF DLLR_CSERSACTV2_SC_Compu /end COMPU_METHOD
/begin COMPU_VTAB DLLR_CSERSACTV2_SC_Compu "" TAB_VERB 2 0 "FALSE" 1 "TRUE" /end COMPU_VTAB
/begin COMPU_METHOD DLLR_CSERSACTV_SC_Compu "" TAB_VERB "%6.3" "" COMPU_TAB_REF DLLR_CSERSACTV_SC_Compu /end COMPU_METHOD
/begin COMPU_VTAB DLLR_CSERSACTV_SC_Compu "" TAB_VERB 2 0 "False" 1 "True" /end COMPU_VTAB
/begin COMPU_METHOD dmNOx_mg_p_s "" RAT_FUNC "%6.3" "mg/s" COEFFS 0 6.66666666666667 0 0 0 1 /end COMPU_METHOD
/begin COMPU_METHOD dmOilAsh_mg_p_s "" RAT_FUNC "%6.4" "mg/s" COEFFS 0 100 0 0 0 1 /end COMPU_METHOD
/begin COMPU_METHOD dmSoot_g_p_s "" RAT_FUNC "%7.6" "g/s" COEFFS 0 10000 0 0 0 1 /end COMPU_METHOD
/begin COMPU_METHOD dmSoot_mg_p_s "" RAT_FUNC "%6.4" "mg/s" COEFFS 0 100 0 0 0 1 /end COMPU_METHOD
/begin COMPU_METHOD DOCU_VAR_SY_Compu "" TAB_VERB "%6.3" "" COMPU_TAB_REF DOCU_VAR_SY_Compu /end COMPU_METHOD
/begin COMPU_VTAB DOCU_VAR_SY_Compu "" TAB_VERB 42 1 "DAI" 3 "VWW" 4 "POR" 5 "AUD" 6 "OPE" 9 "FIA" 11 "BMW" 14 "PSA" 15 "REN" 17 "ALF" 18 "SAB" 19 "VOL" 20 "NIS" 21 "GMU" 22 "FOR" 26 "IMJ" 36 "MAN" 51 "SEA" 53 "CHR" 54 "JAG" 55 "ROL" 69 "FER" 72 "TOY" 123 "MIT" 147 "HYU" 159 "HON" 160 "MAZ" 183 "CU" 190 "LRG" 204 "VVW" 214 "AVT" 242 "Iveco" 243 "DMC" 248 "SUZ" 267 "SSANGYONG" 289 "AMG" 308 "TAT" 319 "MVM" 385 "UAES" 828 "RBCD" 999 "ALL" 9454 "Fuso" /end COMPU_VTAB
/begin COMPU_METHOD DOGOVFLT_SY_Compu "" TAB_VERB "%6.3" "" COMPU_TAB_REF DOGOVFLT_SY_Compu /end COMPU_METHOD
/begin COMPU_VTAB DOGOVFLT_SY_Compu "" TAB_VERB 2 0 "ZERO" 1 "ACTIV" /end COMPU_VTAB
/begin COMPU_METHOD DOGOVSUP_INHOUSE_SC_Compu "" TAB_VERB "%6.3" "" COMPU_TAB_REF DOGOVSUP_INHOUSE_SC_Compu /end COMPU_METHOD
/begin COMPU_VTAB DOGOVSUP_INHOUSE_SC_Compu "" TAB_VERB 2 0 "False" 1 "True" /end COMPU_VTAB
/begin COMPU_METHOD DOGOVTYP_SY_Compu "" TAB_VERB "%6.3" "" COMPU_TAB_REF DOGOVTYP_SY_Compu /end COMPU_METHOD
/begin COMPU_VTAB DOGOVTYP_SY_Compu "" TAB_VERB 5 0 "0" 1 "1" 2 "2" 3 "3" 4 "4" /end COMPU_VTAB
/begin COMPU_METHOD DOGOV_CLUSIG_SC_Compu "" TAB_VERB "%6.3" "" COMPU_TAB_REF DOGOV_CLUSIG_SC_Compu /end COMPU_METHOD
/begin COMPU_VTAB DOGOV_CLUSIG_SC_Compu "" TAB_VERB 2 0 "False" 1 "True" /end COMPU_VTAB
/begin COMPU_METHOD DOGOV_SY_Compu "" TAB_VERB "%6.3" "" COMPU_TAB_REF DOGOV_SY_Compu /end COMPU_METHOD
/begin COMPU_VTAB DOGOV_SY_Compu "" TAB_VERB 2 0 "False" 1 "True" /end COMPU_VTAB
/begin COMPU_METHOD DOIP_SC_Compu "" TAB_VERB "%6.3" "" COMPU_TAB_REF DOIP_SC_Compu /end COMPU_METHOD
/begin COMPU_VTAB DOIP_SC_Compu "" TAB_VERB 2 0 "INACTIVE" 1 "ACTIVE" /end COMPU_VTAB
/begin COMPU_METHOD DPF_TYPTWNFLW_SY_Compu "" TAB_VERB "%6.3" "" COMPU_TAB_REF DPF_TYPTWNFLW_SY_Compu /end COMPU_METHOD
/begin COMPU_VTAB DPF_TYPTWNFLW_SY_Compu "" TAB_VERB 2 0 "False" 1 "True" /end COMPU_VTAB
/begin COMPU_METHOD DRCTSTRT_SY_Compu "" TAB_VERB "%6.3" "" COMPU_TAB_REF DRCTSTRT_SY_Compu /end COMPU_METHOD
/begin COMPU_VTAB DRCTSTRT_SY_Compu "" TAB_VERB 4 0 "DRCTSTRT_DISBL" 1 "DRCTSTRT_STASUPRT" 2 "DRCTSTRT_NOSTASUPRT" 3 "DRCTSTRT_STASPFI" /end COMPU_VTAB
/begin COMPU_METHOD DREQSWT_CLRSWTSIG_SY_Compu "" TAB_VERB "%6.3" "" COMPU_TAB_REF DREQSWT_CLRSWTSIG_SY_Compu /end COMPU_METHOD
/begin COMPU_VTAB DREQSWT_CLRSWTSIG_SY_Compu "" TAB_VERB 3 0 "NOT_CONFIGURED" 1 "CONNECT_DIO" 2 "CONNECT_CAN" /end COMPU_VTAB
/begin COMPU_METHOD drLamRec_Persec "" RAT_FUNC "%6.4" "1/s" COEFFS 0 100 0 0 0 1 /end COMPU_METHOD
/begin COMPU_METHOD EngN "" RAT_FUNC "%6.3" "rpm" COEFFS 0 2 0 0 0 1 /end COMPU_METHOD
/begin COMPU_METHOD Epm_stSync_State_t "" TAB_VERB "%6.3" "" COMPU_TAB_REF Epm_stSync_State_t /end COMPU_METHOD
/begin COMPU_VTAB Epm_stSync_State_t "" TAB_VERB 5 0 "EPM_NO_SYNC" 10 "EPM_ALE_SYNC" 20 "EPM_CAS_SYNC" 21 "EPM_DIRSTALE_SYNC" 30 "EPM_FULL_SYNC" /end COMPU_VTAB
/begin COMPU_METHOD Fact "" RAT_FUNC "%6.5" "-" COEFFS 0 8192 0 0 0 1 /end COMPU_METHOD
/begin COMPU_METHOD Fact1 "" RAT_FUNC "%6.4" "-" COEFFS 0 128 0 0 0 1 /end COMPU_METHOD
/begin COMPU_METHOD Fact_2pwr11 "" RAT_FUNC "%6.5" "-" COEFFS 0 2048 0 0 0 1 /end COMPU_METHOD
/begin COMPU_METHOD FlConsum_l_h "" RAT_FUNC "%6.4" "l/h" COEFFS 0 100 0 0 0 1 /end COMPU_METHOD
/begin COMPU_METHOD i_q1_mA "" RAT_FUNC "%6.2" "mA" COEFFS 0 1 0 0 0 1 /end COMPU_METHOD
/begin COMPU_METHOD Length "" RAT_FUNC "%6.2" "m" COEFFS 0 1 0 0 0 1 /end COMPU_METHOD
/begin COMPU_METHOD md_q0p1 "" RAT_FUNC "%6.3" "Nm" COEFFS 0 10 0 0 0 1 /end COMPU_METHOD
/begin COMPU_METHOD OneToOne "" RAT_FUNC "%6.2" "-" COEFFS 0 1 0 0 0 1 /end COMPU_METHOD
/begin COMPU_METHOD Prc "" RAT_FUNC "%6.4" "%" COEFFS 0 81.92 0 0 0 1 /end COMPU_METHOD
/begin COMPU_METHOD PrcPerSec "" RAT_FUNC "%6.3" "%/s" COEFFS 0 1.6384 0 0 0 1 /end COMPU_METHOD
/begin COMPU_METHOD Prc_EGR "" RAT_FUNC "%6.3" "%" COEFFS 0 2.55 0 0 0 1 /end COMPU_METHOD
/begin COMPU_METHOD Pres_hPa "" RAT_FUNC "%6.2" "hPa" COEFFS 0 1 0 0 0 1 /end COMPU_METHOD
/begin COMPU_METHOD Pres_kPa_VSA "" RAT_FUNC "%6.1" "kPa" COEFFS 0 0.0417362270450751 0 0 0 1 /end COMPU_METHOD
/begin COMPU_METHOD q0p01_V "" RAT_FUNC "%6.4" "V" COEFFS 0 100 0 0 0 1 /end COMPU_METHOD
/begin COMPU_METHOD RBPtCel_fac_0p01_1 "" RAT_FUNC "%6.4" "-" COEFFS 0 100 0 0 0 1 /end COMPU_METHOD
/begin COMPU_METHOD RBPtCel_tq_1p0_1 "" RAT_FUNC "%6.2" "Nm" COEFFS 0 1 0 0 0 1 /end COMPU_METHOD
/begin COMPU_METHOD rel_uw_b100 "" RAT_FUNC "%6.4" "%" COEFFS 0 65536 0 0 0 100 /end COMPU_METHOD
/begin COMPU_METHOD spg_q0p001 "" RAT_FUNC "%6.5" "V" COEFFS 0 1000 0 0 0 1 /end COMPU_METHOD
/begin COMPU_METHOD spg_q0p001_op10_V "" RAT_FUNC "%6.2" "V" COEFFS 0 1000 -10000 0 0 1 /end COMPU_METHOD
/begin COMPU_METHOD spg_q0p00488 "" RAT_FUNC "%6.4" "V" COEFFS 0 1024 0 0 0 5 /end COMPU_METHOD
/begin COMPU_METHOD spg_uw_b5 "" RAT_FUNC "%6.4" "V" COEFFS 0 1024 0 0 0 5 /end COMPU_METHOD
/begin COMPU_METHOD TempDiff_Kelv "" RAT_FUNC "%6.3" "K" COEFFS 0 10 0 0 0 1 /end COMPU_METHOD
/begin COMPU_METHOD Temp_Cels "" RAT_FUNC "%6.1" "deg C" COEFFS 0 10 2731.4 0 0 1 /end COMPU_METHOD
/begin COMPU_METHOD Temp_Fatc "" RAT_FUNC "%6.2" "degC" COEFFS 0 2 80 0 0 1 /end COMPU_METHOD
/begin COMPU_METHOD temp_q0p5_o30_degC "" RAT_FUNC "%6.2" "deg C" COEFFS 0 2 60 0 0 1 /end COMPU_METHOD
/begin COMPU_METHOD TimeDeb "" RAT_FUNC "%6.1" "ms" COEFFS 0 0.1 0 0 0 1 /end COMPU_METHOD
/begin COMPU_METHOD TimeDelay_s "" RAT_FUNC "%6.1" "s" COEFFS 0 0 1 0 0.00023283064365387 0 /end COMPU_METHOD
/begin COMPU_METHOD TimeDelay_s_Lin_16 "" RAT_FUNC "%6.5" "s" COEFFS 0 6553.4 0 0 0 1 /end COMPU_METHOD
/begin COMPU_METHOD Time_ms "" RAT_FUNC "%6.1" "ms" COEFFS 0 0.1 0 0 0 1 /end COMPU_METHOD
/begin COMPU_METHOD Time_s "" RAT_FUNC "%6.4" "s" COEFFS 0 100 0 0 0 1 /end COMPU_METHOD
/begin COMPU_METHOD Time_Second "" RAT_FUNC "%6.2" "s" COEFFS 0 1 0 0 0 1 /end COMPU_METHOD
/begin COMPU_METHOD TransR "" RAT_FUNC "%6.4" "-" COEFFS 0 100 0 0 0 1 /end COMPU_METHOD
/begin COMPU_METHOD TransR_COMPU "" RAT_FUNC "%6.4" "" COEFFS 0 64 0 0 0 1 /end COMPU_METHOD
/begin COMPU_METHOD Trq "" RAT_FUNC "%6.3" "Nm" COEFFS 0 10 0 0 0 1 /end COMPU_METHOD
/begin COMPU_METHOD TrqPerSec "" RAT_FUNC "%6.2" "Nm/s" COEFFS 0 1 0 0 0 1 /end COMPU_METHOD
/begin COMPU_METHOD TrqPrpHigh "" RAT_FUNC "%6.3" "Nm" COEFFS 0 10 0 0 0 1 /end COMPU_METHOD
/begin COMPU_METHOD Trq_float "" RAT_FUNC "%6.2" "Nm" COEFFS 0 1 0 0 0 1 /end COMPU_METHOD
/begin COMPU_METHOD trq_q0p1 "" RAT_FUNC "%6.3" "Nm" COEFFS 0 10 0 0 0 1 /end COMPU_METHOD
/begin COMPU_METHOD Vel "" RAT_FUNC "%6.4" "km/h" COEFFS 0 100 0 0 0 1 /end COMPU_METHOD
/begin COMPU_METHOD Vel_CrCtl "" RAT_FUNC "%6.4" "km/h" COEFFS 0 256 0 0 0 1 /end COMPU_METHOD
/begin COMPU_METHOD Volt_Batt "" RAT_FUNC "%6.1" "mV" COEFFS 0 0.05 0 0 0 1 /end COMPU_METHOD
/begin COMPU_METHOD Volt_q1 "" RAT_FUNC "%6.2" "V" COEFFS 0 1 0 0 0 1 /end COMPU_METHOD
/begin COMPU_METHOD YawRate_q0p2441_om125 "" RAT_FUNC "%6.3" "Deg/s" COEFFS 0 1023 127875 0 0 249.7559 /end COMPU_METHOD
/begin COMPU_METHOD zk10msxs_uw_b655p36 "" RAT_FUNC "%6.2" "s" COEFFS 0 0 65536 0 100 0 /end COMPU_METHOD
/begin RECORD_LAYOUT Cur_Xs16Ws16 NO_AXIS_PTS_X 1 SWORD AXIS_PTS_X 2 SWORD INDEX_INCR DIRECT FNC_VALUES 3 SWORD COLUMN_DIR DIRECT /end RECORD_LAYOUT
/begin RECORD_LAYOUT Kw_Ws16 FNC_VALUES 1 SWORD COLUMN_DIR DIRECT /end RECORD_LAYOUT
/begin RECORD_LAYOUT RB_Axis_S16 NO_AXIS_PTS_X 1 SWORD AXIS_PTS_X 2 SWORD INDEX_INCR DIRECT /end RECORD_LAYOUT
/begin RECORD_LAYOUT RB_CurveGroup_S16 FNC_VALUES 1 SWORD COLUMN_DIR DIRECT /end RECORD_LAYOUT
/begin RECORD_LAYOUT RB_Curve_S16_S16 NO_AXIS_PTS_X 1 SWORD AXIS_PTS_X 2 SWORD INDEX_INCR DIRECT FNC_VALUES 3 SWORD COLUMN_DIR DIRECT /end RECORD_LAYOUT
/begin RECORD_LAYOUT RB_Map_S16S16_S16 NO_AXIS_PTS_X 1 SWORD NO_AXIS_PTS_Y 2 SWORD AXIS_PTS_X 3 SWORD INDEX_INCR DIRECT AXIS_PTS_Y 4 SWORD INDEX_INCR DIRECT FNC_VALUES 5 SWORD COLUMN_DIR DIRECT /end RECORD_LAYOUT
/begin RECORD_LAYOUT RB_Map_S16S16_U16 NO_AXIS_PTS_X 1 SWORD NO_AXIS_PTS_Y 2 SWORD AXIS_PTS_X 3 SWORD INDEX_INCR DIRECT AXIS_PTS_Y 4 SWORD INDEX_INCR DIRECT FNC_VALUES 5 UWORD COLUMN_DIR DIRECT /end RECORD_LAYOUT
/begin RECORD_LAYOUT RB_Val_Wboolean FNC_VALUES 1 UBYTE COLUMN_DIR DIRECT /end RECORD_LAYOUT
/begin RECORD_LAYOUT RB_Val_Ws16 FNC_VALUES 1 SWORD COLUMN_DIR DIRECT /end RECORD_LAYOUT
/begin RECORD_LAYOUT RB_Val_Ws32 FNC_VALUES 1 SLONG COLUMN_DIR DIRECT /end RECORD_LAYOUT
/begin RECORD_LAYOUT RB_Val_Wu16 FNC_VALUES 1 UWORD COLUMN_DIR DIRECT /end RECORD_LAYOUT
/begin RECORD_LAYOUT RB_Val_Wu8 FNC_VALUES 1 UBYTE COLUMN_DIR DIRECT /end RECORD_LAYOUT
/begin RECORD_LAYOUT ValA_Wu8 FNC_VALUES 1 UBYTE COLUMN_DIR DIRECT /end RECORD_LAYOUT
/begin RECORD_LAYOUT Val_Ws16 FNC_VALUES 1 SWORD COLUMN_DIR DIRECT /end RECORD_LAYOUT
/begin RECORD_LAYOUT Val_Ws32 FNC_VALUES 1 SLONG COLUMN_DIR DIRECT /end RECORD_LAYOUT
/begin RECORD_LAYOUT Val_Wu16 FNC_VALUES 1 UWORD COLUMN_DIR DIRECT /end RECORD_LAYOUT
/begin RECORD_LAYOUT Val_Wu8 FNC_VALUES 1 UBYTE COLUMN_DIR DIRECT /end RECORD_LAYOUT
/end MODULE
/end PROJECT
