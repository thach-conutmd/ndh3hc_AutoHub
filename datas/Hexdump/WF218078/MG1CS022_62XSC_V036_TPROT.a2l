ASAP2_VERSION 1 60
/begin PROJECT MG1CS022 "MG1CS022"
/begin HEADER "" VERSION "MG1CS022_62XSC_V036_TPROT" PROJECT_NO MG1CS022 /end HEADER
/begin MODULE DIM ""
/begin MOD_COMMON "" BYTE_ORDER MSB_LAST ALIGNMENT_BYTE 1 ALIGNMENT_WORD 2 ALIGNMENT_LONG 4 ALIGNMENT_INT64 4 ALIGNMENT_FLOAT32_IEEE 4 ALIGNMENT_FLOAT64_IEEE 4 DATA_SIZE 32 /end MOD_COMMON
/begin CHARACTERISTIC DFES_MeterOut.DFC_ComAYCGChksum_C "project specific calibration data / Project specific calibration data for DFC_ComAYCGChksum" VALUE 0x804F539F Val_Wu8 255.0 OneToOne 0.00 255.0 FORMAT "%5.1" /end CHARACTERISTIC
/begin CHARACTERISTIC DFES_MeterOut.DFC_ComAYCGRingCnt_C "project specific calibration data / Project specific calibration data for DFC_ComAYCGRingCnt" VALUE 0x804F53A0 Val_Wu8 255.0 OneToOne 0.00 255.0 FORMAT "%5.1" /end CHARACTERISTIC
/begin CHARACTERISTIC DFES_MeterOut.DFC_ComAYCGTOut_C "project specific calibration data / Project specific calibration data for DFC_ComAYCGTOut" VALUE 0x804F53A1 Val_Wu8 255.0 OneToOne 0.00 255.0 FORMAT "%5.1" /end CHARACTERISTIC
/begin CHARACTERISTIC DFES_MeterOut.DFC_ComAYCIChkSum_C "project specific calibration data / Project specific calibration data for DFC_ComAYCIChkSum" VALUE 0x804F53A2 Val_Wu8 255.0 OneToOne 0.00 255.0 FORMAT "%5.1" /end CHARACTERISTIC
/begin CHARACTERISTIC DFES_MeterOut.DFC_ComAYCIRingCnt_C "project specific calibration data / Project specific calibration data for DFC_ComAYCIRingCnt" VALUE 0x804F53A3 Val_Wu8 255.0 OneToOne 0.00 255.0 FORMAT "%5.1" /end CHARACTERISTIC
/begin CHARACTERISTIC DFES_MeterOut.DFC_ComAYCITOut_C "project specific calibration data / Project specific calibration data for DFC_ComAYCITOut" VALUE 0x804F53A4 Val_Wu8 255.0 OneToOne 0.00 255.0 FORMAT "%5.1" /end CHARACTERISTIC
/begin CHARACTERISTIC DFES_MeterOut.DFC_ComBCM1ChkSum_C "project specific calibration data / Project specific calibration data for DFC_ComBCM1ChkSum" VALUE 0x804F53A5 Val_Wu8 255.0 OneToOne 0.00 255.0 FORMAT "%5.1" /end CHARACTERISTIC
/begin CHARACTERISTIC DFES_MeterOut.DFC_ComBCM1RingCnt_C "project specific calibration data / Project specific calibration data for DFC_ComBCM1RingCnt" VALUE 0x804F53A6 Val_Wu8 255.0 OneToOne 0.00 255.0 FORMAT "%5.1" /end CHARACTERISTIC
/begin CHARACTERISTIC DFES_MeterOut.DFC_ComBCM1TOut_C "project specific calibration data / Project specific calibration data for DFC_ComBCM1TOut" VALUE 0x804F53A7 Val_Wu8 255.0 OneToOne 0.00 255.0 FORMAT "%5.1" /end CHARACTERISTIC
/begin CHARACTERISTIC DFES_MeterOut.DFC_ComCANABusOffErr_C "project specific calibration data / Project specific calibration data for DFC_ComCANABusOffErr" VALUE 0x804F53A8 Val_Wu8 255.0 OneToOne 0.00 255.0 FORMAT "%5.1" /end CHARACTERISTIC
/begin CHARACTERISTIC DFES_MeterOut.DFC_ComCANBBusOffErr_C "project specific calibration data / Project specific calibration data for DFC_ComCANBBusOffErr" VALUE 0x804F53A9 Val_Wu8 255.0 OneToOne 0.00 255.0 FORMAT "%5.1" /end CHARACTERISTIC
/begin CHARACTERISTIC DFES_MeterOut.DFC_ComCANCBusOffErr_C "project specific calibration data / Project specific calibration data for DFC_ComCANCBusOffErr" VALUE 0x804F53AA Val_Wu8 255.0 OneToOne 0.00 255.0 FORMAT "%5.1" /end CHARACTERISTIC
/begin CHARACTERISTIC DFES_MeterOut.DFC_ComCGW1ChkSum_C "project specific calibration data / Project specific calibration data for DFC_ComCGW1ChkSum" VALUE 0x804F53AB Val_Wu8 255.0 OneToOne 0.00 255.0 FORMAT "%5.1" /end CHARACTERISTIC
/begin CHARACTERISTIC DFES_MeterOut.DFC_ComCGW1RingCnt_C "project specific calibration data / Project specific calibration data for DFC_ComCGW1RingCnt" VALUE 0x804F53AC Val_Wu8 255.0 OneToOne 0.00 255.0 FORMAT "%5.1" /end CHARACTERISTIC
/begin CHARACTERISTIC DFES_MeterOut.DFC_ComCGW1TOut_C "project specific calibration data / Project specific calibration data for DFC_ComCGW1TOut" VALUE 0x804F53AD Val_Wu8 255.0 OneToOne 0.00 255.0 FORMAT "%5.1" /end CHARACTERISTIC
/begin CHARACTERISTIC DFES_MeterOut.DFC_ComConvBoostErr_C "project specific calibration data / Project specific calibration data for DFC_ComConvBoostErr" VALUE 0x804F53AE Val_Wu8 255.0 OneToOne 0.00 255.0 FORMAT "%5.1" /end CHARACTERISTIC
/begin CHARACTERISTIC DFES_MeterOut.DFC_ComConvSlipErr_C "project specific calibration data / Project specific calibration data for DFC_ComConvSlipErr" VALUE 0x804F53AF Val_Wu8 255.0 OneToOne 0.00 255.0 FORMAT "%5.1" /end CHARACTERISTIC
/begin CHARACTERISTIC DFES_MeterOut.DFC_ComDCDCPrfmncErr_C "project specific calibration data / Project specific calibration data for DFC_ComDCDCPrfmncErr" VALUE 0x804F53B0 Val_Wu8 255.0 OneToOne 0.00 255.0 FORMAT "%5.1" /end CHARACTERISTIC
/begin CHARACTERISTIC DFES_MeterOut.DFC_ComDCDCTempWarn_C "project specific calibration data / Project specific calibration data for DFC_ComDCDCTempWarn" VALUE 0x804F53B1 Val_Wu8 255.0 OneToOne 0.00 255.0 FORMAT "%5.1" /end CHARACTERISTIC
/begin CHARACTERISTIC DFES_MeterOut.DFC_ComEAT10Chksum_C "project specific calibration data / Project specific calibration data for DFC_ComEAT10Chksum" VALUE 0x804F53B2 Val_Wu8 255.0 OneToOne 0.00 255.0 FORMAT "%5.1" /end CHARACTERISTIC
/begin CHARACTERISTIC DFES_MeterOut.DFC_ComEAT10RingCnt_C "project specific calibration data / Project specific calibration data for DFC_ComEAT10RingCnt" VALUE 0x804F53B3 Val_Wu8 255.0 OneToOne 0.00 255.0 FORMAT "%5.1" /end CHARACTERISTIC
/begin CHARACTERISTIC DFES_MeterOut.DFC_ComEAT10TOut_C "project specific calibration data / Project specific calibration data for DFC_ComEAT10TOut" VALUE 0x804F53B4 Val_Wu8 255.0 OneToOne 0.00 255.0 FORMAT "%5.1" /end CHARACTERISTIC
/begin CHARACTERISTIC DFES_MeterOut.DFC_ComEAT11ChkSum_C "project specific calibration data / Project specific calibration data for DFC_ComEAT11ChkSum" VALUE 0x804F53B5 Val_Wu8 255.0 OneToOne 0.00 255.0 FORMAT "%5.1" /end CHARACTERISTIC
/begin CHARACTERISTIC DFES_MeterOut.DFC_ComEAT11RingCnt_C "project specific calibration data / Project specific calibration data for DFC_ComEAT11RingCnt" VALUE 0x804F53B6 Val_Wu8 255.0 OneToOne 0.00 255.0 FORMAT "%5.1" /end CHARACTERISTIC
/begin CHARACTERISTIC DFES_MeterOut.DFC_ComEAT11TOut_C "project specific calibration data / Project specific calibration data for DFC_ComEAT11TOut" VALUE 0x804F53B7 Val_Wu8 255.0 OneToOne 0.00 255.0 FORMAT "%5.1" /end CHARACTERISTIC
/begin CHARACTERISTIC DFES_MeterOut.DFC_ComEAT12ChkSum_C "project specific calibration data / Project specific calibration data for DFC_ComEAT12ChkSum" VALUE 0x804F53B8 Val_Wu8 255.0 OneToOne 0.00 255.0 FORMAT "%5.1" /end CHARACTERISTIC
/begin CHARACTERISTIC DFES_MeterOut.DFC_ComEAT12RingCnt_C "project specific calibration data / Project specific calibration data for DFC_ComEAT12RingCnt" VALUE 0x804F53B9 Val_Wu8 255.0 OneToOne 0.00 255.0 FORMAT "%5.1" /end CHARACTERISTIC
/begin CHARACTERISTIC DFES_MeterOut.DFC_ComEAT12TOut_C "project specific calibration data / Project specific calibration data for DFC_ComEAT12TOut" VALUE 0x804F53BA Val_Wu8 255.0 OneToOne 0.00 255.0 FORMAT "%5.1" /end CHARACTERISTIC
/begin CHARACTERISTIC DFES_MeterOut.DFC_ComEAT13ChkSum_C "project specific calibration data / Project specific calibration data for DFC_ComEAT13ChkSum" VALUE 0x804F53BB Val_Wu8 255.0 OneToOne 0.00 255.0 FORMAT "%5.1" /end CHARACTERISTIC
/begin CHARACTERISTIC DFES_MeterOut.DFC_ComEAT13RingCnt_C "project specific calibration data / Project specific calibration data for DFC_ComEAT13RingCnt" VALUE 0x804F53BC Val_Wu8 255.0 OneToOne 0.00 255.0 FORMAT "%5.1" /end CHARACTERISTIC
/begin CHARACTERISTIC DFES_MeterOut.DFC_ComEAT13TOut_C "project specific calibration data / Project specific calibration data for DFC_ComEAT13TOut" VALUE 0x804F53BD Val_Wu8 255.0 OneToOne 0.00 255.0 FORMAT "%5.1" /end CHARACTERISTIC
/begin CHARACTERISTIC DFES_MeterOut.DFC_ComEAT1Chksum_C "project specific calibration data / Project specific calibration data for DFC_ComEAT1Chksum" VALUE 0x804F53BE Val_Wu8 255.0 OneToOne 0.00 255.0 FORMAT "%5.1" /end CHARACTERISTIC
/begin CHARACTERISTIC DFES_MeterOut.DFC_ComEAT1RingCnt_C "project specific calibration data / Project specific calibration data for DFC_ComEAT1RingCnt" VALUE 0x804F53BF Val_Wu8 255.0 OneToOne 0.00 255.0 FORMAT "%5.1" /end CHARACTERISTIC
/begin CHARACTERISTIC DFES_MeterOut.DFC_ComEAT1TOut_C "project specific calibration data / Project specific calibration data for DFC_ComEAT1TOut" VALUE 0x804F53C0 Val_Wu8 255.0 OneToOne 0.00 255.0 FORMAT "%5.1" /end CHARACTERISTIC
/begin CHARACTERISTIC DFES_MeterOut.DFC_ComEAT2ChkSum_C "project specific calibration data / Project specific calibration data for DFC_ComEAT2ChkSum" VALUE 0x804F53C1 Val_Wu8 255.0 OneToOne 0.00 255.0 FORMAT "%5.1" /end CHARACTERISTIC
/begin CHARACTERISTIC DFES_MeterOut.DFC_ComEAT2RingCnt_C "project specific calibration data / Project specific calibration data for DFC_ComEAT2RingCnt" VALUE 0x804F53C2 Val_Wu8 255.0 OneToOne 0.00 255.0 FORMAT "%5.1" /end CHARACTERISTIC
/begin CHARACTERISTIC DFES_MeterOut.DFC_ComEAT2TOut_C "project specific calibration data / Project specific calibration data for DFC_ComEAT2TOut" VALUE 0x804F53C3 Val_Wu8 255.0 OneToOne 0.00 255.0 FORMAT "%5.1" /end CHARACTERISTIC
/begin CHARACTERISTIC DFES_MeterOut.DFC_ComEAT4ChkSum_C "project specific calibration data / Project specific calibration data for DFC_ComEAT4ChkSum" VALUE 0x804F53C4 Val_Wu8 255.0 OneToOne 0.00 255.0 FORMAT "%5.1" /end CHARACTERISTIC
/begin CHARACTERISTIC DFES_MeterOut.DFC_ComEAT4RingCnt_C "project specific calibration data / Project specific calibration data for DFC_ComEAT4RingCnt" VALUE 0x804F53C5 Val_Wu8 255.0 OneToOne 0.00 255.0 FORMAT "%5.1" /end CHARACTERISTIC
/begin CHARACTERISTIC DFES_MeterOut.DFC_ComEAT4TOut_C "project specific calibration data / Project specific calibration data for DFC_ComEAT4TOut" VALUE 0x804F53C6 Val_Wu8 255.0 OneToOne 0.00 255.0 FORMAT "%5.1" /end CHARACTERISTIC
/begin CHARACTERISTIC DFES_MeterOut.DFC_ComEAT6Chksum_C "project specific calibration data / Project specific calibration data for DFC_ComEAT6Chksum" VALUE 0x804F53C7 Val_Wu8 255.0 OneToOne 0.00 255.0 FORMAT "%5.1" /end CHARACTERISTIC
/begin CHARACTERISTIC DFES_MeterOut.DFC_ComEAT6RingCnt_C "project specific calibration data / Project specific calibration data for DFC_ComEAT6RingCnt" VALUE 0x804F53C8 Val_Wu8 255.0 OneToOne 0.00 255.0 FORMAT "%5.1" /end CHARACTERISTIC
/begin CHARACTERISTIC DFES_MeterOut.DFC_ComEAT6TOut_C "project specific calibration data / Project specific calibration data for DFC_ComEAT6TOut" VALUE 0x804F53C9 Val_Wu8 255.0 OneToOne 0.00 255.0 FORMAT "%5.1" /end CHARACTERISTIC
/begin CHARACTERISTIC DFES_MeterOut.DFC_ComEAT7Chksum_C "project specific calibration data / Project specific calibration data for DFC_ComEAT7Chksum" VALUE 0x804F53CA Val_Wu8 255.0 OneToOne 0.00 255.0 FORMAT "%5.1" /end CHARACTERISTIC
/begin CHARACTERISTIC DFES_MeterOut.DFC_ComEAT7RingCnt_C "project specific calibration data / Project specific calibration data for DFC_ComEAT7RingCnt" VALUE 0x804F53CB Val_Wu8 255.0 OneToOne 0.00 255.0 FORMAT "%5.1" /end CHARACTERISTIC
/begin CHARACTERISTIC DFES_MeterOut.DFC_ComEAT7TOut_C "project specific calibration data / Project specific calibration data for DFC_ComEAT7TOut" VALUE 0x804F53CC Val_Wu8 255.0 OneToOne 0.00 255.0 FORMAT "%5.1" /end CHARACTERISTIC
/begin CHARACTERISTIC DFES_MeterOut.DFC_ComEAT8Chksum_C "project specific calibration data / Project specific calibration data for DFC_ComEAT8Chksum" VALUE 0x804F53CD Val_Wu8 255.0 OneToOne 0.00 255.0 FORMAT "%5.1" /end CHARACTERISTIC
/begin CHARACTERISTIC DFES_MeterOut.DFC_ComEAT8RingCnt_C "project specific calibration data / Project specific calibration data for DFC_ComEAT8RingCnt" VALUE 0x804F53CE Val_Wu8 255.0 OneToOne 0.00 255.0 FORMAT "%5.1" /end CHARACTERISTIC
/begin CHARACTERISTIC DFES_MeterOut.DFC_ComEAT8TOut_C "project specific calibration data / Project specific calibration data for DFC_ComEAT8TOut" VALUE 0x804F53CF Val_Wu8 255.0 OneToOne 0.00 255.0 FORMAT "%5.1" /end CHARACTERISTIC
/begin CHARACTERISTIC DFES_MeterOut.DFC_ComEATAChksum_C "project specific calibration data / Project specific calibration data for DFC_ComEATAChksum" VALUE 0x804F53D0 Val_Wu8 255.0 OneToOne 0.00 255.0 FORMAT "%5.1" /end CHARACTERISTIC
/begin CHARACTERISTIC DFES_MeterOut.DFC_ComEATARingCnt_C "project specific calibration data / Project specific calibration data for DFC_ComEATARingCnt" VALUE 0x804F53D1 Val_Wu8 255.0 OneToOne 0.00 255.0 FORMAT "%5.1" /end CHARACTERISTIC
/begin CHARACTERISTIC DFES_MeterOut.DFC_ComEATATOut_C "project specific calibration data / Project specific calibration data for DFC_ComEATATOut" VALUE 0x804F53D2 Val_Wu8 255.0 OneToOne 0.00 255.0 FORMAT "%5.1" /end CHARACTERISTIC
/begin CHARACTERISTIC DFES_MeterOut.DFC_ComEATBChkSum_C "project specific calibration data / Project specific calibration data for DFC_ComEATBChkSum" VALUE 0x804F53D3 Val_Wu8 255.0 OneToOne 0.00 255.0 FORMAT "%5.1" /end CHARACTERISTIC
/begin CHARACTERISTIC DFES_MeterOut.DFC_ComEATBRingCnt_C "project specific calibration data / Project specific calibration data for DFC_ComEATBRingCnt" VALUE 0x804F53D4 Val_Wu8 255.0 OneToOne 0.00 255.0 FORMAT "%5.1" /end CHARACTERISTIC
/begin CHARACTERISTIC DFES_MeterOut.DFC_ComEATBTOut_C "project specific calibration data / Project specific calibration data for DFC_ComEATBTOut" VALUE 0x804F53D5 Val_Wu8 255.0 OneToOne 0.00 255.0 FORMAT "%5.1" /end CHARACTERISTIC
/begin CHARACTERISTIC DFES_MeterOut.DFC_ComEATCChksum_C "project specific calibration data / Project specific calibration data for DFC_ComEATCChksum" VALUE 0x804F53D6 Val_Wu8 255.0 OneToOne 0.00 255.0 FORMAT "%5.1" /end CHARACTERISTIC
/begin CHARACTERISTIC DFES_MeterOut.DFC_ComEATCRingCnt_C "project specific calibration data / Project specific calibration data for DFC_ComEATCRingCnt" VALUE 0x804F53D7 Val_Wu8 255.0 OneToOne 0.00 255.0 FORMAT "%5.1" /end CHARACTERISTIC
/begin CHARACTERISTIC DFES_MeterOut.DFC_ComEATCTOut_C "project specific calibration data / Project specific calibration data for DFC_ComEATCTOut" VALUE 0x804F53D8 Val_Wu8 255.0 OneToOne 0.00 255.0 FORMAT "%5.1" /end CHARACTERISTIC
/begin CHARACTERISTIC DFES_MeterOut.DFC_ComEPBBChkSum_C "project specific calibration data / Project specific calibration data for DFC_ComEPBBChkSum" VALUE 0x804F53D9 Val_Wu8 255.0 OneToOne 0.00 255.0 FORMAT "%5.1" /end CHARACTERISTIC
/begin CHARACTERISTIC DFES_MeterOut.DFC_ComEPBBRingCnt_C "project specific calibration data / Project specific calibration data for DFC_ComEPBBRingCnt" VALUE 0x804F53DA Val_Wu8 255.0 OneToOne 0.00 255.0 FORMAT "%5.1" /end CHARACTERISTIC
/begin CHARACTERISTIC DFES_MeterOut.DFC_ComEPBBTOut_C "project specific calibration data / Project specific calibration data for DFC_ComEPBBTOut" VALUE 0x804F53DB Val_Wu8 255.0 OneToOne 0.00 255.0 FORMAT "%5.1" /end CHARACTERISTIC
/begin CHARACTERISTIC DFES_MeterOut.DFC_ComEPBChksum_C "project specific calibration data / Project specific calibration data for DFC_ComEPBChksum" VALUE 0x804F53DC Val_Wu8 255.0 OneToOne 0.00 255.0 FORMAT "%5.1" /end CHARACTERISTIC
/begin CHARACTERISTIC DFES_MeterOut.DFC_ComEPBTOut_C "project specific calibration data / Project specific calibration data for DFC_ComEPBTOut" VALUE 0x804F53DD Val_Wu8 255.0 OneToOne 0.00 255.0 FORMAT "%5.1" /end CHARACTERISTIC
/begin CHARACTERISTIC DFES_MeterOut.DFC_ComEPBctRing_C "project specific calibration data / Project specific calibration data for DFC_ComEPBctRing" VALUE 0x804F53DE Val_Wu8 255.0 OneToOne 0.00 255.0 FORMAT "%5.1" /end CHARACTERISTIC
/begin CHARACTERISTIC DFES_MeterOut.DFC_ComEPS1Chksum_C "project specific calibration data / Project specific calibration data for DFC_ComEPS1Chksum" VALUE 0x804F53DF Val_Wu8 255.0 OneToOne 0.00 255.0 FORMAT "%5.1" /end CHARACTERISTIC
/begin CHARACTERISTIC DFES_MeterOut.DFC_ComEPS1RingCnt_C "project specific calibration data / Project specific calibration data for DFC_ComEPS1RingCnt" VALUE 0x804F53E0 Val_Wu8 255.0 OneToOne 0.00 255.0 FORMAT "%5.1" /end CHARACTERISTIC
/begin CHARACTERISTIC DFES_MeterOut.DFC_ComEPS1TOut_C "project specific calibration data / Project specific calibration data for DFC_ComEPS1TOut" VALUE 0x804F53E1 Val_Wu8 255.0 OneToOne 0.00 255.0 FORMAT "%5.1" /end CHARACTERISTIC
/begin CHARACTERISTIC DFES_MeterOut.DFC_ComEngCanRxErr_C "project specific calibration data / Project specific calibration data for DFC_ComEngCanRxErr" VALUE 0x804F53E2 Val_Wu8 255.0 OneToOne 0.00 255.0 FORMAT "%5.1" /end CHARACTERISTIC
/begin CHARACTERISTIC DFES_MeterOut.DFC_ComGrvySnsrErr_C "project specific calibration data / Project specific calibration data for DFC_ComGrvySnsrErr" VALUE 0x804F53E3 Val_Wu8 255.0 OneToOne 0.00 255.0 FORMAT "%5.1" /end CHARACTERISTIC
/begin CHARACTERISTIC DFES_MeterOut.DFC_ComGwIMG1ChkSum_C "project specific calibration data / Project specific calibration data for DFC_ComGwIMG1ChkSum" VALUE 0x804F53E4 Val_Wu8 255.0 OneToOne 0.00 255.0 FORMAT "%5.1" /end CHARACTERISTIC
/begin CHARACTERISTIC DFES_MeterOut.DFC_ComGwIMG1RingCnt_C "project specific calibration data / Project specific calibration data for DFC_ComGwIMG1RingCnt" VALUE 0x804F53E5 Val_Wu8 255.0 OneToOne 0.00 255.0 FORMAT "%5.1" /end CHARACTERISTIC
/begin CHARACTERISTIC DFES_MeterOut.DFC_ComGwIMG1TOut_C "project specific calibration data / Project specific calibration data for DFC_ComGwIMG1TOut" VALUE 0x804F53E6 Val_Wu8 255.0 OneToOne 0.00 255.0 FORMAT "%5.1" /end CHARACTERISTIC
/begin CHARACTERISTIC DFES_MeterOut.DFC_ComGwIMG3ChkSum_C "project specific calibration data / Project specific calibration data for DFC_ComGwIMG3ChkSum" VALUE 0x804F53E7 Val_Wu8 255.0 OneToOne 0.00 255.0 FORMAT "%5.1" /end CHARACTERISTIC
/begin CHARACTERISTIC DFES_MeterOut.DFC_ComGwIMG3RingCnt_C "project specific calibration data / Project specific calibration data for DFC_ComGwIMG3RingCnt" VALUE 0x804F53E8 Val_Wu8 255.0 OneToOne 0.00 255.0 FORMAT "%5.1" /end CHARACTERISTIC
/begin CHARACTERISTIC DFES_MeterOut.DFC_ComGwIMG3TOut_C "project specific calibration data / Project specific calibration data for DFC_ComGwIMG3TOut" VALUE 0x804F53E9 Val_Wu8 255.0 OneToOne 0.00 255.0 FORMAT "%5.1" /end CHARACTERISTIC
/begin CHARACTERISTIC DFES_MeterOut.DFC_ComGwIMG4ChkSum_C "project specific calibration data / Project specific calibration data for DFC_ComGwIMG4ChkSum" VALUE 0x804F53EA Val_Wu8 255.0 OneToOne 0.00 255.0 FORMAT "%5.1" /end CHARACTERISTIC
/begin CHARACTERISTIC DFES_MeterOut.DFC_ComGwIMG4RingCnt_C "project specific calibration data / Project specific calibration data for DFC_ComGwIMG4RingCnt" VALUE 0x804F53EB Val_Wu8 255.0 OneToOne 0.00 255.0 FORMAT "%5.1" /end CHARACTERISTIC
/begin CHARACTERISTIC DFES_MeterOut.DFC_ComGwIMG4TOut_C "project specific calibration data / Project specific calibration data for DFC_ComGwIMG4TOut" VALUE 0x804F53EC Val_Wu8 255.0 OneToOne 0.00 255.0 FORMAT "%5.1" /end CHARACTERISTIC
/begin CHARACTERISTIC DFES_MeterOut.DFC_ComGwIMG5ChkSum_C "project specific calibration data / Project specific calibration data for DFC_ComGwIMG5ChkSum" VALUE 0x804F53ED Val_Wu8 255.0 OneToOne 0.00 255.0 FORMAT "%5.1" /end CHARACTERISTIC
/begin CHARACTERISTIC DFES_MeterOut.DFC_ComGwIMG5RingCnt_C "project specific calibration data / Project specific calibration data for DFC_ComGwIMG5RingCnt" VALUE 0x804F53EE Val_Wu8 255.0 OneToOne 0.00 255.0 FORMAT "%5.1" /end CHARACTERISTIC
/begin CHARACTERISTIC DFES_MeterOut.DFC_ComGwIMG5TOut_C "project specific calibration data / Project specific calibration data for DFC_ComGwIMG5TOut" VALUE 0x804F53EF Val_Wu8 255.0 OneToOne 0.00 255.0 FORMAT "%5.1" /end CHARACTERISTIC
/begin CHARACTERISTIC DFES_MeterOut.DFC_ComGwIMG6ChkSum_C "project specific calibration data / Project specific calibration data for DFC_ComGwIMG6ChkSum" VALUE 0x804F53F0 Val_Wu8 255.0 OneToOne 0.00 255.0 FORMAT "%5.1" /end CHARACTERISTIC
/begin CHARACTERISTIC DFES_MeterOut.DFC_ComGwIMG6RingCnt_C "project specific calibration data / Project specific calibration data for DFC_ComGwIMG6RingCnt" VALUE 0x804F53F1 Val_Wu8 255.0 OneToOne 0.00 255.0 FORMAT "%5.1" /end CHARACTERISTIC
/begin CHARACTERISTIC DFES_MeterOut.DFC_ComGwIMG6TOut_C "project specific calibration data / Project specific calibration data for DFC_ComGwIMG6TOut" VALUE 0x804F53F2 Val_Wu8 255.0 OneToOne 0.00 255.0 FORMAT "%5.1" /end CHARACTERISTIC
/begin CHARACTERISTIC DFES_MeterOut.DFC_ComIDASBChksum_C "project specific calibration data / Project specific calibration data for DFC_ComIDASBChksum" VALUE 0x804F53F3 Val_Wu8 255.0 OneToOne 0.00 255.0 FORMAT "%5.1" /end CHARACTERISTIC
/begin CHARACTERISTIC DFES_MeterOut.DFC_ComIDASBRingCnt_C "project specific calibration data / Project specific calibration data for DFC_ComIDASBRingCnt" VALUE 0x804F53F4 Val_Wu8 255.0 OneToOne 0.00 255.0 FORMAT "%5.1" /end CHARACTERISTIC
/begin CHARACTERISTIC DFES_MeterOut.DFC_ComIDASBTOut_C "project specific calibration data / Project specific calibration data for DFC_ComIDASBTOut" VALUE 0x804F53F5 Val_Wu8 255.0 OneToOne 0.00 255.0 FORMAT "%5.1" /end CHARACTERISTIC
/begin CHARACTERISTIC DFES_MeterOut.DFC_ComIMGMILReq_C "project specific calibration data / Project specific calibration data for DFC_ComIMGMILReq" VALUE 0x804F53F6 Val_Wu8 255.0 OneToOne 0.00 255.0 FORMAT "%5.1" /end CHARACTERISTIC
/begin CHARACTERISTIC DFES_MeterOut.DFC_ComISSPrms_C "project specific calibration data / Project specific calibration data for DFC_ComISSPrms" VALUE 0x804F53F7 Val_Wu8 255.0 OneToOne 0.00 255.0 FORMAT "%5.1" /end CHARACTERISTIC
/begin CHARACTERISTIC DFES_MeterOut.DFC_ComMETAChksum_C "project specific calibration data / Project specific calibration data for DFC_ComMETAChksum" VALUE 0x804F53F8 Val_Wu8 255.0 OneToOne 0.00 255.0 FORMAT "%5.1" /end CHARACTERISTIC
/begin CHARACTERISTIC DFES_MeterOut.DFC_ComMETAChksumPstDrv_C "project specific calibration data / Project specific calibration data for DFC_ComMETAChksumPstDrv" VALUE 0x804F53F9 Val_Wu8 255.0 OneToOne 0.00 255.0 FORMAT "%5.1" /end CHARACTERISTIC
/begin CHARACTERISTIC DFES_MeterOut.DFC_ComMETARingCnt_C "project specific calibration data / Project specific calibration data for DFC_ComMETARingCnt" VALUE 0x804F53FA Val_Wu8 255.0 OneToOne 0.00 255.0 FORMAT "%5.1" /end CHARACTERISTIC
/begin CHARACTERISTIC DFES_MeterOut.DFC_ComMETARingCntPstDrv_C "project specific calibration data / Project specific calibration data for DFC_ComMETARingCntPstDrv" VALUE 0x804F53FB Val_Wu8 255.0 OneToOne 0.00 255.0 FORMAT "%5.1" /end CHARACTERISTIC
/begin CHARACTERISTIC DFES_MeterOut.DFC_ComMETATOut_C "project specific calibration data / Project specific calibration data for DFC_ComMETATOut" VALUE 0x804F53FC Val_Wu8 255.0 OneToOne 0.00 255.0 FORMAT "%5.1" /end CHARACTERISTIC
/begin CHARACTERISTIC DFES_MeterOut.DFC_ComMETATOutPstDrv_C "project specific calibration data / Project specific calibration data for DFC_ComMETATOutPstDrv" VALUE 0x804F53FD Val_Wu8 255.0 OneToOne 0.00 255.0 FORMAT "%5.1" /end CHARACTERISTIC
/begin CHARACTERISTIC DFES_MeterOut.DFC_ComMETCChksum_C "project specific calibration data / Project specific calibration data for DFC_ComMETCChksum" VALUE 0x804F53FE Val_Wu8 255.0 OneToOne 0.00 255.0 FORMAT "%5.1" /end CHARACTERISTIC
/begin CHARACTERISTIC DFES_MeterOut.DFC_ComMETCRingCnt_C "project specific calibration data / Project specific calibration data for DFC_ComMETCRingCnt" VALUE 0x804F53FF Val_Wu8 255.0 OneToOne 0.00 255.0 FORMAT "%5.1" /end CHARACTERISTIC
/begin CHARACTERISTIC DFES_MeterOut.DFC_ComMETCTOut_C "project specific calibration data / Project specific calibration data for DFC_ComMETCTOut" VALUE 0x804F5400 Val_Wu8 255.0 OneToOne 0.00 255.0 FORMAT "%5.1" /end CHARACTERISTIC
/begin CHARACTERISTIC DFES_MeterOut.DFC_ComMETDChksum_C "project specific calibration data / Project specific calibration data for DFC_ComMETDChksum" VALUE 0x804F5401 Val_Wu8 255.0 OneToOne 0.00 255.0 FORMAT "%5.1" /end CHARACTERISTIC
/begin CHARACTERISTIC DFES_MeterOut.DFC_ComMETDRingCnt_C "project specific calibration data / Project specific calibration data for DFC_ComMETDRingCnt" VALUE 0x804F5402 Val_Wu8 255.0 OneToOne 0.00 255.0 FORMAT "%5.1" /end CHARACTERISTIC
/begin CHARACTERISTIC DFES_MeterOut.DFC_ComMETDTOut_C "project specific calibration data / Project specific calibration data for DFC_ComMETDTOut" VALUE 0x804F5403 Val_Wu8 255.0 OneToOne 0.00 255.0 FORMAT "%5.1" /end CHARACTERISTIC
/begin CHARACTERISTIC DFES_MeterOut.DFC_ComMETE2Chksum_C "project specific calibration data / Project specific calibration data for DFC_ComMETE2Chksum" VALUE 0x804F5404 Val_Wu8 255.0 OneToOne 0.00 255.0 FORMAT "%5.1" /end CHARACTERISTIC
/begin CHARACTERISTIC DFES_MeterOut.DFC_ComMETE2RingCnt_C "project specific calibration data / Project specific calibration data for DFC_ComMETE2RingCnt" VALUE 0x804F5405 Val_Wu8 255.0 OneToOne 0.00 255.0 FORMAT "%5.1" /end CHARACTERISTIC
/begin CHARACTERISTIC DFES_MeterOut.DFC_ComMETE2TOut_C "project specific calibration data / Project specific calibration data for DFC_ComMETE2TOut" VALUE 0x804F5406 Val_Wu8 255.0 OneToOne 0.00 255.0 FORMAT "%5.1" /end CHARACTERISTIC
/begin CHARACTERISTIC DFES_MeterOut.DFC_ComMETFChksum_C "project specific calibration data / Project specific calibration data for DFC_ComMETFChksum" VALUE 0x804F5407 Val_Wu8 255.0 OneToOne 0.00 255.0 FORMAT "%5.1" /end CHARACTERISTIC
/begin CHARACTERISTIC DFES_MeterOut.DFC_ComMETFRingCnt_C "project specific calibration data / Project specific calibration data for DFC_ComMETFRingCnt" VALUE 0x804F5408 Val_Wu8 255.0 OneToOne 0.00 255.0 FORMAT "%5.1" /end CHARACTERISTIC
/begin CHARACTERISTIC DFES_MeterOut.DFC_ComMETFTOut_C "project specific calibration data / Project specific calibration data for DFC_ComMETFTOut" VALUE 0x804F5409 Val_Wu8 255.0 OneToOne 0.00 255.0 FORMAT "%5.1" /end CHARACTERISTIC
/begin CHARACTERISTIC DFES_MeterOut.DFC_ComMETGChksum_C "project specific calibration data / Project specific calibration data for DFC_ComMETGChksum" VALUE 0x804F540A Val_Wu8 255.0 OneToOne 0.00 255.0 FORMAT "%5.1" /end CHARACTERISTIC
/begin CHARACTERISTIC DFES_MeterOut.DFC_ComMETGRingCnt_C "project specific calibration data / Project specific calibration data for DFC_ComMETGRingCnt" VALUE 0x804F540B Val_Wu8 255.0 OneToOne 0.00 255.0 FORMAT "%5.1" /end CHARACTERISTIC
/begin CHARACTERISTIC DFES_MeterOut.DFC_ComMETGTOut_C "project specific calibration data / Project specific calibration data for DFC_ComMETGTOut" VALUE 0x804F540C Val_Wu8 255.0 OneToOne 0.00 255.0 FORMAT "%5.1" /end CHARACTERISTIC
/begin CHARACTERISTIC DFES_MeterOut.DFC_ComMETH2Chksum_C "project specific calibration data / Project specific calibration data for DFC_ComMETH2Chksum" VALUE 0x804F540D Val_Wu8 255.0 OneToOne 0.00 255.0 FORMAT "%5.1" /end CHARACTERISTIC
/begin CHARACTERISTIC DFES_MeterOut.DFC_ComMETH2RingCnt_C "project specific calibration data / Project specific calibration data for DFC_ComMETH2RingCnt" VALUE 0x804F540E Val_Wu8 255.0 OneToOne 0.00 255.0 FORMAT "%5.1" /end CHARACTERISTIC
/begin CHARACTERISTIC DFES_MeterOut.DFC_ComMETH2TOut_C "project specific calibration data / Project specific calibration data for DFC_ComMETH2TOut" VALUE 0x804F540F Val_Wu8 255.0 OneToOne 0.00 255.0 FORMAT "%5.1" /end CHARACTERISTIC
/begin CHARACTERISTIC DFES_MeterOut.DFC_ComMETHChksum_C "project specific calibration data / Project specific calibration data for DFC_ComMETHChksum" VALUE 0x804F5410 Val_Wu8 255.0 OneToOne 0.00 255.0 FORMAT "%5.1" /end CHARACTERISTIC
/begin CHARACTERISTIC DFES_MeterOut.DFC_ComMETHRingCnt_C "project specific calibration data / Project specific calibration data for DFC_ComMETHRingCnt" VALUE 0x804F5411 Val_Wu8 255.0 OneToOne 0.00 255.0 FORMAT "%5.1" /end CHARACTERISTIC
/begin CHARACTERISTIC DFES_MeterOut.DFC_ComMETHTOut_C "project specific calibration data / Project specific calibration data for DFC_ComMETHTOut" VALUE 0x804F5412 Val_Wu8 255.0 OneToOne 0.00 255.0 FORMAT "%5.1" /end CHARACTERISTIC
/begin CHARACTERISTIC DFES_MeterOut.DFC_ComMETIChksum_C "project specific calibration data / Project specific calibration data for DFC_ComMETIChksum" VALUE 0x804F5413 Val_Wu8 255.0 OneToOne 0.00 255.0 FORMAT "%5.1" /end CHARACTERISTIC
/begin CHARACTERISTIC DFES_MeterOut.DFC_ComMETIRingCnt_C "project specific calibration data / Project specific calibration data for DFC_ComMETIRingCnt" VALUE 0x804F5414 Val_Wu8 255.0 OneToOne 0.00 255.0 FORMAT "%5.1" /end CHARACTERISTIC
/begin CHARACTERISTIC DFES_MeterOut.DFC_ComMETITOut_C "project specific calibration data / Project specific calibration data for DFC_ComMETITOut" VALUE 0x804F5415 Val_Wu8 255.0 OneToOne 0.00 255.0 FORMAT "%5.1" /end CHARACTERISTIC
/begin CHARACTERISTIC DFES_MeterOut.DFC_ComMETKChksum_C "project specific calibration data / Project specific calibration data for DFC_ComMETKChksum" VALUE 0x804F5416 Val_Wu8 255.0 OneToOne 0.00 255.0 FORMAT "%5.1" /end CHARACTERISTIC
/begin CHARACTERISTIC DFES_MeterOut.DFC_ComMETKRingCnt_C "project specific calibration data / Project specific calibration data for DFC_ComMETKRingCnt" VALUE 0x804F5417 Val_Wu8 255.0 OneToOne 0.00 255.0 FORMAT "%5.1" /end CHARACTERISTIC
/begin CHARACTERISTIC DFES_MeterOut.DFC_ComMETKTOut_C "project specific calibration data / Project specific calibration data for DFC_ComMETKTOut" VALUE 0x804F5418 Val_Wu8 255.0 OneToOne 0.00 255.0 FORMAT "%5.1" /end CHARACTERISTIC
/begin CHARACTERISTIC DFES_MeterOut.DFC_ComMETLChksum_C "project specific calibration data / Project specific calibration data for DFC_ComMETLChksum" VALUE 0x804F5419 Val_Wu8 255.0 OneToOne 0.00 255.0 FORMAT "%5.1" /end CHARACTERISTIC
/begin CHARACTERISTIC DFES_MeterOut.DFC_ComMETLRingCnt_C "project specific calibration data / Project specific calibration data for DFC_ComMETLRingCnt" VALUE 0x804F541A Val_Wu8 255.0 OneToOne 0.00 255.0 FORMAT "%5.1" /end CHARACTERISTIC
/begin CHARACTERISTIC DFES_MeterOut.DFC_ComMETLTOut_C "project specific calibration data / Project specific calibration data for DFC_ComMETLTOut" VALUE 0x804F541B Val_Wu8 255.0 OneToOne 0.00 255.0 FORMAT "%5.1" /end CHARACTERISTIC
/begin CHARACTERISTIC DFES_MeterOut.DFC_ComMETMChksum_C "project specific calibration data / Project specific calibration data for DFC_ComMETMChksum" VALUE 0x804F541C Val_Wu8 255.0 OneToOne 0.00 255.0 FORMAT "%5.1" /end CHARACTERISTIC
/begin CHARACTERISTIC DFES_MeterOut.DFC_ComMETMRingCnt_C "project specific calibration data / Project specific calibration data for DFC_ComMETMRingCnt" VALUE 0x804F541D Val_Wu8 255.0 OneToOne 0.00 255.0 FORMAT "%5.1" /end CHARACTERISTIC
/begin CHARACTERISTIC DFES_MeterOut.DFC_ComMETMTOut_C "project specific calibration data / Project specific calibration data for DFC_ComMETMTOut" VALUE 0x804F541E Val_Wu8 255.0 OneToOne 0.00 255.0 FORMAT "%5.1" /end CHARACTERISTIC
/begin CHARACTERISTIC DFES_MeterOut.DFC_ComMETNChksum_C "project specific calibration data / Project specific calibration data for DFC_ComMETNChksum" VALUE 0x804F541F Val_Wu8 255.0 OneToOne 0.00 255.0 FORMAT "%5.1" /end CHARACTERISTIC
/begin CHARACTERISTIC DFES_MeterOut.DFC_ComMETNRingCnt_C "project specific calibration data / Project specific calibration data for DFC_ComMETNRingCnt" VALUE 0x804F5420 Val_Wu8 255.0 OneToOne 0.00 255.0 FORMAT "%5.1" /end CHARACTERISTIC
/begin CHARACTERISTIC DFES_MeterOut.DFC_ComMETNTOut_C "project specific calibration data / Project specific calibration data for DFC_ComMETNTOut" VALUE 0x804F5421 Val_Wu8 255.0 OneToOne 0.00 255.0 FORMAT "%5.1" /end CHARACTERISTIC
/begin CHARACTERISTIC DFES_MeterOut.DFC_ComMtrCom_C "project specific calibration data / Project specific calibration data for DFC_ComMtrCom" VALUE 0x804F5422 Val_Wu8 255.0 OneToOne 0.00 255.0 FORMAT "%5.1" /end CHARACTERISTIC
/begin CHARACTERISTIC DFES_MeterOut.DFC_ComPCUChkSum_C "project specific calibration data / Project specific calibration data for DFC_ComPCUChkSum" VALUE 0x804F5423 Val_Wu8 255.0 OneToOne 0.00 255.0 FORMAT "%5.1" /end CHARACTERISTIC
/begin CHARACTERISTIC DFES_MeterOut.DFC_ComPCURingCnt_C "project specific calibration data / Project specific calibration data for DFC_ComPCURingCnt" VALUE 0x804F5424 Val_Wu8 255.0 OneToOne 0.00 255.0 FORMAT "%5.1" /end CHARACTERISTIC
/begin CHARACTERISTIC DFES_MeterOut.DFC_ComPCUTOut_C "project specific calibration data / Project specific calibration data for DFC_ComPCUTOut" VALUE 0x804F5425 Val_Wu8 255.0 OneToOne 0.00 255.0 FORMAT "%5.1" /end CHARACTERISTIC
/begin CHARACTERISTIC DFES_MeterOut.DFC_ComSRSAChksum_C "project specific calibration data / Project specific calibration data for DFC_ComSRSAChksum" VALUE 0x804F5426 Val_Wu8 255.0 OneToOne 0.00 255.0 FORMAT "%5.1" /end CHARACTERISTIC
/begin CHARACTERISTIC DFES_MeterOut.DFC_ComSRSARingCnt_C "project specific calibration data / Project specific calibration data for DFC_ComSRSARingCnt" VALUE 0x804F5427 Val_Wu8 255.0 OneToOne 0.00 255.0 FORMAT "%5.1" /end CHARACTERISTIC
/begin CHARACTERISTIC DFES_MeterOut.DFC_ComSRSATOut_C "project specific calibration data / Project specific calibration data for DFC_ComSRSATOut" VALUE 0x804F5428 Val_Wu8 255.0 OneToOne 0.00 255.0 FORMAT "%5.1" /end CHARACTERISTIC
/begin CHARACTERISTIC DFES_MeterOut.DFC_ComSRSBChksum_C "project specific calibration data / Project specific calibration data for DFC_ComSRSBChksum" VALUE 0x804F5429 Val_Wu8 255.0 OneToOne 0.00 255.0 FORMAT "%5.1" /end CHARACTERISTIC
/begin CHARACTERISTIC DFES_MeterOut.DFC_ComSRSBRingCnt_C "project specific calibration data / Project specific calibration data for DFC_ComSRSBRingCnt" VALUE 0x804F542A Val_Wu8 255.0 OneToOne 0.00 255.0 FORMAT "%5.1" /end CHARACTERISTIC
/begin CHARACTERISTIC DFES_MeterOut.DFC_ComSRSBTOut_C "project specific calibration data / Project specific calibration data for DFC_ComSRSBTOut" VALUE 0x804F542B Val_Wu8 255.0 OneToOne 0.00 255.0 FORMAT "%5.1" /end CHARACTERISTIC
/begin CHARACTERISTIC DFES_MeterOut.DFC_ComSRSChksum_C "project specific calibration data / Project specific calibration data for DFC_ComSRSChksum" VALUE 0x804F542C Val_Wu8 255.0 OneToOne 0.00 255.0 FORMAT "%5.1" /end CHARACTERISTIC
/begin CHARACTERISTIC DFES_MeterOut.DFC_ComSRSErr_C "project specific calibration data / Project specific calibration data for DFC_ComSRSErr" VALUE 0x804F542D Val_Wu8 255.0 OneToOne 0.00 255.0 FORMAT "%5.1" /end CHARACTERISTIC
/begin CHARACTERISTIC DFES_MeterOut.DFC_ComSRSRingCnt_C "project specific calibration data / Project specific calibration data for DFC_ComSRSRingCnt" VALUE 0x804F542E Val_Wu8 255.0 OneToOne 0.00 255.0 FORMAT "%5.1" /end CHARACTERISTIC
/begin CHARACTERISTIC DFES_MeterOut.DFC_ComSRSTOut_C "project specific calibration data / Project specific calibration data for DFC_ComSRSTOut" VALUE 0x804F542F Val_Wu8 255.0 OneToOne 0.00 255.0 FORMAT "%5.1" /end CHARACTERISTIC
/begin CHARACTERISTIC DFES_MeterOut.DFC_ComVehSpdPndFltTCU_C "project specific calibration data / Project specific calibration data for DFC_ComVehSpdPndFltTCU" VALUE 0x804F5430 Val_Wu8 255.0 OneToOne 0.00 255.0 FORMAT "%5.1" /end CHARACTERISTIC
/begin CHARACTERISTIC DFES_MeterOut.DFC_EbsChartcCurrErr_C "project specific calibration data / Project specific calibration data for DFC_EbsChartcCurrErr" VALUE 0x804F5431 Val_Wu8 255.0 OneToOne 0.00 255.0 FORMAT "%5.1" /end CHARACTERISTIC
/begin CHARACTERISTIC DFES_MeterOut.DFC_EbsSelfDiagErr_C "project specific calibration data / Project specific calibration data for DFC_EbsSelfDiagErr" VALUE 0x804F5432 Val_Wu8 255.0 OneToOne 0.00 255.0 FORMAT "%5.1" /end CHARACTERISTIC
/begin CHARACTERISTIC DFES_MeterOut.DFC_GEVlvPhaCsersIntkB1_C "project specific calibration data / Project specific calibration data for DFC_GEVlvPhaCsersIntkB1" VALUE 0x804F5433 Val_Wu8 255.0 OneToOne 0.00 255.0 FORMAT "%5.1" /end CHARACTERISTIC
/begin CHARACTERISTIC DFES_MeterOut.DFC_GEVlvPhaPsOpenLoadIntkB1_C "project specific calibration data / Project specific calibration data for DFC_GEVlvPhaPsOpenLoadIntkB1" VALUE 0x804F5434 Val_Wu8 255.0 OneToOne 0.00 255.0 FORMAT "%5.1" /end CHARACTERISTIC
/begin CHARACTERISTIC DFES_MeterOut.DFC_GEVlvPhaPsShoToBattIntkB1_C "project specific calibration data / Project specific calibration data for DFC_GEVlvPhaPsShoToBattIntkB1" VALUE 0x804F5435 Val_Wu8 255.0 OneToOne 0.00 255.0 FORMAT "%5.1" /end CHARACTERISTIC
/begin CHARACTERISTIC DFES_MeterOut.DFC_GEVlvPhaPsShoToGndIntkB1_C "project specific calibration data / Project specific calibration data for DFC_GEVlvPhaPsShoToGndIntkB1" VALUE 0x804F5436 Val_Wu8 255.0 OneToOne 0.00 255.0 FORMAT "%5.1" /end CHARACTERISTIC
/begin CHARACTERISTIC DFES_MeterOut.DFC_GbxCANDigPlausErr_C "project specific calibration data / Project specific calibration data for DFC_GbxCANDigPlausErr" VALUE 0x804F5437 Val_Wu8 255.0 OneToOne 0.00 255.0 FORMAT "%5.1" /end CHARACTERISTIC
/begin CHARACTERISTIC DFES_MeterOut.DFC_GbxNPos1SRCMax_C "project specific calibration data / Project specific calibration data for DFC_GbxNPos1SRCMax" VALUE 0x804F5438 Val_Wu8 255.0 OneToOne 0.00 255.0 FORMAT "%5.1" /end CHARACTERISTIC
/begin CHARACTERISTIC DFES_MeterOut.DFC_GbxNPos1SRCMin_C "project specific calibration data / Project specific calibration data for DFC_GbxNPos1SRCMin" VALUE 0x804F5439 Val_Wu8 255.0 OneToOne 0.00 255.0 FORMAT "%5.1" /end CHARACTERISTIC
/begin CHARACTERISTIC DFES_MeterOut.DFC_GbxNPos2SRCMax_C "project specific calibration data / Project specific calibration data for DFC_GbxNPos2SRCMax" VALUE 0x804F543A Val_Wu8 255.0 OneToOne 0.00 255.0 FORMAT "%5.1" /end CHARACTERISTIC
/begin CHARACTERISTIC DFES_MeterOut.DFC_GbxNPos2SRCMin_C "project specific calibration data / Project specific calibration data for DFC_GbxNPos2SRCMin" VALUE 0x804F543B Val_Wu8 255.0 OneToOne 0.00 255.0 FORMAT "%5.1" /end CHARACTERISTIC
/begin CHARACTERISTIC DFES_MeterOut.DFC_GbxNPosAlvChk_C "project specific calibration data / Project specific calibration data for DFC_GbxNPosAlvChk" VALUE 0x804F543C Val_Wu8 255.0 OneToOne 0.00 255.0 FORMAT "%5.1" /end CHARACTERISTIC
/begin CHARACTERISTIC DFES_MeterOut.DFC_GbxNPosSyncErr_C "project specific calibration data / Project specific calibration data for DFC_GbxNPosSyncErr" VALUE 0x804F543D Val_Wu8 255.0 OneToOne 0.00 255.0 FORMAT "%5.1" /end CHARACTERISTIC
/begin CHARACTERISTIC DFES_MeterOut.DFC_HEGOS2B1HtrPsMax_C "project specific calibration data / Project specific calibration data for DFC_HEGOS2B1HtrPsMax" VALUE 0x804F543E Val_Wu8 255.0 OneToOne 0.00 255.0 FORMAT "%5.1" /end CHARACTERISTIC
/begin CHARACTERISTIC DFES_MeterOut.DFC_HEGOS2B1HtrPsMin_C "project specific calibration data / Project specific calibration data for DFC_HEGOS2B1HtrPsMin" VALUE 0x804F543F Val_Wu8 255.0 OneToOne 0.00 255.0 FORMAT "%5.1" /end CHARACTERISTIC
/begin CHARACTERISTIC DFES_MeterOut.DFC_HEGOS2B1HtrPsSig_C "project specific calibration data / Project specific calibration data for DFC_HEGOS2B1HtrPsSig" VALUE 0x804F5440 Val_Wu8 255.0 OneToOne 0.00 255.0 FORMAT "%5.1" /end CHARACTERISTIC
/begin CHARACTERISTIC DFES_MeterOut.DFC_LinCSErrACG_C "project specific calibration data / Project specific calibration data for DFC_LinCSErrACG" VALUE 0x804F5441 Val_Wu8 255.0 OneToOne 0.00 255.0 FORMAT "%5.1" /end CHARACTERISTIC
/begin CHARACTERISTIC DFES_MeterOut.DFC_LinCSErrAEV_C "project specific calibration data / Project specific calibration data for DFC_LinCSErrAEV" VALUE 0x804F5442 Val_Wu8 255.0 OneToOne 0.00 255.0 FORMAT "%5.1" /end CHARACTERISTIC
/begin CHARACTERISTIC DFES_MeterOut.DFC_LinCSErrDCDC_C "project specific calibration data / Project specific calibration data for DFC_LinCSErrDCDC" VALUE 0x804F5443 Val_Wu8 255.0 OneToOne 0.00 255.0 FORMAT "%5.1" /end CHARACTERISTIC
/begin CHARACTERISTIC DFES_MeterOut.DFC_LinCSErrEBS_C "project specific calibration data / Project specific calibration data for DFC_LinCSErrEBS" VALUE 0x804F5444 Val_Wu8 255.0 OneToOne 0.00 255.0 FORMAT "%5.1" /end CHARACTERISTIC
/begin CHARACTERISTIC DFES_MeterOut.DFC_LinHdrTimeoutErrACG_C "project specific calibration data / Project specific calibration data for DFC_LinHdrTimeoutErrACG" VALUE 0x804F5445 Val_Wu8 255.0 OneToOne 0.00 255.0 FORMAT "%5.1" /end CHARACTERISTIC
/begin CHARACTERISTIC DFES_MeterOut.DFC_LinHdrTimeoutErrAEV_C "project specific calibration data / Project specific calibration data for DFC_LinHdrTimeoutErrAEV" VALUE 0x804F5446 Val_Wu8 255.0 OneToOne 0.00 255.0 FORMAT "%5.1" /end CHARACTERISTIC
/begin CHARACTERISTIC DFES_MeterOut.DFC_LinHdrTimeoutErrDCDC_C "project specific calibration data / Project specific calibration data for DFC_LinHdrTimeoutErrDCDC" VALUE 0x804F5447 Val_Wu8 255.0 OneToOne 0.00 255.0 FORMAT "%5.1" /end CHARACTERISTIC
/begin CHARACTERISTIC DFES_MeterOut.DFC_LinHdrTimeoutErrEBS_C "project specific calibration data / Project specific calibration data for DFC_LinHdrTimeoutErrEBS" VALUE 0x804F5448 Val_Wu8 255.0 OneToOne 0.00 255.0 FORMAT "%5.1" /end CHARACTERISTIC
/begin CHARACTERISTIC DFES_MeterOut.DFC_LinMsgTimeoutErrACG_C "project specific calibration data / Project specific calibration data for DFC_LinMsgTimeoutErrACG" VALUE 0x804F5449 Val_Wu8 255.0 OneToOne 0.00 255.0 FORMAT "%5.1" /end CHARACTERISTIC
/begin CHARACTERISTIC DFES_MeterOut.DFC_LinMsgTimeoutErrAEV_C "project specific calibration data / Project specific calibration data for DFC_LinMsgTimeoutErrAEV" VALUE 0x804F544A Val_Wu8 255.0 OneToOne 0.00 255.0 FORMAT "%5.1" /end CHARACTERISTIC
/begin CHARACTERISTIC DFES_MeterOut.DFC_LinMsgTimeoutErrDCDC_C "project specific calibration data / Project specific calibration data for DFC_LinMsgTimeoutErrDCDC" VALUE 0x804F544B Val_Wu8 255.0 OneToOne 0.00 255.0 FORMAT "%5.1" /end CHARACTERISTIC
/begin CHARACTERISTIC DFES_MeterOut.DFC_LinMsgTimeoutErrEBS_C "project specific calibration data / Project specific calibration data for DFC_LinMsgTimeoutErrEBS" VALUE 0x804F544C Val_Wu8 255.0 OneToOne 0.00 255.0 FORMAT "%5.1" /end CHARACTERISTIC
/begin CHARACTERISTIC DFES_MeterOut.DFC_LinNoStrtComErr_C "project specific calibration data / Project specific calibration data for DFC_LinNoStrtComErr" VALUE 0x804F544D Val_Wu8 255.0 OneToOne 0.00 255.0 FORMAT "%5.1" /end CHARACTERISTIC
/begin CHARACTERISTIC DFES_MeterOut.DFC_LowPresOilP_C "project specific calibration data / Project specific calibration data for DFC_LowPresOilP" VALUE 0x804F544E Val_Wu8 255.0 OneToOne 0.00 255.0 FORMAT "%5.1" /end CHARACTERISTIC
/begin CHARACTERISTIC DFES_MeterOut.DFC_MisfDetVWhlFrntLeOORHi_C "project specific calibration data / Project specific calibration data for DFC_MisfDetVWhlFrntLeOORHi" VALUE 0x804F544F Val_Wu8 255.0 OneToOne 0.00 255.0 FORMAT "%5.1" /end CHARACTERISTIC
/begin CHARACTERISTIC DFES_MeterOut.DFC_MisfDetVWhlFrntLeRatyHi_C "project specific calibration data / Project specific calibration data for DFC_MisfDetVWhlFrntLeRatyHi" VALUE 0x804F5450 Val_Wu8 255.0 OneToOne 0.00 255.0 FORMAT "%5.1" /end CHARACTERISTIC
/begin CHARACTERISTIC DFES_MeterOut.DFC_MisfDetVWhlFrntLeRatyLo_C "project specific calibration data / Project specific calibration data for DFC_MisfDetVWhlFrntLeRatyLo" VALUE 0x804F5451 Val_Wu8 255.0 OneToOne 0.00 255.0 FORMAT "%5.1" /end CHARACTERISTIC
/begin CHARACTERISTIC DFES_MeterOut.DFC_MisfDetVWhlFrntLeStuck_C "project specific calibration data / Project specific calibration data for DFC_MisfDetVWhlFrntLeStuck" VALUE 0x804F5452 Val_Wu8 255.0 OneToOne 0.00 255.0 FORMAT "%5.1" /end CHARACTERISTIC
/begin CHARACTERISTIC DFES_MeterOut.DFC_MisfDetVWhlFrntRiOORHi_C "project specific calibration data / Project specific calibration data for DFC_MisfDetVWhlFrntRiOORHi" VALUE 0x804F5453 Val_Wu8 255.0 OneToOne 0.00 255.0 FORMAT "%5.1" /end CHARACTERISTIC
/begin CHARACTERISTIC DFES_MeterOut.DFC_MisfDetVWhlFrntRiRatyHi_C "project specific calibration data / Project specific calibration data for DFC_MisfDetVWhlFrntRiRatyHi" VALUE 0x804F5454 Val_Wu8 255.0 OneToOne 0.00 255.0 FORMAT "%5.1" /end CHARACTERISTIC
/begin CHARACTERISTIC DFES_MeterOut.DFC_MisfDetVWhlFrntRiRatyLo_C "project specific calibration data / Project specific calibration data for DFC_MisfDetVWhlFrntRiRatyLo" VALUE 0x804F5455 Val_Wu8 255.0 OneToOne 0.00 255.0 FORMAT "%5.1" /end CHARACTERISTIC
/begin CHARACTERISTIC DFES_MeterOut.DFC_MisfDetVWhlFrntRiStuck_C "project specific calibration data / Project specific calibration data for DFC_MisfDetVWhlFrntRiStuck" VALUE 0x804F5456 Val_Wu8 255.0 OneToOne 0.00 255.0 FORMAT "%5.1" /end CHARACTERISTIC
/begin CHARACTERISTIC DFES_MeterOut.DFC_MisfDetVWhlReLeOORHi_C "project specific calibration data / Project specific calibration data for DFC_MisfDetVWhlReLeOORHi" VALUE 0x804F5457 Val_Wu8 255.0 OneToOne 0.00 255.0 FORMAT "%5.1" /end CHARACTERISTIC
/begin CHARACTERISTIC DFES_MeterOut.DFC_MisfDetVWhlReLeRatyHi_C "project specific calibration data / Project specific calibration data for DFC_MisfDetVWhlReLeRatyHi" VALUE 0x804F5458 Val_Wu8 255.0 OneToOne 0.00 255.0 FORMAT "%5.1" /end CHARACTERISTIC
/begin CHARACTERISTIC DFES_MeterOut.DFC_MisfDetVWhlReLeRatyLo_C "project specific calibration data / Project specific calibration data for DFC_MisfDetVWhlReLeRatyLo" VALUE 0x804F5459 Val_Wu8 255.0 OneToOne 0.00 255.0 FORMAT "%5.1" /end CHARACTERISTIC
/begin CHARACTERISTIC DFES_MeterOut.DFC_MisfDetVWhlReLeStuck_C "project specific calibration data / Project specific calibration data for DFC_MisfDetVWhlReLeStuck" VALUE 0x804F545A Val_Wu8 255.0 OneToOne 0.00 255.0 FORMAT "%5.1" /end CHARACTERISTIC
/begin CHARACTERISTIC DFES_MeterOut.DFC_MisfDetVWhlReRiOORHi_C "project specific calibration data / Project specific calibration data for DFC_MisfDetVWhlReRiOORHi" VALUE 0x804F545B Val_Wu8 255.0 OneToOne 0.00 255.0 FORMAT "%5.1" /end CHARACTERISTIC
/begin CHARACTERISTIC DFES_MeterOut.DFC_MisfDetVWhlReRiRatyHi_C "project specific calibration data / Project specific calibration data for DFC_MisfDetVWhlReRiRatyHi" VALUE 0x804F545C Val_Wu8 255.0 OneToOne 0.00 255.0 FORMAT "%5.1" /end CHARACTERISTIC
/begin CHARACTERISTIC DFES_MeterOut.DFC_MisfDetVWhlReRiRatyLo_C "project specific calibration data / Project specific calibration data for DFC_MisfDetVWhlReRiRatyLo" VALUE 0x804F545D Val_Wu8 255.0 OneToOne 0.00 255.0 FORMAT "%5.1" /end CHARACTERISTIC
/begin CHARACTERISTIC DFES_MeterOut.DFC_MisfDetVWhlReRiStuck_C "project specific calibration data / Project specific calibration data for DFC_MisfDetVWhlReRiStuck" VALUE 0x804F545E Val_Wu8 255.0 OneToOne 0.00 255.0 FORMAT "%5.1" /end CHARACTERISTIC
/begin CHARACTERISTIC DFES_MeterOut.DFC_MisfDetdVWhlFrntLePlaus_C "project specific calibration data / Project specific calibration data for DFC_MisfDetdVWhlFrntLePlaus" VALUE 0x804F545F Val_Wu8 255.0 OneToOne 0.00 255.0 FORMAT "%5.1" /end CHARACTERISTIC
/begin CHARACTERISTIC DFES_MeterOut.DFC_MisfDetdVWhlFrntRiPlaus_C "project specific calibration data / Project specific calibration data for DFC_MisfDetdVWhlFrntRiPlaus" VALUE 0x804F5460 Val_Wu8 255.0 OneToOne 0.00 255.0 FORMAT "%5.1" /end CHARACTERISTIC
/begin CHARACTERISTIC DFES_MeterOut.DFC_MisfDetdVWhlReLePlaus_C "project specific calibration data / Project specific calibration data for DFC_MisfDetdVWhlReLePlaus" VALUE 0x804F5461 Val_Wu8 255.0 OneToOne 0.00 255.0 FORMAT "%5.1" /end CHARACTERISTIC
/begin CHARACTERISTIC DFES_MeterOut.DFC_MisfDetdVWhlReRiPlaus_C "project specific calibration data / Project specific calibration data for DFC_MisfDetdVWhlReRiPlaus" VALUE 0x804F5462 Val_Wu8 255.0 OneToOne 0.00 255.0 FORMAT "%5.1" /end CHARACTERISTIC
/begin CHARACTERISTIC DFES_MeterOut.DFC_PEnvSigRngMax_C "project specific calibration data / Project specific calibration data for DFC_PEnvSigRngMax" VALUE 0x804F5463 Val_Wu8 255.0 OneToOne 0.00 255.0 FORMAT "%5.1" /end CHARACTERISTIC
/begin CHARACTERISTIC DFES_MeterOut.DFC_PEnvSigRngMin_C "project specific calibration data / Project specific calibration data for DFC_PEnvSigRngMin" VALUE 0x804F5464 Val_Wu8 255.0 OneToOne 0.00 255.0 FORMAT "%5.1" /end CHARACTERISTIC
/begin CHARACTERISTIC DFES_MeterOut.DFC_StmFault_C "project specific calibration data / Project specific calibration data for DFC_StmFault" VALUE 0x804F5465 Val_Wu8 255.0 OneToOne 0.00 255.0 FORMAT "%5.1" /end CHARACTERISTIC
/begin CHARACTERISTIC DFES_MeterOut.DFC_StrtCtOffPth_C "project specific calibration data / Project specific calibration data for DFC_StrtCtOffPth" VALUE 0x804F5466 Val_Wu8 255.0 OneToOne 0.00 255.0 FORMAT "%5.1" /end CHARACTERISTIC
/begin CHARACTERISTIC DFES_MeterOut.DFC_StrtCtlErr_C "project specific calibration data / Project specific calibration data for DFC_StrtCtlErr" VALUE 0x804F5467 Val_Wu8 255.0 OneToOne 0.00 255.0 FORMAT "%5.1" /end CHARACTERISTIC
/begin CHARACTERISTIC DFES_MeterOut.DFC_StrtFault_C "project specific calibration data / Project specific calibration data for DFC_StrtFault" VALUE 0x804F5468 Val_Wu8 255.0 OneToOne 0.00 255.0 FORMAT "%5.1" /end CHARACTERISTIC
/begin CHARACTERISTIC DFES_MeterOut.DFC_StrtLckJudg1_C "project specific calibration data / Project specific calibration data for DFC_StrtLckJudg1" VALUE 0x804F5469 Val_Wu8 255.0 OneToOne 0.00 255.0 FORMAT "%5.1" /end CHARACTERISTIC
/begin CHARACTERISTIC DFES_MeterOut.DFC_StrtLckJudg2_C "project specific calibration data / Project specific calibration data for DFC_StrtLckJudg2" VALUE 0x804F546A Val_Wu8 255.0 OneToOne 0.00 255.0 FORMAT "%5.1" /end CHARACTERISTIC
/begin CHARACTERISTIC DFES_MeterOut.DFC_StrtOL_C "project specific calibration data / Project specific calibration data for DFC_StrtOL" VALUE 0x804F546B Val_Wu8 255.0 OneToOne 0.00 255.0 FORMAT "%5.1" /end CHARACTERISTIC
/begin CHARACTERISTIC DFES_MeterOut.DFC_StrtOL2_C "project specific calibration data / Project specific calibration data for DFC_StrtOL2" VALUE 0x804F546C Val_Wu8 255.0 OneToOne 0.00 255.0 FORMAT "%5.1" /end CHARACTERISTIC
/begin CHARACTERISTIC DFES_MeterOut.DFC_StrtSCB_C "project specific calibration data / Project specific calibration data for DFC_StrtSCB" VALUE 0x804F546D Val_Wu8 255.0 OneToOne 0.00 255.0 FORMAT "%5.1" /end CHARACTERISTIC
/begin CHARACTERISTIC DFES_MeterOut.DFC_StrtSCB2_C "project specific calibration data / Project specific calibration data for DFC_StrtSCB2" VALUE 0x804F546E Val_Wu8 255.0 OneToOne 0.00 255.0 FORMAT "%5.1" /end CHARACTERISTIC
/begin CHARACTERISTIC DFES_MeterOut.DFC_StrtSCG_C "project specific calibration data / Project specific calibration data for DFC_StrtSCG" VALUE 0x804F546F Val_Wu8 255.0 OneToOne 0.00 255.0 FORMAT "%5.1" /end CHARACTERISTIC
/begin CHARACTERISTIC DFES_MeterOut.DFC_StrtSCG2_C "project specific calibration data / Project specific calibration data for DFC_StrtSCG2" VALUE 0x804F5470 Val_Wu8 255.0 OneToOne 0.00 255.0 FORMAT "%5.1" /end CHARACTERISTIC
/begin CHARACTERISTIC DFES_MeterOut.DFC_StrtStkRly1_C "project specific calibration data / Project specific calibration data for DFC_StrtStkRly1" VALUE 0x804F5471 Val_Wu8 255.0 OneToOne 0.00 255.0 FORMAT "%5.1" /end CHARACTERISTIC
/begin CHARACTERISTIC DFES_MeterOut.DFC_StrtStkRly2_C "project specific calibration data / Project specific calibration data for DFC_StrtStkRly2" VALUE 0x804F5472 Val_Wu8 255.0 OneToOne 0.00 255.0 FORMAT "%5.1" /end CHARACTERISTIC
/begin CHARACTERISTIC DFES_MeterOut.DFC_TEVEmax_C "project specific calibration data / Project specific calibration data for DFC_TEVEmax" VALUE 0x804F5473 Val_Wu8 255.0 OneToOne 0.00 255.0 FORMAT "%5.1" /end CHARACTERISTIC
/begin CHARACTERISTIC DFES_MeterOut.DFC_TEVEmin_C "project specific calibration data / Project specific calibration data for DFC_TEVEmin" VALUE 0x804F5474 Val_Wu8 255.0 OneToOne 0.00 255.0 FORMAT "%5.1" /end CHARACTERISTIC
/begin CHARACTERISTIC DFES_MeterOut.DFC_TEVEsig_C "project specific calibration data / Project specific calibration data for DFC_TEVEsig" VALUE 0x804F5475 Val_Wu8 255.0 OneToOne 0.00 255.0 FORMAT "%5.1" /end CHARACTERISTIC
/begin CHARACTERISTIC DFES_MeterOut.DFC_UegoHeatrPrfmncLoS1B1_C "project specific calibration data / Project specific calibration data for DFC_UegoHeatrPrfmncLoS1B1" VALUE 0x804F5476 Val_Wu8 255.0 OneToOne 0.00 255.0 FORMAT "%5.1" /end CHARACTERISTIC
/begin CHARACTERISTIC DFES_MeterOut.DFC_VehVAllPlaus_C "project specific calibration data / Project specific calibration data for DFC_VehVAllPlaus" VALUE 0x804F5477 Val_Wu8 255.0 OneToOne 0.00 255.0 FORMAT "%5.1" /end CHARACTERISTIC
/begin CHARACTERISTIC DFES_MeterOut.DFC_VehVNCSnsrElecFailr_C "project specific calibration data / Project specific calibration data for DFC_VehVNCSnsrElecFailr" VALUE 0x804F5478 Val_Wu8 255.0 OneToOne 0.00 255.0 FORMAT "%5.1" /end CHARACTERISTIC
/begin CHARACTERISTIC DFES_MeterOut.DFC_VehVPlausCan_C "project specific calibration data / Project specific calibration data for DFC_VehVPlausCan" VALUE 0x804F5479 Val_Wu8 255.0 OneToOne 0.00 255.0 FORMAT "%5.1" /end CHARACTERISTIC
/begin CHARACTERISTIC DFES_MeterOut.DFC_VehVPlausFco_C "project specific calibration data / Project specific calibration data for DFC_VehVPlausFco" VALUE 0x804F547A Val_Wu8 255.0 OneToOne 0.00 255.0 FORMAT "%5.1" /end CHARACTERISTIC
/begin CHARACTERISTIC DFES_MeterOut.DFC_VehVPlausPwr_C "project specific calibration data / Project specific calibration data for DFC_VehVPlausPwr" VALUE 0x804F547B Val_Wu8 255.0 OneToOne 0.00 255.0 FORMAT "%5.1" /end CHARACTERISTIC
/begin CHARACTERISTIC DFES_MeterOut.DFC_VehVPlausV2N_C "project specific calibration data / Project specific calibration data for DFC_VehVPlausV2N" VALUE 0x804F547C Val_Wu8 255.0 OneToOne 0.00 255.0 FORMAT "%5.1" /end CHARACTERISTIC
/begin CHARACTERISTIC DFES_MeterOut.DFC_VehVSpdSnsrAElecFailr_C "project specific calibration data / Project specific calibration data for DFC_VehVSpdSnsrAElecFailr" VALUE 0x804F547D Val_Wu8 255.0 OneToOne 0.00 255.0 FORMAT "%5.1" /end CHARACTERISTIC
/begin CHARACTERISTIC DFES_MeterOut.DFC_VehVSpdSnsrBElecFailr_C "project specific calibration data / Project specific calibration data for DFC_VehVSpdSnsrBElecFailr" VALUE 0x804F547E Val_Wu8 255.0 OneToOne 0.00 255.0 FORMAT "%5.1" /end CHARACTERISTIC
/begin CHARACTERISTIC DFES_MeterOut.DFC_ClthMax_C "project specific calibration data / Project specific calibration data for DFC_ClthMax" VALUE 0x804F547F Val_Wu8 255.0 OneToOne 0.00 255.0 FORMAT "%5.1" /end CHARACTERISTIC
/begin CHARACTERISTIC DFES_MeterOut.DFC_IgnClPs_DevComErr_C "project specific calibration data / Project specific calibration data for DFC_IgnClPs_DevComErr" VALUE 0x804F5480 Val_Wu8 255.0 OneToOne 0.00 255.0 FORMAT "%5.1" /end CHARACTERISTIC
/begin CHARACTERISTIC DFES_MeterOut.DFC_IgnClPs_LineOl_0_C "project specific calibration data / Project specific calibration data for DFC_IgnClPs_LineOl_0" VALUE 0x804F5481 Val_Wu8 255.0 OneToOne 0.00 255.0 FORMAT "%5.1" /end CHARACTERISTIC
/begin CHARACTERISTIC DFES_MeterOut.DFC_IgnClPs_LineOl_1_C "project specific calibration data / Project specific calibration data for DFC_IgnClPs_LineOl_1" VALUE 0x804F5482 Val_Wu8 255.0 OneToOne 0.00 255.0 FORMAT "%5.1" /end CHARACTERISTIC
/begin CHARACTERISTIC DFES_MeterOut.DFC_IgnClPs_LineOl_2_C "project specific calibration data / Project specific calibration data for DFC_IgnClPs_LineOl_2" VALUE 0x804F5483 Val_Wu8 255.0 OneToOne 0.00 255.0 FORMAT "%5.1" /end CHARACTERISTIC
/begin CHARACTERISTIC DFES_MeterOut.DFC_IgnClPs_LineOl_3_C "project specific calibration data / Project specific calibration data for DFC_IgnClPs_LineOl_3" VALUE 0x804F5484 Val_Wu8 255.0 OneToOne 0.00 255.0 FORMAT "%5.1" /end CHARACTERISTIC
/begin CHARACTERISTIC DFES_MeterOut.DFC_IgnClPs_LineScb_0_C "project specific calibration data / Project specific calibration data for DFC_IgnClPs_LineScb_0" VALUE 0x804F5485 Val_Wu8 255.0 OneToOne 0.00 255.0 FORMAT "%5.1" /end CHARACTERISTIC
/begin CHARACTERISTIC DFES_MeterOut.DFC_IgnClPs_LineScb_1_C "project specific calibration data / Project specific calibration data for DFC_IgnClPs_LineScb_1" VALUE 0x804F5486 Val_Wu8 255.0 OneToOne 0.00 255.0 FORMAT "%5.1" /end CHARACTERISTIC
/begin CHARACTERISTIC DFES_MeterOut.DFC_IgnClPs_LineScb_2_C "project specific calibration data / Project specific calibration data for DFC_IgnClPs_LineScb_2" VALUE 0x804F5487 Val_Wu8 255.0 OneToOne 0.00 255.0 FORMAT "%5.1" /end CHARACTERISTIC
/begin CHARACTERISTIC DFES_MeterOut.DFC_IgnClPs_LineScb_3_C "project specific calibration data / Project specific calibration data for DFC_IgnClPs_LineScb_3" VALUE 0x804F5488 Val_Wu8 255.0 OneToOne 0.00 255.0 FORMAT "%5.1" /end CHARACTERISTIC
/begin CHARACTERISTIC DFES_MeterOut.DFC_IgnClPs_LineScg_0_C "project specific calibration data / Project specific calibration data for DFC_IgnClPs_LineScg_0" VALUE 0x804F5489 Val_Wu8 255.0 OneToOne 0.00 255.0 FORMAT "%5.1" /end CHARACTERISTIC
/begin CHARACTERISTIC DFES_MeterOut.DFC_IgnClPs_LineScg_1_C "project specific calibration data / Project specific calibration data for DFC_IgnClPs_LineScg_1" VALUE 0x804F548A Val_Wu8 255.0 OneToOne 0.00 255.0 FORMAT "%5.1" /end CHARACTERISTIC
/begin CHARACTERISTIC DFES_MeterOut.DFC_IgnClPs_LineScg_2_C "project specific calibration data / Project specific calibration data for DFC_IgnClPs_LineScg_2" VALUE 0x804F548B Val_Wu8 255.0 OneToOne 0.00 255.0 FORMAT "%5.1" /end CHARACTERISTIC
/begin CHARACTERISTIC DFES_MeterOut.DFC_IgnClPs_LineScg_3_C "project specific calibration data / Project specific calibration data for DFC_IgnClPs_LineScg_3" VALUE 0x804F548C Val_Wu8 255.0 OneToOne 0.00 255.0 FORMAT "%5.1" /end CHARACTERISTIC
/begin CHARACTERISTIC DFES_MeterOut.DFC_KRVEKOEVAB_C "project specific calibration data / Project specific calibration data for DFC_KRVEKOEVAB" VALUE 0x804F548D Val_Wu8 255.0 OneToOne 0.00 255.0 FORMAT "%5.1" /end CHARACTERISTIC
/begin CHARACTERISTIC DFES_MeterOut.DFC_KRVEKOEVAB0_C "project specific calibration data / Project specific calibration data for DFC_KRVEKOEVAB0" VALUE 0x804F548E Val_Wu8 255.0 OneToOne 0.00 255.0 FORMAT "%5.1" /end CHARACTERISTIC
/begin CHARACTERISTIC DFES_MeterOut.DFC_KRVEKOEVAB1_C "project specific calibration data / Project specific calibration data for DFC_KRVEKOEVAB1" VALUE 0x804F548F Val_Wu8 255.0 OneToOne 0.00 255.0 FORMAT "%5.1" /end CHARACTERISTIC
/begin CHARACTERISTIC DFES_MeterOut.DFC_KRVEKOEVAB2_C "project specific calibration data / Project specific calibration data for DFC_KRVEKOEVAB2" VALUE 0x804F5490 Val_Wu8 255.0 OneToOne 0.00 255.0 FORMAT "%5.1" /end CHARACTERISTIC
/begin CHARACTERISTIC DFES_MeterOut.DFC_KRVEKOEVAB3_C "project specific calibration data / Project specific calibration data for DFC_KRVEKOEVAB3" VALUE 0x804F5491 Val_Wu8 255.0 OneToOne 0.00 255.0 FORMAT "%5.1" /end CHARACTERISTIC
/begin CHARACTERISTIC DFES_MeterOut.DFC_UegoSigEcuAsicS1B1_C "project specific calibration data / Project specific calibration data for DFC_UegoSigEcuAsicS1B1" VALUE 0x804F5492 Val_Wu8 255.0 OneToOne 0.00 255.0 FORMAT "%5.1" /end CHARACTERISTIC
/begin CHARACTERISTIC DFES_MeterOut.DFC_UegoSigEcuComS1B1_C "project specific calibration data / Project specific calibration data for DFC_UegoSigEcuComS1B1" VALUE 0x804F5493 Val_Wu8 255.0 OneToOne 0.00 255.0 FORMAT "%5.1" /end CHARACTERISTIC
/begin CHARACTERISTIC DFES_MeterOut.DFC_UegoSigSnsrS1B1_C "project specific calibration data / Project specific calibration data for DFC_UegoSigSnsrS1B1" VALUE 0x804F5494 Val_Wu8 255.0 OneToOne 0.00 255.0 FORMAT "%5.1" /end CHARACTERISTIC
/begin CHARACTERISTIC DFES_MeterOut.DFC_UegoSigWireOlApesS1B1_C "project specific calibration data / Project specific calibration data for DFC_UegoSigWireOlApesS1B1" VALUE 0x804F5495 Val_Wu8 255.0 OneToOne 0.00 255.0 FORMAT "%5.1" /end CHARACTERISTIC
/begin CHARACTERISTIC DFES_MeterOut.DFC_UegoSigWireOlIpeS1B1_C "project specific calibration data / Project specific calibration data for DFC_UegoSigWireOlIpeS1B1" VALUE 0x804F5496 Val_Wu8 255.0 OneToOne 0.00 255.0 FORMAT "%5.1" /end CHARACTERISTIC
/begin CHARACTERISTIC DFES_MeterOut.DFC_UegoSigWireOlReS1B1_C "project specific calibration data / Project specific calibration data for DFC_UegoSigWireOlReS1B1" VALUE 0x804F5497 Val_Wu8 255.0 OneToOne 0.00 255.0 FORMAT "%5.1" /end CHARACTERISTIC
/begin CHARACTERISTIC DFES_MeterOut.DFC_UegoSigWireRCmpS1B1_C "project specific calibration data / Project specific calibration data for DFC_UegoSigWireRCmpS1B1" VALUE 0x804F5498 Val_Wu8 255.0 OneToOne 0.00 255.0 FORMAT "%5.1" /end CHARACTERISTIC
/begin CHARACTERISTIC DFES_MeterOut.DFC_UegoSigWireScbS1B1_C "project specific calibration data / Project specific calibration data for DFC_UegoSigWireScbS1B1" VALUE 0x804F5499 Val_Wu8 255.0 OneToOne 0.00 255.0 FORMAT "%5.1" /end CHARACTERISTIC
/begin CHARACTERISTIC DFES_MeterOut.DFC_UegoSigWireScgS1B1_C "project specific calibration data / Project specific calibration data for DFC_UegoSigWireScgS1B1" VALUE 0x804F549A Val_Wu8 255.0 OneToOne 0.00 255.0 FORMAT "%5.1" /end CHARACTERISTIC
/begin CHARACTERISTIC DFES_MeterOut.DFC_AfsPhyRngHiB1_C "project specific calibration data / Project specific calibration data for DFC_AfsPhyRngHiB1" VALUE 0x804F549B Val_Wu8 255.0 OneToOne 0.00 255.0 FORMAT "%5.1" /end CHARACTERISTIC
/begin CHARACTERISTIC DFES_MeterOut.DFC_AfsPhyRngLoB1_C "project specific calibration data / Project specific calibration data for DFC_AfsPhyRngLoB1" VALUE 0x804F549C Val_Wu8 255.0 OneToOne 0.00 255.0 FORMAT "%5.1" /end CHARACTERISTIC
/begin CHARACTERISTIC DFES_MeterOut.DFC_AirCCmprOL_C "project specific calibration data / Project specific calibration data for DFC_AirCCmprOL" VALUE 0x804F549D Val_Wu8 255.0 OneToOne 0.00 255.0 FORMAT "%5.1" /end CHARACTERISTIC
/begin CHARACTERISTIC DFES_MeterOut.DFC_AirCCmprOvrTemp_C "project specific calibration data / Project specific calibration data for DFC_AirCCmprOvrTemp" VALUE 0x804F549E Val_Wu8 255.0 OneToOne 0.00 255.0 FORMAT "%5.1" /end CHARACTERISTIC
/begin CHARACTERISTIC DFES_MeterOut.DFC_AirCCmprSCB_C "project specific calibration data / Project specific calibration data for DFC_AirCCmprSCB" VALUE 0x804F549F Val_Wu8 255.0 OneToOne 0.00 255.0 FORMAT "%5.1" /end CHARACTERISTIC
/begin CHARACTERISTIC DFES_MeterOut.DFC_AirCCmprSCG_C "project specific calibration data / Project specific calibration data for DFC_AirCCmprSCG" VALUE 0x804F54A0 Val_Wu8 255.0 OneToOne 0.00 255.0 FORMAT "%5.1" /end CHARACTERISTIC
/begin CHARACTERISTIC DFES_MeterOut.DFC_AltErr_C "project specific calibration data / Project specific calibration data for DFC_AltErr" VALUE 0x804F54A1 Val_Wu8 255.0 OneToOne 0.00 255.0 FORMAT "%5.1" /end CHARACTERISTIC
/begin CHARACTERISTIC DFES_MeterOut.DFC_BattUSRCMax_C "project specific calibration data / Project specific calibration data for DFC_BattUSRCMax" VALUE 0x804F54A2 Val_Wu8 255.0 OneToOne 0.00 255.0 FORMAT "%5.1" /end CHARACTERISTIC
/begin CHARACTERISTIC DFES_MeterOut.DFC_BattUSRCMin_C "project specific calibration data / Project specific calibration data for DFC_BattUSRCMin" VALUE 0x804F54A3 Val_Wu8 255.0 OneToOne 0.00 255.0 FORMAT "%5.1" /end CHARACTERISTIC
/begin CHARACTERISTIC DFES_MeterOut.DFC_ComChksTCU1_C "project specific calibration data / Project specific calibration data for DFC_ComChksTCU1" VALUE 0x804F54A4 Val_Wu8 255.0 OneToOne 0.00 255.0 FORMAT "%5.1" /end CHARACTERISTIC
/begin CHARACTERISTIC DFES_MeterOut.DFC_ComChksTCU11_C "project specific calibration data / Project specific calibration data for DFC_ComChksTCU11" VALUE 0x804F54A5 Val_Wu8 255.0 OneToOne 0.00 255.0 FORMAT "%5.1" /end CHARACTERISTIC
/begin CHARACTERISTIC DFES_MeterOut.DFC_ComChksTCU12_C "project specific calibration data / Project specific calibration data for DFC_ComChksTCU12" VALUE 0x804F54A6 Val_Wu8 255.0 OneToOne 0.00 255.0 FORMAT "%5.1" /end CHARACTERISTIC
/begin CHARACTERISTIC DFES_MeterOut.DFC_ComChksTCU13_C "project specific calibration data / Project specific calibration data for DFC_ComChksTCU13" VALUE 0x804F54A7 Val_Wu8 255.0 OneToOne 0.00 255.0 FORMAT "%5.1" /end CHARACTERISTIC
/begin CHARACTERISTIC DFES_MeterOut.DFC_ComChksTCU2_C "project specific calibration data / Project specific calibration data for DFC_ComChksTCU2" VALUE 0x804F54A8 Val_Wu8 255.0 OneToOne 0.00 255.0 FORMAT "%5.1" /end CHARACTERISTIC
/begin CHARACTERISTIC DFES_MeterOut.DFC_ComChksTCU3_C "project specific calibration data / Project specific calibration data for DFC_ComChksTCU3" VALUE 0x804F54A9 Val_Wu8 255.0 OneToOne 0.00 255.0 FORMAT "%5.1" /end CHARACTERISTIC
/begin CHARACTERISTIC DFES_MeterOut.DFC_ComChksTCU4_C "project specific calibration data / Project specific calibration data for DFC_ComChksTCU4" VALUE 0x804F54AA Val_Wu8 255.0 OneToOne 0.00 255.0 FORMAT "%5.1" /end CHARACTERISTIC
/begin CHARACTERISTIC DFES_MeterOut.DFC_ComCntTCU1_C "project specific calibration data / Project specific calibration data for DFC_ComCntTCU1" VALUE 0x804F54AB Val_Wu8 255.0 OneToOne 0.00 255.0 FORMAT "%5.1" /end CHARACTERISTIC
/begin CHARACTERISTIC DFES_MeterOut.DFC_ComCntTCU11_C "project specific calibration data / Project specific calibration data for DFC_ComCntTCU11" VALUE 0x804F54AC Val_Wu8 255.0 OneToOne 0.00 255.0 FORMAT "%5.1" /end CHARACTERISTIC
/begin CHARACTERISTIC DFES_MeterOut.DFC_ComCntTCU12_C "project specific calibration data / Project specific calibration data for DFC_ComCntTCU12" VALUE 0x804F54AD Val_Wu8 255.0 OneToOne 0.00 255.0 FORMAT "%5.1" /end CHARACTERISTIC
/begin CHARACTERISTIC DFES_MeterOut.DFC_ComCntTCU13_C "project specific calibration data / Project specific calibration data for DFC_ComCntTCU13" VALUE 0x804F54AE Val_Wu8 255.0 OneToOne 0.00 255.0 FORMAT "%5.1" /end CHARACTERISTIC
/begin CHARACTERISTIC DFES_MeterOut.DFC_ComCntTCU2_C "project specific calibration data / Project specific calibration data for DFC_ComCntTCU2" VALUE 0x804F54AF Val_Wu8 255.0 OneToOne 0.00 255.0 FORMAT "%5.1" /end CHARACTERISTIC
/begin CHARACTERISTIC DFES_MeterOut.DFC_ComCntTCU3_C "project specific calibration data / Project specific calibration data for DFC_ComCntTCU3" VALUE 0x804F54B0 Val_Wu8 255.0 OneToOne 0.00 255.0 FORMAT "%5.1" /end CHARACTERISTIC
/begin CHARACTERISTIC DFES_MeterOut.DFC_ComCntTCU4_C "project specific calibration data / Project specific calibration data for DFC_ComCntTCU4" VALUE 0x804F54B1 Val_Wu8 255.0 OneToOne 0.00 255.0 FORMAT "%5.1" /end CHARACTERISTIC
/begin CHARACTERISTIC DFES_MeterOut.DFC_ComTOutTCU01_C "project specific calibration data / Project specific calibration data for DFC_ComTOutTCU01" VALUE 0x804F54B2 Val_Wu8 255.0 OneToOne 0.00 255.0 FORMAT "%5.1" /end CHARACTERISTIC
/begin CHARACTERISTIC DFES_MeterOut.DFC_ComTOutTCU02_C "project specific calibration data / Project specific calibration data for DFC_ComTOutTCU02" VALUE 0x804F54B3 Val_Wu8 255.0 OneToOne 0.00 255.0 FORMAT "%5.1" /end CHARACTERISTIC
/begin CHARACTERISTIC DFES_MeterOut.DFC_ComTOutTCU1_C "project specific calibration data / Project specific calibration data for DFC_ComTOutTCU1" VALUE 0x804F54B4 Val_Wu8 255.0 OneToOne 0.00 255.0 FORMAT "%5.1" /end CHARACTERISTIC
/begin CHARACTERISTIC DFES_MeterOut.DFC_ComTOutTCU11_C "project specific calibration data / Project specific calibration data for DFC_ComTOutTCU11" VALUE 0x804F54B5 Val_Wu8 255.0 OneToOne 0.00 255.0 FORMAT "%5.1" /end CHARACTERISTIC
/begin CHARACTERISTIC DFES_MeterOut.DFC_ComTOutTCU12_C "project specific calibration data / Project specific calibration data for DFC_ComTOutTCU12" VALUE 0x804F54B6 Val_Wu8 255.0 OneToOne 0.00 255.0 FORMAT "%5.1" /end CHARACTERISTIC
/begin CHARACTERISTIC DFES_MeterOut.DFC_ComTOutTCU13_C "project specific calibration data / Project specific calibration data for DFC_ComTOutTCU13" VALUE 0x804F54B7 Val_Wu8 255.0 OneToOne 0.00 255.0 FORMAT "%5.1" /end CHARACTERISTIC
/begin CHARACTERISTIC DFES_MeterOut.DFC_ComTOutTCU14_C "project specific calibration data / Project specific calibration data for DFC_ComTOutTCU14" VALUE 0x804F54B8 Val_Wu8 255.0 OneToOne 0.00 255.0 FORMAT "%5.1" /end CHARACTERISTIC
/begin CHARACTERISTIC DFES_MeterOut.DFC_ComTOutTCU2_C "project specific calibration data / Project specific calibration data for DFC_ComTOutTCU2" VALUE 0x804F54B9 Val_Wu8 255.0 OneToOne 0.00 255.0 FORMAT "%5.1" /end CHARACTERISTIC
/begin CHARACTERISTIC DFES_MeterOut.DFC_ComTOutTCU3_C "project specific calibration data / Project specific calibration data for DFC_ComTOutTCU3" VALUE 0x804F54BA Val_Wu8 255.0 OneToOne 0.00 255.0 FORMAT "%5.1" /end CHARACTERISTIC
/begin CHARACTERISTIC DFES_MeterOut.DFC_ComTOutTCU4_C "project specific calibration data / Project specific calibration data for DFC_ComTOutTCU4" VALUE 0x804F54BB Val_Wu8 255.0 OneToOne 0.00 255.0 FORMAT "%5.1" /end CHARACTERISTIC
/begin CHARACTERISTIC DFES_MeterOut.DFC_DevLibBattUHi_C "project specific calibration data / Project specific calibration data for DFC_DevLibBattUHi" VALUE 0x804F54BC Val_Wu8 255.0 OneToOne 0.00 255.0 FORMAT "%5.1" /end CHARACTERISTIC
/begin CHARACTERISTIC DFES_MeterOut.DFC_DevLibBattULo_C "project specific calibration data / Project specific calibration data for DFC_DevLibBattULo" VALUE 0x804F54BD Val_Wu8 255.0 OneToOne 0.00 255.0 FORMAT "%5.1" /end CHARACTERISTIC
/begin CHARACTERISTIC DFES_MeterOut.DFC_EGRVlvFailSafeActv_C "project specific calibration data / Project specific calibration data for DFC_EGRVlvFailSafeActv" VALUE 0x804F54BE Val_Wu8 255.0 OneToOne 0.00 255.0 FORMAT "%5.1" /end CHARACTERISTIC
/begin CHARACTERISTIC DFES_MeterOut.DFC_EGRVlvGovDvtCld_C "project specific calibration data / Project specific calibration data for DFC_EGRVlvGovDvtCld" VALUE 0x804F54BF Val_Wu8 255.0 OneToOne 0.00 255.0 FORMAT "%5.1" /end CHARACTERISTIC
/begin CHARACTERISTIC DFES_MeterOut.DFC_EGRVlvPhysSRCMax_C "project specific calibration data / Project specific calibration data for DFC_EGRVlvPhysSRCMax" VALUE 0x804F54C0 Val_Wu8 255.0 OneToOne 0.00 255.0 FORMAT "%5.1" /end CHARACTERISTIC
/begin CHARACTERISTIC DFES_MeterOut.DFC_EGRVlvPhysSRCMin_C "project specific calibration data / Project specific calibration data for DFC_EGRVlvPhysSRCMin" VALUE 0x804F54C1 Val_Wu8 255.0 OneToOne 0.00 255.0 FORMAT "%5.1" /end CHARACTERISTIC
/begin CHARACTERISTIC DFES_MeterOut.DFC_FanDIOOL_0_C "project specific calibration data / Project specific calibration data for DFC_FanDIOOL_0" VALUE 0x804F54C2 Val_Wu8 255.0 OneToOne 0.00 255.0 FORMAT "%5.1" /end CHARACTERISTIC
/begin CHARACTERISTIC DFES_MeterOut.DFC_FanDIOOL_1_C "project specific calibration data / Project specific calibration data for DFC_FanDIOOL_1" VALUE 0x804F54C3 Val_Wu8 255.0 OneToOne 0.00 255.0 FORMAT "%5.1" /end CHARACTERISTIC
/begin CHARACTERISTIC DFES_MeterOut.DFC_FanDIOOvrTemp_0_C "project specific calibration data / Project specific calibration data for DFC_FanDIOOvrTemp_0" VALUE 0x804F54C4 Val_Wu8 255.0 OneToOne 0.00 255.0 FORMAT "%5.1" /end CHARACTERISTIC
/begin CHARACTERISTIC DFES_MeterOut.DFC_FanDIOOvrTemp_1_C "project specific calibration data / Project specific calibration data for DFC_FanDIOOvrTemp_1" VALUE 0x804F54C5 Val_Wu8 255.0 OneToOne 0.00 255.0 FORMAT "%5.1" /end CHARACTERISTIC
/begin CHARACTERISTIC DFES_MeterOut.DFC_FanDIOSCB_0_C "project specific calibration data / Project specific calibration data for DFC_FanDIOSCB_0" VALUE 0x804F54C6 Val_Wu8 255.0 OneToOne 0.00 255.0 FORMAT "%5.1" /end CHARACTERISTIC
/begin CHARACTERISTIC DFES_MeterOut.DFC_FanDIOSCB_1_C "project specific calibration data / Project specific calibration data for DFC_FanDIOSCB_1" VALUE 0x804F54C7 Val_Wu8 255.0 OneToOne 0.00 255.0 FORMAT "%5.1" /end CHARACTERISTIC
/begin CHARACTERISTIC DFES_MeterOut.DFC_FanDIOSCG_0_C "project specific calibration data / Project specific calibration data for DFC_FanDIOSCG_0" VALUE 0x804F54C8 Val_Wu8 255.0 OneToOne 0.00 255.0 FORMAT "%5.1" /end CHARACTERISTIC
/begin CHARACTERISTIC DFES_MeterOut.DFC_FanDIOSCG_1_C "project specific calibration data / Project specific calibration data for DFC_FanDIOSCG_1" VALUE 0x804F54C9 Val_Wu8 255.0 OneToOne 0.00 255.0 FORMAT "%5.1" /end CHARACTERISTIC
/begin CHARACTERISTIC DFES_MeterOut.DFC_MRlyDcOL_C "project specific calibration data / Project specific calibration data for DFC_MRlyDcOL" VALUE 0x804F54CA Val_Wu8 255.0 OneToOne 0.00 255.0 FORMAT "%5.1" /end CHARACTERISTIC
/begin CHARACTERISTIC DFES_MeterOut.DFC_MRlyDcSCB_C "project specific calibration data / Project specific calibration data for DFC_MRlyDcSCB" VALUE 0x804F54CB Val_Wu8 255.0 OneToOne 0.00 255.0 FORMAT "%5.1" /end CHARACTERISTIC
/begin CHARACTERISTIC DFES_MeterOut.DFC_MRlyDcSCG_C "project specific calibration data / Project specific calibration data for DFC_MRlyDcSCG" VALUE 0x804F54CC Val_Wu8 255.0 OneToOne 0.00 255.0 FORMAT "%5.1" /end CHARACTERISTIC
/begin CHARACTERISTIC DFES_MeterOut.DFC_PSPOL_C "project specific calibration data / Project specific calibration data for DFC_PSPOL" VALUE 0x804F54CD Val_Wu8 255.0 OneToOne 0.00 255.0 FORMAT "%5.1" /end CHARACTERISTIC
/begin CHARACTERISTIC DFES_MeterOut.DFC_PSPOvrTemp_C "project specific calibration data / Project specific calibration data for DFC_PSPOvrTemp" VALUE 0x804F54CE Val_Wu8 255.0 OneToOne 0.00 255.0 FORMAT "%5.1" /end CHARACTERISTIC
/begin CHARACTERISTIC DFES_MeterOut.DFC_PSPSCB_C "project specific calibration data / Project specific calibration data for DFC_PSPSCB" VALUE 0x804F54CF Val_Wu8 255.0 OneToOne 0.00 255.0 FORMAT "%5.1" /end CHARACTERISTIC
/begin CHARACTERISTIC DFES_MeterOut.DFC_PSPSCG_C "project specific calibration data / Project specific calibration data for DFC_PSPSCG" VALUE 0x804F54D0 Val_Wu8 255.0 OneToOne 0.00 255.0 FORMAT "%5.1" /end CHARACTERISTIC
/begin CHARACTERISTIC DFES_MeterOut.DFC_T50Err_C "project specific calibration data / Project specific calibration data for DFC_T50Err" VALUE 0x804F54D1 Val_Wu8 255.0 OneToOne 0.00 255.0 FORMAT "%5.1" /end CHARACTERISTIC
/begin CHARACTERISTIC DFES_MeterOut.DFC_ThrVlvLoBattB1_C "project specific calibration data / Project specific calibration data for DFC_ThrVlvLoBattB1" VALUE 0x804F54D2 Val_Wu8 255.0 OneToOne 0.00 255.0 FORMAT "%5.1" /end CHARACTERISTIC
/begin CHARACTERISTIC DFES_MeterOut.DFC_UegoSigOperPlausS1B1_C "project specific calibration data / Project specific calibration data for DFC_UegoSigOperPlausS1B1" VALUE 0x804F54D3 Val_Wu8 255.0 OneToOne 0.00 255.0 FORMAT "%5.1" /end CHARACTERISTIC
/begin CHARACTERISTIC DFES_MeterOut.DFC_VehVPhysRngHi_C "project specific calibration data / Project specific calibration data for DFC_VehVPhysRngHi" VALUE 0x804F54D4 Val_Wu8 255.0 OneToOne 0.00 255.0 FORMAT "%5.1" /end CHARACTERISTIC
/begin CHARACTERISTIC DFES_MeterOut.DFC_VehVSclOutOL_C "project specific calibration data / Project specific calibration data for DFC_VehVSclOutOL" VALUE 0x804F54D5 Val_Wu8 255.0 OneToOne 0.00 255.0 FORMAT "%5.1" /end CHARACTERISTIC
/begin CHARACTERISTIC DFES_MeterOut.DFC_VehVSclOutOT_C "project specific calibration data / Project specific calibration data for DFC_VehVSclOutOT" VALUE 0x804F54D6 Val_Wu8 255.0 OneToOne 0.00 255.0 FORMAT "%5.1" /end CHARACTERISTIC
/begin CHARACTERISTIC DFES_MeterOut.DFC_VehVSclOutSCB_C "project specific calibration data / Project specific calibration data for DFC_VehVSclOutSCB" VALUE 0x804F54D7 Val_Wu8 255.0 OneToOne 0.00 255.0 FORMAT "%5.1" /end CHARACTERISTIC
/begin CHARACTERISTIC DFES_MeterOut.DFC_VehVSclOutSCG_C "project specific calibration data / Project specific calibration data for DFC_VehVSclOutSCG" VALUE 0x804F54D8 Val_Wu8 255.0 OneToOne 0.00 255.0 FORMAT "%5.1" /end CHARACTERISTIC
/begin CHARACTERISTIC DFES_MeterOut.DFC_VehVSigFL_C "project specific calibration data / Project specific calibration data for DFC_VehVSigFL" VALUE 0x804F54D9 Val_Wu8 255.0 OneToOne 0.00 255.0 FORMAT "%5.1" /end CHARACTERISTIC
/begin CHARACTERISTIC DFES_MeterOut.DFC_VehVSigFR_C "project specific calibration data / Project specific calibration data for DFC_VehVSigFR" VALUE 0x804F54DA Val_Wu8 255.0 OneToOne 0.00 255.0 FORMAT "%5.1" /end CHARACTERISTIC
/begin CHARACTERISTIC DFES_MeterOut.DFC_VehVSigRL_C "project specific calibration data / Project specific calibration data for DFC_VehVSigRL" VALUE 0x804F54DB Val_Wu8 255.0 OneToOne 0.00 255.0 FORMAT "%5.1" /end CHARACTERISTIC
/begin CHARACTERISTIC DFES_MeterOut.DFC_VehVSigRR_C "project specific calibration data / Project specific calibration data for DFC_VehVSigRR" VALUE 0x804F54DC Val_Wu8 255.0 OneToOne 0.00 255.0 FORMAT "%5.1" /end CHARACTERISTIC
/begin CHARACTERISTIC DFES_MeterOut.DFC_VehVSnsrARngHi_C "project specific calibration data / Project specific calibration data for DFC_VehVSnsrARngHi" VALUE 0x804F54DD Val_Wu8 255.0 OneToOne 0.00 255.0 FORMAT "%5.1" /end CHARACTERISTIC
/begin CHARACTERISTIC DFES_MeterOut.DFC_VehVSnsrBRngHi_C "project specific calibration data / Project specific calibration data for DFC_VehVSnsrBRngHi" VALUE 0x804F54DE Val_Wu8 255.0 OneToOne 0.00 255.0 FORMAT "%5.1" /end CHARACTERISTIC
/begin CHARACTERISTIC DFES_MeterOut.DFC_VehVSpdRtyDiag_C "project specific calibration data / Project specific calibration data for DFC_VehVSpdRtyDiag" VALUE 0x804F54DF Val_Wu8 255.0 OneToOne 0.00 255.0 FORMAT "%5.1" /end CHARACTERISTIC
/begin CHARACTERISTIC DFES_MeterOut.DFC_DHFHD_C "project specific calibration data / Project specific calibration data for DFC_DHFHD" VALUE 0x804F54E0 Val_Wu8 255.0 OneToOne 0.00 255.0 FORMAT "%5.1" /end CHARACTERISTIC
/begin CHARACTERISTIC DFES_MeterOut.DFC_InjVlv_DI_DcDc_C "project specific calibration data / Project specific calibration data for DFC_InjVlv_DI_DcDc" VALUE 0x804F54E1 Val_Wu8 255.0 OneToOne 0.00 255.0 FORMAT "%5.1" /end CHARACTERISTIC
/begin CHARACTERISTIC DFES_MeterOut.DFC_InjVlv_DI_NoLd_0_C "project specific calibration data / Project specific calibration data for DFC_InjVlv_DI_NoLd_0" VALUE 0x804F54E2 Val_Wu8 255.0 OneToOne 0.00 255.0 FORMAT "%5.1" /end CHARACTERISTIC
/begin CHARACTERISTIC DFES_MeterOut.DFC_InjVlv_DI_NoLd_1_C "project specific calibration data / Project specific calibration data for DFC_InjVlv_DI_NoLd_1" VALUE 0x804F54E3 Val_Wu8 255.0 OneToOne 0.00 255.0 FORMAT "%5.1" /end CHARACTERISTIC
/begin CHARACTERISTIC DFES_MeterOut.DFC_InjVlv_DI_NoLd_2_C "project specific calibration data / Project specific calibration data for DFC_InjVlv_DI_NoLd_2" VALUE 0x804F54E4 Val_Wu8 255.0 OneToOne 0.00 255.0 FORMAT "%5.1" /end CHARACTERISTIC
/begin CHARACTERISTIC DFES_MeterOut.DFC_InjVlv_DI_NoLd_3_C "project specific calibration data / Project specific calibration data for DFC_InjVlv_DI_NoLd_3" VALUE 0x804F54E5 Val_Wu8 255.0 OneToOne 0.00 255.0 FORMAT "%5.1" /end CHARACTERISTIC
/begin CHARACTERISTIC DFES_MeterOut.DFC_InjVlv_DI_ScBnk_0_C "project specific calibration data / Project specific calibration data for DFC_InjVlv_DI_ScBnk_0" VALUE 0x804F54E6 Val_Wu8 255.0 OneToOne 0.00 255.0 FORMAT "%5.1" /end CHARACTERISTIC
/begin CHARACTERISTIC DFES_MeterOut.DFC_InjVlv_DI_ScBnk_1_C "project specific calibration data / Project specific calibration data for DFC_InjVlv_DI_ScBnk_1" VALUE 0x804F54E7 Val_Wu8 255.0 OneToOne 0.00 255.0 FORMAT "%5.1" /end CHARACTERISTIC
/begin CHARACTERISTIC DFES_MeterOut.DFC_InjVlv_DI_ScBnk_2_C "project specific calibration data / Project specific calibration data for DFC_InjVlv_DI_ScBnk_2" VALUE 0x804F54E8 Val_Wu8 255.0 OneToOne 0.00 255.0 FORMAT "%5.1" /end CHARACTERISTIC
/begin CHARACTERISTIC DFES_MeterOut.DFC_InjVlv_DI_ScBnk_3_C "project specific calibration data / Project specific calibration data for DFC_InjVlv_DI_ScBnk_3" VALUE 0x804F54E9 Val_Wu8 255.0 OneToOne 0.00 255.0 FORMAT "%5.1" /end CHARACTERISTIC
/begin CHARACTERISTIC DFES_MeterOut.DFC_InjVlv_DI_ScCyl_0_C "project specific calibration data / Project specific calibration data for DFC_InjVlv_DI_ScCyl_0" VALUE 0x804F54EA Val_Wu8 255.0 OneToOne 0.00 255.0 FORMAT "%5.1" /end CHARACTERISTIC
/begin CHARACTERISTIC DFES_MeterOut.DFC_InjVlv_DI_ScCyl_1_C "project specific calibration data / Project specific calibration data for DFC_InjVlv_DI_ScCyl_1" VALUE 0x804F54EB Val_Wu8 255.0 OneToOne 0.00 255.0 FORMAT "%5.1" /end CHARACTERISTIC
/begin CHARACTERISTIC DFES_MeterOut.DFC_InjVlv_DI_ScCyl_2_C "project specific calibration data / Project specific calibration data for DFC_InjVlv_DI_ScCyl_2" VALUE 0x804F54EC Val_Wu8 255.0 OneToOne 0.00 255.0 FORMAT "%5.1" /end CHARACTERISTIC
/begin CHARACTERISTIC DFES_MeterOut.DFC_InjVlv_DI_ScCyl_3_C "project specific calibration data / Project specific calibration data for DFC_InjVlv_DI_ScCyl_3" VALUE 0x804F54ED Val_Wu8 255.0 OneToOne 0.00 255.0 FORMAT "%5.1" /end CHARACTERISTIC
/begin CHARACTERISTIC DFES_MeterOut.DFC_InjVlv_DI_ScHsLs_0_C "project specific calibration data / Project specific calibration data for DFC_InjVlv_DI_ScHsLs_0" VALUE 0x804F54EE Val_Wu8 255.0 OneToOne 0.00 255.0 FORMAT "%5.1" /end CHARACTERISTIC
/begin CHARACTERISTIC DFES_MeterOut.DFC_InjVlv_DI_ScHsLs_1_C "project specific calibration data / Project specific calibration data for DFC_InjVlv_DI_ScHsLs_1" VALUE 0x804F54EF Val_Wu8 255.0 OneToOne 0.00 255.0 FORMAT "%5.1" /end CHARACTERISTIC
/begin CHARACTERISTIC DFES_MeterOut.DFC_InjVlv_DI_ScHsLs_2_C "project specific calibration data / Project specific calibration data for DFC_InjVlv_DI_ScHsLs_2" VALUE 0x804F54F0 Val_Wu8 255.0 OneToOne 0.00 255.0 FORMAT "%5.1" /end CHARACTERISTIC
/begin CHARACTERISTIC DFES_MeterOut.DFC_InjVlv_DI_ScHsLs_3_C "project specific calibration data / Project specific calibration data for DFC_InjVlv_DI_ScHsLs_3" VALUE 0x804F54F1 Val_Wu8 255.0 OneToOne 0.00 255.0 FORMAT "%5.1" /end CHARACTERISTIC
/begin CHARACTERISTIC DFES_MeterOut.DFC_MfPsDiaOpenLoad1_C "project specific calibration data / Project specific calibration data for DFC_MfPsDiaOpenLoad1" VALUE 0x804F54F2 Val_Wu8 255.0 OneToOne 0.00 255.0 FORMAT "%5.1" /end CHARACTERISTIC
/begin CHARACTERISTIC DFES_MeterOut.DFC_MfPsDiaScHiS1_C "project specific calibration data / Project specific calibration data for DFC_MfPsDiaScHiS1" VALUE 0x804F54F3 Val_Wu8 255.0 OneToOne 0.00 255.0 FORMAT "%5.1" /end CHARACTERISTIC
/begin CHARACTERISTIC DFES_MeterOut.DFC_MfPsDiaScHiSLowS1_C "project specific calibration data / Project specific calibration data for DFC_MfPsDiaScHiSLowS1" VALUE 0x804F54F4 Val_Wu8 255.0 OneToOne 0.00 255.0 FORMAT "%5.1" /end CHARACTERISTIC
/begin CHARACTERISTIC DFES_MeterOut.DFC_MfPsDiaScLowS1_C "project specific calibration data / Project specific calibration data for DFC_MfPsDiaScLowS1" VALUE 0x804F54F5 Val_Wu8 255.0 OneToOne 0.00 255.0 FORMAT "%5.1" /end CHARACTERISTIC
/begin CHARACTERISTIC DFES_MeterOut.DFC_ACEvpTPhysRngHi_C "project specific calibration data / Project specific calibration data for DFC_ACEvpTPhysRngHi" VALUE 0x804F54F6 Val_Wu8 255.0 OneToOne 0.00 255.0 FORMAT "%5.1" /end CHARACTERISTIC
/begin CHARACTERISTIC DFES_MeterOut.DFC_ACEvpTPhysRngLo_C "project specific calibration data / Project specific calibration data for DFC_ACEvpTPhysRngLo" VALUE 0x804F54F7 Val_Wu8 255.0 OneToOne 0.00 255.0 FORMAT "%5.1" /end CHARACTERISTIC
/begin CHARACTERISTIC DFES_MeterOut.DFC_ACEvpTSRCMax_C "project specific calibration data / Project specific calibration data for DFC_ACEvpTSRCMax" VALUE 0x804F54F8 Val_Wu8 255.0 OneToOne 0.00 255.0 FORMAT "%5.1" /end CHARACTERISTIC
/begin CHARACTERISTIC DFES_MeterOut.DFC_ACEvpTSRCMin_C "project specific calibration data / Project specific calibration data for DFC_ACEvpTSRCMin" VALUE 0x804F54F9 Val_Wu8 255.0 OneToOne 0.00 255.0 FORMAT "%5.1" /end CHARACTERISTIC
/begin CHARACTERISTIC DFES_MeterOut.DFC_AfsRawSigRngHiB1_C "project specific calibration data / Project specific calibration data for DFC_AfsRawSigRngHiB1" VALUE 0x804F54FA Val_Wu8 255.0 OneToOne 0.00 255.0 FORMAT "%5.1" /end CHARACTERISTIC
/begin CHARACTERISTIC DFES_MeterOut.DFC_AfsRawSigRngLoB1_C "project specific calibration data / Project specific calibration data for DFC_AfsRawSigRngLoB1" VALUE 0x804F54FB Val_Wu8 255.0 OneToOne 0.00 255.0 FORMAT "%5.1" /end CHARACTERISTIC
/begin CHARACTERISTIC DFES_MeterOut.DFC_AfsSnsrErrB1_C "project specific calibration data / Project specific calibration data for DFC_AfsSnsrErrB1" VALUE 0x804F54FC Val_Wu8 255.0 OneToOne 0.00 255.0 FORMAT "%5.1" /end CHARACTERISTIC
/begin CHARACTERISTIC DFES_MeterOut.DFC_AirCClntPAnaSRCMax_C "project specific calibration data / Project specific calibration data for DFC_AirCClntPAnaSRCMax" VALUE 0x804F54FD Val_Wu8 255.0 OneToOne 0.00 255.0 FORMAT "%5.1" /end CHARACTERISTIC
/begin CHARACTERISTIC DFES_MeterOut.DFC_AirCClntPAnaSRCMin_C "project specific calibration data / Project specific calibration data for DFC_AirCClntPAnaSRCMin" VALUE 0x804F54FE Val_Wu8 255.0 OneToOne 0.00 255.0 FORMAT "%5.1" /end CHARACTERISTIC
/begin CHARACTERISTIC DFES_MeterOut.DFC_AirCSwtNpl_C "project specific calibration data / Project specific calibration data for DFC_AirCSwtNpl" VALUE 0x804F54FF Val_Wu8 255.0 OneToOne 0.00 255.0 FORMAT "%5.1" /end CHARACTERISTIC
/begin CHARACTERISTIC DFES_MeterOut.DFC_AirCSwtSig_C "project specific calibration data / Project specific calibration data for DFC_AirCSwtSig" VALUE 0x804F5500 Val_Wu8 255.0 OneToOne 0.00 255.0 FORMAT "%5.1" /end CHARACTERISTIC
/begin CHARACTERISTIC DFES_MeterOut.DFC_Brk_C "project specific calibration data / Project specific calibration data for DFC_Brk" VALUE 0x804F5501 Val_Wu8 255.0 OneToOne 0.00 255.0 FORMAT "%5.1" /end CHARACTERISTIC
/begin CHARACTERISTIC DFES_MeterOut.DFC_BrkBstSensSCB_C "project specific calibration data / Project specific calibration data for DFC_BrkBstSensSCB" VALUE 0x804F5502 Val_Wu8 255.0 OneToOne 0.00 255.0 FORMAT "%5.1" /end CHARACTERISTIC
/begin CHARACTERISTIC DFES_MeterOut.DFC_BrkBstSensSCG_C "project specific calibration data / Project specific calibration data for DFC_BrkBstSensSCG" VALUE 0x804F5503 Val_Wu8 255.0 OneToOne 0.00 255.0 FORMAT "%5.1" /end CHARACTERISTIC
/begin CHARACTERISTIC DFES_MeterOut.DFC_BrkSig_C "project specific calibration data / Project specific calibration data for DFC_BrkSig" VALUE 0x804F5504 Val_Wu8 255.0 OneToOne 0.00 255.0 FORMAT "%5.1" /end CHARACTERISTIC
/begin CHARACTERISTIC DFES_MeterOut.DFC_ClthSig_C "project specific calibration data / Project specific calibration data for DFC_ClthSig" VALUE 0x804F5505 Val_Wu8 255.0 OneToOne 0.00 255.0 FORMAT "%5.1" /end CHARACTERISTIC
/begin CHARACTERISTIC DFES_MeterOut.DFC_EGRVlvCurrLim_C "project specific calibration data / Project specific calibration data for DFC_EGRVlvCurrLim" VALUE 0x804F5506 Val_Wu8 255.0 OneToOne 0.00 255.0 FORMAT "%5.1" /end CHARACTERISTIC
/begin CHARACTERISTIC DFES_MeterOut.DFC_EGRVlvOL_C "project specific calibration data / Project specific calibration data for DFC_EGRVlvOL" VALUE 0x804F5507 Val_Wu8 255.0 OneToOne 0.00 255.0 FORMAT "%5.1" /end CHARACTERISTIC
/begin CHARACTERISTIC DFES_MeterOut.DFC_EGRVlvOvrTemp_C "project specific calibration data / Project specific calibration data for DFC_EGRVlvOvrTemp" VALUE 0x804F5508 Val_Wu8 255.0 OneToOne 0.00 255.0 FORMAT "%5.1" /end CHARACTERISTIC
/begin CHARACTERISTIC DFES_MeterOut.DFC_EGRVlvSCB_C "project specific calibration data / Project specific calibration data for DFC_EGRVlvSCB" VALUE 0x804F5509 Val_Wu8 255.0 OneToOne 0.00 255.0 FORMAT "%5.1" /end CHARACTERISTIC
/begin CHARACTERISTIC DFES_MeterOut.DFC_EGRVlvSCG_C "project specific calibration data / Project specific calibration data for DFC_EGRVlvSCG" VALUE 0x804F550A Val_Wu8 255.0 OneToOne 0.00 255.0 FORMAT "%5.1" /end CHARACTERISTIC
/begin CHARACTERISTIC DFES_MeterOut.DFC_EGRVlvSRCMax_C "project specific calibration data / Project specific calibration data for DFC_EGRVlvSRCMax" VALUE 0x804F550B Val_Wu8 255.0 OneToOne 0.00 255.0 FORMAT "%5.1" /end CHARACTERISTIC
/begin CHARACTERISTIC DFES_MeterOut.DFC_EGRVlvSRCMin_C "project specific calibration data / Project specific calibration data for DFC_EGRVlvSRCMin" VALUE 0x804F550C Val_Wu8 255.0 OneToOne 0.00 255.0 FORMAT "%5.1" /end CHARACTERISTIC
/begin CHARACTERISTIC DFES_MeterOut.DFC_HLSDemOvhtEngLim_C "project specific calibration data / Project specific calibration data for DFC_HLSDemOvhtEngLim" VALUE 0x804F550D Val_Wu8 255.0 OneToOne 0.00 255.0 FORMAT "%5.1" /end CHARACTERISTIC
/begin CHARACTERISTIC DFES_MeterOut.DFC_OilPSwmpSRCMax_C "project specific calibration data / Project specific calibration data for DFC_OilPSwmpSRCMax" VALUE 0x804F550E Val_Wu8 255.0 OneToOne 0.00 255.0 FORMAT "%5.1" /end CHARACTERISTIC
/begin CHARACTERISTIC DFES_MeterOut.DFC_OilPSwmpSRCMin_C "project specific calibration data / Project specific calibration data for DFC_OilPSwmpSRCMin" VALUE 0x804F550F Val_Wu8 255.0 OneToOne 0.00 255.0 FORMAT "%5.1" /end CHARACTERISTIC
/begin CHARACTERISTIC DFES_MeterOut.DFC_PIntkVUsLineHiB1_C "project specific calibration data / Project specific calibration data for DFC_PIntkVUsLineHiB1" VALUE 0x804F5510 Val_Wu8 255.0 OneToOne 0.00 255.0 FORMAT "%5.1" /end CHARACTERISTIC
/begin CHARACTERISTIC DFES_MeterOut.DFC_PIntkVUsLineLoB1_C "project specific calibration data / Project specific calibration data for DFC_PIntkVUsLineLoB1" VALUE 0x804F5511 Val_Wu8 255.0 OneToOne 0.00 255.0 FORMAT "%5.1" /end CHARACTERISTIC
/begin CHARACTERISTIC DFES_MeterOut.DFC_VehVPhysRngLo_C "project specific calibration data / Project specific calibration data for DFC_VehVPhysRngLo" VALUE 0x804F5512 Val_Wu8 255.0 OneToOne 0.00 255.0 FORMAT "%5.1" /end CHARACTERISTIC
/begin CHARACTERISTIC DFES_MeterOut.DFC_VehVSigCan_C "project specific calibration data / Project specific calibration data for DFC_VehVSigCan" VALUE 0x804F5513 Val_Wu8 255.0 OneToOne 0.00 255.0 FORMAT "%5.1" /end CHARACTERISTIC
/begin CHARACTERISTIC DFES_MeterOut.DFC_VehVSigCanSafe_C "project specific calibration data / Project specific calibration data for DFC_VehVSigCanSafe" VALUE 0x804F5514 Val_Wu8 255.0 OneToOne 0.00 255.0 FORMAT "%5.1" /end CHARACTERISTIC
/begin CHARACTERISTIC DFES_MeterOut.DFC_VlvLftFbOilPSnsrIntk11SRCMax_C "project specific calibration data / Project specific calibration data for DFC_VlvLftFbOilPSnsrIntk11SRCMax" VALUE 0x804F5515 Val_Wu8 255.0 OneToOne 0.00 255.0 FORMAT "%5.1" /end CHARACTERISTIC
/begin CHARACTERISTIC DFES_MeterOut.DFC_VlvLftFbOilPSnsrIntk11SRCMin_C "project specific calibration data / Project specific calibration data for DFC_VlvLftFbOilPSnsrIntk11SRCMin" VALUE 0x804F5516 Val_Wu8 255.0 OneToOne 0.00 255.0 FORMAT "%5.1" /end CHARACTERISTIC
/begin CHARACTERISTIC DFES_MeterOut.DFC_ClthNpl_C "project specific calibration data / Project specific calibration data for DFC_ClthNpl" VALUE 0x804F5517 Val_Wu8 255.0 OneToOne 0.00 255.0 FORMAT "%5.1" /end CHARACTERISTIC
/begin CHARACTERISTIC DFES_MeterOut.DFC_GbxPNPosnDrvCdn_C "project specific calibration data / Project specific calibration data for DFC_GbxPNPosnDrvCdn" VALUE 0x804F5518 Val_Wu8 255.0 OneToOne 0.00 255.0 FORMAT "%5.1" /end CHARACTERISTIC
/begin CHARACTERISTIC DFES_MeterOut.DFC_GbxPNPosnPlausy_C "project specific calibration data / Project specific calibration data for DFC_GbxPNPosnPlausy" VALUE 0x804F5519 Val_Wu8 255.0 OneToOne 0.00 255.0 FORMAT "%5.1" /end CHARACTERISTIC
/begin CHARACTERISTIC DFES_MeterOut.DFC_AfsSigErrLineHiB1_C "project specific calibration data / Project specific calibration data for DFC_AfsSigErrLineHiB1" VALUE 0x804F551A Val_Wu8 255.0 OneToOne 0.00 255.0 FORMAT "%5.1" /end CHARACTERISTIC
/begin CHARACTERISTIC DFES_MeterOut.DFC_AfsSigErrLineLoB1_C "project specific calibration data / Project specific calibration data for DFC_AfsSigErrLineLoB1" VALUE 0x804F551B Val_Wu8 255.0 OneToOne 0.00 255.0 FORMAT "%5.1" /end CHARACTERISTIC
/begin CHARACTERISTIC DFES_MeterOut.DFC_PEnvCcMax_C "project specific calibration data / Project specific calibration data for DFC_PEnvCcMax" VALUE 0x804F551C Val_Wu8 255.0 OneToOne 0.00 255.0 FORMAT "%5.1" /end CHARACTERISTIC
/begin CHARACTERISTIC DFES_MeterOut.DFC_PEnvCcMin_C "project specific calibration data / Project specific calibration data for DFC_PEnvCcMin" VALUE 0x804F551D Val_Wu8 255.0 OneToOne 0.00 255.0 FORMAT "%5.1" /end CHARACTERISTIC
/begin CHARACTERISTIC DFES_MeterOut.DFC_PEnvRngChkMax_C "project specific calibration data / Project specific calibration data for DFC_PEnvRngChkMax" VALUE 0x804F551E Val_Wu8 255.0 OneToOne 0.00 255.0 FORMAT "%5.1" /end CHARACTERISTIC
/begin CHARACTERISTIC DFES_MeterOut.DFC_PEnvRngChkMin_C "project specific calibration data / Project specific calibration data for DFC_PEnvRngChkMin" VALUE 0x804F551F Val_Wu8 255.0 OneToOne 0.00 255.0 FORMAT "%5.1" /end CHARACTERISTIC
/begin CHARACTERISTIC DFES_MeterOut.DFC_PEnvSnsrPlaus_C "project specific calibration data / Project specific calibration data for DFC_PEnvSnsrPlaus" VALUE 0x804F5520 Val_Wu8 255.0 OneToOne 0.00 255.0 FORMAT "%5.1" /end CHARACTERISTIC
/begin CHARACTERISTIC DFES_MeterOut.DFC_UEGOHeatrRlyPsOLS1B1_C "project specific calibration data / Project specific calibration data for DFC_UEGOHeatrRlyPsOLS1B1" VALUE 0x804F5521 Val_Wu8 255.0 OneToOne 0.00 255.0 FORMAT "%5.1" /end CHARACTERISTIC
/begin CHARACTERISTIC DFES_MeterOut.DFC_UEGOHeatrRlyPsSCBS1B1_C "project specific calibration data / Project specific calibration data for DFC_UEGOHeatrRlyPsSCBS1B1" VALUE 0x804F5522 Val_Wu8 255.0 OneToOne 0.00 255.0 FORMAT "%5.1" /end CHARACTERISTIC
/begin CHARACTERISTIC DFES_MeterOut.DFC_UEGOHeatrRlyPsSCGS1B1_C "project specific calibration data / Project specific calibration data for DFC_UEGOHeatrRlyPsSCGS1B1" VALUE 0x804F5523 Val_Wu8 255.0 OneToOne 0.00 255.0 FORMAT "%5.1" /end CHARACTERISTIC
/begin CHARACTERISTIC DFES_MeterOut.DFC_UegoHeatrWireOlS1B1_C "project specific calibration data / Project specific calibration data for DFC_UegoHeatrWireOlS1B1" VALUE 0x804F5524 Val_Wu8 255.0 OneToOne 0.00 255.0 FORMAT "%5.1" /end CHARACTERISTIC
/begin CHARACTERISTIC DFES_MeterOut.DFC_UegoHeatrWireScbS1B1_C "project specific calibration data / Project specific calibration data for DFC_UegoHeatrWireScbS1B1" VALUE 0x804F5525 Val_Wu8 255.0 OneToOne 0.00 255.0 FORMAT "%5.1" /end CHARACTERISTIC
/begin CHARACTERISTIC DFES_MeterOut.DFC_UegoHeatrWireScgS1B1_C "project specific calibration data / Project specific calibration data for DFC_UegoHeatrWireScgS1B1" VALUE 0x804F5526 Val_Wu8 255.0 OneToOne 0.00 255.0 FORMAT "%5.1" /end CHARACTERISTIC
/begin CHARACTERISTIC DFES_MeterOut.DFC_KnDetSens1PortAMax_C "project specific calibration data / Project specific calibration data for DFC_KnDetSens1PortAMax" VALUE 0x804F5527 Val_Wu8 255.0 OneToOne 0.00 255.0 FORMAT "%5.1" /end CHARACTERISTIC
/begin CHARACTERISTIC DFES_MeterOut.DFC_KnDetSens1PortAMin_C "project specific calibration data / Project specific calibration data for DFC_KnDetSens1PortAMin" VALUE 0x804F5528 Val_Wu8 255.0 OneToOne 0.00 255.0 FORMAT "%5.1" /end CHARACTERISTIC
/begin CHARACTERISTIC DFES_MeterOut.DFC_KnDetSens1PortBMax_C "project specific calibration data / Project specific calibration data for DFC_KnDetSens1PortBMax" VALUE 0x804F5529 Val_Wu8 255.0 OneToOne 0.00 255.0 FORMAT "%5.1" /end CHARACTERISTIC
/begin CHARACTERISTIC DFES_MeterOut.DFC_KnDetSens1PortBMin_C "project specific calibration data / Project specific calibration data for DFC_KnDetSens1PortBMin" VALUE 0x804F552A Val_Wu8 255.0 OneToOne 0.00 255.0 FORMAT "%5.1" /end CHARACTERISTIC
/begin CHARACTERISTIC DFES_MeterOut.DFC_Clth2ONStuck_C "project specific calibration data / Project specific calibration data for DFC_Clth2ONStuck" VALUE 0x804F552B Val_Wu8 255.0 OneToOne 0.00 255.0 FORMAT "%5.1" /end CHARACTERISTIC
/begin CHARACTERISTIC DFES_MeterOut.DFC_Clth2ONStuckLdc_C "project specific calibration data / Project specific calibration data for DFC_Clth2ONStuckLdc" VALUE 0x804F552C Val_Wu8 255.0 OneToOne 0.00 255.0 FORMAT "%5.1" /end CHARACTERISTIC
/begin CHARACTERISTIC DFES_MeterOut.DFC_Clth3ONStuckLdc_C "project specific calibration data / Project specific calibration data for DFC_Clth3ONStuckLdc" VALUE 0x804F552D Val_Wu8 255.0 OneToOne 0.00 255.0 FORMAT "%5.1" /end CHARACTERISTIC
/begin CHARACTERISTIC DFES_MeterOut.DFC_Clth3ONStuckPostDrv_C "project specific calibration data / Project specific calibration data for DFC_Clth3ONStuckPostDrv" VALUE 0x804F552E Val_Wu8 255.0 OneToOne 0.00 255.0 FORMAT "%5.1" /end CHARACTERISTIC
/begin CHARACTERISTIC DFES_MeterOut.DFC_Clth4ONStuck_C "project specific calibration data / Project specific calibration data for DFC_Clth4ONStuck" VALUE 0x804F552F Val_Wu8 255.0 OneToOne 0.00 255.0 FORMAT "%5.1" /end CHARACTERISTIC
/begin CHARACTERISTIC DFES_MeterOut.DFC_Clth4ONStuckLdc_C "project specific calibration data / Project specific calibration data for DFC_Clth4ONStuckLdc" VALUE 0x804F5530 Val_Wu8 255.0 OneToOne 0.00 255.0 FORMAT "%5.1" /end CHARACTERISTIC
/begin CHARACTERISTIC DFES_MeterOut.DFC_ComBCMUnit_C "project specific calibration data / Project specific calibration data for DFC_ComBCMUnit" VALUE 0x804F5531 Val_Wu8 255.0 OneToOne 0.00 255.0 FORMAT "%5.1" /end CHARACTERISTIC
/begin CHARACTERISTIC DFES_MeterOut.DFC_ComDLCTCU01_C "project specific calibration data / Project specific calibration data for DFC_ComDLCTCU01" VALUE 0x804F5532 Val_Wu8 255.0 OneToOne 0.00 255.0 FORMAT "%5.1" /end CHARACTERISTIC
/begin CHARACTERISTIC DFES_MeterOut.DFC_ComDLCTCU02_C "project specific calibration data / Project specific calibration data for DFC_ComDLCTCU02" VALUE 0x804F5533 Val_Wu8 255.0 OneToOne 0.00 255.0 FORMAT "%5.1" /end CHARACTERISTIC
/begin CHARACTERISTIC DFES_MeterOut.DFC_ComDLCTCU1_C "project specific calibration data / Project specific calibration data for DFC_ComDLCTCU1" VALUE 0x804F5534 Val_Wu8 255.0 OneToOne 0.00 255.0 FORMAT "%5.1" /end CHARACTERISTIC
/begin CHARACTERISTIC DFES_MeterOut.DFC_ComDLCTCU11_C "project specific calibration data / Project specific calibration data for DFC_ComDLCTCU11" VALUE 0x804F5535 Val_Wu8 255.0 OneToOne 0.00 255.0 FORMAT "%5.1" /end CHARACTERISTIC
/begin CHARACTERISTIC DFES_MeterOut.DFC_ComDLCTCU12_C "project specific calibration data / Project specific calibration data for DFC_ComDLCTCU12" VALUE 0x804F5536 Val_Wu8 255.0 OneToOne 0.00 255.0 FORMAT "%5.1" /end CHARACTERISTIC
/begin CHARACTERISTIC DFES_MeterOut.DFC_ComDLCTCU13_C "project specific calibration data / Project specific calibration data for DFC_ComDLCTCU13" VALUE 0x804F5537 Val_Wu8 255.0 OneToOne 0.00 255.0 FORMAT "%5.1" /end CHARACTERISTIC
/begin CHARACTERISTIC DFES_MeterOut.DFC_ComDLCTCU14_C "project specific calibration data / Project specific calibration data for DFC_ComDLCTCU14" VALUE 0x804F5538 Val_Wu8 255.0 OneToOne 0.00 255.0 FORMAT "%5.1" /end CHARACTERISTIC
/begin CHARACTERISTIC DFES_MeterOut.DFC_ComDLCTCU2_C "project specific calibration data / Project specific calibration data for DFC_ComDLCTCU2" VALUE 0x804F5539 Val_Wu8 255.0 OneToOne 0.00 255.0 FORMAT "%5.1" /end CHARACTERISTIC
/begin CHARACTERISTIC DFES_MeterOut.DFC_ComDLCTCU3_C "project specific calibration data / Project specific calibration data for DFC_ComDLCTCU3" VALUE 0x804F553A Val_Wu8 255.0 OneToOne 0.00 255.0 FORMAT "%5.1" /end CHARACTERISTIC
/begin CHARACTERISTIC DFES_MeterOut.DFC_ComDLCTCU4_C "project specific calibration data / Project specific calibration data for DFC_ComDLCTCU4" VALUE 0x804F553B Val_Wu8 255.0 OneToOne 0.00 255.0 FORMAT "%5.1" /end CHARACTERISTIC
/begin CHARACTERISTIC DFES_MeterOut.DFC_ComEPSUnit_C "project specific calibration data / Project specific calibration data for DFC_ComEPSUnit" VALUE 0x804F553C Val_Wu8 255.0 OneToOne 0.00 255.0 FORMAT "%5.1" /end CHARACTERISTIC
/begin CHARACTERISTIC DFES_MeterOut.DFC_ComIDASBUnit_C "project specific calibration data / Project specific calibration data for DFC_ComIDASBUnit" VALUE 0x804F553D Val_Wu8 255.0 OneToOne 0.00 255.0 FORMAT "%5.1" /end CHARACTERISTIC
/begin CHARACTERISTIC DFES_MeterOut.DFC_ComIMGUnit_C "project specific calibration data / Project specific calibration data for DFC_ComIMGUnit" VALUE 0x804F553E Val_Wu8 255.0 OneToOne 0.00 255.0 FORMAT "%5.1" /end CHARACTERISTIC
/begin CHARACTERISTIC DFES_MeterOut.DFC_ComMETUnit_C "project specific calibration data / Project specific calibration data for DFC_ComMETUnit" VALUE 0x804F553F Val_Wu8 255.0 OneToOne 0.00 255.0 FORMAT "%5.1" /end CHARACTERISTIC
/begin CHARACTERISTIC DFES_MeterOut.DFC_ComSRSUnit_C "project specific calibration data / Project specific calibration data for DFC_ComSRSUnit" VALUE 0x804F5540 Val_Wu8 255.0 OneToOne 0.00 255.0 FORMAT "%5.1" /end CHARACTERISTIC
/begin CHARACTERISTIC DFES_MeterOut.DFC_ComVSAUnit_C "project specific calibration data / Project specific calibration data for DFC_ComVSAUnit" VALUE 0x804F5541 Val_Wu8 255.0 OneToOne 0.00 255.0 FORMAT "%5.1" /end CHARACTERISTIC
/begin CHARACTERISTIC DFES_MeterOut.DFC_EbsSocFlt_C "project specific calibration data / Project specific calibration data for DFC_EbsSocFlt" VALUE 0x804F5542 Val_Wu8 255.0 OneToOne 0.00 255.0 FORMAT "%5.1" /end CHARACTERISTIC
/begin CHARACTERISTIC DFES_MeterOut.DFC_I14229VINErr_C "project specific calibration data / Project specific calibration data for DFC_I14229VINErr" VALUE 0x804F5543 Val_Wu8 255.0 OneToOne 0.00 255.0 FORMAT "%5.1" /end CHARACTERISTIC
/begin CHARACTERISTIC DFES_MeterOut.DFC_InjCatHeatgErr_C "project specific calibration data / Project specific calibration data for DFC_InjCatHeatgErr" VALUE 0x804F5544 Val_Wu8 255.0 OneToOne 0.00 255.0 FORMAT "%5.1" /end CHARACTERISTIC
/begin CHARACTERISTIC DFES_MeterOut.DFC_InjSysMulInjDiagErr_C "project specific calibration data / Project specific calibration data for DFC_InjSysMulInjDiagErr" VALUE 0x804F5545 Val_Wu8 255.0 OneToOne 0.00 255.0 FORMAT "%5.1" /end CHARACTERISTIC
/begin CHARACTERISTIC DFES_MeterOut.DFC_LLRHmax_C "project specific calibration data / Project specific calibration data for DFC_LLRHmax" VALUE 0x804F5546 Val_Wu8 255.0 OneToOne 0.00 255.0 FORMAT "%5.1" /end CHARACTERISTIC
/begin CHARACTERISTIC DFES_MeterOut.DFC_LLRHmin_C "project specific calibration data / Project specific calibration data for DFC_LLRHmin" VALUE 0x804F5547 Val_Wu8 255.0 OneToOne 0.00 255.0 FORMAT "%5.1" /end CHARACTERISTIC
/begin CHARACTERISTIC DFES_MeterOut.DFC_LLRHnpl_C "project specific calibration data / Project specific calibration data for DFC_LLRHnpl" VALUE 0x804F5548 Val_Wu8 255.0 OneToOne 0.00 255.0 FORMAT "%5.1" /end CHARACTERISTIC
/begin CHARACTERISTIC DFES_MeterOut.DFC_LLRKHmax_C "project specific calibration data / Project specific calibration data for DFC_LLRKHmax" VALUE 0x804F5549 Val_Wu8 255.0 OneToOne 0.00 255.0 FORMAT "%5.1" /end CHARACTERISTIC
/begin CHARACTERISTIC DFES_MeterOut.DFC_LLRKHmin_C "project specific calibration data / Project specific calibration data for DFC_LLRKHmin" VALUE 0x804F554A Val_Wu8 255.0 OneToOne 0.00 255.0 FORMAT "%5.1" /end CHARACTERISTIC
/begin CHARACTERISTIC DFES_MeterOut.DFC_LLRKHnpl_C "project specific calibration data / Project specific calibration data for DFC_LLRKHnpl" VALUE 0x804F554B Val_Wu8 255.0 OneToOne 0.00 255.0 FORMAT "%5.1" /end CHARACTERISTIC
/begin CHARACTERISTIC DFES_MeterOut.DFC_LinACGUnit_C "project specific calibration data / Project specific calibration data for DFC_LinACGUnit" VALUE 0x804F554C Val_Wu8 255.0 OneToOne 0.00 255.0 FORMAT "%5.1" /end CHARACTERISTIC
/begin CHARACTERISTIC DFES_MeterOut.DFC_LinAEVUnit_C "project specific calibration data / Project specific calibration data for DFC_LinAEVUnit" VALUE 0x804F554D Val_Wu8 255.0 OneToOne 0.00 255.0 FORMAT "%5.1" /end CHARACTERISTIC
/begin CHARACTERISTIC DFES_MeterOut.DFC_LinEBSUnit_C "project specific calibration data / Project specific calibration data for DFC_LinEBSUnit" VALUE 0x804F554E Val_Wu8 255.0 OneToOne 0.00 255.0 FORMAT "%5.1" /end CHARACTERISTIC
/begin CHARACTERISTIC DFES_MeterOut.DFC_RoughRoad_C "project specific calibration data / Project specific calibration data for DFC_RoughRoad" VALUE 0x804F554F Val_Wu8 255.0 OneToOne 0.00 255.0 FORMAT "%5.1" /end CHARACTERISTIC
/begin CHARACTERISTIC DFES_MeterOut.DFC_SiaEEPRdErr_C "project specific calibration data / Project specific calibration data for DFC_SiaEEPRdErr" VALUE 0x804F5550 Val_Wu8 255.0 OneToOne 0.00 255.0 FORMAT "%5.1" /end CHARACTERISTIC
/begin CHARACTERISTIC DFES_MeterOut.DFC_SiaEEPWrngCod_C "project specific calibration data / Project specific calibration data for DFC_SiaEEPWrngCod" VALUE 0x804F5551 Val_Wu8 255.0 OneToOne 0.00 255.0 FORMAT "%5.1" /end CHARACTERISTIC
/begin CHARACTERISTIC DFES_MeterOut.DFC_UegoHeatrStrtS1B1_C "project specific calibration data / Project specific calibration data for DFC_UegoHeatrStrtS1B1" VALUE 0x804F5552 Val_Wu8 255.0 OneToOne 0.00 255.0 FORMAT "%5.1" /end CHARACTERISTIC
/begin CHARACTERISTIC DFES_MeterOut.DFC_BusDiagCANAPPLBusOff_C "project specific calibration data / Project specific calibration data for DFC_BusDiagCANAPPLBusOff" VALUE 0x804F5553 Val_Wu8 255.0 OneToOne 0.00 255.0 FORMAT "%5.1" /end CHARACTERISTIC
/begin CHARACTERISTIC DFES_MeterOut.DFC_BusDiagCANCANCBusOff_C "project specific calibration data / Project specific calibration data for DFC_BusDiagCANCANCBusOff" VALUE 0x804F5554 Val_Wu8 255.0 OneToOne 0.00 255.0 FORMAT "%5.1" /end CHARACTERISTIC
/begin CHARACTERISTIC DFES_MeterOut.DFC_BusDiagCANVEHICLEBusOff_C "project specific calibration data / Project specific calibration data for DFC_BusDiagCANVEHICLEBusOff" VALUE 0x804F5555 Val_Wu8 255.0 OneToOne 0.00 255.0 FORMAT "%5.1" /end CHARACTERISTIC
/begin CHARACTERISTIC DFES_MeterOut.DFC_RBA_IODIAGPWR_rba_IoExtCy329_SignalVltSply_0_C "project specific calibration data / Project specific calibration data for DFC_RBA_IODIAGPWR_rba_IoExtCy329_SignalVltSply_0" VALUE 0x804F5556 Val_Wu8 255.0 OneToOne 0.00 255.0 FORMAT "%5.1" /end CHARACTERISTIC
/begin CHARACTERISTIC DFES_MeterOut.DFC_RBA_IODIAGPWR_rba_IoExtCy329_SignalVltSply_0OT_C "project specific calibration data / Project specific calibration data for DFC_RBA_IODIAGPWR_rba_IoExtCy329_SignalVltSply_0OT" VALUE 0x804F5557 Val_Wu8 255.0 OneToOne 0.00 255.0 FORMAT "%5.1" /end CHARACTERISTIC
/begin CHARACTERISTIC DFES_MeterOut.DFC_RBA_IODIAGPWR_rba_IoExtCy329_SignalVltSply_0OV_C "project specific calibration data / Project specific calibration data for DFC_RBA_IODIAGPWR_rba_IoExtCy329_SignalVltSply_0OV" VALUE 0x804F5558 Val_Wu8 255.0 OneToOne 0.00 255.0 FORMAT "%5.1" /end CHARACTERISTIC
/begin CHARACTERISTIC DFES_MeterOut.DFC_RBA_IODIAGPWR_rba_IoExtCy329_SignalVltSply_0SCG_C "project specific calibration data / Project specific calibration data for DFC_RBA_IODIAGPWR_rba_IoExtCy329_SignalVltSply_0SCG" VALUE 0x804F5559 Val_Wu8 255.0 OneToOne 0.00 255.0 FORMAT "%5.1" /end CHARACTERISTIC
/begin CHARACTERISTIC DFES_MeterOut.DFC_RBA_IODIAGPWR_rba_IoExtCy329_SignalVltSply_0UV_C "project specific calibration data / Project specific calibration data for DFC_RBA_IODIAGPWR_rba_IoExtCy329_SignalVltSply_0UV" VALUE 0x804F555A Val_Wu8 255.0 OneToOne 0.00 255.0 FORMAT "%5.1" /end CHARACTERISTIC
/begin CHARACTERISTIC DFES_MeterOut.DFC_RBA_IODIAGPWR_rba_IoExtCy329_SignalVltSply_1_C "project specific calibration data / Project specific calibration data for DFC_RBA_IODIAGPWR_rba_IoExtCy329_SignalVltSply_1" VALUE 0x804F555B Val_Wu8 255.0 OneToOne 0.00 255.0 FORMAT "%5.1" /end CHARACTERISTIC
/begin CHARACTERISTIC DFES_MeterOut.DFC_RBA_IODIAGPWR_rba_IoExtCy329_SignalVltSply_1OT_C "project specific calibration data / Project specific calibration data for DFC_RBA_IODIAGPWR_rba_IoExtCy329_SignalVltSply_1OT" VALUE 0x804F555C Val_Wu8 255.0 OneToOne 0.00 255.0 FORMAT "%5.1" /end CHARACTERISTIC
/begin CHARACTERISTIC DFES_MeterOut.DFC_RBA_IODIAGPWR_rba_IoExtCy329_SignalVltSply_1OV_C "project specific calibration data / Project specific calibration data for DFC_RBA_IODIAGPWR_rba_IoExtCy329_SignalVltSply_1OV" VALUE 0x804F555D Val_Wu8 255.0 OneToOne 0.00 255.0 FORMAT "%5.1" /end CHARACTERISTIC
/begin CHARACTERISTIC DFES_MeterOut.DFC_RBA_IODIAGPWR_rba_IoExtCy329_SignalVltSply_1SCG_C "project specific calibration data / Project specific calibration data for DFC_RBA_IODIAGPWR_rba_IoExtCy329_SignalVltSply_1SCG" VALUE 0x804F555E Val_Wu8 255.0 OneToOne 0.00 255.0 FORMAT "%5.1" /end CHARACTERISTIC
/begin CHARACTERISTIC DFES_MeterOut.DFC_RBA_IODIAGPWR_rba_IoExtCy329_SignalVltSply_1UV_C "project specific calibration data / Project specific calibration data for DFC_RBA_IODIAGPWR_rba_IoExtCy329_SignalVltSply_1UV" VALUE 0x804F555F Val_Wu8 255.0 OneToOne 0.00 255.0 FORMAT "%5.1" /end CHARACTERISTIC
/begin CHARACTERISTIC DFES_MeterOut.DFC_RBA_IODIAGPWR_rba_IoExtCy329_SignalVltSply_2_C "project specific calibration data / Project specific calibration data for DFC_RBA_IODIAGPWR_rba_IoExtCy329_SignalVltSply_2" VALUE 0x804F5560 Val_Wu8 255.0 OneToOne 0.00 255.0 FORMAT "%5.1" /end CHARACTERISTIC
/begin CHARACTERISTIC DFES_MeterOut.DFC_RBA_IODIAGPWR_rba_IoExtCy329_SignalVltSply_2OT_C "project specific calibration data / Project specific calibration data for DFC_RBA_IODIAGPWR_rba_IoExtCy329_SignalVltSply_2OT" VALUE 0x804F5561 Val_Wu8 255.0 OneToOne 0.00 255.0 FORMAT "%5.1" /end CHARACTERISTIC
/begin CHARACTERISTIC DFES_MeterOut.DFC_RBA_IODIAGPWR_rba_IoExtCy329_SignalVltSply_2OV_C "project specific calibration data / Project specific calibration data for DFC_RBA_IODIAGPWR_rba_IoExtCy329_SignalVltSply_2OV" VALUE 0x804F5562 Val_Wu8 255.0 OneToOne 0.00 255.0 FORMAT "%5.1" /end CHARACTERISTIC
/begin CHARACTERISTIC DFES_MeterOut.DFC_RBA_IODIAGPWR_rba_IoExtCy329_SignalVltSply_2SCG_C "project specific calibration data / Project specific calibration data for DFC_RBA_IODIAGPWR_rba_IoExtCy329_SignalVltSply_2SCG" VALUE 0x804F5563 Val_Wu8 255.0 OneToOne 0.00 255.0 FORMAT "%5.1" /end CHARACTERISTIC
/begin CHARACTERISTIC DFES_MeterOut.DFC_RBA_IODIAGPWR_rba_IoExtCy329_SignalVltSply_2UV_C "project specific calibration data / Project specific calibration data for DFC_RBA_IODIAGPWR_rba_IoExtCy329_SignalVltSply_2UV" VALUE 0x804F5564 Val_Wu8 255.0 OneToOne 0.00 255.0 FORMAT "%5.1" /end CHARACTERISTIC
/begin CHARACTERISTIC DFES_MeterOut.DFC_CAN_E_TIMEOUT_C "project specific calibration data / Project specific calibration data for DFC_CAN_E_TIMEOUT" VALUE 0x804F5565 Val_Wu8 255.0 OneToOne 0.00 255.0 FORMAT "%5.1" /end CHARACTERISTIC
/begin CHARACTERISTIC DFES_MeterOut.DFC_LIN_E_TIMEOUT_C "project specific calibration data / Project specific calibration data for DFC_LIN_E_TIMEOUT" VALUE 0x804F5566 Val_Wu8 255.0 OneToOne 0.00 255.0 FORMAT "%5.1" /end CHARACTERISTIC
/begin CHARACTERISTIC DFES_MeterOut.DFC_MRlyOL_C "project specific calibration data / Project specific calibration data for DFC_MRlyOL" VALUE 0x804F5567 Val_Wu8 255.0 OneToOne 0.00 255.0 FORMAT "%5.1" /end CHARACTERISTIC
/begin CHARACTERISTIC DFES_MeterOut.DFC_MRlySCB_C "project specific calibration data / Project specific calibration data for DFC_MRlySCB" VALUE 0x804F5568 Val_Wu8 255.0 OneToOne 0.00 255.0 FORMAT "%5.1" /end CHARACTERISTIC
/begin CHARACTERISTIC DFES_MeterOut.DFC_MRlySCG_C "project specific calibration data / Project specific calibration data for DFC_MRlySCG" VALUE 0x804F5569 Val_Wu8 255.0 OneToOne 0.00 255.0 FORMAT "%5.1" /end CHARACTERISTIC
/begin CHARACTERISTIC DFES_MeterOut.DFC_rba_MultiStackTrace_Threshold_C "project specific calibration data / Project specific calibration data for DFC_rba_MultiStackTrace_Threshold" VALUE 0x804F556A Val_Wu8 255.0 OneToOne 0.00 255.0 FORMAT "%5.1" /end CHARACTERISTIC
/begin CHARACTERISTIC DFES_MeterOut.DFC_BSWM_E_ACTION_FAILED_C "project specific calibration data / Project specific calibration data for DFC_BSWM_E_ACTION_FAILED" VALUE 0x804F556B Val_Wu8 255.0 OneToOne 0.00 255.0 FORMAT "%5.1" /end CHARACTERISTIC
/begin CHARACTERISTIC DFES_MeterOut.DFC_BSWM_E_INTRPTQUEUE_FULL_C "project specific calibration data / Project specific calibration data for DFC_BSWM_E_INTRPTQUEUE_FULL" VALUE 0x804F556C Val_Wu8 255.0 OneToOne 0.00 255.0 FORMAT "%5.1" /end CHARACTERISTIC
/begin CHARACTERISTIC DFES_MeterOut.DFC_RBA_IOEXTLIB_KEEPALIVE_DRV_C "project specific calibration data / Project specific calibration data for DFC_RBA_IOEXTLIB_KEEPALIVE_DRV" VALUE 0x804F556D Val_Wu8 255.0 OneToOne 0.00 255.0 FORMAT "%5.1" /end CHARACTERISTIC
/begin CHARACTERISTIC DFES_MeterOut.DFC_RBA_IOEXTLIB_KEEPALIVE_INI_C "project specific calibration data / Project specific calibration data for DFC_RBA_IOEXTLIB_KEEPALIVE_INI" VALUE 0x804F556E Val_Wu8 255.0 OneToOne 0.00 255.0 FORMAT "%5.1" /end CHARACTERISTIC
/begin CHARACTERISTIC DFES_MeterOut.DFC_rba_IoSigRtc_StopCounter_C "project specific calibration data / Project specific calibration data for DFC_rba_IoSigRtc_StopCounter" VALUE 0x804F556F Val_Wu8 255.0 OneToOne 0.00 255.0 FORMAT "%5.1" /end CHARACTERISTIC
/begin CHARACTERISTIC DFES_MeterOut.DFC_rba_MRly_Diag_Stk_Event_C "project specific calibration data / Project specific calibration data for DFC_rba_MRly_Diag_Stk_Event" VALUE 0x804F5570 Val_Wu8 255.0 OneToOne 0.00 255.0 FORMAT "%5.1" /end CHARACTERISTIC
/begin CHARACTERISTIC DFES_MeterOut.DFC_rba_MemDiag_MemReadErr_C "project specific calibration data / Project specific calibration data for DFC_rba_MemDiag_MemReadErr" VALUE 0x804F5571 Val_Wu8 255.0 OneToOne 0.00 255.0 FORMAT "%5.1" /end CHARACTERISTIC
/begin CHARACTERISTIC DFES_MeterOut.DFC_rba_MemDiag_MemWrErr_C "project specific calibration data / Project specific calibration data for DFC_rba_MemDiag_MemWrErr" VALUE 0x804F5572 Val_Wu8 255.0 OneToOne 0.00 255.0 FORMAT "%5.1" /end CHARACTERISTIC
/begin CHARACTERISTIC DFES_MeterOut.DFC_rba_SyC_IrrSwOffTrigEngRun_Event_C "project specific calibration data / Project specific calibration data for DFC_rba_SyC_IrrSwOffTrigEngRun_Event" VALUE 0x804F5573 Val_Wu8 255.0 OneToOne 0.00 255.0 FORMAT "%5.1" /end CHARACTERISTIC
/begin CHARACTERISTIC DFES_MeterOut.DFC_rba_T15_Diag_ComInVld_Event_C "project specific calibration data / Project specific calibration data for DFC_rba_T15_Diag_ComInVld_Event" VALUE 0x804F5574 Val_Wu8 255.0 OneToOne 0.00 255.0 FORMAT "%5.1" /end CHARACTERISTIC
/begin CHARACTERISTIC DFES_MeterOut.DFC_rba_T15_Diag_ComOff_HwOn_Event_C "project specific calibration data / Project specific calibration data for DFC_rba_T15_Diag_ComOff_HwOn_Event" VALUE 0x804F5575 Val_Wu8 255.0 OneToOne 0.00 255.0 FORMAT "%5.1" /end CHARACTERISTIC
/begin CHARACTERISTIC DFES_MeterOut.DFC_rba_T15_Diag_ComOn_HwOff_Event_C "project specific calibration data / Project specific calibration data for DFC_rba_T15_Diag_ComOn_HwOff_Event" VALUE 0x804F5576 Val_Wu8 255.0 OneToOne 0.00 255.0 FORMAT "%5.1" /end CHARACTERISTIC
/begin CHARACTERISTIC DFES_MeterOut.DFC_AAVmin_C "project specific calibration data / Project specific calibration data for DFC_AAVmin" VALUE 0x804F5577 Val_Wu8 255.0 OneToOne 0.00 255.0 FORMAT "%5.1" /end CHARACTERISTIC
/begin CHARACTERISTIC DFES_MeterOut.DFC_AGRSUS_C "project specific calibration data / Project specific calibration data for DFC_AGRSUS" VALUE 0x804F5578 Val_Wu8 255.0 OneToOne 0.00 255.0 FORMAT "%5.1" /end CHARACTERISTIC
/begin CHARACTERISTIC DFES_MeterOut.DFC_AfsPlausDiagHi_C "project specific calibration data / Project specific calibration data for DFC_AfsPlausDiagHi" VALUE 0x804F5579 Val_Wu8 255.0 OneToOne 0.00 255.0 FORMAT "%5.1" /end CHARACTERISTIC
/begin CHARACTERISTIC DFES_MeterOut.DFC_AfsPlausDiagLo_C "project specific calibration data / Project specific calibration data for DFC_AfsPlausDiagLo" VALUE 0x804F557A Val_Wu8 255.0 OneToOne 0.00 255.0 FORMAT "%5.1" /end CHARACTERISTIC
/begin CHARACTERISTIC DFES_MeterOut.DFC_AfsVrntDiagErrB1_C "project specific calibration data / Project specific calibration data for DFC_AfsVrntDiagErrB1" VALUE 0x804F557B Val_Wu8 255.0 OneToOne 0.00 255.0 FORMAT "%5.1" /end CHARACTERISTIC
/begin CHARACTERISTIC DFES_MeterOut.DFC_AppAllSnsrDfct_C "project specific calibration data / Project specific calibration data for DFC_AppAllSnsrDfct" VALUE 0x804F557C Val_Wu8 255.0 OneToOne 0.00 255.0 FORMAT "%5.1" /end CHARACTERISTIC
/begin CHARACTERISTIC DFES_MeterOut.DFC_BBKRnldg_C "project specific calibration data / Project specific calibration data for DFC_BBKRnldg" VALUE 0x804F557D Val_Wu8 255.0 OneToOne 0.00 255.0 FORMAT "%5.1" /end CHARACTERISTIC
/begin CHARACTERISTIC DFES_MeterOut.DFC_BBKRsyne_C "project specific calibration data / Project specific calibration data for DFC_BBKRsyne" VALUE 0x804F557E Val_Wu8 255.0 OneToOne 0.00 255.0 FORMAT "%5.1" /end CHARACTERISTIC
/begin CHARACTERISTIC DFES_MeterOut.DFC_BattUStdbyDiaOL_C "project specific calibration data / Project specific calibration data for DFC_BattUStdbyDiaOL" VALUE 0x804F557F Val_Wu8 255.0 OneToOne 0.00 255.0 FORMAT "%5.1" /end CHARACTERISTIC
/begin CHARACTERISTIC DFES_MeterOut.DFC_BigLeakIntkMnfldEmiInfl_C "project specific calibration data / Project specific calibration data for DFC_BigLeakIntkMnfldEmiInfl" VALUE 0x804F5580 Val_Wu8 255.0 OneToOne 0.00 255.0 FORMAT "%5.1" /end CHARACTERISTIC
/begin CHARACTERISTIC DFES_MeterOut.DFC_BlkdLineTank_C "project specific calibration data / Project specific calibration data for DFC_BlkdLineTank" VALUE 0x804F5581 Val_Wu8 255.0 OneToOne 0.00 255.0 FORMAT "%5.1" /end CHARACTERISTIC
/begin CHARACTERISTIC DFES_MeterOut.DFC_BrkMnSwtContOnWarnLmp_C "project specific calibration data / Project specific calibration data for DFC_BrkMnSwtContOnWarnLmp" VALUE 0x804F5582 Val_Wu8 255.0 OneToOne 0.00 255.0 FORMAT "%5.1" /end CHARACTERISTIC
/begin CHARACTERISTIC DFES_MeterOut.DFC_BrkMnSwtNotStpWarnLmp_C "project specific calibration data / Project specific calibration data for DFC_BrkMnSwtNotStpWarnLmp" VALUE 0x804F5583 Val_Wu8 255.0 OneToOne 0.00 255.0 FORMAT "%5.1" /end CHARACTERISTIC
/begin CHARACTERISTIC DFES_MeterOut.DFC_BrkRdntSwtContOnWarnLmp_C "project specific calibration data / Project specific calibration data for DFC_BrkRdntSwtContOnWarnLmp" VALUE 0x804F5584 Val_Wu8 255.0 OneToOne 0.00 255.0 FORMAT "%5.1" /end CHARACTERISTIC
/begin CHARACTERISTIC DFES_MeterOut.DFC_BrkRdntSwtNotStpWarnLmp_C "project specific calibration data / Project specific calibration data for DFC_BrkRdntSwtNotStpWarnLmp" VALUE 0x804F5585 Val_Wu8 255.0 OneToOne 0.00 255.0 FORMAT "%5.1" /end CHARACTERISTIC
/begin CHARACTERISTIC DFES_MeterOut.DFC_CEngDsTColdStrtMax_C "project specific calibration data / Project specific calibration data for DFC_CEngDsTColdStrtMax" VALUE 0x804F5586 Val_Wu8 255.0 OneToOne 0.00 255.0 FORMAT "%5.1" /end CHARACTERISTIC
/begin CHARACTERISTIC DFES_MeterOut.DFC_CEngDsTColdStrtMin_C "project specific calibration data / Project specific calibration data for DFC_CEngDsTColdStrtMin" VALUE 0x804F5587 Val_Wu8 255.0 OneToOne 0.00 255.0 FORMAT "%5.1" /end CHARACTERISTIC
/begin CHARACTERISTIC DFES_MeterOut.DFC_CEngDsTImps_C "project specific calibration data / Project specific calibration data for DFC_CEngDsTImps" VALUE 0x804F5588 Val_Wu8 255.0 OneToOne 0.00 255.0 FORMAT "%5.1" /end CHARACTERISTIC
/begin CHARACTERISTIC DFES_MeterOut.DFC_CEngDsTPlausHSC_C "project specific calibration data / Project specific calibration data for DFC_CEngDsTPlausHSC" VALUE 0x804F5589 Val_Wu8 255.0 OneToOne 0.00 255.0 FORMAT "%5.1" /end CHARACTERISTIC
/begin CHARACTERISTIC DFES_MeterOut.DFC_CEngDsTPlausLSC_C "project specific calibration data / Project specific calibration data for DFC_CEngDsTPlausLSC" VALUE 0x804F558A Val_Wu8 255.0 OneToOne 0.00 255.0 FORMAT "%5.1" /end CHARACTERISTIC
/begin CHARACTERISTIC DFES_MeterOut.DFC_CEngDsTPlausSTC_C "project specific calibration data / Project specific calibration data for DFC_CEngDsTPlausSTC" VALUE 0x804F558B Val_Wu8 255.0 OneToOne 0.00 255.0 FORMAT "%5.1" /end CHARACTERISTIC
/begin CHARACTERISTIC DFES_MeterOut.DFC_CEngDsTSRCMax_C "project specific calibration data / Project specific calibration data for DFC_CEngDsTSRCMax" VALUE 0x804F558C Val_Wu8 255.0 OneToOne 0.00 255.0 FORMAT "%5.1" /end CHARACTERISTIC
/begin CHARACTERISTIC DFES_MeterOut.DFC_CEngDsTSRCMin_C "project specific calibration data / Project specific calibration data for DFC_CEngDsTSRCMin" VALUE 0x804F558D Val_Wu8 255.0 OneToOne 0.00 255.0 FORMAT "%5.1" /end CHARACTERISTIC
/begin CHARACTERISTIC DFES_MeterOut.DFC_CEngDsTSig_C "project specific calibration data / Project specific calibration data for DFC_CEngDsTSig" VALUE 0x804F558E Val_Wu8 255.0 OneToOne 0.00 255.0 FORMAT "%5.1" /end CHARACTERISTIC
/begin CHARACTERISTIC DFES_MeterOut.DFC_CEngUsTColdStrtMax_C "project specific calibration data / Project specific calibration data for DFC_CEngUsTColdStrtMax" VALUE 0x804F558F Val_Wu8 255.0 OneToOne 0.00 255.0 FORMAT "%5.1" /end CHARACTERISTIC
/begin CHARACTERISTIC DFES_MeterOut.DFC_CEngUsTColdStrtMin_C "project specific calibration data / Project specific calibration data for DFC_CEngUsTColdStrtMin" VALUE 0x804F5590 Val_Wu8 255.0 OneToOne 0.00 255.0 FORMAT "%5.1" /end CHARACTERISTIC
/begin CHARACTERISTIC DFES_MeterOut.DFC_CEngUsTLooseCnctn_C "project specific calibration data / Project specific calibration data for DFC_CEngUsTLooseCnctn" VALUE 0x804F5591 Val_Wu8 255.0 OneToOne 0.00 255.0 FORMAT "%5.1" /end CHARACTERISTIC
/begin CHARACTERISTIC DFES_MeterOut.DFC_CEngUsTSRCMax_C "project specific calibration data / Project specific calibration data for DFC_CEngUsTSRCMax" VALUE 0x804F5592 Val_Wu8 255.0 OneToOne 0.00 255.0 FORMAT "%5.1" /end CHARACTERISTIC
/begin CHARACTERISTIC DFES_MeterOut.DFC_CEngUsTSRCMin_C "project specific calibration data / Project specific calibration data for DFC_CEngUsTSRCMin" VALUE 0x804F5593 Val_Wu8 255.0 OneToOne 0.00 255.0 FORMAT "%5.1" /end CHARACTERISTIC
/begin CHARACTERISTIC DFES_MeterOut.DFC_ComDCDCACCFailr_C "project specific calibration data / Project specific calibration data for DFC_ComDCDCACCFailr" VALUE 0x804F5594 Val_Wu8 255.0 OneToOne 0.00 255.0 FORMAT "%5.1" /end CHARACTERISTIC
/begin CHARACTERISTIC DFES_MeterOut.DFC_DCDCFltDet_C "project specific calibration data / Project specific calibration data for DFC_DCDCFltDet" VALUE 0x804F5595 Val_Wu8 255.0 OneToOne 0.00 255.0 FORMAT "%5.1" /end CHARACTERISTIC
/begin CHARACTERISTIC DFES_MeterOut.DFC_DKRSA_C "project specific calibration data / Project specific calibration data for DFC_DKRSA" VALUE 0x804F5596 Val_Wu8 255.0 OneToOne 0.00 255.0 FORMAT "%5.1" /end CHARACTERISTIC
/begin CHARACTERISTIC DFES_MeterOut.DFC_DKVSmax_C "project specific calibration data / Project specific calibration data for DFC_DKVSmax" VALUE 0x804F5597 Val_Wu8 255.0 OneToOne 0.00 255.0 FORMAT "%5.1" /end CHARACTERISTIC
/begin CHARACTERISTIC DFES_MeterOut.DFC_DKnpl_C "project specific calibration data / Project specific calibration data for DFC_DKnpl" VALUE 0x804F5598 Val_Wu8 255.0 OneToOne 0.00 255.0 FORMAT "%5.1" /end CHARACTERISTIC
/begin CHARACTERISTIC DFES_MeterOut.DFC_DSKVRmax_C "project specific calibration data / Project specific calibration data for DFC_DSKVRmax" VALUE 0x804F5599 Val_Wu8 255.0 OneToOne 0.00 255.0 FORMAT "%5.1" /end CHARACTERISTIC
/begin CHARACTERISTIC DFES_MeterOut.DFC_DSKVRmin_C "project specific calibration data / Project specific calibration data for DFC_DSKVRmin" VALUE 0x804F559A Val_Wu8 255.0 OneToOne 0.00 255.0 FORMAT "%5.1" /end CHARACTERISTIC
/begin CHARACTERISTIC DFES_MeterOut.DFC_DSKVRnpl_C "project specific calibration data / Project specific calibration data for DFC_DSKVRnpl" VALUE 0x804F559B Val_Wu8 255.0 OneToOne 0.00 255.0 FORMAT "%5.1" /end CHARACTERISTIC
/begin CHARACTERISTIC DFES_MeterOut.DFC_DSKVRsig_C "project specific calibration data / Project specific calibration data for DFC_DSKVRsig" VALUE 0x804F559C Val_Wu8 255.0 OneToOne 0.00 255.0 FORMAT "%5.1" /end CHARACTERISTIC
/begin CHARACTERISTIC DFES_MeterOut.DFC_DSKVSsig_C "project specific calibration data / Project specific calibration data for DFC_DSKVSsig" VALUE 0x804F559D Val_Wu8 255.0 OneToOne 0.00 255.0 FORMAT "%5.1" /end CHARACTERISTIC
/begin CHARACTERISTIC DFES_MeterOut.DFC_DSSmax_C "project specific calibration data / Project specific calibration data for DFC_DSSmax" VALUE 0x804F559E Val_Wu8 255.0 OneToOne 0.00 255.0 FORMAT "%5.1" /end CHARACTERISTIC
/begin CHARACTERISTIC DFES_MeterOut.DFC_DSTDmax_C "project specific calibration data / Project specific calibration data for DFC_DSTDmax" VALUE 0x804F559F Val_Wu8 255.0 OneToOne 0.00 255.0 FORMAT "%5.1" /end CHARACTERISTIC
/begin CHARACTERISTIC DFES_MeterOut.DFC_DSTEmax_C "project specific calibration data / Project specific calibration data for DFC_DSTEmax" VALUE 0x804F55A0 Val_Wu8 255.0 OneToOne 0.00 255.0 FORMAT "%5.1" /end CHARACTERISTIC
/begin CHARACTERISTIC DFES_MeterOut.DFC_DSTEmin_C "project specific calibration data / Project specific calibration data for DFC_DSTEmin" VALUE 0x804F55A1 Val_Wu8 255.0 OneToOne 0.00 255.0 FORMAT "%5.1" /end CHARACTERISTIC
/begin CHARACTERISTIC DFES_MeterOut.DFC_DSTOFmax_C "project specific calibration data / Project specific calibration data for DFC_DSTOFmax" VALUE 0x804F55A2 Val_Wu8 255.0 OneToOne 0.00 255.0 FORMAT "%5.1" /end CHARACTERISTIC
/begin CHARACTERISTIC DFES_MeterOut.DFC_DSTRmax_C "project specific calibration data / Project specific calibration data for DFC_DSTRmax" VALUE 0x804F55A3 Val_Wu8 255.0 OneToOne 0.00 255.0 FORMAT "%5.1" /end CHARACTERISTIC
/begin CHARACTERISTIC DFES_MeterOut.DFC_DSTRmin_C "project specific calibration data / Project specific calibration data for DFC_DSTRmin" VALUE 0x804F55A4 Val_Wu8 255.0 OneToOne 0.00 255.0 FORMAT "%5.1" /end CHARACTERISTIC
/begin CHARACTERISTIC DFES_MeterOut.DFC_DSTRnpl_C "project specific calibration data / Project specific calibration data for DFC_DSTRnpl" VALUE 0x804F55A5 Val_Wu8 255.0 OneToOne 0.00 255.0 FORMAT "%5.1" /end CHARACTERISTIC
/begin CHARACTERISTIC DFES_MeterOut.DFC_DSTRsig_C "project specific calibration data / Project specific calibration data for DFC_DSTRsig" VALUE 0x804F55A6 Val_Wu8 255.0 OneToOne 0.00 255.0 FORMAT "%5.1" /end CHARACTERISTIC
/begin CHARACTERISTIC DFES_MeterOut.DFC_DSTTI_C "project specific calibration data / Project specific calibration data for DFC_DSTTI" VALUE 0x804F55A7 Val_Wu8 255.0 OneToOne 0.00 255.0 FORMAT "%5.1" /end CHARACTERISTIC
/begin CHARACTERISTIC DFES_MeterOut.DFC_DSUmax_C "project specific calibration data / Project specific calibration data for DFC_DSUmax" VALUE 0x804F55A8 Val_Wu8 255.0 OneToOne 0.00 255.0 FORMAT "%5.1" /end CHARACTERISTIC
/begin CHARACTERISTIC DFES_MeterOut.DFC_DiagCpv1DteskLoLoadStuckClsd_C "project specific calibration data / Project specific calibration data for DFC_DiagCpv1DteskLoLoadStuckClsd" VALUE 0x804F55A9 Val_Wu8 255.0 OneToOne 0.00 255.0 FORMAT "%5.1" /end CHARACTERISTIC
/begin CHARACTERISTIC DFES_MeterOut.DFC_DiagCpv1DteskLoLoadStuckOpen_C "project specific calibration data / Project specific calibration data for DFC_DiagCpv1DteskLoLoadStuckOpen" VALUE 0x804F55AA Val_Wu8 255.0 OneToOne 0.00 255.0 FORMAT "%5.1" /end CHARACTERISTIC
/begin CHARACTERISTIC DFES_MeterOut.DFC_EGRVlvDrftClsd_C "project specific calibration data / Project specific calibration data for DFC_EGRVlvDrftClsd" VALUE 0x804F55AB Val_Wu8 255.0 OneToOne 0.00 255.0 FORMAT "%5.1" /end CHARACTERISTIC
/begin CHARACTERISTIC DFES_MeterOut.DFC_EGRVlvDrftOpn_C "project specific calibration data / Project specific calibration data for DFC_EGRVlvDrftOpn" VALUE 0x804F55AC Val_Wu8 255.0 OneToOne 0.00 255.0 FORMAT "%5.1" /end CHARACTERISTIC
/begin CHARACTERISTIC DFES_MeterOut.DFC_EGRVlvJamVlvClsd_C "project specific calibration data / Project specific calibration data for DFC_EGRVlvJamVlvClsd" VALUE 0x804F55AD Val_Wu8 255.0 OneToOne 0.00 255.0 FORMAT "%5.1" /end CHARACTERISTIC
/begin CHARACTERISTIC DFES_MeterOut.DFC_EGRVlvJamVlvOpn_C "project specific calibration data / Project specific calibration data for DFC_EGRVlvJamVlvOpn" VALUE 0x804F55AE Val_Wu8 255.0 OneToOne 0.00 255.0 FORMAT "%5.1" /end CHARACTERISTIC
/begin CHARACTERISTIC DFES_MeterOut.DFC_EGRVlvSprgBrk_C "project specific calibration data / Project specific calibration data for DFC_EGRVlvSprgBrk" VALUE 0x804F55AF Val_Wu8 255.0 OneToOne 0.00 255.0 FORMAT "%5.1" /end CHARACTERISTIC
/begin CHARACTERISTIC DFES_MeterOut.DFC_EGRVlvTempMdlEEPErr_C "project specific calibration data / Project specific calibration data for DFC_EGRVlvTempMdlEEPErr" VALUE 0x804F55B0 Val_Wu8 255.0 OneToOne 0.00 255.0 FORMAT "%5.1" /end CHARACTERISTIC
/begin CHARACTERISTIC DFES_MeterOut.DFC_EGRVlvTmpErr_C "project specific calibration data / Project specific calibration data for DFC_EGRVlvTmpErr" VALUE 0x804F55B1 Val_Wu8 255.0 OneToOne 0.00 255.0 FORMAT "%5.1" /end CHARACTERISTIC
/begin CHARACTERISTIC DFES_MeterOut.DFC_EGSDUS2B1LtrDly_C "project specific calibration data / Project specific calibration data for DFC_EGSDUS2B1LtrDly" VALUE 0x804F55B2 Val_Wu8 255.0 OneToOne 0.00 255.0 FORMAT "%5.1" /end CHARACTERISTIC
/begin CHARACTERISTIC DFES_MeterOut.DFC_EGSDUS2B1LtrPT1_C "project specific calibration data / Project specific calibration data for DFC_EGSDUS2B1LtrPT1" VALUE 0x804F55B3 Val_Wu8 255.0 OneToOne 0.00 255.0 FORMAT "%5.1" /end CHARACTERISTIC
/begin CHARACTERISTIC DFES_MeterOut.DFC_EGSDUS2B1RtlDly_C "project specific calibration data / Project specific calibration data for DFC_EGSDUS2B1RtlDly" VALUE 0x804F55B4 Val_Wu8 255.0 OneToOne 0.00 255.0 FORMAT "%5.1" /end CHARACTERISTIC
/begin CHARACTERISTIC DFES_MeterOut.DFC_EGSDUS2B1RtlPT1_C "project specific calibration data / Project specific calibration data for DFC_EGSDUS2B1RtlPT1" VALUE 0x804F55B5 Val_Wu8 255.0 OneToOne 0.00 255.0 FORMAT "%5.1" /end CHARACTERISTIC
/begin CHARACTERISTIC DFES_MeterOut.DFC_EGSDUS2B1TarLean_C "project specific calibration data / Project specific calibration data for DFC_EGSDUS2B1TarLean" VALUE 0x804F55B6 Val_Wu8 255.0 OneToOne 0.00 255.0 FORMAT "%5.1" /end CHARACTERISTIC
/begin CHARACTERISTIC DFES_MeterOut.DFC_EGSDUS2B1TarRich_C "project specific calibration data / Project specific calibration data for DFC_EGSDUS2B1TarRich" VALUE 0x804F55B7 Val_Wu8 255.0 OneToOne 0.00 255.0 FORMAT "%5.1" /end CHARACTERISTIC
/begin CHARACTERISTIC DFES_MeterOut.DFC_EONVmax_C "project specific calibration data / Project specific calibration data for DFC_EONVmax" VALUE 0x804F55B8 Val_Wu8 255.0 OneToOne 0.00 255.0 FORMAT "%5.1" /end CHARACTERISTIC
/begin CHARACTERISTIC DFES_MeterOut.DFC_ETAKHLmax_C "project specific calibration data / Project specific calibration data for DFC_ETAKHLmax" VALUE 0x804F55B9 Val_Wu8 255.0 OneToOne 0.00 255.0 FORMAT "%5.1" /end CHARACTERISTIC
/begin CHARACTERISTIC DFES_MeterOut.DFC_ETAKHTmax_C "project specific calibration data / Project specific calibration data for DFC_ETAKHTmax" VALUE 0x804F55BA Val_Wu8 255.0 OneToOne 0.00 255.0 FORMAT "%5.1" /end CHARACTERISTIC
/begin CHARACTERISTIC DFES_MeterOut.DFC_ETHSEmax_C "project specific calibration data / Project specific calibration data for DFC_ETHSEmax" VALUE 0x804F55BB Val_Wu8 255.0 OneToOne 0.00 255.0 FORMAT "%5.1" /end CHARACTERISTIC
/begin CHARACTERISTIC DFES_MeterOut.DFC_ETHSEmin_C "project specific calibration data / Project specific calibration data for DFC_ETHSEmin" VALUE 0x804F55BC Val_Wu8 255.0 OneToOne 0.00 255.0 FORMAT "%5.1" /end CHARACTERISTIC
/begin CHARACTERISTIC DFES_MeterOut.DFC_ETHSFmax_C "project specific calibration data / Project specific calibration data for DFC_ETHSFmax" VALUE 0x804F55BD Val_Wu8 255.0 OneToOne 0.00 255.0 FORMAT "%5.1" /end CHARACTERISTIC
/begin CHARACTERISTIC DFES_MeterOut.DFC_ETHSFmin_C "project specific calibration data / Project specific calibration data for DFC_ETHSFmin" VALUE 0x804F55BE Val_Wu8 255.0 OneToOne 0.00 255.0 FORMAT "%5.1" /end CHARACTERISTIC
/begin CHARACTERISTIC DFES_MeterOut.DFC_ETHSFsig_C "project specific calibration data / Project specific calibration data for DFC_ETHSFsig" VALUE 0x804F55BF Val_Wu8 255.0 OneToOne 0.00 255.0 FORMAT "%5.1" /end CHARACTERISTIC
/begin CHARACTERISTIC DFES_MeterOut.DFC_ETHSNPWmax_C "project specific calibration data / Project specific calibration data for DFC_ETHSNPWmax" VALUE 0x804F55C0 Val_Wu8 255.0 OneToOne 0.00 255.0 FORMAT "%5.1" /end CHARACTERISTIC
/begin CHARACTERISTIC DFES_MeterOut.DFC_ETHSNPWmin_C "project specific calibration data / Project specific calibration data for DFC_ETHSNPWmin" VALUE 0x804F55C1 Val_Wu8 255.0 OneToOne 0.00 255.0 FORMAT "%5.1" /end CHARACTERISTIC
/begin CHARACTERISTIC DFES_MeterOut.DFC_ETHSNPWsig_C "project specific calibration data / Project specific calibration data for DFC_ETHSNPWsig" VALUE 0x804F55C2 Val_Wu8 255.0 OneToOne 0.00 255.0 FORMAT "%5.1" /end CHARACTERISTIC
/begin CHARACTERISTIC DFES_MeterOut.DFC_ETHSPLnpl_C "project specific calibration data / Project specific calibration data for DFC_ETHSPLnpl" VALUE 0x804F55C3 Val_Wu8 255.0 OneToOne 0.00 255.0 FORMAT "%5.1" /end CHARACTERISTIC
/begin CHARACTERISTIC DFES_MeterOut.DFC_ETHSTPLnpl_C "project specific calibration data / Project specific calibration data for DFC_ETHSTPLnpl" VALUE 0x804F55C4 Val_Wu8 255.0 OneToOne 0.00 255.0 FORMAT "%5.1" /end CHARACTERISTIC
/begin CHARACTERISTIC DFES_MeterOut.DFC_EngICO_C "project specific calibration data / Project specific calibration data for DFC_EngICO" VALUE 0x804F55C5 Val_Wu8 255.0 OneToOne 0.00 255.0 FORMAT "%5.1" /end CHARACTERISTIC
/begin CHARACTERISTIC DFES_MeterOut.DFC_EngPrtOvrSpdMon_C "project specific calibration data / Project specific calibration data for DFC_EngPrtOvrSpdMon" VALUE 0x804F55C6 Val_Wu8 255.0 OneToOne 0.00 255.0 FORMAT "%5.1" /end CHARACTERISTIC
/begin CHARACTERISTIC DFES_MeterOut.DFC_EpmCaSI1ErrSig_C "project specific calibration data / Project specific calibration data for DFC_EpmCaSI1ErrSig" VALUE 0x804F55C7 Val_Wu8 255.0 OneToOne 0.00 255.0 FORMAT "%5.1" /end CHARACTERISTIC
/begin CHARACTERISTIC DFES_MeterOut.DFC_EpmCaSI1MntErr_C "project specific calibration data / Project specific calibration data for DFC_EpmCaSI1MntErr" VALUE 0x804F55C8 Val_Wu8 255.0 OneToOne 0.00 255.0 FORMAT "%5.1" /end CHARACTERISTIC
/begin CHARACTERISTIC DFES_MeterOut.DFC_EpmCaSI1NoSigMax_C "project specific calibration data / Project specific calibration data for DFC_EpmCaSI1NoSigMax" VALUE 0x804F55C9 Val_Wu8 255.0 OneToOne 0.00 255.0 FORMAT "%5.1" /end CHARACTERISTIC
/begin CHARACTERISTIC DFES_MeterOut.DFC_EpmCaSI1NoSigMin_C "project specific calibration data / Project specific calibration data for DFC_EpmCaSI1NoSigMin" VALUE 0x804F55CA Val_Wu8 255.0 OneToOne 0.00 255.0 FORMAT "%5.1" /end CHARACTERISTIC
/begin CHARACTERISTIC DFES_MeterOut.DFC_EpmCaSI1OfsErr_C "project specific calibration data / Project specific calibration data for DFC_EpmCaSI1OfsErr" VALUE 0x804F55CB Val_Wu8 255.0 OneToOne 0.00 255.0 FORMAT "%5.1" /end CHARACTERISTIC
/begin CHARACTERISTIC DFES_MeterOut.DFC_EpmCrSDGI_C "project specific calibration data / Project specific calibration data for DFC_EpmCrSDGI" VALUE 0x804F55CC Val_Wu8 255.0 OneToOne 0.00 255.0 FORMAT "%5.1" /end CHARACTERISTIC
/begin CHARACTERISTIC DFES_MeterOut.DFC_EpmCrSErrSig_C "project specific calibration data / Project specific calibration data for DFC_EpmCrSErrSig" VALUE 0x804F55CD Val_Wu8 255.0 OneToOne 0.00 255.0 FORMAT "%5.1" /end CHARACTERISTIC
/begin CHARACTERISTIC DFES_MeterOut.DFC_EpmCrSNoSig_C "project specific calibration data / Project specific calibration data for DFC_EpmCrSNoSig" VALUE 0x804F55CE Val_Wu8 255.0 OneToOne 0.00 255.0 FORMAT "%5.1" /end CHARACTERISTIC
/begin CHARACTERISTIC DFES_MeterOut.DFC_EtaEngIdleNonCsers_C "project specific calibration data / Project specific calibration data for DFC_EtaEngIdleNonCsers" VALUE 0x804F55CF Val_Wu8 255.0 OneToOne 0.00 255.0 FORMAT "%5.1" /end CHARACTERISTIC
/begin CHARACTERISTIC DFES_MeterOut.DFC_EtaEngPtlNonCsers_C "project specific calibration data / Project specific calibration data for DFC_EtaEngPtlNonCsers" VALUE 0x804F55D0 Val_Wu8 255.0 OneToOne 0.00 255.0 FORMAT "%5.1" /end CHARACTERISTIC
/begin CHARACTERISTIC DFES_MeterOut.DFC_FRAmax_C "project specific calibration data / Project specific calibration data for DFC_FRAmax" VALUE 0x804F55D1 Val_Wu8 255.0 OneToOne 0.00 255.0 FORMAT "%5.1" /end CHARACTERISTIC
/begin CHARACTERISTIC DFES_MeterOut.DFC_FRAmin_C "project specific calibration data / Project specific calibration data for DFC_FRAmin" VALUE 0x804F55D2 Val_Wu8 255.0 OneToOne 0.00 255.0 FORMAT "%5.1" /end CHARACTERISTIC
/begin CHARACTERISTIC DFES_MeterOut.DFC_FSTEmax_C "project specific calibration data / Project specific calibration data for DFC_FSTEmax" VALUE 0x804F55D3 Val_Wu8 255.0 OneToOne 0.00 255.0 FORMAT "%5.1" /end CHARACTERISTIC
/begin CHARACTERISTIC DFES_MeterOut.DFC_FSTEmin_C "project specific calibration data / Project specific calibration data for DFC_FSTEmin" VALUE 0x804F55D4 Val_Wu8 255.0 OneToOne 0.00 255.0 FORMAT "%5.1" /end CHARACTERISTIC
/begin CHARACTERISTIC DFES_MeterOut.DFC_FSTRmax_C "project specific calibration data / Project specific calibration data for DFC_FSTRmax" VALUE 0x804F55D5 Val_Wu8 255.0 OneToOne 0.00 255.0 FORMAT "%5.1" /end CHARACTERISTIC
/begin CHARACTERISTIC DFES_MeterOut.DFC_FSTRmin_C "project specific calibration data / Project specific calibration data for DFC_FSTRmin" VALUE 0x804F55D6 Val_Wu8 255.0 OneToOne 0.00 255.0 FORMAT "%5.1" /end CHARACTERISTIC
/begin CHARACTERISTIC DFES_MeterOut.DFC_FSTRnpl_C "project specific calibration data / Project specific calibration data for DFC_FSTRnpl" VALUE 0x804F55D7 Val_Wu8 255.0 OneToOne 0.00 255.0 FORMAT "%5.1" /end CHARACTERISTIC
/begin CHARACTERISTIC DFES_MeterOut.DFC_FSTmax_C "project specific calibration data / Project specific calibration data for DFC_FSTmax" VALUE 0x804F55D8 Val_Wu8 255.0 OneToOne 0.00 255.0 FORMAT "%5.1" /end CHARACTERISTIC
/begin CHARACTERISTIC DFES_MeterOut.DFC_FTDLAmax_C "project specific calibration data / Project specific calibration data for DFC_FTDLAmax" VALUE 0x804F55D9 Val_Wu8 255.0 OneToOne 0.00 255.0 FORMAT "%5.1" /end CHARACTERISTIC
/begin CHARACTERISTIC DFES_MeterOut.DFC_FTDLAmin_C "project specific calibration data / Project specific calibration data for DFC_FTDLAmin" VALUE 0x804F55DA Val_Wu8 255.0 OneToOne 0.00 255.0 FORMAT "%5.1" /end CHARACTERISTIC
/begin CHARACTERISTIC DFES_MeterOut.DFC_FuPHiSnsrEleclmax_C "project specific calibration data / Project specific calibration data for DFC_FuPHiSnsrEleclmax" VALUE 0x804F55DB Val_Wu8 255.0 OneToOne 0.00 255.0 FORMAT "%5.1" /end CHARACTERISTIC
/begin CHARACTERISTIC DFES_MeterOut.DFC_FuPHiSnsrEleclmin_C "project specific calibration data / Project specific calibration data for DFC_FuPHiSnsrEleclmin" VALUE 0x804F55DC Val_Wu8 255.0 OneToOne 0.00 255.0 FORMAT "%5.1" /end CHARACTERISTIC
/begin CHARACTERISTIC DFES_MeterOut.DFC_FuPHiSnsrEleclnpl_C "project specific calibration data / Project specific calibration data for DFC_FuPHiSnsrEleclnpl" VALUE 0x804F55DD Val_Wu8 255.0 OneToOne 0.00 255.0 FORMAT "%5.1" /end CHARACTERISTIC
/begin CHARACTERISTIC DFES_MeterOut.DFC_FuPHiSnsrURngMax_C "project specific calibration data / Project specific calibration data for DFC_FuPHiSnsrURngMax" VALUE 0x804F55DE Val_Wu8 255.0 OneToOne 0.00 255.0 FORMAT "%5.1" /end CHARACTERISTIC
/begin CHARACTERISTIC DFES_MeterOut.DFC_FuPHiSnsrURngMin_C "project specific calibration data / Project specific calibration data for DFC_FuPHiSnsrURngMin" VALUE 0x804F55DF Val_Wu8 255.0 OneToOne 0.00 255.0 FORMAT "%5.1" /end CHARACTERISTIC
/begin CHARACTERISTIC DFES_MeterOut.DFC_FuSnsrPhyRngMaxErr_C "project specific calibration data / Project specific calibration data for DFC_FuSnsrPhyRngMaxErr" VALUE 0x804F55E0 Val_Wu8 255.0 OneToOne 0.00 255.0 FORMAT "%5.1" /end CHARACTERISTIC
/begin CHARACTERISTIC DFES_MeterOut.DFC_FuSnsrPhyRngMinErr_C "project specific calibration data / Project specific calibration data for DFC_FuSnsrPhyRngMinErr" VALUE 0x804F55E1 Val_Wu8 255.0 OneToOne 0.00 255.0 FORMAT "%5.1" /end CHARACTERISTIC
/begin CHARACTERISTIC DFES_MeterOut.DFC_GEVlvLockPinDiagIntkB1_C "project specific calibration data / Project specific calibration data for DFC_GEVlvLockPinDiagIntkB1" VALUE 0x804F55E2 Val_Wu8 255.0 OneToOne 0.00 255.0 FORMAT "%5.1" /end CHARACTERISTIC
/begin CHARACTERISTIC DFES_MeterOut.DFC_GEVlvPhaSlowIntkB1_C "project specific calibration data / Project specific calibration data for DFC_GEVlvPhaSlowIntkB1" VALUE 0x804F55E3 Val_Wu8 255.0 OneToOne 0.00 255.0 FORMAT "%5.1" /end CHARACTERISTIC
/begin CHARACTERISTIC DFES_MeterOut.DFC_GEVlvPhaTargIntkB1_C "project specific calibration data / Project specific calibration data for DFC_GEVlvPhaTargIntkB1" VALUE 0x804F55E4 Val_Wu8 255.0 OneToOne 0.00 255.0 FORMAT "%5.1" /end CHARACTERISTIC
/begin CHARACTERISTIC DFES_MeterOut.DFC_GbxRvsSwtStk_C "project specific calibration data / Project specific calibration data for DFC_GbxRvsSwtStk" VALUE 0x804F55E5 Val_Wu8 255.0 OneToOne 0.00 255.0 FORMAT "%5.1" /end CHARACTERISTIC
/begin CHARACTERISTIC DFES_MeterOut.DFC_HDRKHmax_C "project specific calibration data / Project specific calibration data for DFC_HDRKHmax" VALUE 0x804F55E6 Val_Wu8 255.0 OneToOne 0.00 255.0 FORMAT "%5.1" /end CHARACTERISTIC
/begin CHARACTERISTIC DFES_MeterOut.DFC_HDRKHmin_C "project specific calibration data / Project specific calibration data for DFC_HDRKHmin" VALUE 0x804F55E7 Val_Wu8 255.0 OneToOne 0.00 255.0 FORMAT "%5.1" /end CHARACTERISTIC
/begin CHARACTERISTIC DFES_MeterOut.DFC_HDRPLmax_C "project specific calibration data / Project specific calibration data for DFC_HDRPLmax" VALUE 0x804F55E8 Val_Wu8 255.0 OneToOne 0.00 255.0 FORMAT "%5.1" /end CHARACTERISTIC
/begin CHARACTERISTIC DFES_MeterOut.DFC_HDRPLmin_C "project specific calibration data / Project specific calibration data for DFC_HDRPLmin" VALUE 0x804F55E9 Val_Wu8 255.0 OneToOne 0.00 255.0 FORMAT "%5.1" /end CHARACTERISTIC
/begin CHARACTERISTIC DFES_MeterOut.DFC_HDRmax_C "project specific calibration data / Project specific calibration data for DFC_HDRmax" VALUE 0x804F55EA Val_Wu8 255.0 OneToOne 0.00 255.0 FORMAT "%5.1" /end CHARACTERISTIC
/begin CHARACTERISTIC DFES_MeterOut.DFC_HDRmin_C "project specific calibration data / Project specific calibration data for DFC_HDRmin" VALUE 0x804F55EB Val_Wu8 255.0 OneToOne 0.00 255.0 FORMAT "%5.1" /end CHARACTERISTIC
/begin CHARACTERISTIC DFES_MeterOut.DFC_HEGOS2B1ElecMax_C "project specific calibration data / Project specific calibration data for DFC_HEGOS2B1ElecMax" VALUE 0x804F55EC Val_Wu8 255.0 OneToOne 0.00 255.0 FORMAT "%5.1" /end CHARACTERISTIC
/begin CHARACTERISTIC DFES_MeterOut.DFC_HEGOS2B1ElecMin_C "project specific calibration data / Project specific calibration data for DFC_HEGOS2B1ElecMin" VALUE 0x804F55ED Val_Wu8 255.0 OneToOne 0.00 255.0 FORMAT "%5.1" /end CHARACTERISTIC
/begin CHARACTERISTIC DFES_MeterOut.DFC_HEGOS2B1ElecSig_C "project specific calibration data / Project specific calibration data for DFC_HEGOS2B1ElecSig" VALUE 0x804F55EE Val_Wu8 255.0 OneToOne 0.00 255.0 FORMAT "%5.1" /end CHARACTERISTIC
/begin CHARACTERISTIC DFES_MeterOut.DFC_HEGOS2B1HtgNpl_C "project specific calibration data / Project specific calibration data for DFC_HEGOS2B1HtgNpl" VALUE 0x804F55EF Val_Wu8 255.0 OneToOne 0.00 255.0 FORMAT "%5.1" /end CHARACTERISTIC
/begin CHARACTERISTIC DFES_MeterOut.DFC_HEV00max_C "project specific calibration data / Project specific calibration data for DFC_HEV00max" VALUE 0x804F55F0 Val_Wu8 255.0 OneToOne 0.00 255.0 FORMAT "%5.1" /end CHARACTERISTIC
/begin CHARACTERISTIC DFES_MeterOut.DFC_HEV01max_C "project specific calibration data / Project specific calibration data for DFC_HEV01max" VALUE 0x804F55F1 Val_Wu8 255.0 OneToOne 0.00 255.0 FORMAT "%5.1" /end CHARACTERISTIC
/begin CHARACTERISTIC DFES_MeterOut.DFC_HEV02max_C "project specific calibration data / Project specific calibration data for DFC_HEV02max" VALUE 0x804F55F2 Val_Wu8 255.0 OneToOne 0.00 255.0 FORMAT "%5.1" /end CHARACTERISTIC
/begin CHARACTERISTIC DFES_MeterOut.DFC_HEV03max_C "project specific calibration data / Project specific calibration data for DFC_HEV03max" VALUE 0x804F55F3 Val_Wu8 255.0 OneToOne 0.00 255.0 FORMAT "%5.1" /end CHARACTERISTIC
/begin CHARACTERISTIC DFES_MeterOut.DFC_HEVE0max_C "project specific calibration data / Project specific calibration data for DFC_HEVE0max" VALUE 0x804F55F4 Val_Wu8 255.0 OneToOne 0.00 255.0 FORMAT "%5.1" /end CHARACTERISTIC
/begin CHARACTERISTIC DFES_MeterOut.DFC_HEVE1max_C "project specific calibration data / Project specific calibration data for DFC_HEVE1max" VALUE 0x804F55F5 Val_Wu8 255.0 OneToOne 0.00 255.0 FORMAT "%5.1" /end CHARACTERISTIC
/begin CHARACTERISTIC DFES_MeterOut.DFC_HFMmax_C "project specific calibration data / Project specific calibration data for DFC_HFMmax" VALUE 0x804F55F6 Val_Wu8 255.0 OneToOne 0.00 255.0 FORMAT "%5.1" /end CHARACTERISTIC
/begin CHARACTERISTIC DFES_MeterOut.DFC_HiPSysHiPMaxLimExcdd_C "project specific calibration data / Project specific calibration data for DFC_HiPSysHiPMaxLimExcdd" VALUE 0x804F55F7 Val_Wu8 255.0 OneToOne 0.00 255.0 FORMAT "%5.1" /end CHARACTERISTIC
/begin CHARACTERISTIC DFES_MeterOut.DFC_IVGdiCtlCvoErrMax_0_C "project specific calibration data / Project specific calibration data for DFC_IVGdiCtlCvoErrMax_0" VALUE 0x804F55F8 Val_Wu8 255.0 OneToOne 0.00 255.0 FORMAT "%5.1" /end CHARACTERISTIC
/begin CHARACTERISTIC DFES_MeterOut.DFC_IVGdiCtlCvoErrMax_1_C "project specific calibration data / Project specific calibration data for DFC_IVGdiCtlCvoErrMax_1" VALUE 0x804F55F9 Val_Wu8 255.0 OneToOne 0.00 255.0 FORMAT "%5.1" /end CHARACTERISTIC
/begin CHARACTERISTIC DFES_MeterOut.DFC_IVGdiCtlCvoErrMax_2_C "project specific calibration data / Project specific calibration data for DFC_IVGdiCtlCvoErrMax_2" VALUE 0x804F55FA Val_Wu8 255.0 OneToOne 0.00 255.0 FORMAT "%5.1" /end CHARACTERISTIC
/begin CHARACTERISTIC DFES_MeterOut.DFC_IVGdiCtlCvoErrMax_3_C "project specific calibration data / Project specific calibration data for DFC_IVGdiCtlCvoErrMax_3" VALUE 0x804F55FB Val_Wu8 255.0 OneToOne 0.00 255.0 FORMAT "%5.1" /end CHARACTERISTIC
/begin CHARACTERISTIC DFES_MeterOut.DFC_IVGdiCtlCvoErrMin_0_C "project specific calibration data / Project specific calibration data for DFC_IVGdiCtlCvoErrMin_0" VALUE 0x804F55FC Val_Wu8 255.0 OneToOne 0.00 255.0 FORMAT "%5.1" /end CHARACTERISTIC
/begin CHARACTERISTIC DFES_MeterOut.DFC_IVGdiCtlCvoErrMin_1_C "project specific calibration data / Project specific calibration data for DFC_IVGdiCtlCvoErrMin_1" VALUE 0x804F55FD Val_Wu8 255.0 OneToOne 0.00 255.0 FORMAT "%5.1" /end CHARACTERISTIC
/begin CHARACTERISTIC DFES_MeterOut.DFC_IVGdiCtlCvoErrMin_2_C "project specific calibration data / Project specific calibration data for DFC_IVGdiCtlCvoErrMin_2" VALUE 0x804F55FE Val_Wu8 255.0 OneToOne 0.00 255.0 FORMAT "%5.1" /end CHARACTERISTIC
/begin CHARACTERISTIC DFES_MeterOut.DFC_IVGdiCtlCvoErrMin_3_C "project specific calibration data / Project specific calibration data for DFC_IVGdiCtlCvoErrMin_3" VALUE 0x804F55FF Val_Wu8 255.0 OneToOne 0.00 255.0 FORMAT "%5.1" /end CHARACTERISTIC
/begin CHARACTERISTIC DFES_MeterOut.DFC_IVGdiCtlCvoErrMinMax_C "project specific calibration data / Project specific calibration data for DFC_IVGdiCtlCvoErrMinMax" VALUE 0x804F5600 Val_Wu8 255.0 OneToOne 0.00 255.0 FORMAT "%5.1" /end CHARACTERISTIC
/begin CHARACTERISTIC DFES_MeterOut.DFC_IVGdiCtlCvoSigPlausErrSmrCdn_C "project specific calibration data / Project specific calibration data for DFC_IVGdiCtlCvoSigPlausErrSmrCdn" VALUE 0x804F5601 Val_Wu8 255.0 OneToOne 0.00 255.0 FORMAT "%5.1" /end CHARACTERISTIC
/begin CHARACTERISTIC DFES_MeterOut.DFC_IVGdiCtl_CvoErr_C "project specific calibration data / Project specific calibration data for DFC_IVGdiCtl_CvoErr" VALUE 0x804F5602 Val_Wu8 255.0 OneToOne 0.00 255.0 FORMAT "%5.1" /end CHARACTERISTIC
/begin CHARACTERISTIC DFES_MeterOut.DFC_IVGdiCtl_CvoSigPlaus_0_C "project specific calibration data / Project specific calibration data for DFC_IVGdiCtl_CvoSigPlaus_0" VALUE 0x804F5603 Val_Wu8 255.0 OneToOne 0.00 255.0 FORMAT "%5.1" /end CHARACTERISTIC
/begin CHARACTERISTIC DFES_MeterOut.DFC_IVGdiCtl_CvoSigPlaus_1_C "project specific calibration data / Project specific calibration data for DFC_IVGdiCtl_CvoSigPlaus_1" VALUE 0x804F5604 Val_Wu8 255.0 OneToOne 0.00 255.0 FORMAT "%5.1" /end CHARACTERISTIC
/begin CHARACTERISTIC DFES_MeterOut.DFC_IVGdiCtl_CvoSigPlaus_2_C "project specific calibration data / Project specific calibration data for DFC_IVGdiCtl_CvoSigPlaus_2" VALUE 0x804F5605 Val_Wu8 255.0 OneToOne 0.00 255.0 FORMAT "%5.1" /end CHARACTERISTIC
/begin CHARACTERISTIC DFES_MeterOut.DFC_IVGdiCtl_CvoSigPlaus_3_C "project specific calibration data / Project specific calibration data for DFC_IVGdiCtl_CvoSigPlaus_3" VALUE 0x804F5606 Val_Wu8 255.0 OneToOne 0.00 255.0 FORMAT "%5.1" /end CHARACTERISTIC
/begin CHARACTERISTIC DFES_MeterOut.DFC_IntkAirTAirFltDsCrssMax_C "project specific calibration data / Project specific calibration data for DFC_IntkAirTAirFltDsCrssMax" VALUE 0x804F5607 Val_Wu8 255.0 OneToOne 0.00 255.0 FORMAT "%5.1" /end CHARACTERISTIC
/begin CHARACTERISTIC DFES_MeterOut.DFC_IntkAirTAirFltDsCrssMin_C "project specific calibration data / Project specific calibration data for DFC_IntkAirTAirFltDsCrssMin" VALUE 0x804F5608 Val_Wu8 255.0 OneToOne 0.00 255.0 FORMAT "%5.1" /end CHARACTERISTIC
/begin CHARACTERISTIC DFES_MeterOut.DFC_IntkAirTAirFltDsHSCMax_C "project specific calibration data / Project specific calibration data for DFC_IntkAirTAirFltDsHSCMax" VALUE 0x804F5609 Val_Wu8 255.0 OneToOne 0.00 255.0 FORMAT "%5.1" /end CHARACTERISTIC
/begin CHARACTERISTIC DFES_MeterOut.DFC_IntkAirTAirFltDsImps_C "project specific calibration data / Project specific calibration data for DFC_IntkAirTAirFltDsImps" VALUE 0x804F560A Val_Wu8 255.0 OneToOne 0.00 255.0 FORMAT "%5.1" /end CHARACTERISTIC
/begin CHARACTERISTIC DFES_MeterOut.DFC_IntkAirTAirFltDsPRCMax_C "project specific calibration data / Project specific calibration data for DFC_IntkAirTAirFltDsPRCMax" VALUE 0x804F560B Val_Wu8 255.0 OneToOne 0.00 255.0 FORMAT "%5.1" /end CHARACTERISTIC
/begin CHARACTERISTIC DFES_MeterOut.DFC_IntkAirTAirFltDsPRCMin_C "project specific calibration data / Project specific calibration data for DFC_IntkAirTAirFltDsPRCMin" VALUE 0x804F560C Val_Wu8 255.0 OneToOne 0.00 255.0 FORMAT "%5.1" /end CHARACTERISTIC
/begin CHARACTERISTIC DFES_MeterOut.DFC_IntkAirTAirFltDsSRCMax_C "project specific calibration data / Project specific calibration data for DFC_IntkAirTAirFltDsSRCMax" VALUE 0x804F560D Val_Wu8 255.0 OneToOne 0.00 255.0 FORMAT "%5.1" /end CHARACTERISTIC
/begin CHARACTERISTIC DFES_MeterOut.DFC_IntkAirTAirFltDsSRCMin_C "project specific calibration data / Project specific calibration data for DFC_IntkAirTAirFltDsSRCMin" VALUE 0x804F560E Val_Wu8 255.0 OneToOne 0.00 255.0 FORMAT "%5.1" /end CHARACTERISTIC
/begin CHARACTERISTIC DFES_MeterOut.DFC_IntkAirTAirFltDsSTC_C "project specific calibration data / Project specific calibration data for DFC_IntkAirTAirFltDsSTC" VALUE 0x804F560F Val_Wu8 255.0 OneToOne 0.00 255.0 FORMAT "%5.1" /end CHARACTERISTIC
/begin CHARACTERISTIC DFES_MeterOut.DFC_IntkAirTIntkMnfldCrssMax_C "project specific calibration data / Project specific calibration data for DFC_IntkAirTIntkMnfldCrssMax" VALUE 0x804F5610 Val_Wu8 255.0 OneToOne 0.00 255.0 FORMAT "%5.1" /end CHARACTERISTIC
/begin CHARACTERISTIC DFES_MeterOut.DFC_IntkAirTIntkMnfldCrssMin_C "project specific calibration data / Project specific calibration data for DFC_IntkAirTIntkMnfldCrssMin" VALUE 0x804F5611 Val_Wu8 255.0 OneToOne 0.00 255.0 FORMAT "%5.1" /end CHARACTERISTIC
/begin CHARACTERISTIC DFES_MeterOut.DFC_IntkAirTIntkMnfldHSCMax_C "project specific calibration data / Project specific calibration data for DFC_IntkAirTIntkMnfldHSCMax" VALUE 0x804F5612 Val_Wu8 255.0 OneToOne 0.00 255.0 FORMAT "%5.1" /end CHARACTERISTIC
/begin CHARACTERISTIC DFES_MeterOut.DFC_IntkAirTIntkMnfldImps_C "project specific calibration data / Project specific calibration data for DFC_IntkAirTIntkMnfldImps" VALUE 0x804F5613 Val_Wu8 255.0 OneToOne 0.00 255.0 FORMAT "%5.1" /end CHARACTERISTIC
/begin CHARACTERISTIC DFES_MeterOut.DFC_IntkAirTIntkMnfldPRCMax_C "project specific calibration data / Project specific calibration data for DFC_IntkAirTIntkMnfldPRCMax" VALUE 0x804F5614 Val_Wu8 255.0 OneToOne 0.00 255.0 FORMAT "%5.1" /end CHARACTERISTIC
/begin CHARACTERISTIC DFES_MeterOut.DFC_IntkAirTIntkMnfldPRCMin_C "project specific calibration data / Project specific calibration data for DFC_IntkAirTIntkMnfldPRCMin" VALUE 0x804F5615 Val_Wu8 255.0 OneToOne 0.00 255.0 FORMAT "%5.1" /end CHARACTERISTIC
/begin CHARACTERISTIC DFES_MeterOut.DFC_IntkAirTIntkMnfldSRCMax_C "project specific calibration data / Project specific calibration data for DFC_IntkAirTIntkMnfldSRCMax" VALUE 0x804F5616 Val_Wu8 255.0 OneToOne 0.00 255.0 FORMAT "%5.1" /end CHARACTERISTIC
/begin CHARACTERISTIC DFES_MeterOut.DFC_IntkAirTIntkMnfldSRCMin_C "project specific calibration data / Project specific calibration data for DFC_IntkAirTIntkMnfldSRCMin" VALUE 0x804F5617 Val_Wu8 255.0 OneToOne 0.00 255.0 FORMAT "%5.1" /end CHARACTERISTIC
/begin CHARACTERISTIC DFES_MeterOut.DFC_IntkAirTIntkMnfldSTC_C "project specific calibration data / Project specific calibration data for DFC_IntkAirTIntkMnfldSTC" VALUE 0x804F5618 Val_Wu8 255.0 OneToOne 0.00 255.0 FORMAT "%5.1" /end CHARACTERISTIC
/begin CHARACTERISTIC DFES_MeterOut.DFC_KRREGRLMX_C "project specific calibration data / Project specific calibration data for DFC_KRREGRLMX" VALUE 0x804F5619 Val_Wu8 255.0 OneToOne 0.00 255.0 FORMAT "%5.1" /end CHARACTERISTIC
/begin CHARACTERISTIC DFES_MeterOut.DFC_KRVEKOCVLCI_C "project specific calibration data / Project specific calibration data for DFC_KRVEKOCVLCI" VALUE 0x804F561A Val_Wu8 255.0 OneToOne 0.00 255.0 FORMAT "%5.1" /end CHARACTERISTIC
/begin CHARACTERISTIC DFES_MeterOut.DFC_KRVEKOENCHMT_C "project specific calibration data / Project specific calibration data for DFC_KRVEKOENCHMT" VALUE 0x804F561B Val_Wu8 255.0 OneToOne 0.00 255.0 FORMAT "%5.1" /end CHARACTERISTIC
/begin CHARACTERISTIC DFES_MeterOut.DFC_KRVEKOENCHMT0_C "project specific calibration data / Project specific calibration data for DFC_KRVEKOENCHMT0" VALUE 0x804F561C Val_Wu8 255.0 OneToOne 0.00 255.0 FORMAT "%5.1" /end CHARACTERISTIC
/begin CHARACTERISTIC DFES_MeterOut.DFC_KRVEKOENCHMT1_C "project specific calibration data / Project specific calibration data for DFC_KRVEKOENCHMT1" VALUE 0x804F561D Val_Wu8 255.0 OneToOne 0.00 255.0 FORMAT "%5.1" /end CHARACTERISTIC
/begin CHARACTERISTIC DFES_MeterOut.DFC_KRVEKOENCHMT2_C "project specific calibration data / Project specific calibration data for DFC_KRVEKOENCHMT2" VALUE 0x804F561E Val_Wu8 255.0 OneToOne 0.00 255.0 FORMAT "%5.1" /end CHARACTERISTIC
/begin CHARACTERISTIC DFES_MeterOut.DFC_KRVEKOENCHMT3_C "project specific calibration data / Project specific calibration data for DFC_KRVEKOENCHMT3" VALUE 0x804F561F Val_Wu8 255.0 OneToOne 0.00 255.0 FORMAT "%5.1" /end CHARACTERISTIC
/begin CHARACTERISTIC DFES_MeterOut.DFC_KRVEKOENCHMT4_C "project specific calibration data / Project specific calibration data for DFC_KRVEKOENCHMT4" VALUE 0x804F5620 Val_Wu8 255.0 OneToOne 0.00 255.0 FORMAT "%5.1" /end CHARACTERISTIC
/begin CHARACTERISTIC DFES_MeterOut.DFC_KRVEKOENCHMT5_C "project specific calibration data / Project specific calibration data for DFC_KRVEKOENCHMT5" VALUE 0x804F5621 Val_Wu8 255.0 OneToOne 0.00 255.0 FORMAT "%5.1" /end CHARACTERISTIC
/begin CHARACTERISTIC DFES_MeterOut.DFC_KRVEKOENCHMT6_C "project specific calibration data / Project specific calibration data for DFC_KRVEKOENCHMT6" VALUE 0x804F5622 Val_Wu8 255.0 OneToOne 0.00 255.0 FORMAT "%5.1" /end CHARACTERISTIC
/begin CHARACTERISTIC DFES_MeterOut.DFC_KRVEKOENCHMT7_C "project specific calibration data / Project specific calibration data for DFC_KRVEKOENCHMT7" VALUE 0x804F5623 Val_Wu8 255.0 OneToOne 0.00 255.0 FORMAT "%5.1" /end CHARACTERISTIC
/begin CHARACTERISTIC DFES_MeterOut.DFC_KRVEKORLMX_C "project specific calibration data / Project specific calibration data for DFC_KRVEKORLMX" VALUE 0x804F5624 Val_Wu8 255.0 OneToOne 0.00 255.0 FORMAT "%5.1" /end CHARACTERISTIC
/begin CHARACTERISTIC DFES_MeterOut.DFC_KRVEKORLMXL_C "project specific calibration data / Project specific calibration data for DFC_KRVEKORLMXL" VALUE 0x804F5625 Val_Wu8 255.0 OneToOne 0.00 255.0 FORMAT "%5.1" /end CHARACTERISTIC
/begin CHARACTERISTIC DFES_MeterOut.DFC_KS1max_C "project specific calibration data / Project specific calibration data for DFC_KS1max" VALUE 0x804F5626 Val_Wu8 255.0 OneToOne 0.00 255.0 FORMAT "%5.1" /end CHARACTERISTIC
/begin CHARACTERISTIC DFES_MeterOut.DFC_KS1min_C "project specific calibration data / Project specific calibration data for DFC_KS1min" VALUE 0x804F5627 Val_Wu8 255.0 OneToOne 0.00 255.0 FORMAT "%5.1" /end CHARACTERISTIC
/begin CHARACTERISTIC DFES_MeterOut.DFC_LMmax_C "project specific calibration data / Project specific calibration data for DFC_LMmax" VALUE 0x804F5628 Val_Wu8 255.0 OneToOne 0.00 255.0 FORMAT "%5.1" /end CHARACTERISTIC
/begin CHARACTERISTIC DFES_MeterOut.DFC_LZSRnpl_C "project specific calibration data / Project specific calibration data for DFC_LZSRnpl" VALUE 0x804F5629 Val_Wu8 255.0 OneToOne 0.00 255.0 FORMAT "%5.1" /end CHARACTERISTIC
/begin CHARACTERISTIC DFES_MeterOut.DFC_LamDynDiagS1B1_C "project specific calibration data / Project specific calibration data for DFC_LamDynDiagS1B1" VALUE 0x804F562A Val_Wu8 255.0 OneToOne 0.00 255.0 FORMAT "%5.1" /end CHARACTERISTIC
/begin CHARACTERISTIC DFES_MeterOut.DFC_LeakIntkMnfldEmiInfl_C "project specific calibration data / Project specific calibration data for DFC_LeakIntkMnfldEmiInfl" VALUE 0x804F562B Val_Wu8 255.0 OneToOne 0.00 255.0 FORMAT "%5.1" /end CHARACTERISTIC
/begin CHARACTERISTIC DFES_MeterOut.DFC_LinFrameErrDCDC_C "project specific calibration data / Project specific calibration data for DFC_LinFrameErrDCDC" VALUE 0x804F562C Val_Wu8 255.0 OneToOne 0.00 255.0 FORMAT "%5.1" /end CHARACTERISTIC
/begin CHARACTERISTIC DFES_MeterOut.DFC_LinOverrunErrDCDC_C "project specific calibration data / Project specific calibration data for DFC_LinOverrunErrDCDC" VALUE 0x804F562D Val_Wu8 255.0 OneToOne 0.00 255.0 FORMAT "%5.1" /end CHARACTERISTIC
/begin CHARACTERISTIC DFES_MeterOut.DFC_MD00max_C "project specific calibration data / Project specific calibration data for DFC_MD00max" VALUE 0x804F562E Val_Wu8 255.0 OneToOne 0.00 255.0 FORMAT "%5.1" /end CHARACTERISTIC
/begin CHARACTERISTIC DFES_MeterOut.DFC_MDBmax_C "project specific calibration data / Project specific calibration data for DFC_MDBmax" VALUE 0x804F562F Val_Wu8 255.0 OneToOne 0.00 255.0 FORMAT "%5.1" /end CHARACTERISTIC
/begin CHARACTERISTIC DFES_MeterOut.DFC_MDCat_C "project specific calibration data / Project specific calibration data for DFC_MDCat" VALUE 0x804F5630 Val_Wu8 255.0 OneToOne 0.00 255.0 FORMAT "%5.1" /end CHARACTERISTIC
/begin CHARACTERISTIC DFES_MeterOut.DFC_MDCatCrit_C "project specific calibration data / Project specific calibration data for DFC_MDCatCrit" VALUE 0x804F5631 Val_Wu8 255.0 OneToOne 0.00 255.0 FORMAT "%5.1" /end CHARACTERISTIC
/begin CHARACTERISTIC DFES_MeterOut.DFC_MDCatCurr_C "project specific calibration data / Project specific calibration data for DFC_MDCatCurr" VALUE 0x804F5632 Val_Wu8 255.0 OneToOne 0.00 255.0 FORMAT "%5.1" /end CHARACTERISTIC
/begin CHARACTERISTIC DFES_MeterOut.DFC_MDCyl_0_C "project specific calibration data / Project specific calibration data for DFC_MDCyl_0" VALUE 0x804F5633 Val_Wu8 255.0 OneToOne 0.00 255.0 FORMAT "%5.1" /end CHARACTERISTIC
/begin CHARACTERISTIC DFES_MeterOut.DFC_MDCyl_1_C "project specific calibration data / Project specific calibration data for DFC_MDCyl_1" VALUE 0x804F5634 Val_Wu8 255.0 OneToOne 0.00 255.0 FORMAT "%5.1" /end CHARACTERISTIC
/begin CHARACTERISTIC DFES_MeterOut.DFC_MDCyl_2_C "project specific calibration data / Project specific calibration data for DFC_MDCyl_2" VALUE 0x804F5635 Val_Wu8 255.0 OneToOne 0.00 255.0 FORMAT "%5.1" /end CHARACTERISTIC
/begin CHARACTERISTIC DFES_MeterOut.DFC_MDCyl_3_C "project specific calibration data / Project specific calibration data for DFC_MDCyl_3" VALUE 0x804F5636 Val_Wu8 255.0 OneToOne 0.00 255.0 FORMAT "%5.1" /end CHARACTERISTIC
/begin CHARACTERISTIC DFES_MeterOut.DFC_MDEmi_C "project specific calibration data / Project specific calibration data for DFC_MDEmi" VALUE 0x804F5637 Val_Wu8 255.0 OneToOne 0.00 255.0 FORMAT "%5.1" /end CHARACTERISTIC
/begin CHARACTERISTIC DFES_MeterOut.DFC_MDEmiStrt_C "project specific calibration data / Project specific calibration data for DFC_MDEmiStrt" VALUE 0x804F5638 Val_Wu8 255.0 OneToOne 0.00 255.0 FORMAT "%5.1" /end CHARACTERISTIC
/begin CHARACTERISTIC DFES_MeterOut.DFC_MDFco_C "project specific calibration data / Project specific calibration data for DFC_MDFco" VALUE 0x804F5639 Val_Wu8 255.0 OneToOne 0.00 255.0 FORMAT "%5.1" /end CHARACTERISTIC
/begin CHARACTERISTIC DFES_MeterOut.DFC_MDMpl_C "project specific calibration data / Project specific calibration data for DFC_MDMpl" VALUE 0x804F563A Val_Wu8 255.0 OneToOne 0.00 255.0 FORMAT "%5.1" /end CHARACTERISTIC
/begin CHARACTERISTIC DFES_MeterOut.DFC_MDSegTiAdpn_C "project specific calibration data / Project specific calibration data for DFC_MDSegTiAdpn" VALUE 0x804F563B Val_Wu8 255.0 OneToOne 0.00 255.0 FORMAT "%5.1" /end CHARACTERISTIC
/begin CHARACTERISTIC DFES_MeterOut.DFC_MDmax_C "project specific calibration data / Project specific calibration data for DFC_MDmax" VALUE 0x804F563C Val_Wu8 255.0 OneToOne 0.00 255.0 FORMAT "%5.1" /end CHARACTERISTIC
/begin CHARACTERISTIC DFES_MeterOut.DFC_MFuOilMax_C "project specific calibration data / Project specific calibration data for DFC_MFuOilMax" VALUE 0x804F563D Val_Wu8 255.0 OneToOne 0.00 255.0 FORMAT "%5.1" /end CHARACTERISTIC
/begin CHARACTERISTIC DFES_MeterOut.DFC_MOXEMM_SMU_ALM0_0_C "project specific calibration data / Project specific calibration data for DFC_MOXEMM_SMU_ALM0_0" VALUE 0x804F563E Val_Wu8 255.0 OneToOne 0.00 255.0 FORMAT "%5.1" /end CHARACTERISTIC
/begin CHARACTERISTIC DFES_MeterOut.DFC_MOXEMM_SMU_ALM0_1_C "project specific calibration data / Project specific calibration data for DFC_MOXEMM_SMU_ALM0_1" VALUE 0x804F563F Val_Wu8 255.0 OneToOne 0.00 255.0 FORMAT "%5.1" /end CHARACTERISTIC
/begin CHARACTERISTIC DFES_MeterOut.DFC_MOXEMM_SMU_ALM0_10_C "project specific calibration data / Project specific calibration data for DFC_MOXEMM_SMU_ALM0_10" VALUE 0x804F5640 Val_Wu8 255.0 OneToOne 0.00 255.0 FORMAT "%5.1" /end CHARACTERISTIC
/begin CHARACTERISTIC DFES_MeterOut.DFC_MOXEMM_SMU_ALM0_11_C "project specific calibration data / Project specific calibration data for DFC_MOXEMM_SMU_ALM0_11" VALUE 0x804F5641 Val_Wu8 255.0 OneToOne 0.00 255.0 FORMAT "%5.1" /end CHARACTERISTIC
/begin CHARACTERISTIC DFES_MeterOut.DFC_MOXEMM_SMU_ALM0_13_C "project specific calibration data / Project specific calibration data for DFC_MOXEMM_SMU_ALM0_13" VALUE 0x804F5642 Val_Wu8 255.0 OneToOne 0.00 255.0 FORMAT "%5.1" /end CHARACTERISTIC
/begin CHARACTERISTIC DFES_MeterOut.DFC_MOXEMM_SMU_ALM0_14_C "project specific calibration data / Project specific calibration data for DFC_MOXEMM_SMU_ALM0_14" VALUE 0x804F5643 Val_Wu8 255.0 OneToOne 0.00 255.0 FORMAT "%5.1" /end CHARACTERISTIC
/begin CHARACTERISTIC DFES_MeterOut.DFC_MOXEMM_SMU_ALM0_2_C "project specific calibration data / Project specific calibration data for DFC_MOXEMM_SMU_ALM0_2" VALUE 0x804F5644 Val_Wu8 255.0 OneToOne 0.00 255.0 FORMAT "%5.1" /end CHARACTERISTIC
/begin CHARACTERISTIC DFES_MeterOut.DFC_MOXEMM_SMU_ALM0_22_C "project specific calibration data / Project specific calibration data for DFC_MOXEMM_SMU_ALM0_22" VALUE 0x804F5645 Val_Wu8 255.0 OneToOne 0.00 255.0 FORMAT "%5.1" /end CHARACTERISTIC
/begin CHARACTERISTIC DFES_MeterOut.DFC_MOXEMM_SMU_ALM0_23_C "project specific calibration data / Project specific calibration data for DFC_MOXEMM_SMU_ALM0_23" VALUE 0x804F5646 Val_Wu8 255.0 OneToOne 0.00 255.0 FORMAT "%5.1" /end CHARACTERISTIC
/begin CHARACTERISTIC DFES_MeterOut.DFC_MOXEMM_SMU_ALM0_4_C "project specific calibration data / Project specific calibration data for DFC_MOXEMM_SMU_ALM0_4" VALUE 0x804F5647 Val_Wu8 255.0 OneToOne 0.00 255.0 FORMAT "%5.1" /end CHARACTERISTIC
/begin CHARACTERISTIC DFES_MeterOut.DFC_MOXEMM_SMU_ALM0_5_C "project specific calibration data / Project specific calibration data for DFC_MOXEMM_SMU_ALM0_5" VALUE 0x804F5648 Val_Wu8 255.0 OneToOne 0.00 255.0 FORMAT "%5.1" /end CHARACTERISTIC
/begin CHARACTERISTIC DFES_MeterOut.DFC_MOXEMM_SMU_ALM0_7_C "project specific calibration data / Project specific calibration data for DFC_MOXEMM_SMU_ALM0_7" VALUE 0x804F5649 Val_Wu8 255.0 OneToOne 0.00 255.0 FORMAT "%5.1" /end CHARACTERISTIC
/begin CHARACTERISTIC DFES_MeterOut.DFC_MOXEMM_SMU_ALM0_8_C "project specific calibration data / Project specific calibration data for DFC_MOXEMM_SMU_ALM0_8" VALUE 0x804F564A Val_Wu8 255.0 OneToOne 0.00 255.0 FORMAT "%5.1" /end CHARACTERISTIC
/begin CHARACTERISTIC DFES_MeterOut.DFC_MOXEMM_SMU_ALM10_16_C "project specific calibration data / Project specific calibration data for DFC_MOXEMM_SMU_ALM10_16" VALUE 0x804F564B Val_Wu8 255.0 OneToOne 0.00 255.0 FORMAT "%5.1" /end CHARACTERISTIC
/begin CHARACTERISTIC DFES_MeterOut.DFC_MOXEMM_SMU_ALM10_17_C "project specific calibration data / Project specific calibration data for DFC_MOXEMM_SMU_ALM10_17" VALUE 0x804F564C Val_Wu8 255.0 OneToOne 0.00 255.0 FORMAT "%5.1" /end CHARACTERISTIC
/begin CHARACTERISTIC DFES_MeterOut.DFC_MOXEMM_SMU_ALM10_21_C "project specific calibration data / Project specific calibration data for DFC_MOXEMM_SMU_ALM10_21" VALUE 0x804F564D Val_Wu8 255.0 OneToOne 0.00 255.0 FORMAT "%5.1" /end CHARACTERISTIC
/begin CHARACTERISTIC DFES_MeterOut.DFC_MOXEMM_SMU_ALM11_0_C "project specific calibration data / Project specific calibration data for DFC_MOXEMM_SMU_ALM11_0" VALUE 0x804F564E Val_Wu8 255.0 OneToOne 0.00 255.0 FORMAT "%5.1" /end CHARACTERISTIC
/begin CHARACTERISTIC DFES_MeterOut.DFC_MOXEMM_SMU_ALM11_1_C "project specific calibration data / Project specific calibration data for DFC_MOXEMM_SMU_ALM11_1" VALUE 0x804F564F Val_Wu8 255.0 OneToOne 0.00 255.0 FORMAT "%5.1" /end CHARACTERISTIC
/begin CHARACTERISTIC DFES_MeterOut.DFC_MOXEMM_SMU_ALM11_2_C "project specific calibration data / Project specific calibration data for DFC_MOXEMM_SMU_ALM11_2" VALUE 0x804F5650 Val_Wu8 255.0 OneToOne 0.00 255.0 FORMAT "%5.1" /end CHARACTERISTIC
/begin CHARACTERISTIC DFES_MeterOut.DFC_MOXEMM_SMU_ALM11_3_C "project specific calibration data / Project specific calibration data for DFC_MOXEMM_SMU_ALM11_3" VALUE 0x804F5651 Val_Wu8 255.0 OneToOne 0.00 255.0 FORMAT "%5.1" /end CHARACTERISTIC
/begin CHARACTERISTIC DFES_MeterOut.DFC_MOXEMM_SMU_ALM11_4_C "project specific calibration data / Project specific calibration data for DFC_MOXEMM_SMU_ALM11_4" VALUE 0x804F5652 Val_Wu8 255.0 OneToOne 0.00 255.0 FORMAT "%5.1" /end CHARACTERISTIC
/begin CHARACTERISTIC DFES_MeterOut.DFC_MOXEMM_SMU_ALM11_5_C "project specific calibration data / Project specific calibration data for DFC_MOXEMM_SMU_ALM11_5" VALUE 0x804F5653 Val_Wu8 255.0 OneToOne 0.00 255.0 FORMAT "%5.1" /end CHARACTERISTIC
/begin CHARACTERISTIC DFES_MeterOut.DFC_MOXEMM_SMU_ALM11_8_C "project specific calibration data / Project specific calibration data for DFC_MOXEMM_SMU_ALM11_8" VALUE 0x804F5654 Val_Wu8 255.0 OneToOne 0.00 255.0 FORMAT "%5.1" /end CHARACTERISTIC
/begin CHARACTERISTIC DFES_MeterOut.DFC_MOXEMM_SMU_ALM11_9_C "project specific calibration data / Project specific calibration data for DFC_MOXEMM_SMU_ALM11_9" VALUE 0x804F5655 Val_Wu8 255.0 OneToOne 0.00 255.0 FORMAT "%5.1" /end CHARACTERISTIC
/begin CHARACTERISTIC DFES_MeterOut.DFC_MOXEMM_SMU_ALM1_0_C "project specific calibration data / Project specific calibration data for DFC_MOXEMM_SMU_ALM1_0" VALUE 0x804F5656 Val_Wu8 255.0 OneToOne 0.00 255.0 FORMAT "%5.1" /end CHARACTERISTIC
/begin CHARACTERISTIC DFES_MeterOut.DFC_MOXEMM_SMU_ALM1_1_C "project specific calibration data / Project specific calibration data for DFC_MOXEMM_SMU_ALM1_1" VALUE 0x804F5657 Val_Wu8 255.0 OneToOne 0.00 255.0 FORMAT "%5.1" /end CHARACTERISTIC
/begin CHARACTERISTIC DFES_MeterOut.DFC_MOXEMM_SMU_ALM1_10_C "project specific calibration data / Project specific calibration data for DFC_MOXEMM_SMU_ALM1_10" VALUE 0x804F5658 Val_Wu8 255.0 OneToOne 0.00 255.0 FORMAT "%5.1" /end CHARACTERISTIC
/begin CHARACTERISTIC DFES_MeterOut.DFC_MOXEMM_SMU_ALM1_11_C "project specific calibration data / Project specific calibration data for DFC_MOXEMM_SMU_ALM1_11" VALUE 0x804F5659 Val_Wu8 255.0 OneToOne 0.00 255.0 FORMAT "%5.1" /end CHARACTERISTIC
/begin CHARACTERISTIC DFES_MeterOut.DFC_MOXEMM_SMU_ALM1_13_C "project specific calibration data / Project specific calibration data for DFC_MOXEMM_SMU_ALM1_13" VALUE 0x804F565A Val_Wu8 255.0 OneToOne 0.00 255.0 FORMAT "%5.1" /end CHARACTERISTIC
/begin CHARACTERISTIC DFES_MeterOut.DFC_MOXEMM_SMU_ALM1_14_C "project specific calibration data / Project specific calibration data for DFC_MOXEMM_SMU_ALM1_14" VALUE 0x804F565B Val_Wu8 255.0 OneToOne 0.00 255.0 FORMAT "%5.1" /end CHARACTERISTIC
/begin CHARACTERISTIC DFES_MeterOut.DFC_MOXEMM_SMU_ALM1_2_C "project specific calibration data / Project specific calibration data for DFC_MOXEMM_SMU_ALM1_2" VALUE 0x804F565C Val_Wu8 255.0 OneToOne 0.00 255.0 FORMAT "%5.1" /end CHARACTERISTIC
/begin CHARACTERISTIC DFES_MeterOut.DFC_MOXEMM_SMU_ALM1_22_C "project specific calibration data / Project specific calibration data for DFC_MOXEMM_SMU_ALM1_22" VALUE 0x804F565D Val_Wu8 255.0 OneToOne 0.00 255.0 FORMAT "%5.1" /end CHARACTERISTIC
/begin CHARACTERISTIC DFES_MeterOut.DFC_MOXEMM_SMU_ALM1_23_C "project specific calibration data / Project specific calibration data for DFC_MOXEMM_SMU_ALM1_23" VALUE 0x804F565E Val_Wu8 255.0 OneToOne 0.00 255.0 FORMAT "%5.1" /end CHARACTERISTIC
/begin CHARACTERISTIC DFES_MeterOut.DFC_MOXEMM_SMU_ALM1_4_C "project specific calibration data / Project specific calibration data for DFC_MOXEMM_SMU_ALM1_4" VALUE 0x804F565F Val_Wu8 255.0 OneToOne 0.00 255.0 FORMAT "%5.1" /end CHARACTERISTIC
/begin CHARACTERISTIC DFES_MeterOut.DFC_MOXEMM_SMU_ALM1_5_C "project specific calibration data / Project specific calibration data for DFC_MOXEMM_SMU_ALM1_5" VALUE 0x804F5660 Val_Wu8 255.0 OneToOne 0.00 255.0 FORMAT "%5.1" /end CHARACTERISTIC
/begin CHARACTERISTIC DFES_MeterOut.DFC_MOXEMM_SMU_ALM1_7_C "project specific calibration data / Project specific calibration data for DFC_MOXEMM_SMU_ALM1_7" VALUE 0x804F5661 Val_Wu8 255.0 OneToOne 0.00 255.0 FORMAT "%5.1" /end CHARACTERISTIC
/begin CHARACTERISTIC DFES_MeterOut.DFC_MOXEMM_SMU_ALM1_8_C "project specific calibration data / Project specific calibration data for DFC_MOXEMM_SMU_ALM1_8" VALUE 0x804F5662 Val_Wu8 255.0 OneToOne 0.00 255.0 FORMAT "%5.1" /end CHARACTERISTIC
/begin CHARACTERISTIC DFES_MeterOut.DFC_MOXEMM_SMU_ALM21_0_C "project specific calibration data / Project specific calibration data for DFC_MOXEMM_SMU_ALM21_0" VALUE 0x804F5663 Val_Wu8 255.0 OneToOne 0.00 255.0 FORMAT "%5.1" /end CHARACTERISTIC
/begin CHARACTERISTIC DFES_MeterOut.DFC_MOXEMM_SMU_ALM21_16_C "project specific calibration data / Project specific calibration data for DFC_MOXEMM_SMU_ALM21_16" VALUE 0x804F5664 Val_Wu8 255.0 OneToOne 0.00 255.0 FORMAT "%5.1" /end CHARACTERISTIC
/begin CHARACTERISTIC DFES_MeterOut.DFC_MOXEMM_SMU_ALM21_3_C "project specific calibration data / Project specific calibration data for DFC_MOXEMM_SMU_ALM21_3" VALUE 0x804F5665 Val_Wu8 255.0 OneToOne 0.00 255.0 FORMAT "%5.1" /end CHARACTERISTIC
/begin CHARACTERISTIC DFES_MeterOut.DFC_MOXEMM_SMU_ALM2_1_C "project specific calibration data / Project specific calibration data for DFC_MOXEMM_SMU_ALM2_1" VALUE 0x804F5666 Val_Wu8 255.0 OneToOne 0.00 255.0 FORMAT "%5.1" /end CHARACTERISTIC
/begin CHARACTERISTIC DFES_MeterOut.DFC_MOXEMM_SMU_ALM2_10_C "project specific calibration data / Project specific calibration data for DFC_MOXEMM_SMU_ALM2_10" VALUE 0x804F5667 Val_Wu8 255.0 OneToOne 0.00 255.0 FORMAT "%5.1" /end CHARACTERISTIC
/begin CHARACTERISTIC DFES_MeterOut.DFC_MOXEMM_SMU_ALM2_11_C "project specific calibration data / Project specific calibration data for DFC_MOXEMM_SMU_ALM2_11" VALUE 0x804F5668 Val_Wu8 255.0 OneToOne 0.00 255.0 FORMAT "%5.1" /end CHARACTERISTIC
/begin CHARACTERISTIC DFES_MeterOut.DFC_MOXEMM_SMU_ALM2_13_C "project specific calibration data / Project specific calibration data for DFC_MOXEMM_SMU_ALM2_13" VALUE 0x804F5669 Val_Wu8 255.0 OneToOne 0.00 255.0 FORMAT "%5.1" /end CHARACTERISTIC
/begin CHARACTERISTIC DFES_MeterOut.DFC_MOXEMM_SMU_ALM2_14_C "project specific calibration data / Project specific calibration data for DFC_MOXEMM_SMU_ALM2_14" VALUE 0x804F566A Val_Wu8 255.0 OneToOne 0.00 255.0 FORMAT "%5.1" /end CHARACTERISTIC
/begin CHARACTERISTIC DFES_MeterOut.DFC_MOXEMM_SMU_ALM2_22_C "project specific calibration data / Project specific calibration data for DFC_MOXEMM_SMU_ALM2_22" VALUE 0x804F566B Val_Wu8 255.0 OneToOne 0.00 255.0 FORMAT "%5.1" /end CHARACTERISTIC
/begin CHARACTERISTIC DFES_MeterOut.DFC_MOXEMM_SMU_ALM2_23_C "project specific calibration data / Project specific calibration data for DFC_MOXEMM_SMU_ALM2_23" VALUE 0x804F566C Val_Wu8 255.0 OneToOne 0.00 255.0 FORMAT "%5.1" /end CHARACTERISTIC
/begin CHARACTERISTIC DFES_MeterOut.DFC_MOXEMM_SMU_ALM2_4_C "project specific calibration data / Project specific calibration data for DFC_MOXEMM_SMU_ALM2_4" VALUE 0x804F566D Val_Wu8 255.0 OneToOne 0.00 255.0 FORMAT "%5.1" /end CHARACTERISTIC
/begin CHARACTERISTIC DFES_MeterOut.DFC_MOXEMM_SMU_ALM2_5_C "project specific calibration data / Project specific calibration data for DFC_MOXEMM_SMU_ALM2_5" VALUE 0x804F566E Val_Wu8 255.0 OneToOne 0.00 255.0 FORMAT "%5.1" /end CHARACTERISTIC
/begin CHARACTERISTIC DFES_MeterOut.DFC_MOXEMM_SMU_ALM2_7_C "project specific calibration data / Project specific calibration data for DFC_MOXEMM_SMU_ALM2_7" VALUE 0x804F566F Val_Wu8 255.0 OneToOne 0.00 255.0 FORMAT "%5.1" /end CHARACTERISTIC
/begin CHARACTERISTIC DFES_MeterOut.DFC_MOXEMM_SMU_ALM2_8_C "project specific calibration data / Project specific calibration data for DFC_MOXEMM_SMU_ALM2_8" VALUE 0x804F5670 Val_Wu8 255.0 OneToOne 0.00 255.0 FORMAT "%5.1" /end CHARACTERISTIC
/begin CHARACTERISTIC DFES_MeterOut.DFC_MOXEMM_SMU_ALM6_0_C "project specific calibration data / Project specific calibration data for DFC_MOXEMM_SMU_ALM6_0" VALUE 0x804F5671 Val_Wu8 255.0 OneToOne 0.00 255.0 FORMAT "%5.1" /end CHARACTERISTIC
/begin CHARACTERISTIC DFES_MeterOut.DFC_MOXEMM_SMU_ALM6_11_C "project specific calibration data / Project specific calibration data for DFC_MOXEMM_SMU_ALM6_11" VALUE 0x804F5672 Val_Wu8 255.0 OneToOne 0.00 255.0 FORMAT "%5.1" /end CHARACTERISTIC
/begin FUNCTION DSM_Conf "30164.6.0 DSM Kernel configuration"
 /begin DEF_CHARACTERISTIC DFES_MeterOut.DFC_ComAYCGChksum_C DFES_MeterOut.DFC_ComAYCGRingCnt_C DFES_MeterOut.DFC_ComAYCGTOut_C DFES_MeterOut.DFC_ComAYCIChkSum_C DFES_MeterOut.DFC_ComAYCIRingCnt_C DFES_MeterOut.DFC_ComAYCITOut_C DFES_MeterOut.DFC_ComBCM1ChkSum_C DFES_MeterOut.DFC_ComBCM1RingCnt_C DFES_MeterOut.DFC_ComBCM1TOut_C DFES_MeterOut.DFC_ComCANABusOffErr_C DFES_MeterOut.DFC_ComCANBBusOffErr_C DFES_MeterOut.DFC_ComCANCBusOffErr_C DFES_MeterOut.DFC_ComCGW1ChkSum_C DFES_MeterOut.DFC_ComCGW1RingCnt_C DFES_MeterOut.DFC_ComCGW1TOut_C DFES_MeterOut.DFC_ComConvBoostErr_C DFES_MeterOut.DFC_ComConvSlipErr_C DFES_MeterOut.DFC_ComDCDCPrfmncErr_C DFES_MeterOut.DFC_ComDCDCTempWarn_C DFES_MeterOut.DFC_ComEAT10Chksum_C DFES_MeterOut.DFC_ComEAT10RingCnt_C DFES_MeterOut.DFC_ComEAT10TOut_C DFES_MeterOut.DFC_ComEAT11ChkSum_C DFES_MeterOut.DFC_ComEAT11RingCnt_C DFES_MeterOut.DFC_ComEAT11TOut_C DFES_MeterOut.DFC_ComEAT12ChkSum_C DFES_MeterOut.DFC_ComEAT12RingCnt_C DFES_MeterOut.DFC_ComEAT12TOut_C DFES_MeterOut.DFC_ComEAT13ChkSum_C DFES_MeterOut.DFC_ComEAT13RingCnt_C DFES_MeterOut.DFC_ComEAT13TOut_C DFES_MeterOut.DFC_ComEAT1Chksum_C DFES_MeterOut.DFC_ComEAT1RingCnt_C DFES_MeterOut.DFC_ComEAT1TOut_C DFES_MeterOut.DFC_ComEAT2ChkSum_C DFES_MeterOut.DFC_ComEAT2RingCnt_C DFES_MeterOut.DFC_ComEAT2TOut_C DFES_MeterOut.DFC_ComEAT4ChkSum_C DFES_MeterOut.DFC_ComEAT4RingCnt_C DFES_MeterOut.DFC_ComEAT4TOut_C DFES_MeterOut.DFC_ComEAT6Chksum_C DFES_MeterOut.DFC_ComEAT6RingCnt_C DFES_MeterOut.DFC_ComEAT6TOut_C DFES_MeterOut.DFC_ComEAT7Chksum_C DFES_MeterOut.DFC_ComEAT7RingCnt_C DFES_MeterOut.DFC_ComEAT7TOut_C DFES_MeterOut.DFC_ComEAT8Chksum_C DFES_MeterOut.DFC_ComEAT8RingCnt_C DFES_MeterOut.DFC_ComEAT8TOut_C DFES_MeterOut.DFC_ComEATAChksum_C DFES_MeterOut.DFC_ComEATARingCnt_C DFES_MeterOut.DFC_ComEATATOut_C DFES_MeterOut.DFC_ComEATBChkSum_C DFES_MeterOut.DFC_ComEATBRingCnt_C DFES_MeterOut.DFC_ComEATBTOut_C DFES_MeterOut.DFC_ComEATCChksum_C DFES_MeterOut.DFC_ComEATCRingCnt_C DFES_MeterOut.DFC_ComEATCTOut_C DFES_MeterOut.DFC_ComEPBBChkSum_C DFES_MeterOut.DFC_ComEPBBRingCnt_C DFES_MeterOut.DFC_ComEPBBTOut_C DFES_MeterOut.DFC_ComEPBChksum_C DFES_MeterOut.DFC_ComEPBTOut_C DFES_MeterOut.DFC_ComEPBctRing_C DFES_MeterOut.DFC_ComEPS1Chksum_C DFES_MeterOut.DFC_ComEPS1RingCnt_C DFES_MeterOut.DFC_ComEPS1TOut_C DFES_MeterOut.DFC_ComEngCanRxErr_C DFES_MeterOut.DFC_ComGrvySnsrErr_C DFES_MeterOut.DFC_ComGwIMG1ChkSum_C DFES_MeterOut.DFC_ComGwIMG1RingCnt_C DFES_MeterOut.DFC_ComGwIMG1TOut_C DFES_MeterOut.DFC_ComGwIMG3ChkSum_C DFES_MeterOut.DFC_ComGwIMG3RingCnt_C DFES_MeterOut.DFC_ComGwIMG3TOut_C DFES_MeterOut.DFC_ComGwIMG4ChkSum_C DFES_MeterOut.DFC_ComGwIMG4RingCnt_C DFES_MeterOut.DFC_ComGwIMG4TOut_C DFES_MeterOut.DFC_ComGwIMG5ChkSum_C DFES_MeterOut.DFC_ComGwIMG5RingCnt_C DFES_MeterOut.DFC_ComGwIMG5TOut_C DFES_MeterOut.DFC_ComGwIMG6ChkSum_C DFES_MeterOut.DFC_ComGwIMG6RingCnt_C DFES_MeterOut.DFC_ComGwIMG6TOut_C DFES_MeterOut.DFC_ComIDASBChksum_C DFES_MeterOut.DFC_ComIDASBRingCnt_C DFES_MeterOut.DFC_ComIDASBTOut_C DFES_MeterOut.DFC_ComIMGMILReq_C DFES_MeterOut.DFC_ComISSPrms_C DFES_MeterOut.DFC_ComMETAChksum_C DFES_MeterOut.DFC_ComMETAChksumPstDrv_C DFES_MeterOut.DFC_ComMETARingCnt_C DFES_MeterOut.DFC_ComMETARingCntPstDrv_C DFES_MeterOut.DFC_ComMETATOut_C DFES_MeterOut.DFC_ComMETATOutPstDrv_C DFES_MeterOut.DFC_ComMETCChksum_C DFES_MeterOut.DFC_ComMETCRingCnt_C DFES_MeterOut.DFC_ComMETCTOut_C DFES_MeterOut.DFC_ComMETDChksum_C DFES_MeterOut.DFC_ComMETDRingCnt_C DFES_MeterOut.DFC_ComMETDTOut_C DFES_MeterOut.DFC_ComMETE2Chksum_C DFES_MeterOut.DFC_ComMETE2RingCnt_C DFES_MeterOut.DFC_ComMETE2TOut_C DFES_MeterOut.DFC_ComMETFChksum_C DFES_MeterOut.DFC_ComMETFRingCnt_C DFES_MeterOut.DFC_ComMETFTOut_C DFES_MeterOut.DFC_ComMETGChksum_C DFES_MeterOut.DFC_ComMETGRingCnt_C DFES_MeterOut.DFC_ComMETGTOut_C DFES_MeterOut.DFC_ComMETH2Chksum_C DFES_MeterOut.DFC_ComMETH2RingCnt_C DFES_MeterOut.DFC_ComMETH2TOut_C DFES_MeterOut.DFC_ComMETHChksum_C DFES_MeterOut.DFC_ComMETHRingCnt_C DFES_MeterOut.DFC_ComMETHTOut_C DFES_MeterOut.DFC_ComMETIChksum_C DFES_MeterOut.DFC_ComMETIRingCnt_C DFES_MeterOut.DFC_ComMETITOut_C DFES_MeterOut.DFC_ComMETKChksum_C DFES_MeterOut.DFC_ComMETKRingCnt_C DFES_MeterOut.DFC_ComMETKTOut_C DFES_MeterOut.DFC_ComMETLChksum_C DFES_MeterOut.DFC_ComMETLRingCnt_C DFES_MeterOut.DFC_ComMETLTOut_C DFES_MeterOut.DFC_ComMETMChksum_C DFES_MeterOut.DFC_ComMETMRingCnt_C DFES_MeterOut.DFC_ComMETMTOut_C DFES_MeterOut.DFC_ComMETNChksum_C DFES_MeterOut.DFC_ComMETNRingCnt_C DFES_MeterOut.DFC_ComMETNTOut_C DFES_MeterOut.DFC_ComMtrCom_C DFES_MeterOut.DFC_ComPCUChkSum_C DFES_MeterOut.DFC_ComPCURingCnt_C DFES_MeterOut.DFC_ComPCUTOut_C DFES_MeterOut.DFC_ComSRSAChksum_C DFES_MeterOut.DFC_ComSRSARingCnt_C DFES_MeterOut.DFC_ComSRSATOut_C DFES_MeterOut.DFC_ComSRSBChksum_C DFES_MeterOut.DFC_ComSRSBRingCnt_C DFES_MeterOut.DFC_ComSRSBTOut_C DFES_MeterOut.DFC_ComSRSChksum_C DFES_MeterOut.DFC_ComSRSErr_C DFES_MeterOut.DFC_ComSRSRingCnt_C DFES_MeterOut.DFC_ComSRSTOut_C DFES_MeterOut.DFC_ComVehSpdPndFltTCU_C DFES_MeterOut.DFC_EbsChartcCurrErr_C DFES_MeterOut.DFC_EbsSelfDiagErr_C DFES_MeterOut.DFC_GEVlvPhaCsersIntkB1_C DFES_MeterOut.DFC_GEVlvPhaPsOpenLoadIntkB1_C DFES_MeterOut.DFC_GEVlvPhaPsShoToBattIntkB1_C DFES_MeterOut.DFC_GEVlvPhaPsShoToGndIntkB1_C DFES_MeterOut.DFC_GbxCANDigPlausErr_C DFES_MeterOut.DFC_GbxNPos1SRCMax_C DFES_MeterOut.DFC_GbxNPos1SRCMin_C DFES_MeterOut.DFC_GbxNPos2SRCMax_C DFES_MeterOut.DFC_GbxNPos2SRCMin_C DFES_MeterOut.DFC_GbxNPosAlvChk_C DFES_MeterOut.DFC_GbxNPosSyncErr_C DFES_MeterOut.DFC_HEGOS2B1HtrPsMax_C DFES_MeterOut.DFC_HEGOS2B1HtrPsMin_C DFES_MeterOut.DFC_HEGOS2B1HtrPsSig_C DFES_MeterOut.DFC_LinCSErrACG_C DFES_MeterOut.DFC_LinCSErrAEV_C DFES_MeterOut.DFC_LinCSErrDCDC_C DFES_MeterOut.DFC_LinCSErrEBS_C DFES_MeterOut.DFC_LinHdrTimeoutErrACG_C DFES_MeterOut.DFC_LinHdrTimeoutErrAEV_C DFES_MeterOut.DFC_LinHdrTimeoutErrDCDC_C DFES_MeterOut.DFC_LinHdrTimeoutErrEBS_C DFES_MeterOut.DFC_LinMsgTimeoutErrACG_C DFES_MeterOut.DFC_LinMsgTimeoutErrAEV_C DFES_MeterOut.DFC_LinMsgTimeoutErrDCDC_C DFES_MeterOut.DFC_LinMsgTimeoutErrEBS_C DFES_MeterOut.DFC_LinNoStrtComErr_C DFES_MeterOut.DFC_LowPresOilP_C DFES_MeterOut.DFC_MisfDetVWhlFrntLeOORHi_C DFES_MeterOut.DFC_MisfDetVWhlFrntLeRatyHi_C DFES_MeterOut.DFC_MisfDetVWhlFrntLeRatyLo_C DFES_MeterOut.DFC_MisfDetVWhlFrntLeStuck_C DFES_MeterOut.DFC_MisfDetVWhlFrntRiOORHi_C DFES_MeterOut.DFC_MisfDetVWhlFrntRiRatyHi_C DFES_MeterOut.DFC_MisfDetVWhlFrntRiRatyLo_C DFES_MeterOut.DFC_MisfDetVWhlFrntRiStuck_C DFES_MeterOut.DFC_MisfDetVWhlReLeOORHi_C DFES_MeterOut.DFC_MisfDetVWhlReLeRatyHi_C DFES_MeterOut.DFC_MisfDetVWhlReLeRatyLo_C DFES_MeterOut.DFC_MisfDetVWhlReLeStuck_C DFES_MeterOut.DFC_MisfDetVWhlReRiOORHi_C DFES_MeterOut.DFC_MisfDetVWhlReRiRatyHi_C DFES_MeterOut.DFC_MisfDetVWhlReRiRatyLo_C DFES_MeterOut.DFC_MisfDetVWhlReRiStuck_C DFES_MeterOut.DFC_MisfDetdVWhlFrntLePlaus_C DFES_MeterOut.DFC_MisfDetdVWhlFrntRiPlaus_C DFES_MeterOut.DFC_MisfDetdVWhlReLePlaus_C DFES_MeterOut.DFC_MisfDetdVWhlReRiPlaus_C DFES_MeterOut.DFC_PEnvSigRngMax_C DFES_MeterOut.DFC_PEnvSigRngMin_C DFES_MeterOut.DFC_StmFault_C DFES_MeterOut.DFC_StrtCtOffPth_C DFES_MeterOut.DFC_StrtCtlErr_C DFES_MeterOut.DFC_StrtFault_C DFES_MeterOut.DFC_StrtLckJudg1_C DFES_MeterOut.DFC_StrtLckJudg2_C DFES_MeterOut.DFC_StrtOL_C DFES_MeterOut.DFC_StrtOL2_C DFES_MeterOut.DFC_StrtSCB_C DFES_MeterOut.DFC_StrtSCB2_C DFES_MeterOut.DFC_StrtSCG_C DFES_MeterOut.DFC_StrtSCG2_C DFES_MeterOut.DFC_StrtStkRly1_C DFES_MeterOut.DFC_StrtStkRly2_C DFES_MeterOut.DFC_TEVEmax_C DFES_MeterOut.DFC_TEVEmin_C DFES_MeterOut.DFC_TEVEsig_C DFES_MeterOut.DFC_UegoHeatrPrfmncLoS1B1_C DFES_MeterOut.DFC_VehVAllPlaus_C DFES_MeterOut.DFC_VehVNCSnsrElecFailr_C DFES_MeterOut.DFC_VehVPlausCan_C DFES_MeterOut.DFC_VehVPlausFco_C DFES_MeterOut.DFC_VehVPlausPwr_C DFES_MeterOut.DFC_VehVPlausV2N_C DFES_MeterOut.DFC_VehVSpdSnsrAElecFailr_C DFES_MeterOut.DFC_VehVSpdSnsrBElecFailr_C DFES_MeterOut.DFC_ClthMax_C DFES_MeterOut.DFC_IgnClPs_DevComErr_C DFES_MeterOut.DFC_IgnClPs_LineOl_0_C DFES_MeterOut.DFC_IgnClPs_LineOl_1_C DFES_MeterOut.DFC_IgnClPs_LineOl_2_C DFES_MeterOut.DFC_IgnClPs_LineOl_3_C DFES_MeterOut.DFC_IgnClPs_LineScb_0_C DFES_MeterOut.DFC_IgnClPs_LineScb_1_C DFES_MeterOut.DFC_IgnClPs_LineScb_2_C DFES_MeterOut.DFC_IgnClPs_LineScb_3_C DFES_MeterOut.DFC_IgnClPs_LineScg_0_C DFES_MeterOut.DFC_IgnClPs_LineScg_1_C DFES_MeterOut.DFC_IgnClPs_LineScg_2_C DFES_MeterOut.DFC_IgnClPs_LineScg_3_C DFES_MeterOut.DFC_KRVEKOEVAB_C DFES_MeterOut.DFC_KRVEKOEVAB0_C DFES_MeterOut.DFC_KRVEKOEVAB1_C DFES_MeterOut.DFC_KRVEKOEVAB2_C DFES_MeterOut.DFC_KRVEKOEVAB3_C DFES_MeterOut.DFC_UegoSigEcuAsicS1B1_C DFES_MeterOut.DFC_UegoSigEcuComS1B1_C DFES_MeterOut.DFC_UegoSigSnsrS1B1_C DFES_MeterOut.DFC_UegoSigWireOlApesS1B1_C DFES_MeterOut.DFC_UegoSigWireOlIpeS1B1_C DFES_MeterOut.DFC_UegoSigWireOlReS1B1_C DFES_MeterOut.DFC_UegoSigWireRCmpS1B1_C DFES_MeterOut.DFC_UegoSigWireScbS1B1_C DFES_MeterOut.DFC_UegoSigWireScgS1B1_C DFES_MeterOut.DFC_AfsPhyRngHiB1_C DFES_MeterOut.DFC_AfsPhyRngLoB1_C DFES_MeterOut.DFC_AirCCmprOL_C DFES_MeterOut.DFC_AirCCmprOvrTemp_C DFES_MeterOut.DFC_AirCCmprSCB_C DFES_MeterOut.DFC_AirCCmprSCG_C DFES_MeterOut.DFC_AltErr_C DFES_MeterOut.DFC_BattUSRCMax_C DFES_MeterOut.DFC_BattUSRCMin_C DFES_MeterOut.DFC_ComChksTCU1_C DFES_MeterOut.DFC_ComChksTCU11_C DFES_MeterOut.DFC_ComChksTCU12_C DFES_MeterOut.DFC_ComChksTCU13_C DFES_MeterOut.DFC_ComChksTCU2_C DFES_MeterOut.DFC_ComChksTCU3_C DFES_MeterOut.DFC_ComChksTCU4_C DFES_MeterOut.DFC_ComCntTCU1_C DFES_MeterOut.DFC_ComCntTCU11_C DFES_MeterOut.DFC_ComCntTCU12_C DFES_MeterOut.DFC_ComCntTCU13_C DFES_MeterOut.DFC_ComCntTCU2_C DFES_MeterOut.DFC_ComCntTCU3_C DFES_MeterOut.DFC_ComCntTCU4_C DFES_MeterOut.DFC_ComTOutTCU01_C DFES_MeterOut.DFC_ComTOutTCU02_C DFES_MeterOut.DFC_ComTOutTCU1_C DFES_MeterOut.DFC_ComTOutTCU11_C DFES_MeterOut.DFC_ComTOutTCU12_C DFES_MeterOut.DFC_ComTOutTCU13_C DFES_MeterOut.DFC_ComTOutTCU14_C DFES_MeterOut.DFC_ComTOutTCU2_C DFES_MeterOut.DFC_ComTOutTCU3_C DFES_MeterOut.DFC_ComTOutTCU4_C DFES_MeterOut.DFC_DevLibBattUHi_C DFES_MeterOut.DFC_DevLibBattULo_C DFES_MeterOut.DFC_EGRVlvFailSafeActv_C DFES_MeterOut.DFC_EGRVlvGovDvtCld_C DFES_MeterOut.DFC_EGRVlvPhysSRCMax_C DFES_MeterOut.DFC_EGRVlvPhysSRCMin_C DFES_MeterOut.DFC_FanDIOOL_0_C DFES_MeterOut.DFC_FanDIOOL_1_C DFES_MeterOut.DFC_FanDIOOvrTemp_0_C DFES_MeterOut.DFC_FanDIOOvrTemp_1_C DFES_MeterOut.DFC_FanDIOSCB_0_C DFES_MeterOut.DFC_FanDIOSCB_1_C DFES_MeterOut.DFC_FanDIOSCG_0_C DFES_MeterOut.DFC_FanDIOSCG_1_C DFES_MeterOut.DFC_MRlyDcOL_C DFES_MeterOut.DFC_MRlyDcSCB_C DFES_MeterOut.DFC_MRlyDcSCG_C DFES_MeterOut.DFC_PSPOL_C DFES_MeterOut.DFC_PSPOvrTemp_C DFES_MeterOut.DFC_PSPSCB_C DFES_MeterOut.DFC_PSPSCG_C DFES_MeterOut.DFC_T50Err_C DFES_MeterOut.DFC_ThrVlvLoBattB1_C DFES_MeterOut.DFC_UegoSigOperPlausS1B1_C DFES_MeterOut.DFC_VehVPhysRngHi_C DFES_MeterOut.DFC_VehVSclOutOL_C DFES_MeterOut.DFC_VehVSclOutOT_C DFES_MeterOut.DFC_VehVSclOutSCB_C DFES_MeterOut.DFC_VehVSclOutSCG_C DFES_MeterOut.DFC_VehVSigFL_C DFES_MeterOut.DFC_VehVSigFR_C DFES_MeterOut.DFC_VehVSigRL_C DFES_MeterOut.DFC_VehVSigRR_C DFES_MeterOut.DFC_VehVSnsrARngHi_C DFES_MeterOut.DFC_VehVSnsrBRngHi_C DFES_MeterOut.DFC_VehVSpdRtyDiag_C DFES_MeterOut.DFC_DHFHD_C DFES_MeterOut.DFC_InjVlv_DI_DcDc_C DFES_MeterOut.DFC_InjVlv_DI_NoLd_0_C DFES_MeterOut.DFC_InjVlv_DI_NoLd_1_C DFES_MeterOut.DFC_InjVlv_DI_NoLd_2_C DFES_MeterOut.DFC_InjVlv_DI_NoLd_3_C DFES_MeterOut.DFC_InjVlv_DI_ScBnk_0_C DFES_MeterOut.DFC_InjVlv_DI_ScBnk_1_C DFES_MeterOut.DFC_InjVlv_DI_ScBnk_2_C DFES_MeterOut.DFC_InjVlv_DI_ScBnk_3_C DFES_MeterOut.DFC_InjVlv_DI_ScCyl_0_C DFES_MeterOut.DFC_InjVlv_DI_ScCyl_1_C DFES_MeterOut.DFC_InjVlv_DI_ScCyl_2_C DFES_MeterOut.DFC_InjVlv_DI_ScCyl_3_C DFES_MeterOut.DFC_InjVlv_DI_ScHsLs_0_C DFES_MeterOut.DFC_InjVlv_DI_ScHsLs_1_C DFES_MeterOut.DFC_InjVlv_DI_ScHsLs_2_C DFES_MeterOut.DFC_InjVlv_DI_ScHsLs_3_C DFES_MeterOut.DFC_MfPsDiaOpenLoad1_C DFES_MeterOut.DFC_MfPsDiaScHiS1_C DFES_MeterOut.DFC_MfPsDiaScHiSLowS1_C DFES_MeterOut.DFC_MfPsDiaScLowS1_C DFES_MeterOut.DFC_ACEvpTPhysRngHi_C DFES_MeterOut.DFC_ACEvpTPhysRngLo_C DFES_MeterOut.DFC_ACEvpTSRCMax_C DFES_MeterOut.DFC_ACEvpTSRCMin_C DFES_MeterOut.DFC_AfsRawSigRngHiB1_C DFES_MeterOut.DFC_AfsRawSigRngLoB1_C DFES_MeterOut.DFC_AfsSnsrErrB1_C DFES_MeterOut.DFC_AirCClntPAnaSRCMax_C DFES_MeterOut.DFC_AirCClntPAnaSRCMin_C DFES_MeterOut.DFC_AirCSwtNpl_C DFES_MeterOut.DFC_AirCSwtSig_C DFES_MeterOut.DFC_Brk_C DFES_MeterOut.DFC_BrkBstSensSCB_C DFES_MeterOut.DFC_BrkBstSensSCG_C DFES_MeterOut.DFC_BrkSig_C DFES_MeterOut.DFC_ClthSig_C DFES_MeterOut.DFC_EGRVlvCurrLim_C DFES_MeterOut.DFC_EGRVlvOL_C DFES_MeterOut.DFC_EGRVlvOvrTemp_C DFES_MeterOut.DFC_EGRVlvSCB_C DFES_MeterOut.DFC_EGRVlvSCG_C DFES_MeterOut.DFC_EGRVlvSRCMax_C DFES_MeterOut.DFC_EGRVlvSRCMin_C DFES_MeterOut.DFC_HLSDemOvhtEngLim_C DFES_MeterOut.DFC_OilPSwmpSRCMax_C DFES_MeterOut.DFC_OilPSwmpSRCMin_C DFES_MeterOut.DFC_PIntkVUsLineHiB1_C DFES_MeterOut.DFC_PIntkVUsLineLoB1_C DFES_MeterOut.DFC_VehVPhysRngLo_C DFES_MeterOut.DFC_VehVSigCan_C DFES_MeterOut.DFC_VehVSigCanSafe_C DFES_MeterOut.DFC_VlvLftFbOilPSnsrIntk11SRCMax_C DFES_MeterOut.DFC_VlvLftFbOilPSnsrIntk11SRCMin_C DFES_MeterOut.DFC_ClthNpl_C DFES_MeterOut.DFC_GbxPNPosnDrvCdn_C DFES_MeterOut.DFC_GbxPNPosnPlausy_C DFES_MeterOut.DFC_AfsSigErrLineHiB1_C DFES_MeterOut.DFC_AfsSigErrLineLoB1_C DFES_MeterOut.DFC_PEnvCcMax_C DFES_MeterOut.DFC_PEnvCcMin_C DFES_MeterOut.DFC_PEnvRngChkMax_C DFES_MeterOut.DFC_PEnvRngChkMin_C DFES_MeterOut.DFC_PEnvSnsrPlaus_C DFES_MeterOut.DFC_UEGOHeatrRlyPsOLS1B1_C DFES_MeterOut.DFC_UEGOHeatrRlyPsSCBS1B1_C DFES_MeterOut.DFC_UEGOHeatrRlyPsSCGS1B1_C DFES_MeterOut.DFC_UegoHeatrWireOlS1B1_C DFES_MeterOut.DFC_UegoHeatrWireScbS1B1_C DFES_MeterOut.DFC_UegoHeatrWireScgS1B1_C DFES_MeterOut.DFC_KnDetSens1PortAMax_C DFES_MeterOut.DFC_KnDetSens1PortAMin_C DFES_MeterOut.DFC_KnDetSens1PortBMax_C DFES_MeterOut.DFC_KnDetSens1PortBMin_C DFES_MeterOut.DFC_Clth2ONStuck_C DFES_MeterOut.DFC_Clth2ONStuckLdc_C DFES_MeterOut.DFC_Clth3ONStuckLdc_C DFES_MeterOut.DFC_Clth3ONStuckPostDrv_C DFES_MeterOut.DFC_Clth4ONStuck_C DFES_MeterOut.DFC_Clth4ONStuckLdc_C DFES_MeterOut.DFC_ComBCMUnit_C DFES_MeterOut.DFC_ComDLCTCU01_C DFES_MeterOut.DFC_ComDLCTCU02_C DFES_MeterOut.DFC_ComDLCTCU1_C DFES_MeterOut.DFC_ComDLCTCU11_C DFES_MeterOut.DFC_ComDLCTCU12_C DFES_MeterOut.DFC_ComDLCTCU13_C DFES_MeterOut.DFC_ComDLCTCU14_C DFES_MeterOut.DFC_ComDLCTCU2_C DFES_MeterOut.DFC_ComDLCTCU3_C DFES_MeterOut.DFC_ComDLCTCU4_C DFES_MeterOut.DFC_ComEPSUnit_C DFES_MeterOut.DFC_ComIDASBUnit_C DFES_MeterOut.DFC_ComIMGUnit_C DFES_MeterOut.DFC_ComMETUnit_C DFES_MeterOut.DFC_ComSRSUnit_C DFES_MeterOut.DFC_ComVSAUnit_C DFES_MeterOut.DFC_EbsSocFlt_C DFES_MeterOut.DFC_I14229VINErr_C DFES_MeterOut.DFC_InjCatHeatgErr_C DFES_MeterOut.DFC_InjSysMulInjDiagErr_C DFES_MeterOut.DFC_LLRHmax_C DFES_MeterOut.DFC_LLRHmin_C DFES_MeterOut.DFC_LLRHnpl_C DFES_MeterOut.DFC_LLRKHmax_C DFES_MeterOut.DFC_LLRKHmin_C DFES_MeterOut.DFC_LLRKHnpl_C DFES_MeterOut.DFC_LinACGUnit_C DFES_MeterOut.DFC_LinAEVUnit_C DFES_MeterOut.DFC_LinEBSUnit_C DFES_MeterOut.DFC_RoughRoad_C DFES_MeterOut.DFC_SiaEEPRdErr_C DFES_MeterOut.DFC_SiaEEPWrngCod_C DFES_MeterOut.DFC_UegoHeatrStrtS1B1_C DFES_MeterOut.DFC_BusDiagCANAPPLBusOff_C DFES_MeterOut.DFC_BusDiagCANCANCBusOff_C DFES_MeterOut.DFC_BusDiagCANVEHICLEBusOff_C DFES_MeterOut.DFC_RBA_IODIAGPWR_rba_IoExtCy329_SignalVltSply_0_C DFES_MeterOut.DFC_RBA_IODIAGPWR_rba_IoExtCy329_SignalVltSply_0OT_C DFES_MeterOut.DFC_RBA_IODIAGPWR_rba_IoExtCy329_SignalVltSply_0OV_C DFES_MeterOut.DFC_RBA_IODIAGPWR_rba_IoExtCy329_SignalVltSply_0SCG_C DFES_MeterOut.DFC_RBA_IODIAGPWR_rba_IoExtCy329_SignalVltSply_0UV_C DFES_MeterOut.DFC_RBA_IODIAGPWR_rba_IoExtCy329_SignalVltSply_1_C DFES_MeterOut.DFC_RBA_IODIAGPWR_rba_IoExtCy329_SignalVltSply_1OT_C DFES_MeterOut.DFC_RBA_IODIAGPWR_rba_IoExtCy329_SignalVltSply_1OV_C DFES_MeterOut.DFC_RBA_IODIAGPWR_rba_IoExtCy329_SignalVltSply_1SCG_C DFES_MeterOut.DFC_RBA_IODIAGPWR_rba_IoExtCy329_SignalVltSply_1UV_C DFES_MeterOut.DFC_RBA_IODIAGPWR_rba_IoExtCy329_SignalVltSply_2_C DFES_MeterOut.DFC_RBA_IODIAGPWR_rba_IoExtCy329_SignalVltSply_2OT_C DFES_MeterOut.DFC_RBA_IODIAGPWR_rba_IoExtCy329_SignalVltSply_2OV_C DFES_MeterOut.DFC_RBA_IODIAGPWR_rba_IoExtCy329_SignalVltSply_2SCG_C DFES_MeterOut.DFC_RBA_IODIAGPWR_rba_IoExtCy329_SignalVltSply_2UV_C DFES_MeterOut.DFC_CAN_E_TIMEOUT_C DFES_MeterOut.DFC_LIN_E_TIMEOUT_C DFES_MeterOut.DFC_MRlyOL_C DFES_MeterOut.DFC_MRlySCB_C DFES_MeterOut.DFC_MRlySCG_C DFES_MeterOut.DFC_rba_MultiStackTrace_Threshold_C DFES_MeterOut.DFC_BSWM_E_ACTION_FAILED_C DFES_MeterOut.DFC_BSWM_E_INTRPTQUEUE_FULL_C DFES_MeterOut.DFC_RBA_IOEXTLIB_KEEPALIVE_DRV_C DFES_MeterOut.DFC_RBA_IOEXTLIB_KEEPALIVE_INI_C DFES_MeterOut.DFC_rba_IoSigRtc_StopCounter_C DFES_MeterOut.DFC_rba_MRly_Diag_Stk_Event_C DFES_MeterOut.DFC_rba_MemDiag_MemReadErr_C DFES_MeterOut.DFC_rba_MemDiag_MemWrErr_C DFES_MeterOut.DFC_rba_SyC_IrrSwOffTrigEngRun_Event_C DFES_MeterOut.DFC_rba_T15_Diag_ComInVld_Event_C DFES_MeterOut.DFC_rba_T15_Diag_ComOff_HwOn_Event_C DFES_MeterOut.DFC_rba_T15_Diag_ComOn_HwOff_Event_C DFES_MeterOut.DFC_AAVmin_C DFES_MeterOut.DFC_AGRSUS_C DFES_MeterOut.DFC_AfsPlausDiagHi_C DFES_MeterOut.DFC_AfsPlausDiagLo_C DFES_MeterOut.DFC_AfsVrntDiagErrB1_C DFES_MeterOut.DFC_AppAllSnsrDfct_C DFES_MeterOut.DFC_BBKRnldg_C DFES_MeterOut.DFC_BBKRsyne_C DFES_MeterOut.DFC_BattUStdbyDiaOL_C DFES_MeterOut.DFC_BigLeakIntkMnfldEmiInfl_C DFES_MeterOut.DFC_BlkdLineTank_C DFES_MeterOut.DFC_BrkMnSwtContOnWarnLmp_C DFES_MeterOut.DFC_BrkMnSwtNotStpWarnLmp_C DFES_MeterOut.DFC_BrkRdntSwtContOnWarnLmp_C DFES_MeterOut.DFC_BrkRdntSwtNotStpWarnLmp_C DFES_MeterOut.DFC_CEngDsTColdStrtMax_C DFES_MeterOut.DFC_CEngDsTColdStrtMin_C DFES_MeterOut.DFC_CEngDsTImps_C DFES_MeterOut.DFC_CEngDsTPlausHSC_C DFES_MeterOut.DFC_CEngDsTPlausLSC_C DFES_MeterOut.DFC_CEngDsTPlausSTC_C DFES_MeterOut.DFC_CEngDsTSRCMax_C DFES_MeterOut.DFC_CEngDsTSRCMin_C DFES_MeterOut.DFC_CEngDsTSig_C DFES_MeterOut.DFC_CEngUsTColdStrtMax_C DFES_MeterOut.DFC_CEngUsTColdStrtMin_C DFES_MeterOut.DFC_CEngUsTLooseCnctn_C DFES_MeterOut.DFC_CEngUsTSRCMax_C DFES_MeterOut.DFC_CEngUsTSRCMin_C DFES_MeterOut.DFC_ComDCDCACCFailr_C DFES_MeterOut.DFC_DCDCFltDet_C DFES_MeterOut.DFC_DKRSA_C DFES_MeterOut.DFC_DKVSmax_C DFES_MeterOut.DFC_DKnpl_C DFES_MeterOut.DFC_DSKVRmax_C DFES_MeterOut.DFC_DSKVRmin_C DFES_MeterOut.DFC_DSKVRnpl_C DFES_MeterOut.DFC_DSKVRsig_C DFES_MeterOut.DFC_DSKVSsig_C DFES_MeterOut.DFC_DSSmax_C DFES_MeterOut.DFC_DSTDmax_C DFES_MeterOut.DFC_DSTEmax_C DFES_MeterOut.DFC_DSTEmin_C DFES_MeterOut.DFC_DSTOFmax_C DFES_MeterOut.DFC_DSTRmax_C DFES_MeterOut.DFC_DSTRmin_C DFES_MeterOut.DFC_DSTRnpl_C DFES_MeterOut.DFC_DSTRsig_C DFES_MeterOut.DFC_DSTTI_C DFES_MeterOut.DFC_DSUmax_C DFES_MeterOut.DFC_DiagCpv1DteskLoLoadStuckClsd_C DFES_MeterOut.DFC_DiagCpv1DteskLoLoadStuckOpen_C DFES_MeterOut.DFC_EGRVlvDrftClsd_C DFES_MeterOut.DFC_EGRVlvDrftOpn_C DFES_MeterOut.DFC_EGRVlvJamVlvClsd_C DFES_MeterOut.DFC_EGRVlvJamVlvOpn_C DFES_MeterOut.DFC_EGRVlvSprgBrk_C DFES_MeterOut.DFC_EGRVlvTempMdlEEPErr_C DFES_MeterOut.DFC_EGRVlvTmpErr_C DFES_MeterOut.DFC_EGSDUS2B1LtrDly_C DFES_MeterOut.DFC_EGSDUS2B1LtrPT1_C DFES_MeterOut.DFC_EGSDUS2B1RtlDly_C DFES_MeterOut.DFC_EGSDUS2B1RtlPT1_C DFES_MeterOut.DFC_EGSDUS2B1TarLean_C DFES_MeterOut.DFC_EGSDUS2B1TarRich_C DFES_MeterOut.DFC_EONVmax_C DFES_MeterOut.DFC_ETAKHLmax_C DFES_MeterOut.DFC_ETAKHTmax_C DFES_MeterOut.DFC_ETHSEmax_C DFES_MeterOut.DFC_ETHSEmin_C DFES_MeterOut.DFC_ETHSFmax_C DFES_MeterOut.DFC_ETHSFmin_C DFES_MeterOut.DFC_ETHSFsig_C DFES_MeterOut.DFC_ETHSNPWmax_C DFES_MeterOut.DFC_ETHSNPWmin_C DFES_MeterOut.DFC_ETHSNPWsig_C DFES_MeterOut.DFC_ETHSPLnpl_C DFES_MeterOut.DFC_ETHSTPLnpl_C DFES_MeterOut.DFC_EngICO_C DFES_MeterOut.DFC_EngPrtOvrSpdMon_C DFES_MeterOut.DFC_EpmCaSI1ErrSig_C DFES_MeterOut.DFC_EpmCaSI1MntErr_C DFES_MeterOut.DFC_EpmCaSI1NoSigMax_C DFES_MeterOut.DFC_EpmCaSI1NoSigMin_C DFES_MeterOut.DFC_EpmCaSI1OfsErr_C DFES_MeterOut.DFC_EpmCrSDGI_C DFES_MeterOut.DFC_EpmCrSErrSig_C DFES_MeterOut.DFC_EpmCrSNoSig_C DFES_MeterOut.DFC_EtaEngIdleNonCsers_C DFES_MeterOut.DFC_EtaEngPtlNonCsers_C DFES_MeterOut.DFC_FRAmax_C DFES_MeterOut.DFC_FRAmin_C DFES_MeterOut.DFC_FSTEmax_C DFES_MeterOut.DFC_FSTEmin_C DFES_MeterOut.DFC_FSTRmax_C DFES_MeterOut.DFC_FSTRmin_C DFES_MeterOut.DFC_FSTRnpl_C DFES_MeterOut.DFC_FSTmax_C DFES_MeterOut.DFC_FTDLAmax_C DFES_MeterOut.DFC_FTDLAmin_C DFES_MeterOut.DFC_FuPHiSnsrEleclmax_C DFES_MeterOut.DFC_FuPHiSnsrEleclmin_C DFES_MeterOut.DFC_FuPHiSnsrEleclnpl_C DFES_MeterOut.DFC_FuPHiSnsrURngMax_C DFES_MeterOut.DFC_FuPHiSnsrURngMin_C DFES_MeterOut.DFC_FuSnsrPhyRngMaxErr_C DFES_MeterOut.DFC_FuSnsrPhyRngMinErr_C DFES_MeterOut.DFC_GEVlvLockPinDiagIntkB1_C DFES_MeterOut.DFC_GEVlvPhaSlowIntkB1_C DFES_MeterOut.DFC_GEVlvPhaTargIntkB1_C DFES_MeterOut.DFC_GbxRvsSwtStk_C DFES_MeterOut.DFC_HDRKHmax_C DFES_MeterOut.DFC_HDRKHmin_C DFES_MeterOut.DFC_HDRPLmax_C DFES_MeterOut.DFC_HDRPLmin_C DFES_MeterOut.DFC_HDRmax_C DFES_MeterOut.DFC_HDRmin_C DFES_MeterOut.DFC_HEGOS2B1ElecMax_C DFES_MeterOut.DFC_HEGOS2B1ElecMin_C DFES_MeterOut.DFC_HEGOS2B1ElecSig_C DFES_MeterOut.DFC_HEGOS2B1HtgNpl_C DFES_MeterOut.DFC_HEV00max_C DFES_MeterOut.DFC_HEV01max_C DFES_MeterOut.DFC_HEV02max_C DFES_MeterOut.DFC_HEV03max_C DFES_MeterOut.DFC_HEVE0max_C DFES_MeterOut.DFC_HEVE1max_C DFES_MeterOut.DFC_HFMmax_C DFES_MeterOut.DFC_HiPSysHiPMaxLimExcdd_C DFES_MeterOut.DFC_IVGdiCtlCvoErrMax_0_C DFES_MeterOut.DFC_IVGdiCtlCvoErrMax_1_C DFES_MeterOut.DFC_IVGdiCtlCvoErrMax_2_C DFES_MeterOut.DFC_IVGdiCtlCvoErrMax_3_C DFES_MeterOut.DFC_IVGdiCtlCvoErrMin_0_C DFES_MeterOut.DFC_IVGdiCtlCvoErrMin_1_C DFES_MeterOut.DFC_IVGdiCtlCvoErrMin_2_C DFES_MeterOut.DFC_IVGdiCtlCvoErrMin_3_C DFES_MeterOut.DFC_IVGdiCtlCvoErrMinMax_C DFES_MeterOut.DFC_IVGdiCtlCvoSigPlausErrSmrCdn_C DFES_MeterOut.DFC_IVGdiCtl_CvoErr_C DFES_MeterOut.DFC_IVGdiCtl_CvoSigPlaus_0_C DFES_MeterOut.DFC_IVGdiCtl_CvoSigPlaus_1_C DFES_MeterOut.DFC_IVGdiCtl_CvoSigPlaus_2_C DFES_MeterOut.DFC_IVGdiCtl_CvoSigPlaus_3_C DFES_MeterOut.DFC_IntkAirTAirFltDsCrssMax_C DFES_MeterOut.DFC_IntkAirTAirFltDsCrssMin_C DFES_MeterOut.DFC_IntkAirTAirFltDsHSCMax_C DFES_MeterOut.DFC_IntkAirTAirFltDsImps_C DFES_MeterOut.DFC_IntkAirTAirFltDsPRCMax_C DFES_MeterOut.DFC_IntkAirTAirFltDsPRCMin_C DFES_MeterOut.DFC_IntkAirTAirFltDsSRCMax_C DFES_MeterOut.DFC_IntkAirTAirFltDsSRCMin_C DFES_MeterOut.DFC_IntkAirTAirFltDsSTC_C DFES_MeterOut.DFC_IntkAirTIntkMnfldCrssMax_C DFES_MeterOut.DFC_IntkAirTIntkMnfldCrssMin_C DFES_MeterOut.DFC_IntkAirTIntkMnfldHSCMax_C DFES_MeterOut.DFC_IntkAirTIntkMnfldImps_C DFES_MeterOut.DFC_IntkAirTIntkMnfldPRCMax_C DFES_MeterOut.DFC_IntkAirTIntkMnfldPRCMin_C DFES_MeterOut.DFC_IntkAirTIntkMnfldSRCMax_C DFES_MeterOut.DFC_IntkAirTIntkMnfldSRCMin_C DFES_MeterOut.DFC_IntkAirTIntkMnfldSTC_C DFES_MeterOut.DFC_KRREGRLMX_C DFES_MeterOut.DFC_KRVEKOCVLCI_C DFES_MeterOut.DFC_KRVEKOENCHMT_C DFES_MeterOut.DFC_KRVEKOENCHMT0_C DFES_MeterOut.DFC_KRVEKOENCHMT1_C DFES_MeterOut.DFC_KRVEKOENCHMT2_C DFES_MeterOut.DFC_KRVEKOENCHMT3_C DFES_MeterOut.DFC_KRVEKOENCHMT4_C DFES_MeterOut.DFC_KRVEKOENCHMT5_C DFES_MeterOut.DFC_KRVEKOENCHMT6_C DFES_MeterOut.DFC_KRVEKOENCHMT7_C DFES_MeterOut.DFC_KRVEKORLMX_C DFES_MeterOut.DFC_KRVEKORLMXL_C DFES_MeterOut.DFC_KS1max_C DFES_MeterOut.DFC_KS1min_C DFES_MeterOut.DFC_LMmax_C DFES_MeterOut.DFC_LZSRnpl_C DFES_MeterOut.DFC_LamDynDiagS1B1_C DFES_MeterOut.DFC_LeakIntkMnfldEmiInfl_C DFES_MeterOut.DFC_LinFrameErrDCDC_C DFES_MeterOut.DFC_LinOverrunErrDCDC_C DFES_MeterOut.DFC_MD00max_C DFES_MeterOut.DFC_MDBmax_C DFES_MeterOut.DFC_MDCat_C DFES_MeterOut.DFC_MDCatCrit_C DFES_MeterOut.DFC_MDCatCurr_C DFES_MeterOut.DFC_MDCyl_0_C DFES_MeterOut.DFC_MDCyl_1_C DFES_MeterOut.DFC_MDCyl_2_C DFES_MeterOut.DFC_MDCyl_3_C DFES_MeterOut.DFC_MDEmi_C DFES_MeterOut.DFC_MDEmiStrt_C DFES_MeterOut.DFC_MDFco_C DFES_MeterOut.DFC_MDMpl_C DFES_MeterOut.DFC_MDSegTiAdpn_C DFES_MeterOut.DFC_MDmax_C DFES_MeterOut.DFC_MFuOilMax_C DFES_MeterOut.DFC_MOXEMM_SMU_ALM0_0_C DFES_MeterOut.DFC_MOXEMM_SMU_ALM0_1_C DFES_MeterOut.DFC_MOXEMM_SMU_ALM0_10_C DFES_MeterOut.DFC_MOXEMM_SMU_ALM0_11_C DFES_MeterOut.DFC_MOXEMM_SMU_ALM0_13_C DFES_MeterOut.DFC_MOXEMM_SMU_ALM0_14_C DFES_MeterOut.DFC_MOXEMM_SMU_ALM0_2_C DFES_MeterOut.DFC_MOXEMM_SMU_ALM0_22_C DFES_MeterOut.DFC_MOXEMM_SMU_ALM0_23_C DFES_MeterOut.DFC_MOXEMM_SMU_ALM0_4_C DFES_MeterOut.DFC_MOXEMM_SMU_ALM0_5_C DFES_MeterOut.DFC_MOXEMM_SMU_ALM0_7_C DFES_MeterOut.DFC_MOXEMM_SMU_ALM0_8_C DFES_MeterOut.DFC_MOXEMM_SMU_ALM10_16_C DFES_MeterOut.DFC_MOXEMM_SMU_ALM10_17_C DFES_MeterOut.DFC_MOXEMM_SMU_ALM10_21_C DFES_MeterOut.DFC_MOXEMM_SMU_ALM11_0_C DFES_MeterOut.DFC_MOXEMM_SMU_ALM11_1_C DFES_MeterOut.DFC_MOXEMM_SMU_ALM11_2_C DFES_MeterOut.DFC_MOXEMM_SMU_ALM11_3_C DFES_MeterOut.DFC_MOXEMM_SMU_ALM11_4_C DFES_MeterOut.DFC_MOXEMM_SMU_ALM11_5_C DFES_MeterOut.DFC_MOXEMM_SMU_ALM11_8_C DFES_MeterOut.DFC_MOXEMM_SMU_ALM11_9_C DFES_MeterOut.DFC_MOXEMM_SMU_ALM1_0_C DFES_MeterOut.DFC_MOXEMM_SMU_ALM1_1_C DFES_MeterOut.DFC_MOXEMM_SMU_ALM1_10_C DFES_MeterOut.DFC_MOXEMM_SMU_ALM1_11_C DFES_MeterOut.DFC_MOXEMM_SMU_ALM1_13_C DFES_MeterOut.DFC_MOXEMM_SMU_ALM1_14_C DFES_MeterOut.DFC_MOXEMM_SMU_ALM1_2_C DFES_MeterOut.DFC_MOXEMM_SMU_ALM1_22_C DFES_MeterOut.DFC_MOXEMM_SMU_ALM1_23_C DFES_MeterOut.DFC_MOXEMM_SMU_ALM1_4_C DFES_MeterOut.DFC_MOXEMM_SMU_ALM1_5_C DFES_MeterOut.DFC_MOXEMM_SMU_ALM1_7_C DFES_MeterOut.DFC_MOXEMM_SMU_ALM1_8_C DFES_MeterOut.DFC_MOXEMM_SMU_ALM21_0_C DFES_MeterOut.DFC_MOXEMM_SMU_ALM21_16_C DFES_MeterOut.DFC_MOXEMM_SMU_ALM21_3_C DFES_MeterOut.DFC_MOXEMM_SMU_ALM2_1_C DFES_MeterOut.DFC_MOXEMM_SMU_ALM2_10_C DFES_MeterOut.DFC_MOXEMM_SMU_ALM2_11_C DFES_MeterOut.DFC_MOXEMM_SMU_ALM2_13_C DFES_MeterOut.DFC_MOXEMM_SMU_ALM2_14_C DFES_MeterOut.DFC_MOXEMM_SMU_ALM2_22_C DFES_MeterOut.DFC_MOXEMM_SMU_ALM2_23_C DFES_MeterOut.DFC_MOXEMM_SMU_ALM2_4_C DFES_MeterOut.DFC_MOXEMM_SMU_ALM2_5_C DFES_MeterOut.DFC_MOXEMM_SMU_ALM2_7_C DFES_MeterOut.DFC_MOXEMM_SMU_ALM2_8_C DFES_MeterOut.DFC_MOXEMM_SMU_ALM6_0_C DFES_MeterOut.DFC_MOXEMM_SMU_ALM6_11_C /end DEF_CHARACTERISTIC
 FUNCTION_VERSION "30164.6.0" /end FUNCTION
/begin COMPU_METHOD OneToOne "" RAT_FUNC "%6.2" "-" COEFFS 0 1 0 0 0 1 /end COMPU_METHOD
/begin RECORD_LAYOUT Val_Wu8 FNC_VALUES 1 UBYTE COLUMN_DIR DIRECT /end RECORD_LAYOUT
/end MODULE
/end PROJECT
