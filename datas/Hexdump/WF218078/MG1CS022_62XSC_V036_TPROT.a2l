ASAP2_VERSION 1 60
/begin PROJECT MG1CS022 "MG1CS022"
/begin HEADER "" VERSION "MG1CS022_62XSC_V036_TPROT" PROJECT_NO MG1CS022 /end HEADER
/begin MODULE DIM ""
/begin MOD_COMMON "" BYTE_ORDER MSB_LAST ALIGNMENT_BYTE 1 ALIGNMENT_WORD 2 ALIGNMENT_LONG 4 ALIGNMENT_INT64 4 ALIGNMENT_FLOAT32_IEEE 4 ALIGNMENT_FLOAT64_IEEE 4 DATA_SIZE 32 /end MOD_COMMON
/begin CHARACTERISTIC CEngDsT_cntrSTCDrvgCycColdThd_MAP "char. map:number of driving cycles with cond. radiation power high for tmot stuck check" MAP 0x80526380 RB_Map_S16S16_U8 255.0 OneToOne 0.00 255.0 FORMAT "%5.1"
 /begin AXIS_DESCR STD_AXIS CEngDsT_tSnsrStrtFrst Temp_Cels 4 -3549.940 3003.560 FORMAT "%8.3" DEPOSIT ABSOLUTE /end AXIS_DESCR
 /begin AXIS_DESCR STD_AXIS EnvT_t Temp_Cels 4 -3549.940 3003.560 FORMAT "%8.3" DEPOSIT ABSOLUTE /end AXIS_DESCR
/end CHARACTERISTIC
/begin CHARACTERISTIC CEngDsT_cntrSTCDrvgCycHotThd_MAP "char. map: number of driving cycles with cond. radiation power low for tmot stuck check" MAP 0x805263A4 RB_Map_S16S16_U8 255.0 OneToOne 0.00 255.0 FORMAT "%5.1"
 /begin AXIS_DESCR STD_AXIS CEngDsT_tSnsrStrtFrst Temp_Cels 4 -3549.940 3003.560 FORMAT "%8.3" DEPOSIT ABSOLUTE /end AXIS_DESCR
 /begin AXIS_DESCR STD_AXIS EnvT_t Temp_Cels 4 -3549.940 3003.560 FORMAT "%8.3" DEPOSIT ABSOLUTE /end AXIS_DESCR
/end CHARACTERISTIC
/begin CHARACTERISTIC CEngDsT_facCorrnStoi_CUR "Correction factor for heat transition to engine coolant at GDIs specific modes" CURVE 0x80526320 RB_Curve_U8_U8 1.992188 fak_ub_b2 0.00 1.992188 FORMAT "%8.6"
 /begin AXIS_DESCR STD_AXIS CEngDsT_mfAirStoi m_ub_b1020 8 0.00 1020. FORMAT "%5.0" DEPOSIT ABSOLUTE /end AXIS_DESCR
/end CHARACTERISTIC
/begin CHARACTERISTIC CEngDsT_facRefMdlCalcnGradOn_CUR "char. Curve: Delay time for usage of reference model gradient during running engine after first engine stop" CURVE 0x80526580 RB_Curve_S16_U8_Static 4.980 fak_ub_b5 0.00 4.980 FORMAT "%5.3"
 /begin AXIS_DESCR STD_AXIS EnvT_t Temp_Cels 4 -3549.940 3003.560 FORMAT "%8.3" DEPOSIT ABSOLUTE /end AXIS_DESCR
/end CHARACTERISTIC
/begin CHARACTERISTIC CEngDsT_facRefMdlEngTFall_CUR "char. Curve: Delay time for detection of falling engine temperature after first engine stop" CURVE 0x8052658E RB_Curve_S16_U8_Static 4.980 fak_ub_b5 0.00 4.980 FORMAT "%5.3"
 /begin AXIS_DESCR STD_AXIS EnvT_t Temp_Cels 4 -3549.940 3003.560 FORMAT "%8.3" DEPOSIT ABSOLUTE /end AXIS_DESCR
/end CHARACTERISTIC
/begin CHARACTERISTIC CEngDsT_facRefMdlOffWtrPmp_CUR "influence water pump for engine coolant temperature model during engine off phases" CURVE 0x8052659C RB_Curve_S16_U8_Static 1.992188 fak_ub_b2 0.00 1.992188 FORMAT "%8.6"
 /begin AXIS_DESCR STD_AXIS CEngDsT_tDifRefMdlEnv TempDiff_Kelv 5 -3276.800 3276.700 FORMAT "%8.3" DEPOSIT ABSOLUTE /end AXIS_DESCR
/end CHARACTERISTIC
/begin CHARACTERISTIC CEngDsT_facReplMdlEngOffInin_C "weighting factor for calculating the initial-value of engine-coolant replacement value" VALUE 0x80526331 RB_Val_Wu8 0.9961 fak_ub_b1 0.00 0.9961 /end CHARACTERISTIC
/begin CHARACTERISTIC CEngDsT_facReplMdlEngOffTi_CUR "Factor engine off time for model temperature" CURVE 0x80526332 RB_Curve_U16_U8_Static 0.9961 fak_ub_b1 0.00 0.9961
 /begin AXIS_DESCR STD_AXIS CEngDsT_tiReplMdlEngOff Time_sec_q1_COMPU 5 0.00 65535.00 FORMAT "%8.2" DEPOSIT ABSOLUTE /end AXIS_DESCR
/end CHARACTERISTIC
/begin CHARACTERISTIC CEngDsT_mAirIntglHSCEnagThd_C "Lower threshold value for imlatm (tmhsrc enabling of the operating range)" VALUE 0x805263C8 RB_Val_Wu8 23.21 m_ub_b23p3 0.00 23.21 FORMAT "%5.2" /end CHARACTERISTIC
/begin CHARACTERISTIC CEngDsT_mfAirSTCColdThdHi_CUR "maximum threshold of air-mass flow for condition radiation power high" CURVE 0x805263CA RB_Curve_S16_U8_Static 1020. m_ub_b1020 0.00 1020. FORMAT "%5.0"
 /begin AXIS_DESCR STD_AXIS VehV_v Vel 5 -327.6800 327.6700 FORMAT "%8.4" DEPOSIT ABSOLUTE /end AXIS_DESCR
/end CHARACTERISTIC
/begin CHARACTERISTIC CEngDsT_mfAirSTCColdThdLo_CUR "minimum threshold of air-mass flow for condition radiation power high" CURVE 0x805263DC RB_Curve_S16_U8_Static 1020. m_ub_b1020 0.00 1020. FORMAT "%5.0"
 /begin AXIS_DESCR STD_AXIS VehV_v Vel 5 -327.6800 327.6700 FORMAT "%8.4" DEPOSIT ABSOLUTE /end AXIS_DESCR
/end CHARACTERISTIC
/begin CHARACTERISTIC CEngDsT_mfAirSTCHotThdHi_CUR "maximum threshold of air-mass flow for condition radiation power low" CURVE 0x805263EE RB_Curve_S16_U8_Static 1020. m_ub_b1020 0.00 1020. FORMAT "%5.0"
 /begin AXIS_DESCR STD_AXIS VehV_v Vel 5 -327.6800 327.6700 FORMAT "%8.4" DEPOSIT ABSOLUTE /end AXIS_DESCR
/end CHARACTERISTIC
/begin CHARACTERISTIC CEngDsT_mfAirSTCHotThdLo_CUR "minimum threshold of air-mass flow for condition radiation power low" CURVE 0x80526400 RB_Curve_S16_U8_Static 1020. m_ub_b1020 0.00 1020. FORMAT "%5.0"
 /begin AXIS_DESCR STD_AXIS VehV_v Vel 5 -327.6800 327.6700 FORMAT "%8.4" DEPOSIT ABSOLUTE /end AXIS_DESCR
/end CHARACTERISTIC
/begin CHARACTERISTIC CEngDsT_nEngHSCEnagThd_C "nmot threshold (tmhsrc enabling of the operating range)" VALUE 0x80526412 RB_Val_Ws16 32767.50 EngN -16384.00 16383.50 FORMAT "%8.2" /end CHARACTERISTIC
/begin CHARACTERISTIC CEngDsT_nEngLSCEnagHi_C "upper threshold for engine speed enabling Low-Side-check engine coolant temeprature sensor" VALUE 0x80526414 RB_Val_Ws16 32767.50 EngN -16384.00 16383.50 FORMAT "%8.2" /end CHARACTERISTIC
/begin CHARACTERISTIC CEngDsT_nEngLSCEnagLo_C "lower threshold for engine speed disabling Low-Side-check engine coolant temperature sensor" VALUE 0x80526416 RB_Val_Ws16 32767.50 EngN -16384.00 16383.50 FORMAT "%8.2" /end CHARACTERISTIC
/begin CHARACTERISTIC CEngDsT_stSwtPlausHSC_C "code word: diagnosis configuration for tans" VALUE 0x80526418 RB_Val_Wu8 255.0 OneToOne 0.00 255.0 FORMAT "%5.1" /end CHARACTERISTIC
/begin CHARACTERISTIC CEngDsT_stSwtPlausLSC2_C "code word: diagnosis configuration of engine coolant temperature sensor" VALUE 0x80526419 RB_Val_Wu8 255.0 OneToOne 0.00 255.0 FORMAT "%5.1" /end CHARACTERISTIC
/begin CHARACTERISTIC CEngDsT_stSwtPlausLSC_C "code word: diagnosis configuration for tans" VALUE 0x8052641A RB_Val_Wu8 255.0 OneToOne 0.00 255.0 FORMAT "%5.1" /end CHARACTERISTIC
/begin CHARACTERISTIC CEngDsT_stSwtPlausSTCEnag_C "Code word for switch of the condition engine stop time for stuck check" VALUE 0x8052641B RB_Val_Wu8 255.0 OneToOne 0.00 255.0 FORMAT "%5.1" /end CHARACTERISTIC
/begin CHARACTERISTIC CEngDsT_stSwtPlausSTC_C "code word: diagnosis configuration for tmot" VALUE 0x8052641C RB_Val_Wu8 255.0 OneToOne 0.00 255.0 FORMAT "%5.1" /end CHARACTERISTIC
/begin CHARACTERISTIC CEngDsT_stSwtRefMdl_C "code word for cinfiguration of refernce temperature model" VALUE 0x805265AE RB_Val_Wu8 255.0 OneToOne 0.00 255.0 FORMAT "%5.1" /end CHARACTERISTIC
/begin CHARACTERISTIC CEngDsT_stSwtReplMdlCfg_C "codeword for configuration of replacement model engine coolant temperature" VALUE 0x80526344 RB_Val_Wu8 255.0 OneToOne 0.00 255.0 FORMAT "%5.1" /end CHARACTERISTIC
/begin CHARACTERISTIC CEngDsT_tDeltaRefMdlEnd_C "Offset value to the CEngDsT reference model end value" VALUE 0x8052641E RB_Val_Ws16 6553.500 Temp_Cels -3549.940 3003.560 FORMAT "%8.3" /end CHARACTERISTIC
/begin CHARACTERISTIC CEngDsT_tDifLSCRefMdlErrHi_C "offset on engine temperature model to upper threshold for non-plausibility" VALUE 0x80526420 RB_Val_Ws16 6553.500 Temp_Cels -3549.940 3003.560 FORMAT "%8.3" /end CHARACTERISTIC
/begin CHARACTERISTIC CEngDsT_tDifLSCRefMdlErrLo_C "offset on engine temperature model to lower threshold for non-plausibility" VALUE 0x80526422 RB_Val_Ws16 6553.500 Temp_Cels -3549.940 3003.560 FORMAT "%8.3" /end CHARACTERISTIC
/begin CHARACTERISTIC CEngDsT_tDifSTCSnsrFildThd_CUR "threshold difference (min and max value) engine coolant temperature for Stuck-Check" CURVE 0x80526424 RB_Curve_S16_S16 6553.500 T_degC_q0p1_COMPU -3276.800 3276.700 FORMAT "%8.3"
 /begin AXIS_DESCR STD_AXIS CEngDsT_tSnsrStrtFrst Temp_Cels 8 -3549.940 3003.560 FORMAT "%8.3" DEPOSIT ABSOLUTE /end AXIS_DESCR
/end CHARACTERISTIC
/begin CHARACTERISTIC CEngDsT_tGrdtHSCFcoGsl_CUR "Temperature gradient High-Side-Check model for fuel cut-off for Gasoline Engine" CURVE 0x80526446 RB_Curve_S16_U16_Static 191.9971 temp_uw_q0p0029_o48 -48.0000 143.9971 FORMAT "%8.4"
 /begin AXIS_DESCR STD_AXIS CEngDsT_tHSCMdl Temp_Cels 7 -3549.940 3003.560 FORMAT "%8.3" DEPOSIT ABSOLUTE /end AXIS_DESCR
/end CHARACTERISTIC
/begin CHARACTERISTIC CEngDsT_tGrdtHSCGsl_MAP "Temperature gradient for high side check model (gasoline engines)" MAP 0x80526464 RB_Map_U8S16_U16 191.9971 temp_uw_q0p0029_o48 -48.0000 143.9971 FORMAT "%8.4"
 /begin AXIS_DESCR STD_AXIS CEngDsT_mfAirPLD m_ub_b1020 7 0.00 1020. FORMAT "%5.0" DEPOSIT ABSOLUTE /end AXIS_DESCR
 /begin AXIS_DESCR STD_AXIS CEngDsT_tHSCMdl Temp_Cels 7 -3549.940 3003.560 FORMAT "%8.3" DEPOSIT ABSOLUTE /end AXIS_DESCR
/end CHARACTERISTIC
/begin CHARACTERISTIC CEngDsT_tGrdtRefMdlCoolg_MAP "reference temperature model: cooling down gradient for running combustion engine" MAP 0x805265B0 RB_Map_S16S16_U16 19.99805 temp_uw_q0p0029_o48 -9.999023 9.999023 FORMAT "%8.6" EXTENDED_LIMITS -48.00000 143.9971
 /begin AXIS_DESCR STD_AXIS CEngDsT_tDifRefMdlEnv TempDiff_Kelv 4 -3276.800 3276.700 FORMAT "%8.3" DEPOSIT ABSOLUTE /end AXIS_DESCR
 /begin AXIS_DESCR STD_AXIS VehV_v Vel 6 -327.6800 327.6700 FORMAT "%8.4" DEPOSIT ABSOLUTE /end AXIS_DESCR
/end CHARACTERISTIC
/begin CHARACTERISTIC CEngDsT_tGrdtRefMdlEnvFcoGsl_CUR "Reference Model: gradient ambient air temperature influence (gasoline engine) during fuel cutoff" CURVE 0x805265F8 RB_Curve_S16_U16_Static 19.99805 temp_uw_q0p0029_o48 -9.999023 9.999023 FORMAT "%8.6" EXTENDED_LIMITS -48.00000 143.9971
 /begin AXIS_DESCR STD_AXIS EnvT_t Temp_Cels 4 -3549.940 3003.560 FORMAT "%8.3" DEPOSIT ABSOLUTE /end AXIS_DESCR
/end CHARACTERISTIC
/begin CHARACTERISTIC CEngDsT_tGrdtRefMdlEnv_MAP "char. map for correction gradient of engine coolant temp. at low warming up" MAP 0x8052660A RB_Map_U8S16_U16 19.99805 temp_uw_q0p0029_o48 -9.999023 9.999023 FORMAT "%8.6" EXTENDED_LIMITS -48.00000 143.9971
 /begin AXIS_DESCR STD_AXIS CEngDsT_mfAirStoiRefMdl m_ub_b1020 5 0.00 1020. FORMAT "%5.0" DEPOSIT ABSOLUTE /end AXIS_DESCR
 /begin AXIS_DESCR STD_AXIS EnvT_t Temp_Cels 4 -3549.940 3003.560 FORMAT "%8.3" DEPOSIT ABSOLUTE /end AXIS_DESCR
/end CHARACTERISTIC
/begin CHARACTERISTIC CEngDsT_tGrdtRefMdlLoadFcoGsl_MAP "Reference Model: gradient influence load (gasoline engine) during fuel cutoff" MAP 0x80526642 RB_Map_U8S16_U16 19.99805 temp_uw_q0p0029_o48 -9.999023 9.999023 FORMAT "%8.6" EXTENDED_LIMITS -48.00000 143.9971
 /begin AXIS_DESCR STD_AXIS CEngDsT_mfAirStoiRefMdl m_ub_b1020 5 0.00 1020. FORMAT "%5.0" DEPOSIT ABSOLUTE /end AXIS_DESCR
 /begin AXIS_DESCR STD_AXIS CEngDsT_tRefMdl Temp_Cels 4 -3549.940 3003.560 FORMAT "%8.3" DEPOSIT ABSOLUTE /end AXIS_DESCR
/end CHARACTERISTIC
/begin CHARACTERISTIC CEngDsT_tGrdtRefMdlLoadStrat_MAP "char. map for load at stratified operation mode in reference model" MAP 0x8052667A RB_Map_U8S16_U16 19.99805 temp_uw_q0p0029_o48 -9.999023 9.999023 FORMAT "%8.6" EXTENDED_LIMITS -48.00000 143.9971
 /begin AXIS_DESCR STD_AXIS CEngDsT_mfAirStoiRefMdl m_ub_b1020 5 0.00 1020. FORMAT "%5.0" DEPOSIT ABSOLUTE /end AXIS_DESCR
 /begin AXIS_DESCR STD_AXIS CEngDsT_tRefMdl Temp_Cels 4 -3549.940 3003.560 FORMAT "%8.3" DEPOSIT ABSOLUTE /end AXIS_DESCR
/end CHARACTERISTIC
/begin CHARACTERISTIC CEngDsT_tGrdtRefMdlLoad_MAP "char. map for load in reference model" MAP 0x805266B2 RB_Map_U8S16_U16 19.99805 temp_uw_q0p0029_o48 -9.999023 9.999023 FORMAT "%8.6" EXTENDED_LIMITS -48.00000 143.9971
 /begin AXIS_DESCR STD_AXIS CEngDsT_mfAirStoiRefMdl m_ub_b1020 5 0.00 1020. FORMAT "%5.0" DEPOSIT ABSOLUTE /end AXIS_DESCR
 /begin AXIS_DESCR STD_AXIS CEngDsT_tRefMdl Temp_Cels 4 -3549.940 3003.560 FORMAT "%8.3" DEPOSIT ABSOLUTE /end AXIS_DESCR
/end CHARACTERISTIC
/begin CHARACTERISTIC CEngDsT_tGrdtRefMdlOff_MAP "char. map for gradient of engine coolant temperature in reference model for engine off state" MAP 0x805266EA RB_Map_S16S16_U16 19.99805 temp_uw_q0p0029_o48 -9.999023 9.999023 FORMAT "%8.6" EXTENDED_LIMITS -48.00000 143.9971
 /begin AXIS_DESCR STD_AXIS CEngDsT_tDifRefMdlEnv TempDiff_Kelv 4 -3276.800 3276.700 FORMAT "%8.3" DEPOSIT ABSOLUTE /end AXIS_DESCR
 /begin AXIS_DESCR STD_AXIS VehV_v Vel 4 -327.6800 327.6700 FORMAT "%8.4" DEPOSIT ABSOLUTE /end AXIS_DESCR
/end CHARACTERISTIC
/begin CHARACTERISTIC CEngDsT_tGrdtReplMdlOnGsl_MAP "map for heating of engine coolant (for gasoline engines)" MAP 0x80526346 RB_Map_U8S16_S8 2.988 temp_q0p01172 -1.500 1.488 FORMAT "%5.3"
 /begin AXIS_DESCR STD_AXIS CEngDsT_mfAirStoi m_ub_b1020 5 0.00 1020. FORMAT "%5.0" DEPOSIT ABSOLUTE /end AXIS_DESCR
 /begin AXIS_DESCR STD_AXIS CEngDsT_tReplMdl Temp_Cels 4 -3549.940 3003.560 FORMAT "%8.3" DEPOSIT ABSOLUTE /end AXIS_DESCR
/end CHARACTERISTIC
/begin CHARACTERISTIC CEngDsT_tHSCMdlThdHi_C "Minimum value for ""high side check"" temperature model (tmhsrc)" VALUE 0x805264DE RB_Val_Ws16 6553.500 Temp_Cels -3549.940 3003.560 FORMAT "%8.3" /end CHARACTERISTIC
/begin CHARACTERISTIC CEngDsT_tHSCMdlThdLo_C "Maximum value for ""high side check"" temperature model (tmhsrc)" VALUE 0x805264E0 RB_Val_Ws16 6553.500 Temp_Cels -3549.940 3003.560 FORMAT "%8.3" /end CHARACTERISTIC
/begin CHARACTERISTIC CEngDsT_tHSCOffs_MAP "Temperature offset for the model (by TUM/VFZG correction)" MAP 0x805264E2 RB_Map_S16S16_S16 6553.500 Temp_Cels -3549.940 3003.560 FORMAT "%8.3"
 /begin AXIS_DESCR STD_AXIS VehV_v Vel 4 -327.6800 327.6700 FORMAT "%8.4" DEPOSIT ABSOLUTE /end AXIS_DESCR
 /begin AXIS_DESCR STD_AXIS EnvT_t Temp_Cels 4 -3549.940 3003.560 FORMAT "%8.3" DEPOSIT ABSOLUTE /end AXIS_DESCR
/end CHARACTERISTIC
/begin CHARACTERISTIC CEngDsT_tHSCSnsrFildOffs_C "tmotlin offset (safety factor for TMOT diagnosis / Max. plaus. temp.)" VALUE 0x80526516 RB_Val_Ws16 6553.500 Temp_Cels -3549.940 3003.560 FORMAT "%8.3" /end CHARACTERISTIC
/begin CHARACTERISTIC CEngDsT_tiDebEngRot_C "debounce time for engine rotation" VALUE 0x8052636C RB_Val_Ws32 2147.48364700 Time_Dt 0.00 2147.48364700 FORMAT "%13.8" EXTENDED_LIMITS -2147.48364800 2147.48364700 /end CHARACTERISTIC
/begin CHARACTERISTIC CEngDsT_tiDebHSCEnag_C "Delay time to disable the diagnosis High side check (physical conditions)" VALUE 0x80526518 RB_Val_Ws32 2147.48364700 Time_Dt 0.00 2147.48364700 FORMAT "%13.8" EXTENDED_LIMITS -2147.48364800 2147.48364700 /end CHARACTERISTIC
/begin CHARACTERISTIC CEngDsT_tiDebHSCErr_C "Delay time after fault detection (diagnosis ""high side check"")" VALUE 0x8052651C RB_Val_Ws32 2147.48364700 Time_Dt 0.00 2147.48364700 FORMAT "%13.8" EXTENDED_LIMITS -2147.48364800 2147.48364700 /end CHARACTERISTIC
/begin CHARACTERISTIC CEngDsT_tiDebHSCHeal_C "Delay time after enabling/healing (diagnosis ""high side check"")" VALUE 0x80526520 RB_Val_Ws32 2147.48364700 Time_Dt 0.00 2147.48364700 FORMAT "%13.8" EXTENDED_LIMITS -2147.48364800 2147.48364700 /end CHARACTERISTIC
/begin CHARACTERISTIC CEngDsT_tiDebLSCErr_C "Delay time to disable the diagnosis low side check (physical conditions)" VALUE 0x80526524 RB_Val_Ws32 2147.48364700 Time_Dt 0.00 2147.48364700 FORMAT "%13.8" EXTENDED_LIMITS -2147.48364800 2147.48364700 /end CHARACTERISTIC
/begin CHARACTERISTIC CEngDsT_tiDebLSCHeal_C "Delay time to heal error of diagnosis low side check Engine Coolant Temperature Sensor" VALUE 0x80526528 RB_Val_Ws32 2147.48364700 Time_Dt 0.00 2147.48364700 FORMAT "%13.8" EXTENDED_LIMITS -2147.48364800 2147.48364700 /end CHARACTERISTIC
/begin CHARACTERISTIC CEngDsT_tiDebLSCPlausEnagHi_C "deboucning time for engine speed higher upper enabling threshold Low-Side-check engine coolant temperature sensor" VALUE 0x8052652C RB_Val_Ws32 2147.48364700 Time_Dt 0.00 2147.48364700 FORMAT "%13.8" EXTENDED_LIMITS -2147.48364800 2147.48364700 /end CHARACTERISTIC
/begin CHARACTERISTIC CEngDsT_tiDebLSCPlausEnagLo_C "deboucning time for engine speed lower upper threshold disablingd Low-Side-check engine coolant temperature sensor" VALUE 0x80526530 RB_Val_Ws32 2147.48364700 Time_Dt 0.00 2147.48364700 FORMAT "%13.8" EXTENDED_LIMITS -2147.48364800 2147.48364700 /end CHARACTERISTIC
/begin CHARACTERISTIC CEngDsT_tiDebRefMdlCalcnGrdOn_C "Delay time for usage of reference model gradient during running engine before first engine stop" VALUE 0x80526720 RB_Val_Ws32 2147.48364700 Time_Dt 0.00 2147.48364700 FORMAT "%13.8" EXTENDED_LIMITS -2147.48364800 2147.48364700 /end CHARACTERISTIC
/begin CHARACTERISTIC CEngDsT_tiDebRefMdlCalcnGrdOn_MAP "char. map: Delay time for usage of reference model gradient during running engine after first engine stop" MAP 0x80526724 RB_Map_S16U16_U16 65535.00 Time_sec_q1_COMPU 0.00 65535.00 FORMAT "%8.2"
 /begin AXIS_DESCR STD_AXIS CEngDsT_vAvrgElec Vel 8 0.00 327.6700 FORMAT "%8.4" EXTENDED_LIMITS -327.6800 327.6700 DEPOSIT ABSOLUTE /end AXIS_DESCR
 /begin AXIS_DESCR STD_AXIS CEngDsT_tiRefMdlEngOff Time_sec_q1_COMPU 8 0.00 65535.00 FORMAT "%8.2" DEPOSIT ABSOLUTE /end AXIS_DESCR
/end CHARACTERISTIC
/begin CHARACTERISTIC CEngDsT_tiDebRefMdlEngN_C "debounce time for detection of long engine off phases" VALUE 0x805267C8 RB_Val_Ws32 2147.48364700 Time_Dt 0.00 2147.48364700 FORMAT "%13.8" EXTENDED_LIMITS -2147.48364800 2147.48364700 /end CHARACTERISTIC
/begin CHARACTERISTIC CEngDsT_tiDebRefMdlEngTFall_C "Delay time for detection of falling engine temperature before first engine stop" VALUE 0x805267CC RB_Val_Ws32 2147.48364700 Time_Dt 0.00 2147.48364700 FORMAT "%13.8" EXTENDED_LIMITS -2147.48364800 2147.48364700 /end CHARACTERISTIC
/begin CHARACTERISTIC CEngDsT_tiDebRefMdlEngTFall_MAP "char. map: Delay time for detection of falling engine temperature after first engine stop" MAP 0x805267D0 RB_Map_S16U16_U16 65535.00 Time_sec_q1_COMPU 0.00 65535.00 FORMAT "%8.2"
 /begin AXIS_DESCR STD_AXIS CEngDsT_vAvrgElec Vel 8 0.00 327.6700 FORMAT "%8.4" EXTENDED_LIMITS -327.6800 327.6700 DEPOSIT ABSOLUTE /end AXIS_DESCR
 /begin AXIS_DESCR STD_AXIS CEngDsT_tiRefMdlEngOff Time_sec_q1_COMPU 8 0.00 65535.00 FORMAT "%8.2" DEPOSIT ABSOLUTE /end AXIS_DESCR
/end CHARACTERISTIC
/begin CHARACTERISTIC CEngDsT_tiDebReplMdlHml_C "time constant for change of heat transition ratio due to mode homogeneous-lean" VALUE 0x80526370 RB_Val_Ws32 2147.48364700 Time_Dt 0.00 2147.48364700 FORMAT "%13.8" EXTENDED_LIMITS -2147.48364800 2147.48364700 /end CHARACTERISTIC
/begin CHARACTERISTIC CEngDsT_tiDebReplMdlStrat_C "time constant for change of heat transition ratio due to mode stratified" VALUE 0x80526374 RB_Val_Ws32 2147.48364700 Time_Dt 0.00 2147.48364700 FORMAT "%13.8" EXTENDED_LIMITS -2147.48364800 2147.48364700 /end CHARACTERISTIC
/begin CHARACTERISTIC CEngDsT_tiDiagDSMCycRprt_C "Freely adjustable CEngDsT diagnose coordinator specific repetition rate at which diagnostic result should be sent to the DSM" VALUE 0x8052688C RB_Val_Wu8 25.50 t_q0p1 0.00 25.50 FORMAT "%5.2" /end CHARACTERISTIC
/begin CHARACTERISTIC CEngDsT_tiDiagDSMFrstRprt_C "Time period at which diagnostic result should be sent to the DSM for the first time once DSM is ready (after new start or with DSM clear)" VALUE 0x8052688D RB_Val_Wu8 25.50 t_q0p1 0.00 25.50 FORMAT "%5.2" /end CHARACTERISTIC
/begin CHARACTERISTIC CEngDsT_tiFilVElec_C "time constant for filterung vehicle speed during elctrical driving phases" VALUE 0x80526874 RB_Val_Ws32 4294.9672940000000 TimeDelay_s 0.0000020000000 4294.9672959999998 FORMAT "%19.14" EXTENDED_LIMITS 0.000002000000001 4294.9672959999998 /end CHARACTERISTIC
/begin CHARACTERISTIC CEngDsT_tiSTCColdOffThd_C "accumulated waiting time out of matched area to reset cond. radiation power high" VALUE 0x80526534 RB_Val_Ws32 2147.48364700 Time_Dt 0.00 2147.48364700 FORMAT "%13.8" EXTENDED_LIMITS -2147.48364800 2147.48364700 /end CHARACTERISTIC
/begin CHARACTERISTIC CEngDsT_tiSTCColdOnThd_C "waiting time within matched area to set condition radiation power high" VALUE 0x80526538 RB_Val_Ws32 2147.48364700 Time_Dt 0.00 2147.48364700 FORMAT "%13.8" EXTENDED_LIMITS -2147.48364800 2147.48364700 /end CHARACTERISTIC
/begin CHARACTERISTIC CEngDsT_tiSTCEngOffThdLo_C "Upper threshold for condition stuck check" VALUE 0x8052653C RB_Val_Ws32 2147483647.00 Time_sec_q1_COMPU 0.00 2147483647.00 FORMAT "%13.2" EXTENDED_LIMITS -2147483648.00 2147483647.00 /end CHARACTERISTIC
/begin CHARACTERISTIC CEngDsT_tiSTCHotOffThd_C "accumulated waiting time out of matched area to reset cond. radiation power low" VALUE 0x80526540 RB_Val_Ws32 2147.48364700 Time_Dt 0.00 2147.48364700 FORMAT "%13.8" EXTENDED_LIMITS -2147.48364800 2147.48364700 /end CHARACTERISTIC
/begin CHARACTERISTIC CEngDsT_tiSTCHotOnThd_C "waiting time within matched area to set condition radiation power low" VALUE 0x80526544 RB_Val_Ws32 2147.48364700 Time_Dt 0.00 2147.48364700 FORMAT "%13.8" EXTENDED_LIMITS -2147.48364800 2147.48364700 /end CHARACTERISTIC
/begin CHARACTERISTIC CEngDsT_tLSCRefMdlEnagThd_C "threshold reference value of the engine temperature model for enabling of Low-Side-Check Engine Coolant Temperature Sensor" VALUE 0x80526548 RB_Val_Ws16 6553.500 Temp_Cels -3549.940 3003.560 FORMAT "%8.3" /end CHARACTERISTIC
/begin CHARACTERISTIC CEngDsT_tLSCRefMdlEnd_CUR "end value of reference model value in depending on ambient temperature for LSC Kühlmitteltemperatur" CURVE 0x8052654A RB_Curve_S16_S16 6553.500 Temp_Cels -3549.940 3003.560 FORMAT "%8.3"
 /begin AXIS_DESCR STD_AXIS EnvT_t Temp_Cels 4 -3549.940 3003.560 FORMAT "%8.3" DEPOSIT ABSOLUTE /end AXIS_DESCR
/end CHARACTERISTIC
/begin CHARACTERISTIC CEngDsT_tLSCStrtTEnagThd_CUR "Curve: engine coolant temperature at first start depending on ambient temperature" CURVE 0x8052655C RB_Curve_S16_S16 6553.500 Temp_Cels -3549.940 3003.560 FORMAT "%8.3"
 /begin AXIS_DESCR STD_AXIS EnvT_t Temp_Cels 4 -3549.940 3003.560 FORMAT "%8.3" DEPOSIT ABSOLUTE /end AXIS_DESCR
/end CHARACTERISTIC
/begin CHARACTERISTIC CEngDsT_tOffsRefMdl_C "Quantization offset value in case the coolant reference model temperature CEngDsT_tRefMdl is reached the model end value CEngDsT_tLSCRefMdlEnd" VALUE 0x8052656E RB_Val_Wu8 25.50 TempDiff_Kelv 0.00 25.50 FORMAT "%5.2" /end CHARACTERISTIC
/begin CHARACTERISTIC CEngDsT_tRefMdlEnd_CUR "endvalue of reference temperature model" CURVE 0x80526878 RB_Curve_S16_S16 6553.500 Temp_Cels -3549.940 3003.560 FORMAT "%8.3"
 /begin AXIS_DESCR STD_AXIS EnvT_t Temp_Cels 4 -3549.940 3003.560 FORMAT "%8.3" DEPOSIT ABSOLUTE /end AXIS_DESCR
/end CHARACTERISTIC
/begin CHARACTERISTIC CEngDsT_tReplMdlEngOffLim_C "Lowest Possible start vaue for Engine Temperature model" VALUE 0x80526378 RB_Val_Ws16 6553.500 Temp_Cels -3549.940 3003.560 FORMAT "%8.3" /end CHARACTERISTIC
/begin CHARACTERISTIC CEngDsT_tReplMdlEngOnLim_C "final temperature for substitute value of engine temperature" VALUE 0x8052637A RB_Val_Ws16 6553.500 Temp_Cels -3549.940 3003.560 FORMAT "%8.3" /end CHARACTERISTIC
/begin CHARACTERISTIC CEngDsT_tReplMdlInin_C "initialization value engine coolant temperature replacement model" VALUE 0x8052637C RB_Val_Ws16 6553.500 Temp_Cels -3549.940 3003.560 FORMAT "%8.3" /end CHARACTERISTIC
/begin CHARACTERISTIC CEngDsT_tSTCRefMdlHotThd_C "minimum threshold of substitute engine temperature for stuck signal check" VALUE 0x80526570 RB_Val_Ws16 6553.500 Temp_Cels -3549.940 3003.560 FORMAT "%8.3" /end CHARACTERISTIC
/begin CHARACTERISTIC CEngDsT_tSTCSnsrStrtFrstThdHi_C "upper threshold of engine coolant temp. for stuck signal check" VALUE 0x80526572 RB_Val_Ws16 6553.500 Temp_Cels -3549.940 3003.560 FORMAT "%8.3" /end CHARACTERISTIC
/begin CHARACTERISTIC CEngDsT_tSTCSnsrStrtFrstThdLo_C "lower threshold of engine coolant temp. for stuck signal check" VALUE 0x80526574 RB_Val_Ws16 6553.500 Temp_Cels -3549.940 3003.560 FORMAT "%8.3" /end CHARACTERISTIC
/begin CHARACTERISTIC CEngDsT_tStrtFrstRefMdlEnd_C "the engine coolant start temperature is under the reference model end value" VALUE 0x80526576 RB_Val_Ws16 6553.500 Temp_Cels -3549.940 3003.560 FORMAT "%8.3" /end CHARACTERISTIC
/begin CHARACTERISTIC CEngDsT_vVehSTCColdThdHi_C "upper vehicle speed threshold for condition radiation power high" VALUE 0x80526578 RB_Val_Ws16 327.6700 Vel 0.00 327.6700 FORMAT "%8.4" EXTENDED_LIMITS -327.6800 327.6700 /end CHARACTERISTIC
/begin CHARACTERISTIC CEngDsT_vVehSTCColdThdLo_C "lower vehicle speed threshold for condition radiation power high" VALUE 0x8052657A RB_Val_Ws16 327.6700 Vel 0.00 327.6700 FORMAT "%8.4" EXTENDED_LIMITS -327.6800 327.6700 /end CHARACTERISTIC
/begin CHARACTERISTIC CEngDsT_vVehSTCHotThdHi_C "upper vehicle speed threshold for condition radiation power low" VALUE 0x8052657C RB_Val_Ws16 327.6700 Vel 0.00 327.6700 FORMAT "%8.4" EXTENDED_LIMITS -327.6800 327.6700 /end CHARACTERISTIC
/begin CHARACTERISTIC CEngDsT_vVehSTCHotThdLo_C "lower vehicle speed threshold for condition radiation power low" VALUE 0x8052657E RB_Val_Ws16 327.6700 Vel 0.00 327.6700 FORMAT "%8.4" EXTENDED_LIMITS -327.6800 327.6700 /end CHARACTERISTIC
/begin CHARACTERISTIC CEngUsT_stSwtCfg_C "Configuration switch for engine coolant upstrem temperature sensor aquisition" VALUE 0x80526890 RB_Val_Wu8 255.0 OneToOne 0.00 255.0 FORMAT "%5.1" /end CHARACTERISTIC
/begin CHARACTERISTIC CEngUsT_tDftValReplMdl_C "Default value of replacement model of engine coolant upstream temperature" VALUE 0x805268FA RB_Val_Ws16 6553.500 Temp_Cels -3549.940 3003.560 FORMAT "%8.3" /end CHARACTERISTIC
/begin CHARACTERISTIC CEngUsT_tiDebLooseCnctn1_C "Debounce time for loose connection check of engine coolant upstream temperature" VALUE 0x80526891 RB_Val_Wu8 25.50 t_q0p1 0.00 25.50 FORMAT "%5.2" /end CHARACTERISTIC
/begin CHARACTERISTIC CEngUsT_tiDebLooseCnctn2_C "Debounce Time for loose connection diagnosis of engine coolant upstream temperature" VALUE 0x80526892 RB_Val_Wu8 25.50 t_q0p1 0.00 25.50 FORMAT "%5.2" /end CHARACTERISTIC
/begin CHARACTERISTIC CEngUsT_tiDebSRCErr_C "Debounce Time for signal range check diagnosis of engine coolant upstream temperature" VALUE 0x80526893 RB_Val_Wu8 25.50 t_q0p1 0.00 25.50 FORMAT "%5.2" /end CHARACTERISTIC
/begin CHARACTERISTIC CEngUsT_tiDebSRCHeal_C "Debounce time for healing of signal range check of engine coolant upstream temperature" VALUE 0x80526894 RB_Val_Wu8 25.50 t_q0p1 0.00 25.50 FORMAT "%5.2" /end CHARACTERISTIC
/begin CHARACTERISTIC CEngUsT_tiFil_C "Time constant for signal filter of engine coolant upstream temperature" VALUE 0x805268F4 RB_Val_Wu16 655.3400 t_q0p01 0.0100 655.3500 FORMAT "%8.4" EXTENDED_LIMITS 0.00 655.3500 /end CHARACTERISTIC
/begin CHARACTERISTIC CEngUsT_tiTempPT1_C "Filter constant for filtering of temperature signal of engine coolant upstream temperature" VALUE 0x80526895 RB_Val_Wu8 25.40 t_q0p1 0.10 25.50 FORMAT "%5.2" EXTENDED_LIMITS 0.00 25.50 /end CHARACTERISTIC
/begin CHARACTERISTIC CEngUsT_tiVltgPT1_C "Filter constant for filtering of voltage signal of engine coolant upstream temperature" VALUE 0x80526896 RB_Val_Wu16 6553.400 t_q0p1 0.100 6553.500 FORMAT "%8.3" EXTENDED_LIMITS 0.00 6553.500 /end CHARACTERISTIC
/begin CHARACTERISTIC CEngUsT_tStopIni_C "Initial value of Engine coolant upstream temperature at engine stop event" VALUE 0x805268F6 RB_Val_Wu8 191.3 temp_ub_q0p75_o48 -48.0 143.3 FORMAT "%5.1" /end CHARACTERISTIC
/begin CHARACTERISTIC CEngUsT_tStrtThd_C "Temperature threshold for correction of engine coolant upstream temerature at engine start with temperature drop" VALUE 0x805268F8 RB_Val_Ws16 6553.500 Temp_Cels -3549.940 3003.560 FORMAT "%8.3" /end CHARACTERISTIC
/begin CHARACTERISTIC CEngUsT_u2t_T "Curve for calculation from voltage signal to temperature signal of engine coolant upstream temperature" CURVE 0x80526898 RB_Curve_U16_S16_Static 6553.500 Temp_Cels -3549.940 3003.560 FORMAT "%8.3"
 /begin AXIS_DESCR STD_AXIS CEngUsT_uSnsr Volt 20 0.00 13107.00 FORMAT "%8.2" DEPOSIT ABSOLUTE /end AXIS_DESCR
/end CHARACTERISTIC
/begin CHARACTERISTIC CEngUsT_uRawDft_C "Default sensor voltage value at deactivated SDC Port of egine coolant upstream temperature" VALUE 0x805268EA RB_Val_Ws16 13107.00 Volt -6553.600 6553.400 FORMAT "%8.3" /end CHARACTERISTIC
/begin CHARACTERISTIC CEngUsT_uThdLooseCnctn_C "Signal voltage threshold of loose connection check of engine coolant upstream temperature" VALUE 0x805268EC RB_Val_Wu16 13107.00 Volt 0.00 13107.00 FORMAT "%8.2" /end CHARACTERISTIC
/begin CHARACTERISTIC CEngUsT_uThdSRCMaxErr_C "Signal voltage threshold of max signal range check of engine coolant upstream temperature" VALUE 0x805268EE RB_Val_Wu16 13107.00 Volt 0.00 13107.00 FORMAT "%8.2" /end CHARACTERISTIC
/begin CHARACTERISTIC CEngUsT_uThdSRCMinErr_C "Signal voltage threshold of min signal range check of engine coolant upstream temperature" VALUE 0x805268F0 RB_Val_Wu16 13107.00 Volt 0.00 13107.00 FORMAT "%8.2" /end CHARACTERISTIC
/begin CHARACTERISTIC CEngUsT_vThdLooseCnctnHeal_C "Velocity threshold of loose connection check of engine coolant upstream temperature" VALUE 0x805268F2 RB_Val_Ws16 655.3500 Vel -327.6800 327.6700 FORMAT "%8.4" /end CHARACTERISTIC
/begin CHARACTERISTIC Clth2_Deb.tiHiLo_C "Structure containing debounce time parameters for Clth2/Time for a high to low transition / Time for a High to Low transition" VALUE 0x8058A92E Kw_Ws16 655350.0 TimeDeb -327680.0 327670.0 FORMAT "%8.1" /end CHARACTERISTIC
/begin CHARACTERISTIC Clth2_Deb.tiLoHi_C "Structure containing debounce time parameters for Clth2/Time for a high to low transition / Time for a Low to High transition" VALUE 0x8058A930 Kw_Ws16 655350.0 TimeDeb -327680.0 327670.0 FORMAT "%8.1" /end CHARACTERISTIC
/begin CHARACTERISTIC Clth3_Deb.tiHiLo_C "Structure containing debounce time parameters for Clth3 / Time for a High to Low transition" VALUE 0x8058A932 Kw_Ws16 655350.0 TimeDeb -327680.0 327670.0 FORMAT "%8.1" /end CHARACTERISTIC
/begin CHARACTERISTIC Clth3_Deb.tiLoHi_C "Structure containing debounce time parameters for Clth3 / Time for a Low to High transition" VALUE 0x8058A934 Kw_Ws16 655350.0 TimeDeb -327680.0 327670.0 FORMAT "%8.1" /end CHARACTERISTIC
/begin CHARACTERISTIC Clth4_Deb.tiHiLo_C "Structure containing debounce time parameters for Clth4 / Time for a High to Low transition" VALUE 0x8058A936 Kw_Ws16 655350.0 TimeDeb -327680.0 327670.0 FORMAT "%8.1" /end CHARACTERISTIC
/begin CHARACTERISTIC Clth4_Deb.tiLoHi_C "Structure containing debounce time parameters for Clth4 / Time for a Low to High transition" VALUE 0x8058A938 Kw_Ws16 655350.0 TimeDeb -327680.0 327670.0 FORMAT "%8.1" /end CHARACTERISTIC
/begin CHARACTERISTIC ClthEPBTout_Deb.tiHiLo_C "Structure containing debounce time parameters for EPB Received Time Out / Time for a High to Low transition" VALUE 0x8058A93A Kw_Ws16 655350.0 TimeDeb -327680.0 327670.0 FORMAT "%8.1" /end CHARACTERISTIC
/begin CHARACTERISTIC ClthEPBTout_Deb.tiLoHi_C "Structure containing debounce time parameters for EPB Received Time Out / Time for a Low to High transition" VALUE 0x8058A93C Kw_Ws16 655350.0 TimeDeb -327680.0 327670.0 FORMAT "%8.1" /end CHARACTERISTIC
/begin CHARACTERISTIC Clth_Deb.tiHiLo_C "Debounce structure for clutch signal / Time for a High to Low transition" VALUE 0x8058A93E Kw_Ws16 655350.0 TimeDeb -327680.0 327670.0 FORMAT "%8.1" /end CHARACTERISTIC
/begin CHARACTERISTIC Clth_Deb.tiLoHi_C "Debounce structure for clutch signal / Time for a Low to High transition" VALUE 0x8058A940 Kw_Ws16 655350.0 TimeDeb -327680.0 327670.0 FORMAT "%8.1" /end CHARACTERISTIC
/begin CHARACTERISTIC Clth_flgStkSensClthSwtPrs_C "Stroke sensor and deepest clutch switch is present" VALUE 0x8052691A RB_Val_Wu8 255.0 OneToOne 0.00 255.0 FORMAT "%5.1" /end CHARACTERISTIC
/begin CHARACTERISTIC Clth_nEngThd_C "Threshold for Engine speed to detect Clutch 2 or Clutch 4 ON stuck error" VALUE 0x8052691C RB_Val_Ws16 32767.50 EngN -16384.00 16383.50 FORMAT "%8.2" /end CHARACTERISTIC
/begin CHARACTERISTIC Clth_nNoGearShftDet_C "Minimal engine speed for gear shift detection" VALUE 0x8052691E RB_Val_Ws16 32767.50 EngN -16384.00 16383.50 FORMAT "%8.2" /end CHARACTERISTIC
/begin CHARACTERISTIC Clth_numGearSlip_C "Gear in which slipping clutch will be detected" VALUE 0x805268FC RB_Val_Wu8 9.000 OneToOne 0.00 9.000 FORMAT "%5.3" EXTENDED_LIMITS 0.00 255.0 /end CHARACTERISTIC
/begin CHARACTERISTIC Clth_rClthStkDfl_C "Default clutch information in case of error or stroke sensor not installed" VALUE 0x805268FD RB_Val_Wu8 100.0 Prc_EGR 0.00 100.0 FORMAT "%5.1" /end CHARACTERISTIC
/begin CHARACTERISTIC Clth_rClthStkMaxThres_C "Max threshold of stroke sensor above which error is detected if deepest clutch switch is not pressed" VALUE 0x80526920 RB_Val_Wu8 100.0 Prc_EGR 0.00 100.0 FORMAT "%5.1" /end CHARACTERISTIC
/begin CHARACTERISTIC Clth_rClthStkMinThres_C "Min threshold of stroke sensor below which error is detected if deepest clutch switch is pressed" VALUE 0x80526921 RB_Val_Wu8 100.0 Prc_EGR 0.00 100.0 FORMAT "%5.1" /end CHARACTERISTIC
/begin CHARACTERISTIC Clth_rCluStkThd_C "Clutch stroke sensor CAN input Threshold for clutch pressed status calculation." VALUE 0x805268FE RB_Val_Ws16 255.9961 Prc_Fact256 -128.0000 127.9961 FORMAT "%8.4" /end CHARACTERISTIC
/begin CHARACTERISTIC Clth_rStkHiThdCC_C "Threshold for clutch stroke higher value for cruise control cut off" VALUE 0x80526900 RB_Val_Ws16 255.9961 Prc_Fact256 -128.0000 127.9961 FORMAT "%8.4" /end CHARACTERISTIC
/begin CHARACTERISTIC Clth_rStkHiThdIS_C "Threshold for clutch stroke higher value for Idle Stop" VALUE 0x80526902 RB_Val_Ws16 255.9961 Prc_Fact256 -128.0000 127.9961 FORMAT "%8.4" /end CHARACTERISTIC
/begin CHARACTERISTIC Clth_rStkHiThdSIL_C "Threshold for clutch stroke higher value for shift indication" VALUE 0x80526904 RB_Val_Ws16 255.9961 Prc_Fact256 -128.0000 127.9961 FORMAT "%8.4" /end CHARACTERISTIC
/begin CHARACTERISTIC Clth_rStkLoThdCC_C "Threshold for clutch stroke lower value for cruise control cut off" VALUE 0x80526906 RB_Val_Ws16 255.9961 Prc_Fact256 -128.0000 127.9961 FORMAT "%8.4" /end CHARACTERISTIC
/begin CHARACTERISTIC Clth_rStkLoThdIS_C "Threshold for clutch stroke lower value for Idle Stop" VALUE 0x80526908 RB_Val_Ws16 255.9961 Prc_Fact256 -128.0000 127.9961 FORMAT "%8.4" /end CHARACTERISTIC
/begin CHARACTERISTIC Clth_rStkLoThdSIL_C "Threshold for clutch stroke lower value for shift indication" VALUE 0x8052690A RB_Val_Ws16 255.9961 Prc_Fact256 -128.0000 127.9961 FORMAT "%8.4" /end CHARACTERISTIC
/begin CHARACTERISTIC Clth_rThd1_C "Lower threshold for clutch position evaluation" VALUE 0x80526922 RB_Val_Ws16 255.9961 Prc_Fact256 -128.0000 127.9961 FORMAT "%8.4" /end CHARACTERISTIC
/begin CHARACTERISTIC Clth_rThd2_C "Middle threshold for clutch position evaluation" VALUE 0x80526924 RB_Val_Ws16 255.9961 Prc_Fact256 -128.0000 127.9961 FORMAT "%8.4" /end CHARACTERISTIC
/begin CHARACTERISTIC Clth_rThd3_C "Upper threshold for clutch position evaluation" VALUE 0x80526926 RB_Val_Ws16 255.9961 Prc_Fact256 -128.0000 127.9961 FORMAT "%8.4" /end CHARACTERISTIC
/begin CHARACTERISTIC Clth_stClthONEEPRepl_C "Replacement value for Clutch 2 or Clutch 4 stuck error" VALUE 0x80526928 RB_Val_Wu8 255.0 OneToOne 0.00 255.0 FORMAT "%5.1" /end CHARACTERISTIC
/begin CHARACTERISTIC Clth_stDflVal_C "Default value of clutch state" VALUE 0x80526929 RB_Val_Wu8 255.0 OneToOne 0.00 255.0 FORMAT "%5.1" /end CHARACTERISTIC
/begin CHARACTERISTIC Clth_stOpn_C "Bit mask to detect the open clutch status" VALUE 0x8052690C RB_Val_Wu8 255.0 OneToOne 0.00 255.0 FORMAT "%5.1" /end CHARACTERISTIC
/begin CHARACTERISTIC Clth_stSetClu_C "Calibration switch to select the clutch input for clutch pressed status." VALUE 0x8052690D RB_Val_Wu8 255.0 OneToOne 0.00 255.0 FORMAT "%5.1" /end CHARACTERISTIC
/begin CHARACTERISTIC Clth_stSlipClsd_C "Clutch state: clutch is slipping closed" VALUE 0x8052690E RB_Val_Wu8 255.0 OneToOne 0.00 255.0 FORMAT "%5.1" /end CHARACTERISTIC
/begin CHARACTERISTIC Clth_stSlipOpn_C "Clutch state: clutch is slipping open" VALUE 0x8052690F RB_Val_Wu8 255.0 OneToOne 0.00 255.0 FORMAT "%5.1" /end CHARACTERISTIC
/begin CHARACTERISTIC Clth_stSlip_C "Clutch state: clutch is slipping" VALUE 0x80526910 RB_Val_Wu8 255.0 OneToOne 0.00 255.0 FORMAT "%5.1" /end CHARACTERISTIC
/begin CHARACTERISTIC Clth_stStkActvn_C "calibration for activation of clutch stroke sensor" VALUE 0x80526911 RB_Val_Wu8 255.0 OneToOne 0.00 255.0 FORMAT "%5.1" /end CHARACTERISTIC
/begin CHARACTERISTIC Clth_swtCond_C "Switch for cluth condition" VALUE 0x8052692A RB_Val_Wu16 511.0000 OneToOne 0.00 511.0000 FORMAT "%8.4" EXTENDED_LIMITS 0.00 65535.00 /end CHARACTERISTIC
/begin CHARACTERISTIC Clth_swtSig_C "Switch for signal source of clutch state" VALUE 0x80526912 RB_Val_Wu8 255.0 OneToOne 0.00 255.0 FORMAT "%5.1" /end CHARACTERISTIC
/begin CHARACTERISTIC Clth_tiCANDlyClthOff_C "Debouncing time to detect error Clth_stPlausErr0" VALUE 0x8052692C RB_Val_Ws16 655.3500 Time_s -327.6800 327.6700 FORMAT "%8.4" /end CHARACTERISTIC
/begin CHARACTERISTIC Clth_tiCANDlyClthOn_C "Debouncing time to detect error Clth_stPlausErr1" VALUE 0x8052692E RB_Val_Ws16 655.3500 Time_s -327.6800 327.6700 FORMAT "%8.4" /end CHARACTERISTIC
/begin CHARACTERISTIC Clth_tiClth2NrmDet_C "Threshold for timer to detect release status of clutch 2" VALUE 0x80526930 RB_Val_Ws16 327670.0 Time_ms 0.00 327670.0 FORMAT "%8.1" EXTENDED_LIMITS -327680.0 327670.0 /end CHARACTERISTIC
/begin CHARACTERISTIC Clth_tiClth3NrmDet_C "Threshold for timer to detect release status of clutch 3" VALUE 0x80526932 RB_Val_Ws16 327670.0 Time_ms 0.00 327670.0 FORMAT "%8.1" EXTENDED_LIMITS -327680.0 327670.0 /end CHARACTERISTIC
/begin CHARACTERISTIC Clth_tiClth4NrmDet_C "Threshold for timer to detect release status of clutch 4" VALUE 0x80526934 RB_Val_Ws16 327670.0 Time_ms 0.00 327670.0 FORMAT "%8.1" EXTENDED_LIMITS -327680.0 327670.0 /end CHARACTERISTIC
/begin CHARACTERISTIC Clth_tiCluSwtImpsOffDeb_C "Off debouncing time for 2 clutch pedal plausibility test" VALUE 0x80526936 RB_Val_Ws16 655350.0 TimeDeb -327680.0 327670.0 FORMAT "%8.1" /end CHARACTERISTIC
/begin CHARACTERISTIC Clth_tiCluSwtImpsOnDeb_C "On debouncing time for 2 clutch pedal plausibility test" VALUE 0x80526938 RB_Val_Ws16 655350.0 TimeDeb -327680.0 327670.0 FORMAT "%8.1" /end CHARACTERISTIC
/begin CHARACTERISTIC Clth_tiEPBComDeb_C "Debounce time after which EPB communication is declared" VALUE 0x80526914 RB_Val_Ws16 327670.0 Time_ms 0.00 327670.0 FORMAT "%8.1" EXTENDED_LIMITS -327680.0 327670.0 /end CHARACTERISTIC
/begin CHARACTERISTIC Clth_tiGearShft_C "Debounce time for gear shift detection" VALUE 0x8052693A RB_Val_Ws16 655350.0 Time_ms -327680.0 327670.0 FORMAT "%8.1" /end CHARACTERISTIC
/begin CHARACTERISTIC Clth_tiReOpenDly_C "time threshold to confirm clutch reopening status" VALUE 0x8052693C RB_Val_Ws16 655350.0 Time_ms -327680.0 327670.0 FORMAT "%8.1" /end CHARACTERISTIC
/begin CHARACTERISTIC Clth_tiRxEPBDeb_C "Debounce time after which EPB communication is declared" VALUE 0x80526916 RB_Val_Ws16 327670.0 Time_ms 0.00 327670.0 FORMAT "%8.1" EXTENDED_LIMITS -327680.0 327670.0 /end CHARACTERISTIC
/begin CHARACTERISTIC Clth_tiUnderURstStrtReqOff_C "Delay time for start request off after under voltage reset" VALUE 0x80526918 RB_Val_Ws16 327670.0 Time_ms 0.00 327670.0 FORMAT "%8.1" EXTENDED_LIMITS -327680.0 327670.0 /end CHARACTERISTIC
/begin CHARACTERISTIC Clth_vNoGearShftDet_C "Minimal vehicle speed for gear shift detection" VALUE 0x8052693E RB_Val_Ws16 655.3500 Vel -327.6800 327.6700 FORMAT "%8.4" /end CHARACTERISTIC
/begin CHARACTERISTIC Clth_vVehSpdThd_C "Threshold for Vehicle speed to detect Clutch 2 or Clutch 4 ON stuck error" VALUE 0x80526940 RB_Val_Ws16 655.3500 Vel -327.6800 327.6700 FORMAT "%8.4" /end CHARACTERISTIC
/begin CHARACTERISTIC CoDsplCtl_nEngHigh_C "High threshold engine speed switches according to the HYS" VALUE 0x8058A942 Val_Ws16 5960.000 EngN 40.000 6000.000 FORMAT "%8.3" EXTENDED_LIMITS -16384.00 16383.50 READ_ONLY /end CHARACTERISTIC
/begin CHARACTERISTIC CoDsplCtl_nEngLow_C "Low threshold engine speed switches according to the HYS" VALUE 0x8058A944 Val_Ws16 5960.000 EngN 40.000 6000.000 FORMAT "%8.3" EXTENDED_LIMITS -16384.00 16383.50 READ_ONLY /end CHARACTERISTIC
/begin CHARACTERISTIC CoDsplCtl_nJdgMIDThd_C "engine rpm threshold for MID judgement" VALUE 0x8058A946 Val_Ws16 16383.50 EngN 0.00 16383.50 FORMAT "%8.2" EXTENDED_LIMITS -16384.00 16383.50 /end CHARACTERISTIC
/begin CHARACTERISTIC CoDsplCtl_nOilPres1Low_C "Lower hysteresis 1 for oil pressure warning lamp control change point for engine speed" VALUE 0x8058A948 Val_Ws16 6000.000 EngN 0.00 6000.000 FORMAT "%8.3" EXTENDED_LIMITS -16384.00 16383.50 /end CHARACTERISTIC
/begin CHARACTERISTIC CoDsplCtl_nOilPres2High_C "Upper hysteresis 2 for oil pressure warning lamp control change point for engine speed" VALUE 0x8058A94A Val_Ws16 5960.000 EngN 40.000 6000.000 FORMAT "%8.3" EXTENDED_LIMITS -16384.00 16383.50 /end CHARACTERISTIC
/begin CHARACTERISTIC CoDsplCtl_nOilPres2Low_C "Lower hysteresis 2 for oil pressure warning lamp control change point for engine speed" VALUE 0x8058A94C Val_Ws16 5960.000 EngN 40.000 6000.000 FORMAT "%8.3" EXTENDED_LIMITS -16384.00 16383.50 /end CHARACTERISTIC
/begin CHARACTERISTIC CoDsplCtl_stOilPSnsrActv_C "Masking parameter of oil pressure sensor errors" VALUE 0x8058A94E Val_Wu8 255.0 OneToOne 0.00 255.0 FORMAT "%5.1" /end CHARACTERISTIC
/begin CHARACTERISTIC CoDsplCtl_tiOilPresBrkAwayDly_C "Delay time for oil pressure warning lamp control in case of Idle stop brake away" VALUE 0x8058A950 Val_Ws16 327460.0 Time_ms 0.00 327460.0 FORMAT "%8.1" EXTENDED_LIMITS -327680.0 327670.0 /end CHARACTERISTIC
/begin CHARACTERISTIC CoDsplCtl_tiOilPresDly_C "Delay time for oil pressure warning lamp control" VALUE 0x8058A952 Val_Ws16 327460.0 Time_ms 0.00 327460.0 FORMAT "%8.1" EXTENDED_LIMITS -327680.0 327670.0 /end CHARACTERISTIC
/begin CHARACTERISTIC CoDsplCtl_tiOilPresEngRunDly_C "Delay time for oil pressure warning lamp control in case of direct engine run from idle stop" VALUE 0x8058A954 Val_Ws16 327460.0 Time_ms 0.00 327460.0 FORMAT "%8.1" EXTENDED_LIMITS -327680.0 327670.0 /end CHARACTERISTIC
/begin CHARACTERISTIC CoDsplCtl_tiOilPresRetDly_C "Delay time for oil pressure warning lamp control in Idle start-stop condition" VALUE 0x8058A956 Val_Ws16 327460.0 Time_ms 0.00 327460.0 FORMAT "%8.1" EXTENDED_LIMITS -327680.0 327670.0 /end CHARACTERISTIC
/begin CHARACTERISTIC CoDsplCtl_tiSuspndMid_C "time period for suspend the MID update" VALUE 0x8058A958 Val_Ws16 327460.0 Time_ms 0.00 327460.0 FORMAT "%8.1" EXTENDED_LIMITS -327680.0 327670.0 /end CHARACTERISTIC
/begin CHARACTERISTIC CoEng_bEnaStrt2AutoStop_C "Enable the transition from STARTING to AUTOSTOPPING" VALUE 0x805277A2 RB_Val_Wu8 1.00000000000 B_TRUE 0.00 1.00000000000 FORMAT "%13.11" /end CHARACTERISTIC
/begin CHARACTERISTIC CoEng_flgEngStrtT50Use_C "Parameter for selection whether T50 will be considered at Start-Stop Start or not." VALUE 0x805277A0 RB_Val_Wu8 255.0 OneToOne 0.00 255.0 FORMAT "%5.1" /end CHARACTERISTIC
/begin CHARACTERISTIC CoEng_idxEngTSelStSpStopEna_C "Index to choose an engine temperture for the stop release." VALUE 0x805277A8 RB_Val_Wu8 255.0 OneToOne 0.00 255.0 FORMAT "%5.1" /end CHARACTERISTIC
/begin CHARACTERISTIC CoEng_nEngStrtCdnMin_C "Minimal engine speed threshold which desribes a running engine for OBD" VALUE 0x8052779C RB_Val_Ws16 16383.50 EngN 0.00 16383.50 FORMAT "%8.2" EXTENDED_LIMITS -16384.00 16383.50 /end CHARACTERISTIC
/begin CHARACTERISTIC CoEng_numMaxStopEnblObsrv_C "Number of the requesters in the CoEng_StopEnbl observer list" VALUE 0x805277A9 RB_Val_Wu8 3.000 OneToOne 1.000 4.000 FORMAT "%5.3" EXTENDED_LIMITS 0.00 255.0 /end CHARACTERISTIC
/begin CHARACTERISTIC CoEng_numMaxStrtDesObsrv_C "Number of the requesters in the CoEng_StrtDes observer list" VALUE 0x805278C8 RB_Val_Wu8 3.000 OneToOne 1.000 4.000 FORMAT "%5.3" EXTENDED_LIMITS 0.00 255.0 /end CHARACTERISTIC
/begin CHARACTERISTIC CoEng_numNoUrgStopPhd_C "No urgent stop prohibition" VALUE 0x805277AA RB_Val_Wu8 36.0000000000 CoEng_EngOnDmd_VERB 0.00 36.0000000000 FORMAT "%13.10" READ_ONLY /end CHARACTERISTIC
/begin CHARACTERISTIC CoEng_numNoUrgStrtDmd_C "No urgent start demand" VALUE 0x805278C9 RB_Val_Wu8 36.0000000000 CoEng_EngOnDmd_VERB 0.00 36.0000000000 FORMAT "%13.10" READ_ONLY /end CHARACTERISTIC
/begin CHARACTERISTIC CoEng_stActvtStopEnblCdn_CA "Status to deactivate the stop enable condtitions for Start-Stop" VAL_BLK 0x805277AC RB_ValA_Wu16 65535.00 OneToOne 0.00 65535.00 FORMAT "%8.2" NUMBER 3 /end CHARACTERISTIC
/begin CHARACTERISTIC CoEng_stActvtStrtDmdCdn_CA "Status to deactivate the start demand conditions for Start-Stop" VAL_BLK 0x805278CA RB_ValA_Wu16 65535.00 OneToOne 0.00 65535.00 FORMAT "%8.2" NUMBER 3 /end CHARACTERISTIC
/begin CHARACTERISTIC CoEng_stEngRunDmd_CUR "Status of the demand for a running engine (stop prohibition or start demand)." CURVE 0x805277B2 RB_Curve_S16_S16 32768.00 OneToOne -1.00 32767.00 FORMAT "%8.2" EXTENDED_LIMITS -32768.00 32767.00
 /begin AXIS_DESCR STD_AXIS NO_INPUT_QUANTITY CoEng_EngOnDmd_VERB 37 0.00 36.0000000000 FORMAT "%13.10" DEPOSIT ABSOLUTE /end AXIS_DESCR
/end CHARACTERISTIC
/begin CHARACTERISTIC CoEng_stNoStspStop16ExhMgT_C "Bitcoded codeword for stop inhibitors from exhaust temperature and catalyst heating" VALUE 0x80527848 RB_Val_Wu16 65535.00 OneToOne 0.00 65535.00 FORMAT "%8.2" /end CHARACTERISTIC
/begin CHARACTERISTIC CoEng_stNoStspStop21FuPurgCtlDiag_C "Bitcoded codeword for stop inhibitors from fuel purge system diagnosises" VALUE 0x8052784A RB_Val_Wu16 65535.00 OneToOne 0.00 65535.00 FORMAT "%8.2" /end CHARACTERISTIC
/begin CHARACTERISTIC CoEng_StopEnblLstObsrv_CA "Index-Name list for CoEng_StopEnbl with the requesters which must be observed" VAL_BLK 0x8052784C RB_ValA_Wu8 36.0000000000 CoEng_EngOnDmd_VERB 0.00 36.0000000000 FORMAT "%13.10" NUMBER 4 /end CHARACTERISTIC
/begin CHARACTERISTIC CoEng_StopEnblObsrv_C "Index-Name foe CoEng_StopEnbl of the requesters which must be observed" VALUE 0x80527850 RB_Val_Wu8 36.0000000000 CoEng_EngOnDmd_VERB 0.00 36.0000000000 FORMAT "%13.10" /end CHARACTERISTIC
/begin CHARACTERISTIC CoEng_stPrioMinNoStopExhMgT_C "Minimum priority of ExhMgT_stPrioWpDmdHyb for a stop inhibition" VALUE 0x80527851 RB_Val_Wu8 255.0 OneToOne 0.00 255.0 FORMAT "%5.1" /end CHARACTERISTIC
/begin CHARACTERISTIC CoEng_stRstrtTran_C "Parameter to decide, which transitions in CoEng_stMai have to be made via the restart-task (value of the corresponding bit position: true)" VALUE 0x805277A3 RB_Val_Wu8 255.0 OneToOne 0.00 255.0 FORMAT "%5.1" /end CHARACTERISTIC
/begin CHARACTERISTIC CoEng_StrtDesLstObsrv_CA "Index-Name list for CoEng_StrtDes with the requesters which must be observed" VAL_BLK 0x805278D0 RB_ValA_Wu8 36.0000000000 CoEng_EngOnDmd_VERB 0.00 36.0000000000 FORMAT "%13.10" NUMBER 4 /end CHARACTERISTIC
/begin CHARACTERISTIC CoEng_StrtDesObsrv_C "Index-Name foe CoEng_StrtDes of the requesters which must be observed" VALUE 0x805278D4 RB_Val_Wu8 36.0000000000 CoEng_EngOnDmd_VERB 0.00 36.0000000000 FORMAT "%13.10" /end CHARACTERISTIC
/begin CHARACTERISTIC CoEng_stStopPhdUrgThd_C "Threshold for the classification of a stop prohibition as urgent" VALUE 0x80527852 RB_Val_Wu8 14.00 OneToOne 1.00 15.00 FORMAT "%5.2" EXTENDED_LIMITS 0.00 255.0 /end CHARACTERISTIC
/begin CHARACTERISTIC CoEng_stStopPhdUrg_CUR "Urgency of the stop prohibitions" CURVE 0x80527853 RB_Curve_S8_S8 16.00 OneToOne -1.00 15.00 FORMAT "%5.2" EXTENDED_LIMITS -128.0 127.0
 /begin AXIS_DESCR STD_AXIS NO_INPUT_QUANTITY CoEng_EngOnDmd_VERB 37 0.00 36.0000000000 FORMAT "%13.10" DEPOSIT ABSOLUTE /end AXIS_DESCR
/end CHARACTERISTIC
/begin CHARACTERISTIC CoEng_stStrtDmdUrgThd_C "Threshold for the classification of a start demand as urgent" VALUE 0x805278D5 RB_Val_Wu8 254.0 OneToOne 1.0 255.0 FORMAT "%5.1" EXTENDED_LIMITS 0.00 255.0 /end CHARACTERISTIC
/begin CHARACTERISTIC CoEng_stStrtDmdUrg_CUR "Urgency of the start demands" CURVE 0x805278D6 RB_Curve_S8_S8 16.00 OneToOne -1.00 15.00 FORMAT "%5.2" EXTENDED_LIMITS -128.0 127.0
 /begin AXIS_DESCR STD_AXIS NO_INPUT_QUANTITY CoEng_EngOnDmd_VERB 37 0.00 36.0000000000 FORMAT "%13.10" DEPOSIT ABSOLUTE /end AXIS_DESCR
/end CHARACTERISTIC
/begin CHARACTERISTIC CoEng_stTestStopEnbl_CA "Status to inhibit the stop enable condtitions of start-stop for test purposes." VAL_BLK 0x8052789E RB_ValA_Wu16 65535.00 OneToOne 0.00 65535.00 FORMAT "%8.2" NUMBER 3 /end CHARACTERISTIC
/begin CHARACTERISTIC CoEng_stTestStrtDmd_CA "Status of simulation of start demanders of start-stop for test purposes." VAL_BLK 0x80527922 RB_ValA_Wu16 65535.00 OneToOne 0.00 65535.00 FORMAT "%8.2" NUMBER 3 /end CHARACTERISTIC
/begin CHARACTERISTIC CoEng_stTestStrtEnbl_C "Status to inhibit the start enable condtitions of start-stop for test purposes." VALUE 0x805051F8 Val_Wu16 65535.00 OneToOne 0.00 65535.00 FORMAT "%8.2" /end CHARACTERISTIC
/begin CHARACTERISTIC CoEng_tCooltUsMaxStopEnbl_C "Maximum coolant temperature at engine out for stop release of start-stop" VALUE 0x805278A4 RB_Val_Ws16 6553.500 Temp_Cels -3549.940 3003.560 FORMAT "%8.3" /end CHARACTERISTIC
/begin CHARACTERISTIC CoEng_tCooltUsMinStopEnbl_C "Minimal coolant temperature at engine out for stop release of start-stop" VALUE 0x805278A6 RB_Val_Ws16 6553.500 Temp_Cels -3549.940 3003.560 FORMAT "%8.3" /end CHARACTERISTIC
/begin CHARACTERISTIC CoEng_tEngMaxStopEnblDelta_C "Hysteresis delta for CoEng_tEngMaxStopEnbl_C" VALUE 0x805278A8 RB_Val_Ws16 6553.500 Temp_Cels_Diff -3276.800 3276.700 FORMAT "%8.3" /end CHARACTERISTIC
/begin CHARACTERISTIC CoEng_tEngMaxStopEnbl_C "Maximal engine temperature for stop permission of start-stop" VALUE 0x805278AA RB_Val_Ws16 6553.500 Temp_Cels -3549.940 3003.560 FORMAT "%8.3" /end CHARACTERISTIC
/begin CHARACTERISTIC CoEng_tEngMinStopEnblDelta_C "Hysteresis delta for CoEng_tEngMinStopEnbl_C" VALUE 0x805278AC RB_Val_Ws16 6553.500 Temp_Cels_Diff -3276.800 3276.700 FORMAT "%8.3" /end CHARACTERISTIC
/begin CHARACTERISTIC CoEng_tEngMinStopEnbl_C "Minimal engine temperature for stop permission of start-stop" VALUE 0x805278AE RB_Val_Ws16 6553.500 Temp_Cels -3549.940 3003.560 FORMAT "%8.3" /end CHARACTERISTIC
/begin CHARACTERISTIC CoEng_tiDiStopAftEngOff_C "Minimal engine run time after a long stop period for stop permission of start-stop" VALUE 0x805278B0 RB_Val_Wu16 655.3500 Time_s 0.00 655.3500 FORMAT "%8.4" /end CHARACTERISTIC
/begin CHARACTERISTIC CoEng_tiEngOffThdOil_C "Time threshold for stop period to activate CoEng_tiDiStopAftEngOff_C" VALUE 0x805278B4 RB_Val_Ws32 4294967295.00 Time_sec_q1_COMPU -2147483648.00 2147483647.00 FORMAT "%13.2" /end CHARACTERISTIC
/begin CHARACTERISTIC CoEng_tiPwrStgDiaRdy_C "delay time to diagnose turned off actuators while engine state afterrun is active" VALUE 0x805277A4 RB_Val_Ws16 327670.0 Time_ms 0.00 327670.0 FORMAT "%8.1" EXTENDED_LIMITS -327680.0 327670.0 /end CHARACTERISTIC
/begin CHARACTERISTIC CoEng_tiScneEngStrtStM.CoEng_tiScneEngStrtWait_C "The State machine which controls the behaviour of the PID 1F / Minimal time threshold which declares together with CoEng_nEngMinObd_C the OBD definition of a running engine" VALUE 0x8052779E RB_Val_Ws16 327.6700 Time_s 0.00 327.6700 FORMAT "%8.4" EXTENDED_LIMITS -327.6800 327.6700 /end CHARACTERISTIC
/begin CHARACTERISTIC CoEng_tiTTcDeltaMaxDly_CUR "Duration of tolerated exceeding of the exhaust temperature range without stop inhibition" CURVE 0x805278B8 RB_Curve_S16_S16 655.3500 Time_s -327.6800 327.6700 FORMAT "%8.4"
 /begin AXIS_DESCR STD_AXIS CoEng_tTrbUsCompu Temp_Cels 2 -3549.940 3003.560 FORMAT "%8.3" DEPOSIT ABSOLUTE /end AXIS_DESCR
/end CHARACTERISTIC
/begin CHARACTERISTIC CoEng_tiTTcMinDly_C "Duration of tolerated undercut of the minimum turbo charger temperature without stop inhibition" VALUE 0x805278C2 RB_Val_Wu16 655.3500 Time_s 0.00 655.3500 FORMAT "%8.4" /end CHARACTERISTIC
/begin CHARACTERISTIC CoEng_tTcMaxStopEnbl_C "Maximum turbo charger temperature without stop inhibition of start-stop" VALUE 0x805278C4 RB_Val_Ws16 6553.500 Temp_Cels -3549.940 3003.560 FORMAT "%8.3" /end CHARACTERISTIC
/begin CHARACTERISTIC CoEng_tTcMinStopEnbl_C "Minimum turbo charger temperature without stop inhibition of start-stop" VALUE 0x805278C6 RB_Val_Ws16 6553.500 Temp_Cels -3549.940 3003.560 FORMAT "%8.3" /end CHARACTERISTIC
/begin CHARACTERISTIC TDev_tDflValPID67_C "Default temperature value for PID67 signal Tester" VALUE 0x8052688E RB_Val_Wu8 255.0 temp_ub_q1_o40 -40.0 215.0 FORMAT "%5.1" /end CHARACTERISTIC
/begin MEASUREMENT B_kuppl_msg "Condition clutch pedal pressed" UBYTE B_TRUE 1 100 0.00 1.00000000000 BIT_MASK 0x1 FORMAT "%13.11" ECU_ADDRESS 0x70000B94 /end MEASUREMENT
/begin MEASUREMENT CEngBlkT_tCEngTCHdT2SV "sensor value engine block coolant temperature" SWORD Temp_Cels 1 100 -3549.940 3003.560 FORMAT "%8.3" ECU_ADDRESS 0x600076F8 /end MEASUREMENT
/begin MEASUREMENT CEngDsT_cntrSTCDrvgCycCold "number of driving cycles with radiation power high for tmot stuck check" UBYTE OneToOne 1 100 0.00 255.0 FORMAT "%5.1" ECU_ADDRESS 0x6000E8B0 /end MEASUREMENT
/begin MEASUREMENT CEngDsT_cntrSTCDrvgCycHot "number of driving cycles with radiation power low for tmot stuck check" UBYTE OneToOne 1 100 0.00 255.0 FORMAT "%5.1" ECU_ADDRESS 0x6000E8AF /end MEASUREMENT
/begin MEASUREMENT CEngDsT_facCorrnStoi "correction factor engine temperature model" UBYTE fak_ub_b2 1 100 0.00 1.992188 FORMAT "%8.6" ECU_ADDRESS 0x6000F04C /end MEASUREMENT
/begin MEASUREMENT CEngDsT_facFilVElec "factor for filterung vehicle speed during eletrical driving phases" UWORD fak_q1p526Em5 1 100 0.00 0.9999847 FORMAT "%9.7" ECU_ADDRESS 0x60007726 /end MEASUREMENT
/begin MEASUREMENT CEngDsT_facRefMdlFan "factor for influence engine fan on reference model during engine on phases" UBYTE fak_ub_b2 1 100 0.00 1.992188 FORMAT "%8.6" ECU_ADDRESS 0x6000E8AC /end MEASUREMENT
/begin MEASUREMENT CEngDsT_facReplMdlEngOffInit "weighting-factor for calculating the initial-replacemen-value for engine-coolant temperature" UBYTE fak_ub_b1 1 100 0.00 0.9961 ECU_ADDRESS 0x6000E8A9 /end MEASUREMENT
/begin MEASUREMENT CEngDsT_flgBlkHeatrActvdShft "condition: Blockheater detection, when sensor-temperature is below model-temperature" UBYTE B_TRUE 1 100 0.00 1.00000000000 BIT_MASK 0x1 FORMAT "%13.11" ECU_ADDRESS 0x700003AC /end MEASUREMENT
/begin MEASUREMENT CEngDsT_flgCalcnReplMdlEngStop "Flag to indicate that model value is updated as replacement model stop temperature" UBYTE B_TRUE 1 100 0.00 1.00000000000 BIT_MASK 0x1 FORMAT "%13.11" ECU_ADDRESS 0x6003948C /end MEASUREMENT
/begin MEASUREMENT CEngDsT_flgComErrWtrPmp "communication-Error of water pump" UBYTE B_TRUE 1 100 0.00 1.00000000000 BIT_MASK 0x1 FORMAT "%13.11" ECU_ADDRESS 0x700003D9 /end MEASUREMENT
/begin MEASUREMENT CEngDsT_flgDSMClr1000msPlausDiag "DSM Clear requested for engine coolant downstream temperature sensor" UBYTE B_TRUE 1 100 0.00 1.00000000000 BIT_MASK 0x1 FORMAT "%13.11" ECU_ADDRESS 0x6000E8AE /end MEASUREMENT
/begin MEASUREMENT CEngDsT_flgEngNEdgeFall "condition: Edge falling of engine speed" UBYTE B_TRUE 1 100 0.00 1.00000000000 BIT_MASK 0x1 FORMAT "%13.11" ECU_ADDRESS 0x700003AB /end MEASUREMENT
/begin MEASUREMENT CEngDsT_flgEngRotDeb "condition engine rotation debounced" UBYTE B_TRUE 1 100 0.00 1.00000000000 BIT_MASK 0x1 FORMAT "%13.11" ECU_ADDRESS 0x700003A6 /end MEASUREMENT
/begin MEASUREMENT CEngDsT_flgEngTFall "condition: falling engie coolant temperature" UBYTE B_TRUE 1 100 0.00 1.00000000000 BIT_MASK 0x1 FORMAT "%13.11" ECU_ADDRESS 0x700003AA /end MEASUREMENT
/begin MEASUREMENT CEngDsT_flgFanFlapRelsLSC "Flag for Fan flap LSC release" UBYTE B_TRUE 1 100 0.00 1.00000000000 BIT_MASK 0x1 FORMAT "%13.11" ECU_ADDRESS 0x700003D8 /end MEASUREMENT
/begin MEASUREMENT CEngDsT_flgFuEngStop "Fueled Engine Stop" UBYTE B_TRUE 1 100 0.00 1.00000000000 BIT_MASK 0x1 FORMAT "%13.11" ECU_ADDRESS 0x700003A9 /end MEASUREMENT
/begin MEASUREMENT CEngDsT_flgHSCAirMEnad "Condition: enabling threshold air mass for High-Side-Check" UBYTE B_TRUE 1 100 0.00 1.00000000000 BIT_MASK 0x1 FORMAT "%13.11" ECU_ADDRESS 0x700003D7 /end MEASUREMENT
/begin MEASUREMENT CEngDsT_flgHSCEnad "Condition: HSC-diagnosis released" UBYTE B_TRUE 1 100 0.00 1.00000000000 BIT_MASK 0x1 FORMAT "%13.11" ECU_ADDRESS 0x700003D6 /end MEASUREMENT
/begin MEASUREMENT CEngDsT_flgHSCEngNEnad "Condition: Engine Rotation threshold for enabling High-Side-Check" UBYTE B_TRUE 1 100 0.00 1.00000000000 BIT_MASK 0x1 FORMAT "%13.11" ECU_ADDRESS 0x700003D5 /end MEASUREMENT
/begin MEASUREMENT CEngDsT_flgHSCErrDeb "Condition: error criterion High-Side-Check debounced" UBYTE B_TRUE 1 100 0.00 1.00000000000 BIT_MASK 0x1 FORMAT "%13.11" ECU_ADDRESS 0x700003D4 /end MEASUREMENT
/begin MEASUREMENT CEngDsT_flgHSCErrDi "Condition: HSC-diagnosis not released" UBYTE B_TRUE 1 100 0.00 1.00000000000 BIT_MASK 0x1 FORMAT "%13.11" ECU_ADDRESS 0x700003D3 /end MEASUREMENT
/begin MEASUREMENT CEngDsT_flgHSCHealDeb "Condition: healing criterion High-Side-Check debounced" UBYTE B_TRUE 1 100 0.00 1.00000000000 BIT_MASK 0x1 FORMAT "%13.11" ECU_ADDRESS 0x700003D2 /end MEASUREMENT
/begin MEASUREMENT CEngDsT_flgHSCNrDeb "Condition: criterion for rise of IUMPR-counter of High-Side-Check debounced" UBYTE B_TRUE 1 100 0.00 1.00000000000 BIT_MASK 0x1 FORMAT "%13.11" ECU_ADDRESS 0x700003D1 /end MEASUREMENT
/begin MEASUREMENT CEngDsT_flgImpsClr "Clear request loose connection check Engine Coolant Temperature Sensor" UBYTE B_TRUE 1 100 0.00 1.00000000000 BIT_MASK 0x1 FORMAT "%13.11" ECU_ADDRESS 0x700003A3 /end MEASUREMENT
/begin MEASUREMENT CEngDsT_flgLSCEnad "Condition: LSC-diagnosis released" UBYTE B_TRUE 1 100 0.00 1.00000000000 BIT_MASK 0x1 FORMAT "%13.11" ECU_ADDRESS 0x700003D0 /end MEASUREMENT
/begin MEASUREMENT CEngDsT_flgLSCEngNEnagThd "Condition: Engine rotation in defined range for enabling Low-Side-Check" UBYTE B_TRUE 1 100 0.00 1.00000000000 BIT_MASK 0x1 FORMAT "%13.11" ECU_ADDRESS 0x700003CF /end MEASUREMENT
/begin MEASUREMENT CEngDsT_flgLSCEngNEnagThdHi "Condition: Engine Roation higher than enabling threshold Low-Side-Check" UBYTE B_TRUE 1 100 0.00 1.00000000000 BIT_MASK 0x1 FORMAT "%13.11" ECU_ADDRESS 0x700003CE /end MEASUREMENT
/begin MEASUREMENT CEngDsT_flgLSCEngNEnagThdLo "Condition: Engine Roation lower than enabling threshold Low-Side-Check" UBYTE B_TRUE 1 100 0.00 1.00000000000 BIT_MASK 0x1 FORMAT "%13.11" ECU_ADDRESS 0x700003CD /end MEASUREMENT
/begin MEASUREMENT CEngDsT_flgLSCEnvTEnad "Engine coolant temperature as a enable condition for low side check" UBYTE B_TRUE 1 100 0.00 1.00000000000 BIT_MASK 0x1 FORMAT "%13.11" ECU_ADDRESS 0x700003CC /end MEASUREMENT
/begin MEASUREMENT CEngDsT_flgLSCEnvTHealEnad "condition flag to enable healing of low-side-check when engine temperature at start within threshold." UBYTE B_TRUE 1 100 0.00 1.00000000000 BIT_MASK 0x1 FORMAT "%13.11" ECU_ADDRESS 0x700003CB /end MEASUREMENT
/begin MEASUREMENT CEngDsT_flgLSCErrDi "Condition: LSC-diagnosis not released" UBYTE B_TRUE 1 100 0.00 1.00000000000 BIT_MASK 0x1 FORMAT "%13.11" ECU_ADDRESS 0x700003CA /end MEASUREMENT
/begin MEASUREMENT CEngDsT_flgLSCHealEnag "Condition: Healing LSC enabled" UBYTE B_TRUE 1 100 0.00 1.00000000000 BIT_MASK 0x1 FORMAT "%13.11" ECU_ADDRESS 0x700003C9 /end MEASUREMENT
/begin MEASUREMENT CEngDsT_flgLSCHealLockd "healing of LSC locked by low load driving cycle" UBYTE B_TRUE 1 100 0.00 1.00000000000 BIT_MASK 0x1 FORMAT "%13.11" ECU_ADDRESS 0x700003C8 /end MEASUREMENT
/begin MEASUREMENT CEngDsT_flgLSCRefMdlEnagThd "Condition: reference model threshold for enabling LSC reached" UBYTE B_TRUE 1 100 0.00 1.00000000000 BIT_MASK 0x1 FORMAT "%13.11" ECU_ADDRESS 0x700003C7 /end MEASUREMENT
/begin MEASUREMENT CEngDsT_flgLSCSnsrRefMdlEnd "Flag: The start temperature of the engine coolant is below the reference model end value" UBYTE B_TRUE 1 100 0.00 1.00000000000 BIT_MASK 0x1 FORMAT "%13.11" ECU_ADDRESS 0x700003C6 /end MEASUREMENT
/begin MEASUREMENT CEngDsT_flgLSCStrtEnd "Condition: detection of engine start-end for lowside check" UBYTE B_TRUE 1 100 0.00 1.00000000000 BIT_MASK 0x1 FORMAT "%13.11" ECU_ADDRESS 0x700003C5 /end MEASUREMENT
/begin MEASUREMENT CEngDsT_flgNgvGrdtRstTMdl "flag to indicate the detection of negative gradient of engine block temperature or cylinder head temperature to reset the model" UBYTE B_TRUE 1 100 0.00 1.00000000000 BIT_MASK 0x1 FORMAT "%13.11" ECU_ADDRESS 0x6000E8AB /end MEASUREMENT
/begin MEASUREMENT CEngDsT_flgPlausHSCDi "high side check engine coolant temperature sensor disabled" UBYTE B_TRUE 1 100 0.00 1.00000000000 BIT_MASK 0x1 FORMAT "%13.11" ECU_ADDRESS 0x70000ACB /end MEASUREMENT
/begin MEASUREMENT CEngDsT_flgPlausHSCErr "Interface: enable-bit for high-side-check of tmot-sensor" UBYTE B_TRUE 1 100 0.00 1.00000000000 BIT_MASK 0x1 FORMAT "%13.11" ECU_ADDRESS 0x70000ACA /end MEASUREMENT
/begin MEASUREMENT CEngDsT_flgPlausHSCErrTmp "Condition: High-Side-Check-Error for engine coolant temperature sensor undebounced" UBYTE B_TRUE 1 100 0.00 1.00000000000 BIT_MASK 0x1 FORMAT "%13.11" ECU_ADDRESS 0x700003C4 /end MEASUREMENT
/begin MEASUREMENT CEngDsT_flgPlausHSCHeal "healing High-Side-Check plausibility diagnosis engine coolant temperature sensor" UBYTE B_TRUE 1 100 0.00 1.00000000000 BIT_MASK 0x1 FORMAT "%13.11" ECU_ADDRESS 0x70000AC9 /end MEASUREMENT
/begin MEASUREMENT CEngDsT_flgPlausHSCHealTmp "Condition: Healing High-Side-Check-Error engine coolant temperature sensor undebounced" UBYTE B_TRUE 1 100 0.00 1.00000000000 BIT_MASK 0x1 FORMAT "%13.11" ECU_ADDRESS 0x700003C3 /end MEASUREMENT
/begin MEASUREMENT CEngDsT_flgPlausHSCRiseNr "Condition: IUMPR-release for HSC-diagnosis" UBYTE B_TRUE 1 100 0.00 1.00000000000 BIT_MASK 0x1 FORMAT "%13.11" ECU_ADDRESS 0x70000AC8 /end MEASUREMENT
/begin MEASUREMENT CEngDsT_flgPlausHSCRiseNrTmp "Bedingung: IUMPR-Freigabe für Diagnose HSC" UBYTE B_TRUE 1 100 0.00 1.00000000000 BIT_MASK 0x1 FORMAT "%13.11" ECU_ADDRESS 0x700003C2 /end MEASUREMENT
/begin MEASUREMENT CEngDsT_flgPlausLSCDi "Condition: Disabling Low-Side-Check of Plausibility diagnosis Engine Coolant Temperature Sensor" UBYTE B_TRUE 1 100 0.00 1.00000000000 BIT_MASK 0x1 FORMAT "%13.11" ECU_ADDRESS 0x70000AC7 /end MEASUREMENT
/begin MEASUREMENT CEngDsT_flgPlausLSCErr "Condition: Error Low-Side-Check for engine coolant temperature sensor" UBYTE B_TRUE 1 100 0.00 1.00000000000 BIT_MASK 0x1 FORMAT "%13.11" ECU_ADDRESS 0x70000AC6 /end MEASUREMENT
/begin MEASUREMENT CEngDsT_flgPlausLSCErrTmp "LowSideCheck-Error for engine coolant temperature sensor (previous)" UBYTE B_TRUE 1 100 0.00 1.00000000000 BIT_MASK 0x1 FORMAT "%13.11" ECU_ADDRESS 0x700003C1 /end MEASUREMENT
/begin MEASUREMENT CEngDsT_flgPlausLSCHeal "healing Low-Side-Check plausibility diagnosis engine coolant temperature sensor" UBYTE B_TRUE 1 100 0.00 1.00000000000 BIT_MASK 0x1 FORMAT "%13.11" ECU_ADDRESS 0x70000AC5 /end MEASUREMENT
/begin MEASUREMENT CEngDsT_flgPlausLSCHealTmp "Condition: Healing Low-Side-Check engine coolant temperature sensor undebounced" UBYTE B_TRUE 1 100 0.00 1.00000000000 BIT_MASK 0x1 FORMAT "%13.11" ECU_ADDRESS 0x700003C0 /end MEASUREMENT
/begin MEASUREMENT CEngDsT_flgPlausLSCRiseNr "Condition: IUMPR-release for LSC-diagnosis" UBYTE B_TRUE 1 100 0.00 1.00000000000 BIT_MASK 0x1 FORMAT "%13.11" ECU_ADDRESS 0x70000AC4 /end MEASUREMENT
/begin MEASUREMENT CEngDsT_flgPlausLSCRiseNrTmp "Condition: IUMPR-release for LSC-diagnosis" UBYTE B_TRUE 1 100 0.00 1.00000000000 BIT_MASK 0x1 FORMAT "%13.11" ECU_ADDRESS 0x700003BF /end MEASUREMENT
/begin MEASUREMENT CEngDsT_flgPlausSTCDi "Condition: Disabling Stuck-Side-Check of Plausibility diagnosis Engine Coolant Temperature Sensor" UBYTE B_TRUE 1 100 0.00 1.00000000000 BIT_MASK 0x1 FORMAT "%13.11" ECU_ADDRESS 0x70000AC3 /end MEASUREMENT
/begin MEASUREMENT CEngDsT_flgPlausSTCErr "Condition: Error Stuck-Check for engine coolant temperature sensor" UBYTE B_TRUE 1 100 0.00 1.00000000000 BIT_MASK 0x1 FORMAT "%13.11" ECU_ADDRESS 0x70000AC2 /end MEASUREMENT
/begin MEASUREMENT CEngDsT_flgPlausSTCErrTmp "StuckCheck-Error for engine coolant temperature sensor (previous)" UBYTE B_TRUE 1 100 0.00 1.00000000000 BIT_MASK 0x1 FORMAT "%13.11" ECU_ADDRESS 0x700003BE /end MEASUREMENT
/begin MEASUREMENT CEngDsT_flgPlausSTCHeal "Condition: HealingStuck-Check for engine coolant temperature sensor" UBYTE B_TRUE 1 100 0.00 1.00000000000 BIT_MASK 0x1 FORMAT "%13.11" ECU_ADDRESS 0x70000AC1 /end MEASUREMENT
/begin MEASUREMENT CEngDsT_flgPlausSTCHealTmp "HealingCondition (StuckCheck) for engine coolant temperature sensor (previous)" UBYTE B_TRUE 1 100 0.00 1.00000000000 BIT_MASK 0x1 FORMAT "%13.11" ECU_ADDRESS 0x700003BD /end MEASUREMENT
/begin MEASUREMENT CEngDsT_flgPlausSTCRiseNr "Condition: IUMPR-release for STC-diagnosis" UBYTE B_TRUE 1 100 0.00 1.00000000000 BIT_MASK 0x1 FORMAT "%13.11" ECU_ADDRESS 0x70000AC0 /end MEASUREMENT
/begin MEASUREMENT CEngDsT_flgPlausSTCRiseNrTmp "Condition: IUMPR-release for STC-diagnosis" UBYTE B_TRUE 1 100 0.00 1.00000000000 BIT_MASK 0x1 FORMAT "%13.11" ECU_ADDRESS 0x700003BC /end MEASUREMENT
/begin MEASUREMENT CEngDsT_flgRefMdlCalcnGrdOn "calculation of gradient (in state engine running) reference value model engine coolant temperature enabled" UBYTE B_TRUE 1 100 0.00 1.00000000000 BIT_MASK 0x1 FORMAT "%13.11" ECU_ADDRESS 0x70000ABF /end MEASUREMENT
/begin MEASUREMENT CEngDsT_flgRefMdlEndVal "Final value for the reference engine temperature model was reached" UBYTE B_TRUE 1 100 0.00 1.00000000000 BIT_MASK 0x1 FORMAT "%13.11" ECU_ADDRESS 0x700003BB /end MEASUREMENT
/begin MEASUREMENT CEngDsT_flgRefMdlFrstStop "condition: first engine stop after first engine start" UBYTE B_TRUE 1 100 0.00 1.00000000000 BIT_MASK 0x1 FORMAT "%13.11" ECU_ADDRESS 0x70000ABE /end MEASUREMENT
/begin MEASUREMENT CEngDsT_flgRefMdlRst "reference model for engine coolant temperature: reset" UBYTE B_TRUE 1 100 0.00 1.00000000000 BIT_MASK 0x1 FORMAT "%13.11" ECU_ADDRESS 0x700003A8 /end MEASUREMENT
/begin MEASUREMENT CEngDsT_flgRefMdlRstLongStop "reset of reference model value after long engine off phases" UBYTE B_TRUE 1 100 0.00 1.00000000000 BIT_MASK 0x1 FORMAT "%13.11" ECU_ADDRESS 0x70000ABD /end MEASUREMENT
/begin MEASUREMENT CEngDsT_flgRefMdlStrt "condition engine start for reference temperature model fulfilled" UBYTE B_TRUE 1 100 0.00 1.00000000000 BIT_MASK 0x1 FORMAT "%13.11" ECU_ADDRESS 0x70000ABC /end MEASUREMENT
/begin MEASUREMENT CEngDsT_flgRefMdlStrtEndFrst "Condition: first start end" UBYTE B_TRUE 1 100 0.00 1.00000000000 BIT_MASK 0x1 FORMAT "%13.11" ECU_ADDRESS 0x70000ABB /end MEASUREMENT
/begin MEASUREMENT CEngDsT_flgReplMdlEngOffRst "Soack time after engine stall was reseted" UBYTE B_TRUE 1 100 0.00 1.00000000000 BIT_MASK 0x1 FORMAT "%13.11" ECU_ADDRESS 0x70000ABA /end MEASUREMENT
/begin MEASUREMENT CEngDsT_flgReplMdlHmlDeb "condition mode homogeneous debounced" UBYTE B_TRUE 1 100 0.00 1.00000000000 BIT_MASK 0x1 FORMAT "%13.11" ECU_ADDRESS 0x700003A5 /end MEASUREMENT
/begin MEASUREMENT CEngDsT_flgReplMdlStratDeb "condition mode stratified debounced" UBYTE B_TRUE 1 100 0.00 1.00000000000 BIT_MASK 0x1 FORMAT "%13.11" ECU_ADDRESS 0x700003A4 /end MEASUREMENT
/begin MEASUREMENT CEngDsT_flgSetDFC1000ms "DSM Report is allowed (1000ms)" UBYTE B_TRUE 1 100 0.00 1.00000000000 BIT_MASK 0x1 FORMAT "%13.11" ECU_ADDRESS 0x700003A2 /end MEASUREMENT
/begin MEASUREMENT CEngDsT_flgSetDFC100ms "DSM Report is allowed (100ms)" UBYTE B_TRUE 1 100 0.00 1.00000000000 BIT_MASK 0x1 FORMAT "%13.11" ECU_ADDRESS 0x700003A1 /end MEASUREMENT
/begin MEASUREMENT CEngDsT_flgSigClr "Clear request signal check Engine Coolant Temperature Sensor" UBYTE B_TRUE 1 100 0.00 1.00000000000 BIT_MASK 0x1 FORMAT "%13.11" ECU_ADDRESS 0x700003A0 /end MEASUREMENT
/begin MEASUREMENT CEngDsT_flgSnsrClr "Clear request Engine Coolant Temperature Sensor" UBYTE B_TRUE 1 100 0.00 1.00000000000 BIT_MASK 0x1 FORMAT "%13.11" ECU_ADDRESS 0x70000AB3 /end MEASUREMENT
/begin MEASUREMENT CEngDsT_flgSnsrColdStrtClr "Clear request cold start diagnosis Engine Coolant Temperature Sensor" UBYTE B_TRUE 1 100 0.00 1.00000000000 BIT_MASK 0x1 FORMAT "%13.11" ECU_ADDRESS 0x70000AB2 /end MEASUREMENT
/begin MEASUREMENT CEngDsT_flgSnsrColdStrtVld "Validity-Flag cold start diagnosis Engine Coolant Temperature Sensor" UBYTE B_TRUE 1 100 0.00 1.00000000000 BIT_MASK 0x1 FORMAT "%13.11" ECU_ADDRESS 0x7000039F /end MEASUREMENT
/begin MEASUREMENT CEngDsT_flgSnsrElecClr "Clear request Diagnostic Fault Check electrical diagnosis engine coolant temperature sensor" UBYTE B_TRUE 1 100 0.00 1.00000000000 BIT_MASK 0x1 FORMAT "%13.11" ECU_ADDRESS 0x70000AB1 /end MEASUREMENT
/begin MEASUREMENT CEngDsT_flgSnsrPlausClr "Condition: Clear-Request Plausibility diagnosis Engine Coolant Temperature Sensor" UBYTE B_TRUE 1 100 0.00 1.00000000000 BIT_MASK 0x1 FORMAT "%13.11" ECU_ADDRESS 0x70000AAF /end MEASUREMENT
/begin MEASUREMENT CEngDsT_flgSnsrPlausVld "Validity bit on the basis of the plausibility-diagnosis coolant temperature sensor" UBYTE B_TRUE 1 100 0.00 1.00000000000 BIT_MASK 0x1 FORMAT "%13.11" ECU_ADDRESS 0x7000039E /end MEASUREMENT
/begin MEASUREMENT CEngDsT_flgSnsrVld "Bit: signal from engine coolant temperature sensor is error-free" UBYTE B_TRUE 1 100 0.00 1.00000000000 BIT_MASK 0x1 FORMAT "%13.11" ECU_ADDRESS 0x70000AAD /end MEASUREMENT
/begin MEASUREMENT CEngDsT_flgSnsrVldLoc "Bit: signal from engine coolant temperature sensor is error-free (local)" UBYTE B_TRUE 1 100 0.00 1.00000000000 BIT_MASK 0x1 FORMAT "%13.11" ECU_ADDRESS 0x7000039D /end MEASUREMENT
/begin MEASUREMENT CEngDsT_flgSRCClr "Clear request signal range check Engine Coolant Temperature Sensor" UBYTE B_TRUE 1 100 0.00 1.00000000000 BIT_MASK 0x1 FORMAT "%13.11" ECU_ADDRESS 0x7000039C /end MEASUREMENT
/begin MEASUREMENT CEngDsT_flgSTCCold "stuck check engine coolant temperature sensor: condition engine coolant temperature low" UBYTE B_TRUE 1 100 0.00 1.00000000000 BIT_MASK 0x1 FORMAT "%13.11" ECU_ADDRESS 0x700003BA /end MEASUREMENT
/begin MEASUREMENT CEngDsT_flgSTCDrvgCycCold "Condition: high radiation power" UBYTE B_TRUE 1 100 0.00 1.00000000000 BIT_MASK 0x1 FORMAT "%13.11" ECU_ADDRESS 0x700003B9 /end MEASUREMENT
/begin MEASUREMENT CEngDsT_flgSTCDrvgCycColdCntUp "Condition: increase counter Driving Cycle Cold" UBYTE B_TRUE 1 100 0.00 1.00000000000 BIT_MASK 0x1 FORMAT "%13.11" ECU_ADDRESS 0x700003B8 /end MEASUREMENT
/begin MEASUREMENT CEngDsT_flgSTCDrvgCycColdHot "Condition: numver of driving cycles with high and low radiation power reached" UBYTE B_TRUE 1 100 0.00 1.00000000000 BIT_MASK 0x1 FORMAT "%13.11" ECU_ADDRESS 0x700003B7 /end MEASUREMENT
/begin MEASUREMENT CEngDsT_flgSTCDrvgCycHot "Condition: low radiation power" UBYTE B_TRUE 1 100 0.00 1.00000000000 BIT_MASK 0x1 FORMAT "%13.11" ECU_ADDRESS 0x700003B6 /end MEASUREMENT
/begin MEASUREMENT CEngDsT_flgSTCDrvgCycHotCntUp "Condition: increase counter Driving Cycle Hot" UBYTE B_TRUE 1 100 0.00 1.00000000000 BIT_MASK 0x1 FORMAT "%13.11" ECU_ADDRESS 0x700003B5 /end MEASUREMENT
/begin MEASUREMENT CEngDsT_flgSTCEnad "Condition: Stuck-Check enabled" UBYTE B_TRUE 1 100 0.00 1.00000000000 BIT_MASK 0x1 FORMAT "%13.11" ECU_ADDRESS 0x700003B4 /end MEASUREMENT
/begin MEASUREMENT CEngDsT_flgSTCErrDi "Condition: Stuck-Check disabled by component error" UBYTE B_TRUE 1 100 0.00 1.00000000000 BIT_MASK 0x1 FORMAT "%13.11" ECU_ADDRESS 0x700003B3 /end MEASUREMENT
/begin MEASUREMENT CEngDsT_flgSTCHot "Stuck check engine coolant temperature: condition engine coolant temperature high" UBYTE B_TRUE 1 100 0.00 1.00000000000 BIT_MASK 0x1 FORMAT "%13.11" ECU_ADDRESS 0x700003B2 /end MEASUREMENT
/begin MEASUREMENT CEngDsT_flgSTCTDifSnsrFildThdLo "difference (min and max value) engine coolant temperature lower threshold" UBYTE B_TRUE 1 100 0.00 1.00000000000 BIT_MASK 0x1 FORMAT "%13.11" ECU_ADDRESS 0x700003B1 /end MEASUREMENT
/begin MEASUREMENT CEngDsT_flgSTCTmrColdOnEnad "Condition: timer for condition Cold Stuck-Check enabled" UBYTE B_TRUE 1 100 0.00 1.00000000000 BIT_MASK 0x1 FORMAT "%13.11" ECU_ADDRESS 0x700003B0 /end MEASUREMENT
/begin MEASUREMENT CEngDsT_flgSTCTmrColdRst "Condition: reset timer for condition Cold Stuck-Check" UBYTE B_TRUE 1 100 0.00 1.00000000000 BIT_MASK 0x1 FORMAT "%13.11" ECU_ADDRESS 0x700003AF /end MEASUREMENT
/begin MEASUREMENT CEngDsT_flgSTCTmrHotOnEnad "Condition: timer for condition Hot Stuck-Check enabled" UBYTE B_TRUE 1 100 0.00 1.00000000000 BIT_MASK 0x1 FORMAT "%13.11" ECU_ADDRESS 0x700003AE /end MEASUREMENT
/begin MEASUREMENT CEngDsT_flgSTCTmrHotRst "Condition: reset timer for condition Hot Stuck-Check" UBYTE B_TRUE 1 100 0.00 1.00000000000 BIT_MASK 0x1 FORMAT "%13.11" ECU_ADDRESS 0x700003AD /end MEASUREMENT
/begin MEASUREMENT CEngDsT_flgSwtRefMdlWtrPmp "condition: usage of influence water pump during engine off phases" UBYTE B_TRUE 1 100 0.00 1.00000000000 BIT_MASK 0x1 FORMAT "%13.11" ECU_ADDRESS 0x700003A7 /end MEASUREMENT
/begin MEASUREMENT CEngDsT_mfAirPLD "air mass flow for plausibility check" UBYTE m_ub_b1020 1 100 0.00 1020. FORMAT "%5.0" ECU_ADDRESS 0x6000E8AD /end MEASUREMENT
/begin MEASUREMENT CEngDsT_mfAirStoi "air mass flow related on lambda=1" UBYTE m_ub_b1020 1 100 0.00 1020. FORMAT "%5.0" ECU_ADDRESS 0x6000F049 /end MEASUREMENT
/begin MEASUREMENT CEngDsT_mfAirStoiRefMdl "air mass flow related on lambda=1" UBYTE m_ub_b1020 1 100 0.00 1020. FORMAT "%5.0" ECU_ADDRESS 0x6000E8AA /end MEASUREMENT
/begin MEASUREMENT CEngDsT_stDiagCycRprt1000ms "Status flag to enable cyclic reporting to DSM in 1000ms" UBYTE B_TRUE 1 100 0.00 1.00000000000 BIT_MASK 0x1 FORMAT "%13.11" ECU_ADDRESS 0x6000E8A7 /end MEASUREMENT
/begin MEASUREMENT CEngDsT_stDiagCycRprt100ms "Status flag to enable cyclic reporting to DSM in 100ms" UBYTE B_TRUE 1 100 0.00 1.00000000000 BIT_MASK 0x1 FORMAT "%13.11" ECU_ADDRESS 0x6000E8A6 /end MEASUREMENT
/begin MEASUREMENT CEngDsT_stSigT "Status to indicate signal quality of sensor value" UBYTE OneToOne 1 100 0.00 255.0 FORMAT "%5.1" ECU_ADDRESS 0x6000F048 /end MEASUREMENT
/begin MEASUREMENT CEngDsT_tCEngTCHdT2SV "Engine coolant temperature, linearised and calculated" SWORD Temp_Cels 1 100 -3549.940 3003.560 FORMAT "%8.3" ECU_ADDRESS 0x600076F6 /end MEASUREMENT
/begin MEASUREMENT CEngDsT_tDifHSCRst "initialization value for High-Side-Check model" SWORD Temp_Cels 1 100 -3549.940 3003.560 FORMAT "%8.3" ECU_ADDRESS 0x6000773A /end MEASUREMENT
/begin MEASUREMENT CEngDsT_tDifHSCSnsrFild "Temperature difference for HSC-diagnosis" SWORD Temp_Cels 1 100 -3549.940 3003.560 FORMAT "%8.3" ECU_ADDRESS 0x60007738 /end MEASUREMENT
/begin MEASUREMENT CEngDsT_tDifRefMdlEnv "difference between reference temperature and ambient temperature" SWORD TempDiff_Kelv 1 100 -3276.800 3276.700 FORMAT "%8.3" ECU_ADDRESS 0x60007724 /end MEASUREMENT
/begin MEASUREMENT CEngDsT_tDifReplMdlEngOff "difference (Engine Coolant Off Temperature, intake air temperature)" SWORD Temp_Cels 1 100 -3549.940 3003.560 FORMAT "%8.3" ECU_ADDRESS 0x60007704 /end MEASUREMENT
/begin MEASUREMENT CEngDsT_tDifSTCSnsrFild "difference (min and max value) engine coolant temperature for Stuck-Check" SWORD T_degC_q0p1_COMPU 1 100 -3276.800 3276.700 FORMAT "%8.3" ECU_ADDRESS 0x60007736 /end MEASUREMENT
/begin MEASUREMENT CEngDsT_tGrdtHSC "gradient High-Side-Check model" UWORD temp_uw_q0p0029_o48 1 100 -48.0000 143.9971 FORMAT "%8.4" ECU_ADDRESS 0x60007734 /end MEASUREMENT
/begin MEASUREMENT CEngDsT_tGrdtRefMdl "Temperature gradient for model in LSC diagnostic" UWORD temp_uw_q0p0029_o48 1 100 -48.0000 143.9971 FORMAT "%8.4" ECU_ADDRESS 0x60007722 /end MEASUREMENT
/begin MEASUREMENT CEngDsT_tGrdtRefMdlAcm "calculated model-based reference value for plausibility check of engine temperature signal (16-bit)" UWORD temp_uw_q0p0029_o48 1 100 -48.0000 143.9971 FORMAT "%8.4" ECU_ADDRESS 0x60007720 /end MEASUREMENT
/begin MEASUREMENT CEngDsT_tGrdtRefMdlDegPosTMEE "gradient: influence of heating circuit based on opening degree" UWORD temp_uw_q0p0029_o48 1 100 -48.0000 143.9971 FORMAT "%8.4" ECU_ADDRESS 0x6000771E /end MEASUREMENT
/begin MEASUREMENT CEngDsT_tGrdtRefMdlFco "gradient of engine coolant temp. during cutoff for reference model" UWORD temp_uw_q0p0029_o48 1 100 -48.0000 143.9971 FORMAT "%8.4" ECU_ADDRESS 0x6000771C /end MEASUREMENT
/begin MEASUREMENT CEngDsT_tGrdtRefMdlHeat "gradient: influence heating during running engine for reference model" UWORD temp_uw_q0p0029_o48 1 100 -9.999023 9.999023 FORMAT "%8.6" ECU_ADDRESS 0x6000771A /end MEASUREMENT
/begin MEASUREMENT CEngDsT_tGrdtRefMdlInj "gradient of engine coolant temp. during fuel injection" UWORD temp_uw_q0p0029_o48 1 100 -9.999023 9.999023 FORMAT "%8.6" ECU_ADDRESS 0x60007718 /end MEASUREMENT
/begin MEASUREMENT CEngDsT_tGrdtRefMdlOff "Temperature gradient for engine coolant temperature model engine off" UWORD temp_uw_q0p0029_o48 1 100 -48.0000 143.9971 FORMAT "%8.4" ECU_ADDRESS 0x60007716 /end MEASUREMENT
/begin MEASUREMENT CEngDsT_tGrdtRefMdlOffLoc "Temperature gradient for engine coolant temperature model engine off without influence from TME" UWORD temp_uw_q0p0029_o48 1 100 -48.0000 143.9971 FORMAT "%8.4" ECU_ADDRESS 0x60007714 /end MEASUREMENT
/begin MEASUREMENT CEngDsT_tGrdtRefMdlOn "Temperature gradient for engine coolant temperature model engine on" UWORD temp_uw_q0p0029_o48 1 100 -48.0000 143.9971 FORMAT "%8.4" ECU_ADDRESS 0x60007712 /end MEASUREMENT
/begin MEASUREMENT CEngDsT_tGrdtRefMdlOnLoc "Temperature gradient for engine coolant temperature model engine on without influence from TME" UWORD temp_uw_q0p0029_o48 1 100 -48.0000 143.9971 FORMAT "%8.4" ECU_ADDRESS 0x60007710 /end MEASUREMENT
/begin MEASUREMENT CEngDsT_tGrdtReplMdlEngOn "temperature gradient replacement model during engine on" SBYTE temp_q0p01172 1 100 -1.500 1.488 FORMAT "%5.3" ECU_ADDRESS 0x6000E8A8 /end MEASUREMENT
/begin MEASUREMENT CEngDsT_tHSCMdl "Temperature model for ""high side"" rationality check" SWORD Temp_Cels 1 100 -3549.940 3003.560 FORMAT "%8.3" ECU_ADDRESS 0x60007732 /end MEASUREMENT
/begin MEASUREMENT CEngDsT_tHSCMdlCorrd "tmhsrc corrected modell with environmental temperature (max. TMOT plausible)" SWORD Temp_Cels 1 100 -3549.940 3003.560 FORMAT "%8.3" ECU_ADDRESS 0x60007730 /end MEASUREMENT
/begin MEASUREMENT CEngDsT_tHSCMdlHiResl "temperature model for ""high side rationality check"" (word)" ULONG temp_uw_q0p0029_o48 1 100 -48.0000 12582863.9971 FORMAT "%13.4" ECU_ADDRESS 0x600030F4 /end MEASUREMENT
/begin MEASUREMENT CEngDsT_tHSCOffs "Temperature offset for the model (by TUM/VFZG correction)" SWORD Temp_Cels 1 100 -3549.940 3003.560 FORMAT "%8.3" ECU_ADDRESS 0x6000772E /end MEASUREMENT
/begin MEASUREMENT CEngDsT_tiDebRefMdlCalcnGrdOn "Delay time for usage of reference model gradient during running engine" SLONG Time_Dt 1 100 0.00 2147.48364700 FORMAT "%13.8" ECU_ADDRESS 0x600030E0 /end MEASUREMENT
/begin MEASUREMENT CEngDsT_tiDebRefMdlCalcnGrdOnCalcd "Delay time for usage of reference model gradient during running engine after first engine stop" SLONG Time_Dt 1 100 0.00 2147.48364700 FORMAT "%13.8" ECU_ADDRESS 0x500010E4 /end MEASUREMENT
/begin MEASUREMENT CEngDsT_tiDebRefMdlEngTFall "Delay time for detection of falling engine temperature" SLONG Time_Dt 1 100 0.00 2147.48364700 FORMAT "%13.8" ECU_ADDRESS 0x500010E8 /end MEASUREMENT
/begin MEASUREMENT CEngDsT_tiDebRefMdlEngTFallCalcd "Delay time for detection of falling engine temperature after first engine stop" SLONG Time_Dt 1 100 0.00 2147.48364700 FORMAT "%13.8" ECU_ADDRESS 0x600030DC /end MEASUREMENT
/begin MEASUREMENT CEngDsT_tiDiagCycRprt1000ms "Timer to evaluate cyclic reporting to DSM in 1000ms" UBYTE t_q1 1 100 0.00 255.0 FORMAT "%5.1" ECU_ADDRESS 0x6000E8A5 /end MEASUREMENT
/begin MEASUREMENT CEngDsT_tiDiagCycRprt100ms "Timer to evaluate cyclic reporting to DSM in 100ms" UBYTE t_q0p1 1 100 0.00 25.50 FORMAT "%5.2" ECU_ADDRESS 0x6000E8A4 /end MEASUREMENT
/begin MEASUREMENT CEngDsT_tiRefMdlEngOff "engine off time for reference value model" UWORD Time_sec_q1_COMPU 1 100 0.00 65535.00 FORMAT "%8.2" ECU_ADDRESS 0x6000770E /end MEASUREMENT
/begin MEASUREMENT CEngDsT_tiReplMdlEngOff "engine off time for replacement model engine coolant temperature" UWORD Time_sec_q1_COMPU 1 100 0.00 65535.00 FORMAT "%8.2" ECU_ADDRESS 0x60007702 /end MEASUREMENT
/begin MEASUREMENT CEngDsT_tiSTCColdOff "Accumulated time for reseting condition - cooling capacity too low" SLONG Time_Dt 1 100 0.00 2147.48364700 FORMAT "%13.8" ECU_ADDRESS 0x600030F0 /end MEASUREMENT
/begin MEASUREMENT CEngDsT_tiSTCColdOn "waiting time to set condition radiation power low" SLONG Time_Dt 1 100 0.00 2147.48364700 FORMAT "%13.8" ECU_ADDRESS 0x600030EC /end MEASUREMENT
/begin MEASUREMENT CEngDsT_tiSTCHotOff "Accumulated time for reseting condition - cooling capacity too high" SLONG Time_Dt 1 100 0.00 2147.48364700 FORMAT "%13.8" ECU_ADDRESS 0x600030E8 /end MEASUREMENT
/begin MEASUREMENT CEngDsT_tiSTCHotOn "waiting time to set condition radiation power high" SLONG Time_Dt 1 100 0.00 2147.48364700 FORMAT "%13.8" ECU_ADDRESS 0x600030E4 /end MEASUREMENT
/begin MEASUREMENT CEngDsT_tLSCRefMdlEnd "end value of reference model for Low-Side-Check" SWORD Temp_Cels 1 100 -3549.940 3003.560 FORMAT "%8.3" ECU_ADDRESS 0x6000772C /end MEASUREMENT
/begin MEASUREMENT CEngDsT_tMod "model-based substitute value for engine temperature signal in case of error" SWORD Temp_Cels 1 100 -3549.940 3003.560 FORMAT "%8.3" ECU_ADDRESS 0x60008A1A /end MEASUREMENT
/begin MEASUREMENT CEngDsT_tRaw "Engine coolant temperature, linearised and calculated" SWORD Temp_Cels 1 100 -3549.940 3003.560 FORMAT "%8.3" ECU_ADDRESS 0x60008A16 /end MEASUREMENT
/begin MEASUREMENT CEngDsT_tRefMdl "model-based reference value for plausibility check of engine temperature signal" SWORD Temp_Cels 1 100 -3549.940 3003.560 FORMAT "%8.3" ECU_ADDRESS 0x60008A14 /end MEASUREMENT
/begin MEASUREMENT CEngDsT_tRefMdlEnd "end value model-based reference value for plausibility check of engine temperature signal" SWORD Temp_Cels 1 100 -3549.940 3003.560 FORMAT "%8.3" ECU_ADDRESS 0x60008A12 /end MEASUREMENT
/begin MEASUREMENT CEngDsT_tRefMdlHiResl "model-based reference value for plausibility check of engine temperature signal (16-bit)" UWORD temp_uw_q0p0029_o48 1 100 -48.0000 143.9971 FORMAT "%8.4" ECU_ADDRESS 0x6000770C /end MEASUREMENT
/begin MEASUREMENT CEngDsT_tRefMdlLoc "model-based reference value for plausibility check of engine temperature signal local" SWORD Temp_Cels 1 100 -3549.940 3003.560 FORMAT "%8.3" ECU_ADDRESS 0x6000770A /end MEASUREMENT
/begin MEASUREMENT CEngDsT_tReplMdl "model-based substitute value for engine temperature signal in case of error" SWORD Temp_Cels 1 100 -3549.940 3003.560 FORMAT "%8.3" ECU_ADDRESS 0x60013E04 /end MEASUREMENT
/begin MEASUREMENT CEngDsT_tReplMdlEngOffCoolg "Cooling down if engine coolant temperature after engine stop" SWORD Temp_Cels 1 100 -3549.940 3003.560 FORMAT "%8.3" ECU_ADDRESS 0x60007700 /end MEASUREMENT
/begin MEASUREMENT CEngDsT_tReplMdlIntkAir "Intake Air Temperature for enigne coolant temperatur replacement model" SWORD Temp_Cels 1 100 -3549.940 3003.560 FORMAT "%8.3" ECU_ADDRESS 0x600076FE /end MEASUREMENT
/begin MEASUREMENT CEngDsT_tReplMdlLoc "model-based replacement value for engine coolant temperature local" UWORD temp_uw_q0p0029_o48 1 100 -48.0000 143.9971 FORMAT "%8.4" ECU_ADDRESS 0x600076FC /end MEASUREMENT
/begin MEASUREMENT CEngDsT_tReplMdlStop "Starting value for model value calculation of TMOT sensor when engine moves out of RUNNING state in case of Cold start error" SWORD Temp_Cels 1 100 -3549.940 3003.560 FORMAT "%8.3" ECU_ADDRESS 0x60008A10 /end MEASUREMENT
/begin MEASUREMENT CEngDsT_tSens "Sensed engine coolant temperature" SWORD Temp_Cels 1 100 -3549.940 3003.560 FORMAT "%8.3" ECU_ADDRESS 0x60008A0E /end MEASUREMENT
/begin MEASUREMENT CEngDsT_tSnsrSub "Sensor value coolant temperature with consideration of sensor validity" SWORD Temp_Cels 1 100 -3549.940 3003.560 FORMAT "%8.3" ECU_ADDRESS 0x60007708 /end MEASUREMENT
/begin MEASUREMENT CEngDsT_tSnsrTstrSAE "Engine coolant downstream temperature for PID-Service" UBYTE temp_ub_q1_o40 1 100 -40.0 215.0 FORMAT "%5.1" ECU_ADDRESS 0x6000F047 /end MEASUREMENT
/begin MEASUREMENT CEngDsT_tSTCSnsrFildMax "Maximum-occurring engine temperature" SWORD Temp_Cels 1 100 -3549.940 3003.560 FORMAT "%8.3" ECU_ADDRESS 0x6000772A /end MEASUREMENT
/begin MEASUREMENT CEngDsT_tSTCSnsrFildMin "Minimum-occurring engine temperature" SWORD Temp_Cels 1 100 -3549.940 3003.560 FORMAT "%8.3" ECU_ADDRESS 0x60007728 /end MEASUREMENT
/begin MEASUREMENT CEngDsT_tStopReplMdlLoc "model-based replacement value for engine coolant temperature local during engine off" UWORD temp_uw_q0p0029_o48 1 100 -48.0000 143.9971 FORMAT "%8.4" ECU_ADDRESS 0x600076FA /end MEASUREMENT
/begin MEASUREMENT CEngDsT_vAvrgElec "filtered vehicle speed during eletrical driving cycles" SWORD Vel 1 100 0.00 327.6700 FORMAT "%8.4" ECU_ADDRESS 0x60007706 /end MEASUREMENT
/begin MEASUREMENT CEngUsT_flgColdChkMaxClr "Diagnosis clear request from max coldstart diagnosis of engine coolant upstream temperature" UBYTE B_TRUE 1 100 0.00 1.00000000000 BIT_MASK 0x1 FORMAT "%13.11" ECU_ADDRESS 0x70000AA2 /end MEASUREMENT
/begin MEASUREMENT CEngUsT_flgColdChkMinClr "Diagnosis clear request from min coldstart diagnosis of engine coolant upstream temperature" UBYTE B_TRUE 1 100 0.00 1.00000000000 BIT_MASK 0x1 FORMAT "%13.11" ECU_ADDRESS 0x70000AA1 /end MEASUREMENT
/begin MEASUREMENT CEngUsT_flgDSMClrReq "Clear request from DSM Clear Task" UBYTE B_TRUE 1 100 0.00 1.00000000000 BIT_MASK 0x1 FORMAT "%13.11" ECU_ADDRESS 0x6000EE7A /end MEASUREMENT
/begin MEASUREMENT CEngUsT_flgEngStopdThisCyc "Engine Stop event in current driving cycle detected" UBYTE B_TRUE 1 100 0.00 1.00000000000 BIT_MASK 0x1 FORMAT "%13.11" ECU_ADDRESS 0x70000A98 /end MEASUREMENT
/begin MEASUREMENT CEngUsT_flgFilInitER "Edge Rising Event for filter initialisation" UBYTE B_TRUE 1 100 0.00 1.00000000000 BIT_MASK 0x1 FORMAT "%13.11" ECU_ADDRESS 0x70000A97 /end MEASUREMENT
/begin MEASUREMENT CEngUsT_flgIniSRCErr "Signal range check error while initialisation" UBYTE B_TRUE 1 100 0.00 1.00000000000 BIT_MASK 0x1 FORMAT "%13.11" ECU_ADDRESS 0x70000A96 /end MEASUREMENT
/begin MEASUREMENT CEngUsT_flgLooseCnctnClr "Diagnosis clear request from loose connection check diagnosis of engine coolant upstream temperature" UBYTE B_TRUE 1 100 0.00 1.00000000000 BIT_MASK 0x1 FORMAT "%13.11" ECU_ADDRESS 0x70000A95 /end MEASUREMENT
/begin MEASUREMENT CEngUsT_flgLooseCnctnDi "Deactivation of Loose Connection Check" UBYTE B_TRUE 1 100 0.00 1.00000000000 BIT_MASK 0x1 FORMAT "%13.11" ECU_ADDRESS 0x70000A94 /end MEASUREMENT
/begin MEASUREMENT CEngUsT_flgLooseCnctnErr "Error of Loose Connection Check diagnosis" UBYTE B_TRUE 1 100 0.00 1.00000000000 BIT_MASK 0x1 FORMAT "%13.11" ECU_ADDRESS 0x70000A93 /end MEASUREMENT
/begin MEASUREMENT CEngUsT_flgLooseCnctnFflp "Error of Loose Connection Check diagnosis in current driving cycle" UBYTE B_TRUE 1 100 0.00 1.00000000000 BIT_MASK 0x1 FORMAT "%13.11" ECU_ADDRESS 0x70000A92 /end MEASUREMENT
/begin MEASUREMENT CEngUsT_flgLooseCnctnHeal "Healing of Loose Connection Check diagnosis" UBYTE B_TRUE 1 100 0.00 1.00000000000 BIT_MASK 0x1 FORMAT "%13.11" ECU_ADDRESS 0x70000A91 /end MEASUREMENT
/begin MEASUREMENT CEngUsT_flgLooseCnctnStr "Error of Loose Connection Check idiagnosis n last driving cycle" UBYTE B_TRUE 1 100 0.00 1.00000000000 BIT_MASK 0x1 FORMAT "%13.11" ECU_ADDRESS 0x60036E07 /end MEASUREMENT
/begin MEASUREMENT CEngUsT_flgSnsrClr "Clear request Engine Coolant Temperature Sensor" UBYTE B_TRUE 1 100 0.00 1.00000000000 BIT_MASK 0x1 FORMAT "%13.11" ECU_ADDRESS 0x70000A85 /end MEASUREMENT
/begin MEASUREMENT CEngUsT_flgSnsrColdChkClr "Diagnosis clear request from coldstart diagnosis of engine coolant upstream temperature" UBYTE B_TRUE 1 100 0.00 1.00000000000 BIT_MASK 0x1 FORMAT "%13.11" ECU_ADDRESS 0x70000A84 /end MEASUREMENT
/begin MEASUREMENT CEngUsT_flgSnsrElecClr "Clear request of electrical diagnosis of engine coolant upstream temperature" UBYTE B_TRUE 1 100 0.00 1.00000000000 BIT_MASK 0x1 FORMAT "%13.11" ECU_ADDRESS 0x70000A83 /end MEASUREMENT
/begin MEASUREMENT CEngUsT_flgSnsrPlausClr "Condition: Clear-Request Plausibility diagnosis Engine Coolant Temperature Sensor" UBYTE B_TRUE 1 100 0.00 1.00000000000 BIT_MASK 0x1 FORMAT "%13.11" ECU_ADDRESS 0x70000A82 /end MEASUREMENT
/begin MEASUREMENT CEngUsT_flgSnsrSigAvl "Coolant Upstream Temperature Sensor(Radiator Outlet) Signal Availability" UBYTE B_TRUE 1 100 0.00 1.00000000000 BIT_MASK 0x1 FORMAT "%13.11" ECU_ADDRESS 0x70000A81 /end MEASUREMENT
/begin MEASUREMENT CEngUsT_flgSnsrVldStop "Evaluated Stop Temperature is valid" UBYTE B_TRUE 1 100 0.00 1.00000000000 BIT_MASK 0x1 FORMAT "%13.11" ECU_ADDRESS 0x70000A80 /end MEASUREMENT
/begin MEASUREMENT CEngUsT_flgSnsrVldStopLstCyc "Evaluated Stop Temperature in previous driving cycle is valid" UBYTE B_TRUE 1 100 0.00 1.00000000000 BIT_MASK 0x1 FORMAT "%13.11" ECU_ADDRESS 0x70000A7F /end MEASUREMENT
/begin MEASUREMENT CEngUsT_flgSnsrVldStopStr "Evaluated Stop Temperature is valid. (internal storage)" UBYTE B_TRUE 1 100 0.00 1.00000000000 BIT_MASK 0x1 FORMAT "%13.11" ECU_ADDRESS 0x60036DEC /end MEASUREMENT
/begin MEASUREMENT CEngUsT_flgSnsrVldStrt "Evaluated Start Temperature is valid" UBYTE B_TRUE 1 100 0.00 1.00000000000 BIT_MASK 0x1 FORMAT "%13.11" ECU_ADDRESS 0x70000A7E /end MEASUREMENT
/begin MEASUREMENT CEngUsT_flgSRCClr "Diagnosis clear request from signal range check diagnosis of engine coolant upstream temperature" UBYTE B_TRUE 1 100 0.00 1.00000000000 BIT_MASK 0x1 FORMAT "%13.11" ECU_ADDRESS 0x70000A90 /end MEASUREMENT
/begin MEASUREMENT CEngUsT_flgSRCErr "Error in Signal Range Check diagnosis" UBYTE B_TRUE 1 100 0.00 1.00000000000 BIT_MASK 0x1 FORMAT "%13.11" ECU_ADDRESS 0x70000A8F /end MEASUREMENT
/begin MEASUREMENT CEngUsT_flgSRCHeal "Healing in Signal Range Check diagnosis" UBYTE B_TRUE 1 100 0.00 1.00000000000 BIT_MASK 0x1 FORMAT "%13.11" ECU_ADDRESS 0x70000A8E /end MEASUREMENT
/begin MEASUREMENT CEngUsT_flgSRCMaxErr "Max Error in Signal Range Check diagnosis" UBYTE B_TRUE 1 100 0.00 1.00000000000 BIT_MASK 0x1 FORMAT "%13.11" ECU_ADDRESS 0x70000A8D /end MEASUREMENT
/begin MEASUREMENT CEngUsT_flgSRCMaxHeal "Max Healing in Signal Range Check diagnosis" UBYTE B_TRUE 1 100 0.00 1.00000000000 BIT_MASK 0x1 FORMAT "%13.11" ECU_ADDRESS 0x70000A8C /end MEASUREMENT
/begin MEASUREMENT CEngUsT_flgSRCMinErr "Min Error in Signal Range Check diagnosis" UBYTE B_TRUE 1 100 0.00 1.00000000000 BIT_MASK 0x1 FORMAT "%13.11" ECU_ADDRESS 0x70000A8B /end MEASUREMENT
/begin MEASUREMENT CEngUsT_flgSRCMinHeal "Min Healing in Signal Range Check diagnosis" UBYTE B_TRUE 1 100 0.00 1.00000000000 BIT_MASK 0x1 FORMAT "%13.11" ECU_ADDRESS 0x70000A8A /end MEASUREMENT
/begin MEASUREMENT CEngUsT_flgSRCTmpErr "Temporary error in Signal Range Check diagnosis" UBYTE B_TRUE 1 100 0.00 1.00000000000 BIT_MASK 0x1 FORMAT "%13.11" ECU_ADDRESS 0x70000A89 /end MEASUREMENT
/begin MEASUREMENT CEngUsT_flgSRCTmpHeal "Temporary healing in Signal Range Check diagnosis" UBYTE B_TRUE 1 100 0.00 1.00000000000 BIT_MASK 0x1 FORMAT "%13.11" ECU_ADDRESS 0x70000A88 /end MEASUREMENT
/begin MEASUREMENT CEngUsT_flgSRCTmpMaxErr "Temporary Max error in Signal Range Check diagnosis" UBYTE B_TRUE 1 100 0.00 1.00000000000 BIT_MASK 0x1 FORMAT "%13.11" ECU_ADDRESS 0x70000A87 /end MEASUREMENT
/begin MEASUREMENT CEngUsT_flgSRCTmpMinErr "Temporary Min error in Signal Range Check diagnosis" UBYTE B_TRUE 1 100 0.00 1.00000000000 BIT_MASK 0x1 FORMAT "%13.11" ECU_ADDRESS 0x70000A86 /end MEASUREMENT
/begin MEASUREMENT CEngUsT_flgStopFirst "First engine stop during actual driving cycle has taken place" UBYTE B_TRUE 1 100 0.00 1.00000000000 BIT_MASK 0x1 FORMAT "%13.11" ECU_ADDRESS 0x7000039B /end MEASUREMENT
/begin MEASUREMENT CEngUsT_flgSwtReplMdl "Condition to switch the input signal to the replacement model" UBYTE B_TRUE 1 100 0.00 1.00000000000 BIT_MASK 0x1 FORMAT "%13.11" ECU_ADDRESS 0x70000A7D /end MEASUREMENT
/begin MEASUREMENT CEngUsT_flgSwtReplMdlStrt "Start condition to switch the input signal to the replacement model until first valid sensor signal" UBYTE B_TRUE 1 100 0.00 1.00000000000 BIT_MASK 0x1 FORMAT "%13.11" ECU_ADDRESS 0x7000039A /end MEASUREMENT
/begin MEASUREMENT CEngUsT_flgSwtReplMdlStrtEdgeFall "Reset condition to switch the input signal to the replacement model" UBYTE B_TRUE 1 100 0.00 1.00000000000 BIT_MASK 0x1 FORMAT "%13.11" ECU_ADDRESS 0x70000399 /end MEASUREMENT
/begin MEASUREMENT CEngUsT_flgTmpLooseCnctn "Temporary error of Loose Connection Check diagnosis" UBYTE B_TRUE 1 100 0.00 1.00000000000 BIT_MASK 0x1 FORMAT "%13.11" ECU_ADDRESS 0x70000A7C /end MEASUREMENT
/begin MEASUREMENT CEngUsT_flgVCdnLooseCnctnHeal "Driving requirement for healing of Loose Connection Check" UBYTE B_TRUE 1 100 0.00 1.00000000000 BIT_MASK 0x1 FORMAT "%13.11" ECU_ADDRESS 0x70000A7B /end MEASUREMENT
/begin MEASUREMENT CEngUsT_stDiag "Status information of diagnosis of engine coolant upstream sensor" UBYTE OneToOne 1 100 0.00 255.0 FORMAT "%5.1" ECU_ADDRESS 0x6000F046 /end MEASUREMENT
/begin MEASUREMENT CEngUsT_stSigT "Status to indicate signal quality of sensor value" UBYTE OneToOne 1 100 0.00 255.0 FORMAT "%5.1" ECU_ADDRESS 0x6000F783 /end MEASUREMENT
/begin MEASUREMENT CEngUsT_stSnsr "Status information of engine coolant upstream sensor" UBYTE OneToOne 1 100 0.00 255.0 FORMAT "%5.1" ECU_ADDRESS 0x6000F045 /end MEASUREMENT
/begin MEASUREMENT CEngUsT_t "Coolant Engine Upstream Temperature" SWORD Temp_Cels 1 100 -3549.940 3003.560 FORMAT "%8.3" ECU_ADDRESS 0x60009352 /end MEASUREMENT
/begin MEASUREMENT CEngUsT_tCEngTCHdT2SV "Sensed value of upstream engine coolant temperature" SWORD Temp_Cels 1 100 -3549.940 3003.560 FORMAT "%8.3" ECU_ADDRESS 0x600076F4 /end MEASUREMENT
/begin MEASUREMENT CEngUsT_tInpFild "Engine coolant upstream temperature before filter" SWORD Temp_Cels 1 100 -3549.940 3003.560 FORMAT "%8.3" ECU_ADDRESS 0x60009350 /end MEASUREMENT
/begin MEASUREMENT CEngUsT_tReplMdl "Replacement Model of Engine coolant upstream temperature" SWORD Temp_Cels 1 100 -3549.940 3003.560 FORMAT "%8.3" ECU_ADDRESS 0x60008A06 /end MEASUREMENT
/begin MEASUREMENT CEngUsT_tSens "Sensed value of upstream engine coolant temperature" SWORD Temp_Cels 1 100 -3549.940 3003.560 FORMAT "%8.3" ECU_ADDRESS 0x6000934E /end MEASUREMENT
/begin MEASUREMENT CEngUsT_tSnsr "temperature of engine coolant Up Stream sensor" SWORD Temp_Cels 1 100 -3549.940 3003.560 FORMAT "%8.3" ECU_ADDRESS 0x60008A04 /end MEASUREMENT
/begin MEASUREMENT CEngUsT_tSnsrFild "Filtered the raw sensor value of coolant upstream temperature" SWORD Temp_Cels 1 100 -3549.940 3003.560 FORMAT "%8.3" ECU_ADDRESS 0x60008A02 /end MEASUREMENT
/begin MEASUREMENT CEngUsT_tSnsrFildLstVld "Last valid filtered sensor signal of engine coolant upstream temperature" SWORD Temp_Cels 1 100 -3549.940 3003.560 FORMAT "%8.3" ECU_ADDRESS 0x600076F0 /end MEASUREMENT
/begin MEASUREMENT CEngUsT_tSnsrFildStrt "Filtered Sensor signal at engine start of engine coolant upstream temperature" SWORD Temp_Cels 1 100 -3549.940 3003.560 FORMAT "%8.3" ECU_ADDRESS 0x6000934C /end MEASUREMENT
/begin MEASUREMENT CEngUsT_tStop "Engine coolant upstream temperature at engine stop event" SWORD Temp_Cels 1 100 -3549.940 3003.560 FORMAT "%8.3" ECU_ADDRESS 0x6000934A /end MEASUREMENT
/begin MEASUREMENT CEngUsT_tStopLstCyc "Engine coolant upstream temperature at stop of engine of last driving cycle" SWORD Temp_Cels 1 100 -3549.940 3003.560 FORMAT "%8.3" ECU_ADDRESS 0x60009348 /end MEASUREMENT
/begin MEASUREMENT CEngUsT_tStopStr "Engine coolant upstream temperature at engine stop event (internal storage)" SWORD Temp_Cels 1 100 -3549.940 3003.560 FORMAT "%8.3" ECU_ADDRESS 0x6003948A /end MEASUREMENT
/begin MEASUREMENT CEngUsT_tStrt "Starting value of upstream engine coolant temperature" SWORD Temp_Cels 1 100 -3549.940 3003.560 FORMAT "%8.3" ECU_ADDRESS 0x60009346 /end MEASUREMENT
/begin MEASUREMENT CEngUsT_t_Sq "Signal Quality of Engine coolant upstream temperature" UBYTE SigQly_COMPU_VERB 1 100 0.00 15.0000000000 FORMAT "%13.10" ECU_ADDRESS 0x6000F782 /end MEASUREMENT
/begin MEASUREMENT CEngUsT_uSnsr "Sensor voltage value of engine coolant upstream temperature" UWORD Volt 1 100 0.00 13107.00 FORMAT "%8.2" ECU_ADDRESS 0x60008750 /end MEASUREMENT
/begin MEASUREMENT CEngUsT_uSnsrFild "Filtered sensor voltage value of engine coolant upstream temperature" UWORD Volt 1 100 0.00 13107.00 FORMAT "%8.2" ECU_ADDRESS 0x6000874E /end MEASUREMENT
/begin MEASUREMENT CHdT_tCEngTCHdT2SV "temperature in cylinder-head ; sensor value after lowpass" SWORD Temp_Cels 1 100 -3549.940 3003.560 FORMAT "%8.3" ECU_ADDRESS 0x600076F2 /end MEASUREMENT
/begin MEASUREMENT Clth2_st "Clutch switch signal 2" UBYTE OneToOne 1 100 0.00 255.0 FORMAT "%5.1" ECU_ADDRESS 0x6000F781 /end MEASUREMENT
/begin MEASUREMENT Clth2_stRaw "Raw input for the Clutch switch signal 2" UBYTE OneToOne 1 100 0.00 255.0 FORMAT "%5.1" ECU_ADDRESS 0x6000F780 /end MEASUREMENT
/begin MEASUREMENT Clth3_st "Clutch switch signal 3" UBYTE OneToOne 1 100 0.00 255.0 FORMAT "%5.1" ECU_ADDRESS 0x6000F77F /end MEASUREMENT
/begin MEASUREMENT Clth3_stRaw "Raw input for the Clutch switch signal 3" UBYTE OneToOne 1 100 0.00 255.0 FORMAT "%5.1" ECU_ADDRESS 0x6000F77E /end MEASUREMENT
/begin MEASUREMENT Clth4_st "clutch switch signal 4" UBYTE OneToOne 1 100 0.00 255.0 FORMAT "%5.1" ECU_ADDRESS 0x6000F77D /end MEASUREMENT
/begin MEASUREMENT Clth4_stRaw "Clutch 4 raw signal status" UBYTE OneToOne 1 100 0.00 255.0 FORMAT "%5.1" ECU_ADDRESS 0x6000F77C /end MEASUREMENT
/begin MEASUREMENT Clth_bClth2ONStuckFlt_mp "Measuring point used in calculation of Clutch 2 ON stuck fault detection" UWORD OneToOne 1 100 0.00 65535.00 FORMAT "%8.2" ECU_ADDRESS 0x7000A7C8 /end MEASUREMENT
/begin MEASUREMENT Clth_bClth3ONStuckFlt_mp "Measuring point used in calculation of Clutch 3 ON stuck fault detection" UWORD OneToOne 1 100 0.00 65535.00 FORMAT "%8.2" ECU_ADDRESS 0x7000A7C6 /end MEASUREMENT
/begin MEASUREMENT Clth_bClth4ONStuckFlt_mp "Measuring point used in calculation of Clutch 4 ON stuck fault detection" UWORD OneToOne 1 100 0.00 65535.00 FORMAT "%8.2" ECU_ADDRESS 0x7000A7C4 /end MEASUREMENT
/begin MEASUREMENT Clth_bCtrlFlgPrevValGS "Control Flag status for previous value maintain for GS" UBYTE OneToOne 1 100 0.00 1.000 BIT_MASK 0x1 FORMAT "%5.3" ECU_ADDRESS 0x6000F77B /end MEASUREMENT
/begin MEASUREMENT Clth_flgCluSwtImps "Error status for 2 clutch switch plausibility test" UBYTE OneToOne 1 100 0.00 255.0 FORMAT "%5.1" ECU_ADDRESS 0x6000F77A /end MEASUREMENT
/begin MEASUREMENT Clth_flgFailr "Cluth failure" UBYTE B_TRUE 1 100 0.00 1.00000000000 BIT_MASK 0x1 FORMAT "%13.11" ECU_ADDRESS 0x70000398 /end MEASUREMENT
/begin MEASUREMENT Clth_flgFullDePsd "Cluth full depressed" UBYTE B_TRUE 1 100 0.00 1.00000000000 BIT_MASK 0x1 FORMAT "%13.11" ECU_ADDRESS 0x70000397 /end MEASUREMENT
/begin MEASUREMENT Clth_flgFullPsd "Cluth full pressed" UBYTE B_TRUE 1 100 0.00 1.00000000000 BIT_MASK 0x1 FORMAT "%13.11" ECU_ADDRESS 0x70000396 /end MEASUREMENT
/begin MEASUREMENT Clth_flgFullReld "Cluth full released" UBYTE B_TRUE 1 100 0.00 1.00000000000 BIT_MASK 0x1 FORMAT "%13.11" ECU_ADDRESS 0x70000395 /end MEASUREMENT
/begin MEASUREMENT Clth_flgPtlPsd "Cluth partial pressed" UBYTE B_TRUE 1 100 0.00 1.00000000000 BIT_MASK 0x1 FORMAT "%13.11" ECU_ADDRESS 0x70000394 /end MEASUREMENT
/begin MEASUREMENT Clth_flgPtlReld "Cluth partial released" UBYTE B_TRUE 1 100 0.00 1.00000000000 BIT_MASK 0x1 FORMAT "%13.11" ECU_ADDRESS 0x70000393 /end MEASUREMENT
/begin MEASUREMENT Clth_flgPtlReldDebd "Cluth partial released debounced" UBYTE B_TRUE 1 100 0.00 1.00000000000 BIT_MASK 0x1 FORMAT "%13.11" ECU_ADDRESS 0x70000392 /end MEASUREMENT
/begin MEASUREMENT Clth_flgRxEPBErr "flag for Rx Electric Parking Brake Error" UBYTE OneToOne 1 100 0.00 1.000 BIT_MASK 0x1 FORMAT "%5.3" ECU_ADDRESS 0x6000F779 /end MEASUREMENT
/begin MEASUREMENT Clth_flgRxEPBTout "flag for Rx Electric Parking Brake Tout" UBYTE OneToOne 1 100 0.00 1.000 BIT_MASK 0x1 FORMAT "%5.3" ECU_ADDRESS 0x6000F778 /end MEASUREMENT
/begin MEASUREMENT Clth_r "Clutch ratio" SWORD Prc_Fact256 1 100 -128.0000 127.9961 FORMAT "%8.4" ECU_ADDRESS 0x60009340 /end MEASUREMENT
/begin MEASUREMENT Clth_rClthStk "Clutch Stroke sensor ratio" UBYTE Prc_EGR 1 100 0.00 100.0 FORMAT "%5.1" ECU_ADDRESS 0x6000E8A0 /end MEASUREMENT
/begin MEASUREMENT Clth_st "Debounced status of Clutch" UBYTE OneToOne 1 100 0.00 255.0 FORMAT "%5.1" ECU_ADDRESS 0x50006008 /end MEASUREMENT
/begin MEASUREMENT Clth_stClth2ErrXPostDrv_mp "Status to indicate that the post drive has been delayed by Clutch 2" UBYTE OneToOne 1 100 0.00 255.0 FORMAT "%5.1" ECU_ADDRESS 0x7000A7C3 /end MEASUREMENT
/begin MEASUREMENT Clth_stClth2ONErrEEP_mp "Measuring point used to update the EEPROM status for clutch 2" UBYTE OneToOne 1 100 0.00 255.0 FORMAT "%5.1" ECU_ADDRESS 0x7000A7C2 /end MEASUREMENT
/begin MEASUREMENT Clth_stClth3ErrXPostDrv_mp "Status to indicate that the post drive has been delayed by Clutch 3" UBYTE OneToOne 1 100 0.00 255.0 FORMAT "%5.1" ECU_ADDRESS 0x7000A7C1 /end MEASUREMENT
/begin MEASUREMENT Clth_stClth3ONErrEEP_mp "Measuring point used to update the EEPROM status for clutch 3" UBYTE OneToOne 1 100 0.00 255.0 FORMAT "%5.1" ECU_ADDRESS 0x7000A7C0 /end MEASUREMENT
/begin MEASUREMENT Clth_stClth3ONStuckFlt_mp "Measuring point used in calculation of Clutch 3 ON stuck fault detection" UBYTE OneToOne 1 100 0.00 255.0 FORMAT "%5.1" ECU_ADDRESS 0x7000A7BF /end MEASUREMENT
/begin MEASUREMENT Clth_stClth4ErrXPostDrv_mp "Status to indicate that the post drive has been delayed by Clutch 4." UBYTE OneToOne 1 100 0.00 255.0 FORMAT "%5.1" ECU_ADDRESS 0x7000A7BE /end MEASUREMENT
/begin MEASUREMENT Clth_stClth4OFFStuckFlt_mp "Measuring point used in calculation of Clutch 4 OFF stuck fault detection" UBYTE OneToOne 1 100 0.00 255.0 FORMAT "%5.1" ECU_ADDRESS 0x7000A7BD /end MEASUREMENT
/begin MEASUREMENT Clth_stClth4ONErrEEP_mp "Measuring point used to update the EEPROM status for clutch 4" UBYTE OneToOne 1 100 0.00 255.0 FORMAT "%5.1" ECU_ADDRESS 0x7000A7BC /end MEASUREMENT
/begin MEASUREMENT Clth_stClthOFFStuckFlt_mp "Measuring point used in calculation of Clutch OFF stuck fault detection" UBYTE OneToOne 1 100 0.00 255.0 FORMAT "%5.1" ECU_ADDRESS 0x7000A7BB /end MEASUREMENT
/begin MEASUREMENT Clth_stClthONStuckFlt_mp "Measuring point used in calculation of Clutch ON stuck fault detection" UBYTE OneToOne 1 100 0.00 255.0 FORMAT "%5.1" ECU_ADDRESS 0x7000A7BA /end MEASUREMENT
/begin MEASUREMENT Clth_stGSH "clutch status information for gear shift harmonization" UBYTE OneToOne 1 100 0.00 255.0 FORMAT "%5.1" ECU_ADDRESS 0x6000F776 /end MEASUREMENT
/begin MEASUREMENT Clth_stIntDebVal "Internal debounced Clutch sensor value" UBYTE OneToOne 1 100 0.00 255.0 FORMAT "%5.1" ECU_ADDRESS 0x6000F775 /end MEASUREMENT
/begin MEASUREMENT Clth_stLastGear "Gear information from last calculation cycle" SBYTE OneToOne 1 100 -128.0 127.0 FORMAT "%5.1" ECU_ADDRESS 0x60014112 /end MEASUREMENT
/begin MEASUREMENT Clth_stOldGear "Last valid gear information" SBYTE OneToOne 1 100 -128.0 127.0 FORMAT "%5.1" ECU_ADDRESS 0x6000F7BE /end MEASUREMENT
/begin MEASUREMENT Clth_stOpnMark "marker of clutch state: clutch is open" UBYTE OneToOne 1 100 0.00 255.0 FORMAT "%5.1" ECU_ADDRESS 0x6000F774 /end MEASUREMENT
/begin MEASUREMENT Clth_stPlausErr0 "Status of error when stroke sensor still lies above max. threshold even after deepest clutch switch is not pressed" UBYTE OneToOne 1 100 0.00 255.0 FORMAT "%5.1" ECU_ADDRESS 0x6000F773 /end MEASUREMENT
/begin MEASUREMENT Clth_stPlausErr1 "Status of error when stroke sensor still lies below min. threshold even after deepest clutch switch is pressed" UBYTE OneToOne 1 100 0.00 255.0 FORMAT "%5.1" ECU_ADDRESS 0x6000F772 /end MEASUREMENT
/begin MEASUREMENT Clth_stRaw "Raw signal of clutch state" UBYTE OneToOne 1 100 0.00 255.0 FORMAT "%5.1" ECU_ADDRESS 0x60014113 /end MEASUREMENT
/begin MEASUREMENT Clth_tiClth2NrmDetPostDrv_mp "Timer used to check the release time of clutch 2 in post drive" SWORD Time_ms 1 100 -327680.0 327670.0 FORMAT "%8.1" ECU_ADDRESS 0x7000A7B8 /end MEASUREMENT
/begin MEASUREMENT Clth_tiClth2NrmDet_mp "Timer used to check the release time of clutch 2 in normal Driving cycle" SWORD Time_ms 1 100 -327680.0 327670.0 FORMAT "%8.1" ECU_ADDRESS 0x7000A7B6 /end MEASUREMENT
/begin MEASUREMENT Clth_tiClth3NrmDetPostDrv_mp "Timer used to check the release time of clutch 3 in post drive" SWORD Time_ms 1 100 -327680.0 327670.0 FORMAT "%8.1" ECU_ADDRESS 0x7000A7B4 /end MEASUREMENT
/begin MEASUREMENT Clth_tiClth3NrmDet_mp "Timer used to check the release time of clutch 3 in normal Driving cycle" SWORD Time_ms 1 100 -327680.0 327670.0 FORMAT "%8.1" ECU_ADDRESS 0x7000A7B2 /end MEASUREMENT
/begin MEASUREMENT Clth_tiClth4NrmDetPostDrv_mp "Timer used to check the release time of clutch 4 in post drive" SWORD Time_ms 1 100 -327680.0 327670.0 FORMAT "%8.1" ECU_ADDRESS 0x7000A7B0 /end MEASUREMENT
/begin MEASUREMENT Clth_tiClth4NrmDet_mp "Timer used to check the release time of clutch 4 in normal Driving cycle" SWORD Time_ms 1 100 -327680.0 327670.0 FORMAT "%8.1" ECU_ADDRESS 0x7000A7AE /end MEASUREMENT
/begin MEASUREMENT CoDsplCtl_stHiOilP "Status of High oil pressure" UBYTE OneToOne 1 100 0.00 255.0 BIT_MASK 0x1 FORMAT "%5.1" ECU_ADDRESS 0x6000E89F /end MEASUREMENT
/begin MEASUREMENT CoDsplCtl_stJdgMID "status of MID judgement enable" UBYTE OneToOne 1 100 0.00 255.0 BIT_MASK 0x1 FORMAT "%5.1" ECU_ADDRESS 0x6000E89E /end MEASUREMENT
/begin MEASUREMENT CoDsplCtl_stMIDPrev "Previous Status of MID Lamp" UBYTE OneToOne 1 100 0.00 255.0 FORMAT "%5.1" ECU_ADDRESS 0x6000E89D /end MEASUREMENT
/begin MEASUREMENT CoDsplCtl_stOilLmp "Oil pressure warning lamp" UBYTE OneToOne 1 100 0.00 255.0 FORMAT "%5.1" ECU_ADDRESS 0x6000F892 /end MEASUREMENT
/begin MEASUREMENT CoDsplCtl_stOilLmpInfo "Oil pressure warning lamp for multi information" UBYTE OneToOne 1 100 0.00 255.0 FORMAT "%5.1" ECU_ADDRESS 0x6000F891 /end MEASUREMENT
/begin MEASUREMENT CoDsplCtl_stOilLmpOut_mp "Oil pressure warning lamp contrl status" UBYTE OneToOne 1 100 0.00 255.0 FORMAT "%5.1" ECU_ADDRESS 0x70009FE7 /end MEASUREMENT
/begin MEASUREMENT CoDsplCtl_stOilPDlyTmr "status of oil pressure delay timer" UBYTE OneToOne 1 100 0.00 255.0 FORMAT "%5.1" ECU_ADDRESS 0x6000E89C /end MEASUREMENT
/begin MEASUREMENT CoEngStopEnbl_TExhMax_TOFFDLY_I.time "Delay time for deactivation of start-stopp after exhaust manifold temperature above threshold / Pointer to internal timer value" SLONG TimeDT 1 100 -2147483648.00 2147483647.00 FORMAT "%13.2" ECU_ADDRESS 0x600030D8 /end MEASUREMENT
/begin MEASUREMENT CoEngStopEnbl_TExhMin_TOFFDLY_I.time "Delay time for deactivation of start-stopp after exhaust manifold temperature below threshold / Pointer to internal timer value" SLONG TimeDT 1 100 -2147483648.00 2147483647.00 FORMAT "%13.2" ECU_ADDRESS 0x600030D4 /end MEASUREMENT
/begin MEASUREMENT CoEng_bObdTmrInctg "On Board Diagnostic timer is incrementing" UBYTE B_TRUE 1 100 0.00 1.00000000000 BIT_MASK 0x1 FORMAT "%13.11" ECU_ADDRESS 0x6000F1CB /end MEASUREMENT
/begin MEASUREMENT CoEng_bStalEng "Engine stall" UBYTE B_TRUE 1 100 0.00 1.00000000000 BIT_MASK 0x1 FORMAT "%13.11" ECU_ADDRESS 0x70000A73 /end MEASUREMENT
/begin MEASUREMENT CoEng_bStopEna "Engine STOP order enabled" UBYTE B_TRUE 1 100 0.00 1.00000000000 BIT_MASK 0x1 FORMAT "%13.11" ECU_ADDRESS 0x70000A72 /end MEASUREMENT
/begin MEASUREMENT CoEng_bStopEnblStSp "Enablesdisables the possible engine Stop order from StartStop" UBYTE B_TRUE 1 100 0.00 1.00000000000 BIT_MASK 0x1 FORMAT "%13.11" ECU_ADDRESS 0x70000A71 /end MEASUREMENT
/begin MEASUREMENT CoEng_bStrtDes "Engine START order desired" UBYTE B_TRUE 1 100 0.00 1.00000000000 BIT_MASK 0x1 FORMAT "%13.11" ECU_ADDRESS 0x70000A70 /end MEASUREMENT
/begin MEASUREMENT CoEng_bStrtEnbl "Engine START order enabled" UBYTE OneToOne 1 100 0.00 1.000 BIT_MASK 0x1 FORMAT "%5.3" ECU_ADDRESS 0x7000548B /end MEASUREMENT
/begin MEASUREMENT CoEng_bXPostDrv "Measurement point indicating whether an extension of afterrun (PostDrive) is requested" UBYTE B_TRUE 1 100 0.00 1.00000000000 BIT_MASK 0x1 FORMAT "%13.11" ECU_ADDRESS 0x70000391 /end MEASUREMENT
/begin MEASUREMENT CoEng_flgEngStrtCdn "The conditions for a detected OBD-relevant Engine-Start is given" UBYTE B_TRUE 1 100 0.00 1.00000000000 BIT_MASK 0x1 FORMAT "%13.11" ECU_ADDRESS 0x7000544E /end MEASUREMENT
/begin MEASUREMENT CoEng_flgObdPreCdn "Flag: Precondition for the start of the PID1F." UBYTE B_TRUE 1 100 0.00 1.00000000000 BIT_MASK 0x1 FORMAT "%13.11" ECU_ADDRESS 0x7000548C /end MEASUREMENT
/begin MEASUREMENT CoEng_flgStopPhdUrg "Indicates an urgent stop prohibition" UBYTE B_TRUE 1 100 0.00 1.00000000000 BIT_MASK 0x1 FORMAT "%13.11" ECU_ADDRESS 0x70000A6E /end MEASUREMENT
/begin MEASUREMENT CoEng_flgStrtDmdUrg "The start demand is urgent." UBYTE B_TRUE 1 100 0.00 1.00000000000 BIT_MASK 0x1 FORMAT "%13.11" ECU_ADDRESS 0x70000A6D /end MEASUREMENT
/begin MEASUREMENT CoEng_flgSyCDriveERNM_I.oldSignal "System sub-state of the ECU changed to SYC_DRIVE. / value of input signal last calculation" UBYTE B_TRUE 1 100 0.00 1.00000000000 BIT_MASK 0x1 FORMAT "%13.11" ECU_ADDRESS 0x6000E89B /end MEASUREMENT
/begin MEASUREMENT CoEng_numStopPhdUrgMax "Demander with the most urgent stop prohibition" UBYTE CoEng_EngOnDmd_VERB 1 100 0.00 36.0000000000 FORMAT "%13.10" ECU_ADDRESS 0x70005450 /end MEASUREMENT
/begin MEASUREMENT CoEng_numStrtDmdUrgMax "Demander with the most urgent start demand" UBYTE CoEng_EngOnDmd_VERB 1 100 0.00 36.0000000000 FORMAT "%13.10" ECU_ADDRESS 0x70005451 /end MEASUREMENT
/begin MEASUREMENT CoEng_st "Engine operation status" UBYTE CoEng_st_COMPU_VERB 1 100 0.00 5.00000000000 FORMAT "%13.11" ECU_ADDRESS 0x6000F739 /end MEASUREMENT
/begin MEASUREMENT CoEng_stDmdStrtStSp_a "Message array with the start demanders for Start-Stop" UWORD OneToOne 1 100 0.00 65535.00 FORMAT "%8.2" ARRAY_SIZE 3 ECU_ADDRESS 0x60013E2C /end MEASUREMENT
/begin MEASUREMENT CoEng_stEngRunDmd "Status of the demand for a running engine (stop prohibition or start demand)" UWORD OneToOne 1 100 0.00 65535.00 FORMAT "%8.2" ECU_ADDRESS 0x7000535C /end MEASUREMENT
/begin MEASUREMENT CoEng_stEngStopOrdLoc "Local copy of values unequal 0 of CoVeh_stEngStopOrd." UBYTE OneToOne 1 100 0.00 255.0 FORMAT "%5.1" ECU_ADDRESS 0x70005452 /end MEASUREMENT
/begin MEASUREMENT CoEng_stEngStrtOrdExtd "Internal continuation of the message CoVeh_stEngStrtOrd." UBYTE OneToOne 1 100 0.00 255.0 FORMAT "%5.1" ECU_ADDRESS 0x70005453 /end MEASUREMENT
/begin MEASUREMENT CoEng_stEngStrtOrdOldStEng "The latter value of CoVeh_stEngStrtOrd in the function CoEng_StEng." UBYTE B_TRUE 1 100 0.00 1.00000000000 BIT_MASK 0x1 FORMAT "%13.11" ECU_ADDRESS 0x70000390 /end MEASUREMENT
/begin MEASUREMENT CoEng_stInhbStopStSp_a "Message array with the stop inhibitors for Start-Stop" UWORD OneToOne 1 100 0.00 65535.00 FORMAT "%8.2" ARRAY_SIZE 3 ECU_ADDRESS 0x60013E32 /end MEASUREMENT
/begin MEASUREMENT CoEng_stInhbStrt_mp "Measurementpoint to indicate start inhibitors for start-stop" UWORD OneToOne 1 100 0.00 65535.00 FORMAT "%8.2" ECU_ADDRESS 0x70009EE0 /end MEASUREMENT
/begin MEASUREMENT CoEng_stMai "" UWORD CoEng_stMai_VERB 1 100 0.00 16384.0000000 FORMAT "%13.7" ECU_ADDRESS 0x50005C3C /end MEASUREMENT
/begin MEASUREMENT CoEng_stMaiOld "" UWORD CoEng_stMai_VERB 1 100 0.00 16384.0000000 FORMAT "%13.7" ECU_ADDRESS 0x60013E38 /end MEASUREMENT
/begin MEASUREMENT CoEng_stOld "engine state before current state was reached" UBYTE CoEng_st_COMPU_VERB 1 100 0.00 5.00000000000 FORMAT "%13.11" ECU_ADDRESS 0x6000F738 /end MEASUREMENT
/begin MEASUREMENT CoEng_stStalEngReas "Status to indicate the reason of engine stall" UBYTE OneToOne 1 100 0.00 255.0 FORMAT "%5.1" ECU_ADDRESS 0x6000F736 /end MEASUREMENT
/begin MEASUREMENT CoEng_stStopEnblActvLstObsrv "List of the selected requester, which enables an Engine stop" UBYTE OneToOne 1 100 0.00 255.0 FORMAT "%5.1" ECU_ADDRESS 0x70005454 /end MEASUREMENT
/begin MEASUREMENT CoEng_stStopEnblActvObsrv "Information if a selected requester enables an engine stop" UBYTE B_TRUE 1 100 0.00 1.00000000000 BIT_MASK 0x1 FORMAT "%13.11" ECU_ADDRESS 0x70005455 /end MEASUREMENT
/begin MEASUREMENT CoEng_stStopEnblLstActvObsrv_a "Display which of the requesters in the observer list enables an Engine stop" UBYTE CoEng_EngOnDmd_VERB 1 100 0.00 36.0000000000 FORMAT "%13.10" ARRAY_SIZE 4 ECU_ADDRESS 0x6000E897 /end MEASUREMENT
/begin MEASUREMENT CoEng_stStopEng "Engine STOP order from CoEng" UBYTE OneToOne 1 100 0.00 255.0 FORMAT "%5.1" ECU_ADDRESS 0x6000F735 /end MEASUREMENT
/begin MEASUREMENT CoEng_stStopPhdUrgMax "Urgency of the stop prohibition" UBYTE OneToOne 1 100 0.00 255.0 FORMAT "%5.1" ECU_ADDRESS 0x70005456 /end MEASUREMENT
/begin MEASUREMENT CoEng_stStrtDesActvLstObsrv "List of the selected demanders, which requests an engine start" UBYTE OneToOne 1 100 0.00 255.0 FORMAT "%5.1" ECU_ADDRESS 0x70005457 /end MEASUREMENT
/begin MEASUREMENT CoEng_stStrtDesActvObsrv "Engine start demand status of selected requester" UBYTE B_TRUE 1 100 0.00 1.00000000000 BIT_MASK 0x1 FORMAT "%13.11" ECU_ADDRESS 0x70005458 /end MEASUREMENT
/begin MEASUREMENT CoEng_stStrtDesLstActvObsrv_a "Display which of the requesters in the observer list requests an Engine start" UBYTE CoEng_EngOnDmd_VERB 1 100 0.00 36.0000000000 FORMAT "%13.10" ARRAY_SIZE 4 ECU_ADDRESS 0x6000E893 /end MEASUREMENT
/begin MEASUREMENT CoEng_stStrtDmdUrgMax "Urgency of the start demand" UBYTE OneToOne 1 100 0.00 255.0 FORMAT "%5.1" ECU_ADDRESS 0x70005459 /end MEASUREMENT
/begin MEASUREMENT CoEng_tEngStopEnbl "Engine temperature for release of automatic stop" SWORD Temp_Cels 1 100 -3549.940 3003.560 FORMAT "%8.3" ECU_ADDRESS 0x600076EE /end MEASUREMENT
/begin MEASUREMENT CoEng_tiAfterrun "Time since reaching engine state afterrun (COENG_STOPPING & COENG_FINISH)" ULONG Time_ms 1 100 0.00 42949672950.0 FORMAT "%13.1" ECU_ADDRESS 0x70005210 /end MEASUREMENT
/begin MEASUREMENT CoEng_tiAfterrunBuf "Buffer for time since reaching engine state afterrun (COENG_STOPPING COENG_FINISH)" ULONG Time_ms 1 100 0.00 42949672950.0 FORMAT "%13.1" ECU_ADDRESS 0x500013E0 /end MEASUREMENT
/begin MEASUREMENT CoEng_tiAfterrunRed "time since reaching engine state afterrun (COENG_STOPPING & COENG_FINISH) with reduced resolution for curve/map input" SWORD TimeRed 1 100 -5242.880 5242.720 FORMAT "%8.3" ECU_ADDRESS 0x7000535E /end MEASUREMENT
/begin MEASUREMENT CoEng_tiCranking "Time elapsed in CRANKING state" ULONG Time_ms 1 100 0.00 42949672950.0 FORMAT "%13.1" ECU_ADDRESS 0x70005214 /end MEASUREMENT
/begin MEASUREMENT CoEng_tiCrankingRed "Time elapsed in CRANKING state with reduced resolution for curvemap input" SWORD TimeRed 1 100 -5242.880 5242.720 FORMAT "%8.3" ECU_ADDRESS 0x70005360 /end MEASUREMENT
/begin MEASUREMENT CoEng_tiNormal "time since running state was reached" ULONG Time_ms 1 100 0.00 42949672950.0 FORMAT "%13.1" ECU_ADDRESS 0x600038E4 /end MEASUREMENT
/begin MEASUREMENT CoEng_tiNormalBuf "Buffer for time since reaching normal engine (COENG_ST_RUNNING, COENG_ST_AUTOSTOPPING)" ULONG Time_ms 1 100 0.00 42949672950.0 FORMAT "%13.1" ECU_ADDRESS 0x60012544 /end MEASUREMENT
/begin MEASUREMENT CoEng_tiNormalRed "time since engine state COENG_RUNNING was reached, with reduced resolution for curve/map input" SWORD TimeRed 1 100 -5242.880 5242.720 FORMAT "%8.3" ECU_ADDRESS 0x6000932C /end MEASUREMENT
/begin MEASUREMENT CoEng_tiRunngSumBuf "How long engine is RUNNING." ULONG Time_ms 1 100 0.00 42949672950.0 FORMAT "%13.1" ECU_ADDRESS 0x60012548 /end MEASUREMENT
/begin MEASUREMENT CoEng_tiScneEngStrtPrmIdH1F "PID 1F Time elapsed since engine start" ULONG Time_sec_q1_COMPU 1 100 0.00 65535.0000000 FORMAT "%13.7" ECU_ADDRESS 0x60013104 /end MEASUREMENT
/begin MEASUREMENT CoEng_tiScneEngStrtStM.CoEng_bObdTmrInctg "The State machine which controls the behaviour of the PID 1F / OBD timer is incrementing" UBYTE B_TRUE 1 100 0.00 1.00000000000 BIT_MASK 0x1 FORMAT "%13.11" ECU_ADDRESS 0x6001254C /end MEASUREMENT
/begin MEASUREMENT CoEng_tiScneEngStrtStM.CoEng_flgEngStrtCdn "The State machine which controls the behaviour of the PID 1F / The conditions for a detected OBD-relevant Engine-Start is given" UBYTE B_TRUE 1 100 0.00 1.00000000000 BIT_MASK 0x1 FORMAT "%13.11" ECU_ADDRESS 0x6001254D /end MEASUREMENT
/begin MEASUREMENT CoEng_tiScneEngStrtStM.CoEng_flgObdPreCdn "The State machine which controls the behaviour of the PID 1F / Flag: Precondition for the start of the PID1F" UBYTE B_TRUE 1 100 0.00 1.00000000000 BIT_MASK 0x1 FORMAT "%13.11" ECU_ADDRESS 0x6001254E /end MEASUREMENT
/begin MEASUREMENT CoEng_tiScneEngStrtStM.CoEng_stStMPrmID1F "The State machine which controls the behaviour of the PID 1F / Pointing-Variable to point out the actual state of the PID1F-State machine" UBYTE CoEng_PID1F_States_COMPU_VERB 1 100 0.00 4.00000000000 FORMAT "%13.11" ECU_ADDRESS 0x60036618 /end MEASUREMENT
/begin MEASUREMENT CoEng_tiScneEngStrtStM.CoEng_tiEngRunDcyc "The State machine which controls the behaviour of the PID 1F / CoEng time since engine start for OBD calculations in higher resolution" SLONG Time_ms 1 100 0.00 21474836470.0 FORMAT "%13.1" ECU_ADDRESS 0x60012550 /end MEASUREMENT
/begin MEASUREMENT CoEng_tiScneEngStrtStM.CoEng_tiEngRunDcycLoc "The State machine which controls the behaviour of the PID 1F / Local CoEng time since engine start for OBD calculations in higher resolution" SLONG Time_ms 1 100 0.00 21474836470.0 FORMAT "%13.1" ECU_ADDRESS 0x6003661C /end MEASUREMENT
/begin MEASUREMENT CoEng_tiScneEngStrtStM.CoEng_tiEngRunPreDcycLoc "The State machine which controls the behaviour of the PID 1F / Actual counted CoEng time since engine start for OBD calculations in Dase of a SW-Reset" SLONG Time_ms 1 100 0.00 21474836470.0 FORMAT "%13.1" ECU_ADDRESS 0x60012554 /end MEASUREMENT
/begin MEASUREMENT CoEng_tiScneEngStrtStM.CoEng_tiScneEngStrtWaitLoc "The State machine which controls the behaviour of the PID 1F / Local waiting time since engine start conditions for OBD related calulations are given" SWORD Time_ms 1 100 0.00 327670.0 FORMAT "%8.1" ECU_ADDRESS 0x60012558 /end MEASUREMENT
/begin MEASUREMENT CoEng_tiScneEngStrtStM.CoPOM_bHybDrvCycl "The State machine which controls the behaviour of the PID 1F / Signal inside the CoEng_tiScneEngStrt.StM for Readynes for Driving" UBYTE B_TRUE 1 100 0.00 1.00000000000 BIT_MASK 0x1 FORMAT "%13.11" ECU_ADDRESS 0x6001255A /end MEASUREMENT
/begin MEASUREMENT CoEng_tiScneEngStrtStM.SyC_stSub "The State machine which controls the behaviour of the PID 1F / Current systemECU sub-state" UBYTE OneToOne 1 100 0.00 255.0 FORMAT "%5.1" ECU_ADDRESS 0x6001255B /end MEASUREMENT
/begin MEASUREMENT CoEng_tiScneEngStrtStM.sm "The State machine which controls the behaviour of the PID 1F / Internal state variable of the PID 1F-State Machine" UBYTE CoEng_tiScneEngStrtStM_sm_VERB 1 100 0.00 4.00000000000 FORMAT "%13.11" ECU_ADDRESS 0x6001255C /end MEASUREMENT
/begin MEASUREMENT CoEng_tiScneEngStrtStM.CoEng_tiScneEngStrtSWT_I.tiStrd "The State machine which controls the behaviour of the PID 1F / timer for PID1F / Sum value" SLONG Time_ms 1 100 -21474836480.0 21474836470.0 FORMAT "%13.1" ECU_ADDRESS 0x60012560 /end MEASUREMENT
/begin MEASUREMENT CoEng_tiScneEngStrtStM.CoEng_tiScneEngStrtWaitSWT_I.tiStrd "The State machine which controls the behaviour of the PID 1F / timer for the start detection delaytime / Sum value" SWORD Time_ms 1 100 -327680.0 327670.0 FORMAT "%8.1" ECU_ADDRESS 0x60012564 /end MEASUREMENT
/begin MEASUREMENT CoEng_tiStandby "time since engine state COENG_STANDBY was reached" ULONG Time_ms 1 100 0.00 42949672950.0 FORMAT "%13.1" ECU_ADDRESS 0x70005218 /end MEASUREMENT
/begin MEASUREMENT CoEng_tiStandbyRed "Time elapsed since reaching standby state, reduced resolution" SWORD TimeRed 1 100 -5242.880 5242.720 FORMAT "%8.3" ECU_ADDRESS 0x70005362 /end MEASUREMENT
/begin MEASUREMENT CoEng_tiStart "time since engine state (COENG_READY & COENG_CRANKING) was reached" ULONG Time_ms 1 100 0.00 42949672950.0 FORMAT "%13.1" ECU_ADDRESS 0x7000521C /end MEASUREMENT
/begin MEASUREMENT CoEng_tiStartBuf "Buffer for time since engine state (COENG_READY COENG_CRANKING) was reached" ULONG Time_ms 1 100 0.00 42949672950.0 FORMAT "%13.1" ECU_ADDRESS 0x500013E4 /end MEASUREMENT
/begin MEASUREMENT CoEng_tiStartRed "Time elapsed since reaching start state, reduced resolution" SWORD TimeRed 1 100 -5242.880 5242.720 FORMAT "%8.3" ECU_ADDRESS 0x70005364 /end MEASUREMENT
/begin MEASUREMENT CoEng_tiStMaiRed_a "times of main engine states with reduced resolution" SWORD TimeRed 1 100 -5242.880 5242.720 FORMAT "%8.3" ARRAY_SIZE 11 ECU_ADDRESS 0x60013E3A /end MEASUREMENT
/begin MEASUREMENT CoEng_tiStMai_a "times of main engine states" ULONG Time_ms 1 100 0.00 42949672950.0 FORMAT "%13.1" ARRAY_SIZE 11 ECU_ADDRESS 0x60013108 /end MEASUREMENT
/begin MEASUREMENT CoEng_tqEngRefPrmIdH63 "PID 63 Indicated Engine Reference Torque" SLONG Trq 1 100 0.00 65535.0000000 FORMAT "%13.7" ECU_ADDRESS 0x60013134 /end MEASUREMENT
/begin MEASUREMENT CoEng_tqEngRefPrmIdH63_f "PID 63 Indicated Engine Reference Torque in floating point calculation." FLOAT32_IEEE RBPtCel_tq_1p0_1 1 100 0.00 65535.0000 FORMAT "%10.4" ECU_ADDRESS 0x60003A58 /end MEASUREMENT
/begin MEASUREMENT CoEng_tTrbUsCompu "Turbine upstream temperature" SWORD Temp_Cels 1 100 -3549.940 3003.560 FORMAT "%8.3" ECU_ADDRESS 0x600076EC /end MEASUREMENT
/begin MEASUREMENT CTM_nMin "minimal engine speed for CTM" SWORD EngN 1 100 -16384.00 16383.50 FORMAT "%8.2" ECU_ADDRESS 0x60013E0C /end MEASUREMENT
/begin MEASUREMENT CTM_trqDes "desired engine torque for CTM" SWORD Trq 1 100 -3276.800 3276.700 FORMAT "%8.3" ECU_ADDRESS 0x60013E0E /end MEASUREMENT
/begin MEASUREMENT CTM_trqResv "desired engine torque reserve for CTM" SWORD Trq 1 100 -3276.800 3276.700 FORMAT "%8.3" ECU_ADDRESS 0x60013E10 /end MEASUREMENT
/begin MEASUREMENT ects2sva1 "PID67h, Data Byte A" UBYTE dez 1 100 0.00 255.0 FORMAT "%5.1" ECU_ADDRESS 0x6000E8A3 /end MEASUREMENT
/begin MEASUREMENT ects2sva_msg "PID67h, Data Byte A" UBYTE dez 1 100 0.00 255.0 FORMAT "%5.1" ECU_ADDRESS 0x6000EEFC /end MEASUREMENT
/begin MEASUREMENT ects2svb1 "PID67h, Data Byte B" UBYTE temp_ub_q1_o40 1 100 -40.0 215.0 FORMAT "%5.1" ECU_ADDRESS 0x6000E8A2 /end MEASUREMENT
/begin MEASUREMENT ects2svb_msg "PID67h, Data Byte B" UBYTE temp_ub_q1_o40 1 100 -40.0 215.0 FORMAT "%5.1" ECU_ADDRESS 0x6000EEFB /end MEASUREMENT
/begin MEASUREMENT ects2svc1 "PID67h, Data Byte C" UBYTE temp_ub_q1_o40 1 100 -40.0 215.0 FORMAT "%5.1" ECU_ADDRESS 0x6000E8A1 /end MEASUREMENT
/begin MEASUREMENT ects2svc_msg "PID67h, Data Byte C" UBYTE temp_ub_q1_o40 1 100 -40.0 215.0 FORMAT "%5.1" ECU_ADDRESS 0x6000EEFA /end MEASUREMENT
/begin MEASUREMENT EngDa_tEng "Engine temperature" SWORD Temp_Cels 1 100 -3549.940 3003.560 FORMAT "%8.3" ECU_ADDRESS 0x6000899C /end MEASUREMENT
/begin MEASUREMENT tka_msg "Temperature engine radiator outlet (coolant)" UBYTE temp_ub_q0p75_o48 1 100 -48.0 143.3 FORMAT "%5.1" ECU_ADDRESS 0x6000F2D2 /end MEASUREMENT
/begin FUNCTION CEngDsT_VdPlausDiag "1.34.0    Coolant Engine Downstream Temperature - plausibility diagnosis"
 /begin DEF_CHARACTERISTIC CEngDsT_cntrSTCDrvgCycColdThd_MAP CEngDsT_cntrSTCDrvgCycHotThd_MAP CEngDsT_mAirIntglHSCEnagThd_C CEngDsT_mfAirSTCColdThdHi_CUR CEngDsT_mfAirSTCColdThdLo_CUR CEngDsT_mfAirSTCHotThdHi_CUR CEngDsT_mfAirSTCHotThdLo_CUR CEngDsT_nEngHSCEnagThd_C CEngDsT_nEngLSCEnagHi_C CEngDsT_nEngLSCEnagLo_C CEngDsT_stSwtPlausHSC_C CEngDsT_stSwtPlausLSC2_C CEngDsT_stSwtPlausLSC_C CEngDsT_stSwtPlausSTCEnag_C CEngDsT_stSwtPlausSTC_C CEngDsT_tDeltaRefMdlEnd_C CEngDsT_tDifLSCRefMdlErrHi_C CEngDsT_tDifLSCRefMdlErrLo_C CEngDsT_tDifSTCSnsrFildThd_CUR CEngDsT_tGrdtHSCFcoGsl_CUR CEngDsT_tGrdtHSCGsl_MAP CEngDsT_tHSCMdlThdHi_C CEngDsT_tHSCMdlThdLo_C CEngDsT_tHSCOffs_MAP CEngDsT_tHSCSnsrFildOffs_C CEngDsT_tiDebHSCEnag_C CEngDsT_tiDebHSCErr_C CEngDsT_tiDebHSCHeal_C CEngDsT_tiDebLSCErr_C CEngDsT_tiDebLSCHeal_C CEngDsT_tiDebLSCPlausEnagHi_C CEngDsT_tiDebLSCPlausEnagLo_C CEngDsT_tiSTCColdOffThd_C CEngDsT_tiSTCColdOnThd_C CEngDsT_tiSTCEngOffThdLo_C CEngDsT_tiSTCHotOffThd_C CEngDsT_tiSTCHotOnThd_C CEngDsT_tLSCRefMdlEnagThd_C CEngDsT_tLSCRefMdlEnd_CUR CEngDsT_tLSCStrtTEnagThd_CUR CEngDsT_tOffsRefMdl_C CEngDsT_tSTCRefMdlHotThd_C CEngDsT_tSTCSnsrStrtFrstThdHi_C CEngDsT_tSTCSnsrStrtFrstThdLo_C CEngDsT_tStrtFrstRefMdlEnd_C CEngDsT_vVehSTCColdThdHi_C CEngDsT_vVehSTCColdThdLo_C CEngDsT_vVehSTCHotThdHi_C CEngDsT_vVehSTCHotThdLo_C /end DEF_CHARACTERISTIC
 /begin IN_MEASUREMENT CEngDsT_flgBlkHeatrActvd CEngDsT_flgEngN CEngDsT_flgOvrRun CEngDsT_flgSnsrElecVld CEngDsT_flgSnsrPlausClr CEngDsT_flgStrtEnd CEngDsT_mAirIntgl CEngDsT_mfAirStoi CEngDsT_tRefMdl CEngDsT_tRefMdlEnd CEngDsT_tSnsrFild CEngDsT_tSnsrStrtFrst EngStrt_bFrstStrtEnd EnvT_t Epm_nEng SyC_stSub TiOff_stTiStrtEndOffFirstStrt TiOff_tiStrtEndOffFirstStrt VehV_v /end IN_MEASUREMENT
 /begin OUT_MEASUREMENT CEngDsT_flgPlausHSCDi CEngDsT_flgPlausHSCErr CEngDsT_flgPlausHSCHeal CEngDsT_flgPlausHSCRiseNr CEngDsT_flgPlausLSCDi CEngDsT_flgPlausLSCErr CEngDsT_flgPlausLSCHeal CEngDsT_flgPlausLSCRiseNr CEngDsT_flgPlausSTCDi CEngDsT_flgPlausSTCErr CEngDsT_flgPlausSTCHeal CEngDsT_flgPlausSTCRiseNr /end OUT_MEASUREMENT
 /begin LOC_MEASUREMENT CEngDsT_cntrSTCDrvgCycCold CEngDsT_cntrSTCDrvgCycHot CEngDsT_flgComErrWtrPmp CEngDsT_flgDSMClr1000msPlausDiag CEngDsT_flgFanFlapRelsLSC CEngDsT_flgHSCAirMEnad CEngDsT_flgHSCEnad CEngDsT_flgHSCEngNEnad CEngDsT_flgHSCErrDeb CEngDsT_flgHSCErrDi CEngDsT_flgHSCHealDeb CEngDsT_flgHSCNrDeb CEngDsT_flgLSCEnad CEngDsT_flgLSCEngNEnagThd CEngDsT_flgLSCEngNEnagThdHi CEngDsT_flgLSCEngNEnagThdLo CEngDsT_flgLSCEnvTEnad CEngDsT_flgLSCEnvTHealEnad CEngDsT_flgLSCErrDi CEngDsT_flgLSCHealEnag CEngDsT_flgLSCHealLockd CEngDsT_flgLSCRefMdlEnagThd CEngDsT_flgLSCSnsrRefMdlEnd CEngDsT_flgLSCStrtEnd CEngDsT_flgPlausHSCErrTmp CEngDsT_flgPlausHSCHealTmp CEngDsT_flgPlausHSCRiseNrTmp CEngDsT_flgPlausLSCErrTmp CEngDsT_flgPlausLSCHealTmp CEngDsT_flgPlausLSCRiseNrTmp CEngDsT_flgPlausSTCErrTmp CEngDsT_flgPlausSTCHealTmp CEngDsT_flgPlausSTCRiseNrTmp CEngDsT_flgRefMdlEndVal CEngDsT_flgSTCCold CEngDsT_flgSTCDrvgCycCold CEngDsT_flgSTCDrvgCycColdCntUp CEngDsT_flgSTCDrvgCycColdHot CEngDsT_flgSTCDrvgCycHot CEngDsT_flgSTCDrvgCycHotCntUp CEngDsT_flgSTCEnad CEngDsT_flgSTCErrDi CEngDsT_flgSTCHot CEngDsT_flgSTCTDifSnsrFildThdLo CEngDsT_flgSTCTmrColdOnEnad CEngDsT_flgSTCTmrColdRst CEngDsT_flgSTCTmrHotOnEnad CEngDsT_flgSTCTmrHotRst CEngDsT_mfAirPLD CEngDsT_tDifHSCRst CEngDsT_tDifHSCSnsrFild CEngDsT_tDifSTCSnsrFild CEngDsT_tGrdtHSC CEngDsT_tHSCMdl CEngDsT_tHSCMdlCorrd CEngDsT_tHSCMdlHiResl CEngDsT_tHSCOffs CEngDsT_tiSTCColdOff CEngDsT_tiSTCColdOn CEngDsT_tiSTCHotOff CEngDsT_tiSTCHotOn CEngDsT_tLSCRefMdlEnd CEngDsT_tSTCSnsrFildMax CEngDsT_tSTCSnsrFildMin /end LOC_MEASUREMENT
 FUNCTION_VERSION "1.34.0" /end FUNCTION
/begin FUNCTION CEngDsT_VdRefMdl "1.8.0     Coolant Engine Downstream Temperature - Reference Model"
 /begin DEF_CHARACTERISTIC CEngDsT_facRefMdlCalcnGradOn_CUR CEngDsT_facRefMdlEngTFall_CUR CEngDsT_facRefMdlOffWtrPmp_CUR CEngDsT_stSwtRefMdl_C CEngDsT_tGrdtRefMdlCoolg_MAP CEngDsT_tGrdtRefMdlEnvFcoGsl_CUR CEngDsT_tGrdtRefMdlEnv_MAP CEngDsT_tGrdtRefMdlLoadFcoGsl_MAP CEngDsT_tGrdtRefMdlLoadStrat_MAP CEngDsT_tGrdtRefMdlLoad_MAP CEngDsT_tGrdtRefMdlOff_MAP CEngDsT_tiDebRefMdlCalcnGrdOn_C CEngDsT_tiDebRefMdlCalcnGrdOn_MAP CEngDsT_tiDebRefMdlEngN_C CEngDsT_tiDebRefMdlEngTFall_C CEngDsT_tiDebRefMdlEngTFall_MAP CEngDsT_tiFilVElec_C CEngDsT_tRefMdlEnd_CUR /end DEF_CHARACTERISTIC
 /begin IN_MEASUREMENT CEngDsT_facCorrnStoi CEngDsT_flgEngN CEngDsT_flgOvrRun CEngDsT_flgSnsrElecVld CEngDsT_flgStrat CEngDsT_flgStrtEnd CEngDsT_flgStrtEndFrst CEngDsT_mfAirStoi CEngDsT_tReplMdl CEngDsT_tSnsrFild EnvT_t InjSys_flgFuEngOperActv SyC_stSub TiEngOff_ti VehV_v /end IN_MEASUREMENT
 /begin OUT_MEASUREMENT CEngDsT_flgRefMdlCalcnGrdOn CEngDsT_flgRefMdlRstLongStop CEngDsT_tRefMdl CEngDsT_tRefMdlEnd /end OUT_MEASUREMENT
 /begin LOC_MEASUREMENT CEngDsT_facFilVElec CEngDsT_facRefMdlFan CEngDsT_flgBlkHeatrActvdShft CEngDsT_flgEngNEdgeFall CEngDsT_flgEngTFall CEngDsT_flgFuEngStop CEngDsT_flgNgvGrdtRstTMdl CEngDsT_flgRefMdlFrstStop CEngDsT_flgRefMdlRst CEngDsT_flgRefMdlStrt CEngDsT_flgRefMdlStrtEndFrst CEngDsT_flgSwtRefMdlWtrPmp CEngDsT_mfAirStoiRefMdl CEngDsT_tDifRefMdlEnv CEngDsT_tGrdtRefMdl CEngDsT_tGrdtRefMdlAcm CEngDsT_tGrdtRefMdlDegPosTMEE CEngDsT_tGrdtRefMdlFco CEngDsT_tGrdtRefMdlHeat CEngDsT_tGrdtRefMdlInj CEngDsT_tGrdtRefMdlOff CEngDsT_tGrdtRefMdlOffLoc CEngDsT_tGrdtRefMdlOn CEngDsT_tGrdtRefMdlOnLoc CEngDsT_tiDebRefMdlCalcnGrdOn CEngDsT_tiDebRefMdlCalcnGrdOnCalcd CEngDsT_tiDebRefMdlEngTFall CEngDsT_tiDebRefMdlEngTFallCalcd CEngDsT_tiRefMdlEngOff CEngDsT_tRefMdlHiResl CEngDsT_tRefMdlLoc CEngDsT_tSnsrSub CEngDsT_vAvrgElec /end LOC_MEASUREMENT
 FUNCTION_VERSION "1.8.0" /end FUNCTION
/begin FUNCTION CEngDsT_VDReplMdl "2.7.0     Replacement Model for Engine Coolant Temperature"
 /begin DEF_CHARACTERISTIC CEngDsT_facCorrnStoi_CUR CEngDsT_facReplMdlEngOffInin_C CEngDsT_facReplMdlEngOffTi_CUR CEngDsT_stSwtReplMdlCfg_C CEngDsT_tGrdtReplMdlOnGsl_MAP CEngDsT_tiDebEngRot_C CEngDsT_tiDebReplMdlHml_C CEngDsT_tiDebReplMdlStrat_C CEngDsT_tReplMdlEngOffLim_C CEngDsT_tReplMdlEngOnLim_C CEngDsT_tReplMdlInin_C /end DEF_CHARACTERISTIC
 /begin IN_MEASUREMENT CEngDsT_facLamDesLim CEngDsT_flgHml CEngDsT_flgStrat CEngDsT_mfAir CEngDsT_tStop IntkAirT_tSnsrFild1 TiEngOff_bEngRot TiEngOff_bRst TiEngOff_stTi TiEngOff_ti /end IN_MEASUREMENT
 /begin OUT_MEASUREMENT CEngDsT_facCorrnStoi CEngDsT_flgReplMdlEngOffRst CEngDsT_mfAirStoi CEngDsT_tReplMdl CEngDsT_tReplMdlStop /end OUT_MEASUREMENT
 /begin LOC_MEASUREMENT CEngDsT_facReplMdlEngOffInit CEngDsT_flgCalcnReplMdlEngStop CEngDsT_flgEngRotDeb CEngDsT_flgReplMdlHmlDeb CEngDsT_flgReplMdlStratDeb CEngDsT_tDifReplMdlEngOff CEngDsT_tGrdtReplMdlEngOn CEngDsT_tiReplMdlEngOff CEngDsT_tReplMdlEngOffCoolg CEngDsT_tReplMdlIntkAir CEngDsT_tReplMdlLoc CEngDsT_tStopReplMdlLoc /end LOC_MEASUREMENT
 FUNCTION_VERSION "2.7.0" /end FUNCTION
/begin FUNCTION CEngDsT_Vd_DiagCoorr "1.18.0    Diagnosis Coordinator of Coolant Engine Downstream Temperature Sensor" /begin DEF_CHARACTERISTIC CEngDsT_tiDiagDSMCycRprt_C CEngDsT_tiDiagDSMFrstRprt_C /end DEF_CHARACTERISTIC
 /begin IN_MEASUREMENT CEngDsT_flgColdStrtDi CEngDsT_flgColdStrtFinal CEngDsT_flgColdStrtHeal CEngDsT_flgColdStrtMaxErr CEngDsT_flgColdStrtMinErr CEngDsT_flgColdStrtRiseNr CEngDsT_flgImpsDi CEngDsT_flgImpsErr CEngDsT_flgImpsHeal CEngDsT_flgPlausHSCDi CEngDsT_flgPlausHSCErr CEngDsT_flgPlausHSCHeal CEngDsT_flgPlausHSCRiseNr CEngDsT_flgPlausLSCDi CEngDsT_flgPlausLSCErr CEngDsT_flgPlausLSCHeal CEngDsT_flgPlausLSCRiseNr CEngDsT_flgPlausSTCDi CEngDsT_flgPlausSTCErr CEngDsT_flgPlausSTCHeal CEngDsT_flgPlausSTCRiseNr CEngDsT_flgSigErr CEngDsT_flgSigHeal CEngDsT_flgSnsrElecVld CEngDsT_flgSRCMaxErr CEngDsT_flgSRCMaxHeal CEngDsT_flgSRCMinErr CEngDsT_flgSRCMinHeal TDev_flgDSMRprt1000ms TDev_flgDSMRprt100ms /end IN_MEASUREMENT
 /begin OUT_MEASUREMENT CEngDsT_flgSnsrClr CEngDsT_flgSnsrColdStrtClr CEngDsT_flgSnsrElecClr CEngDsT_flgSnsrPlausClr CEngDsT_flgSnsrVld /end OUT_MEASUREMENT
 /begin LOC_MEASUREMENT CEngDsT_flgImpsClr CEngDsT_flgSetDFC1000ms CEngDsT_flgSetDFC100ms CEngDsT_flgSigClr CEngDsT_flgSnsrColdStrtVld CEngDsT_flgSnsrPlausVld CEngDsT_flgSnsrVldLoc CEngDsT_flgSRCClr CEngDsT_stDiagCycRprt1000ms CEngDsT_stDiagCycRprt100ms CEngDsT_tiDiagCycRprt1000ms CEngDsT_tiDiagCycRprt100ms /end LOC_MEASUREMENT
 FUNCTION_VERSION "1.18.0" /end FUNCTION
/begin FUNCTION CEngDsT_Vld2Lcy "2.12.0    Interface adapter of package Coolant Engine Downstream Temperature"
 /begin IN_MEASUREMENT CEngDsT_flgSnsrVld CEngDsT_t CEngDsT_tReplMdl CEngDsT_tSnsr CEngDsT_tSnsrFild CEngDsT_tSnsrTstr /end IN_MEASUREMENT
 /begin OUT_MEASUREMENT CEngDsT_stSigT CEngDsT_tMod CEngDsT_tRaw CEngDsT_tSens CEngDsT_tSnsrTstrSAE EngDa_tEng /end OUT_MEASUREMENT
 FUNCTION_VERSION "2.12.0" /end FUNCTION
/begin FUNCTION CEngTCHdT2SV "1.8.0     services 01,02 for engine temperature (coolant or cylinder head)" /begin DEF_CHARACTERISTIC TDev_tDflValPID67_C /end DEF_CHARACTERISTIC /begin IN_MEASUREMENT CEngDsT_tSnsrTstr CEngUsT_tSens /end IN_MEASUREMENT /begin OUT_MEASUREMENT ects2sva_msg ects2svb_msg ects2svc_msg /end OUT_MEASUREMENT
 /begin LOC_MEASUREMENT CEngBlkT_tCEngTCHdT2SV CEngDsT_tCEngTCHdT2SV CEngUsT_tCEngTCHdT2SV CHdT_tCEngTCHdT2SV ects2sva1 ects2svb1 ects2svc1 /end LOC_MEASUREMENT
 FUNCTION_VERSION "1.8.0" /end FUNCTION
/begin FUNCTION CEngUsT_DD "32.0.0    Coolant temperature (at engine inle / radiator outlet) - device driver"
 /begin DEF_CHARACTERISTIC CEngUsT_stSwtCfg_C CEngUsT_tiDebLooseCnctn1_C CEngUsT_tiDebLooseCnctn2_C CEngUsT_tiDebSRCErr_C CEngUsT_tiDebSRCHeal_C CEngUsT_tiTempPT1_C CEngUsT_tiVltgPT1_C CEngUsT_u2t_T CEngUsT_uRawDft_C CEngUsT_uThdLooseCnctn_C CEngUsT_uThdSRCMaxErr_C CEngUsT_uThdSRCMinErr_C CEngUsT_vThdLooseCnctnHeal_C /end DEF_CHARACTERISTIC
 /begin IN_MEASUREMENT CEngUsT_flgSnsrElecClr SyC_stSub TDev_flgDSMRprt100ms VehV_v /end IN_MEASUREMENT
 /begin OUT_MEASUREMENT CEngUsT_flgLooseCnctnDi CEngUsT_flgLooseCnctnErr CEngUsT_flgLooseCnctnHeal CEngUsT_flgSnsrSigAvl CEngUsT_flgSRCMaxErr CEngUsT_flgSRCMaxHeal CEngUsT_flgSRCMinErr CEngUsT_flgSRCMinHeal CEngUsT_stSnsr CEngUsT_tSnsr CEngUsT_tSnsrFild CEngUsT_uSnsr CEngUsT_uSnsrFild /end OUT_MEASUREMENT
 /begin LOC_MEASUREMENT CEngUsT_flgDSMClrReq CEngUsT_flgFilInitER CEngUsT_flgIniSRCErr CEngUsT_flgLooseCnctnFflp CEngUsT_flgLooseCnctnStr CEngUsT_flgSRCErr CEngUsT_flgSRCHeal CEngUsT_flgSRCTmpErr CEngUsT_flgSRCTmpHeal CEngUsT_flgSRCTmpMaxErr CEngUsT_flgSRCTmpMinErr CEngUsT_flgTmpLooseCnctn CEngUsT_flgVCdnLooseCnctnHeal /end LOC_MEASUREMENT
 FUNCTION_VERSION "32.0.0" /end FUNCTION
/begin FUNCTION CEngUsT_VD "32.0.0    Coolant temperature (at engine inle / radiator outlet) - virtual device" /begin DEF_CHARACTERISTIC CEngUsT_tiFil_C CEngUsT_tStopIni_C CEngUsT_tStrtThd_C /end DEF_CHARACTERISTIC
 /begin IN_MEASUREMENT CEngUsT_stDiag CEngUsT_tReplMdl CEngUsT_tSnsrFild Eep_EnvRamHist Eep_EnvRamInvld TiEngOff_bEngRot TiEngOff_bRst /end IN_MEASUREMENT
 /begin OUT_MEASUREMENT CEngUsT_flgSnsrVldStop CEngUsT_flgSnsrVldStopLstCyc CEngUsT_flgSnsrVldStrt CEngUsT_stSigT CEngUsT_t CEngUsT_tSens CEngUsT_tSnsrFildStrt CEngUsT_tStop CEngUsT_tStopLstCyc CEngUsT_tStrt CEngUsT_t_Sq tka_msg /end OUT_MEASUREMENT
 /begin LOC_MEASUREMENT CEngUsT_flgEngStopdThisCyc CEngUsT_flgSnsrVldStopStr CEngUsT_flgStopFirst CEngUsT_flgSwtReplMdl CEngUsT_flgSwtReplMdlStrt CEngUsT_flgSwtReplMdlStrtEdgeFall CEngUsT_tInpFild CEngUsT_tSnsrFildLstVld CEngUsT_tStopStr /end LOC_MEASUREMENT
 FUNCTION_VERSION "32.0.0" /end FUNCTION
/begin FUNCTION CEngUsT_VDDiagCoorr "32.2.0    Diagnosis Coordinator of Coolant Engine Upstream Temperature Sensor"
 /begin IN_MEASUREMENT CEngUsT_flgColdStrtDi CEngUsT_flgColdStrtFinal CEngUsT_flgColdStrtMaxErr CEngUsT_flgColdStrtMaxHeal CEngUsT_flgColdStrtMinErr CEngUsT_flgColdStrtMinHeal CEngUsT_flgColdStrtRiseNr CEngUsT_flgLooseCnctnDi CEngUsT_flgLooseCnctnErr CEngUsT_flgLooseCnctnHeal CEngUsT_flgSRCMaxErr CEngUsT_flgSRCMaxHeal CEngUsT_flgSRCMinErr CEngUsT_flgSRCMinHeal CEngUsT_stSnsr TDev_flgDSMRprt1000ms TDev_flgDSMRprt100ms /end IN_MEASUREMENT
 /begin OUT_MEASUREMENT CEngUsT_flgSnsrColdChkClr CEngUsT_flgSnsrElecClr CEngUsT_flgSnsrPlausClr CEngUsT_stDiag /end OUT_MEASUREMENT
 /begin LOC_MEASUREMENT CEngUsT_flgColdChkMaxClr CEngUsT_flgColdChkMinClr CEngUsT_flgLooseCnctnClr CEngUsT_flgSnsrClr CEngUsT_flgSRCClr /end LOC_MEASUREMENT
 FUNCTION_VERSION "32.2.0" /end FUNCTION
/begin FUNCTION CEngUsT_VDReplMdl "10.0.0    Replacement Temperature Model of Engine Upstream Coolant Temerature" /begin DEF_CHARACTERISTIC CEngUsT_tDftValReplMdl_C /end DEF_CHARACTERISTIC /begin OUT_MEASUREMENT CEngUsT_tReplMdl /end OUT_MEASUREMENT FUNCTION_VERSION "10.0.0" /end FUNCTION
/begin FUNCTION Clth_DD "70.3.0    Clutch Device Driver"
 /begin DEF_CHARACTERISTIC Clth2_Deb.tiHiLo_C Clth2_Deb.tiLoHi_C Clth3_Deb.tiHiLo_C Clth3_Deb.tiLoHi_C Clth4_Deb.tiHiLo_C Clth4_Deb.tiLoHi_C ClthEPBTout_Deb.tiHiLo_C ClthEPBTout_Deb.tiLoHi_C Clth_Deb.tiHiLo_C Clth_Deb.tiLoHi_C Clth_numGearSlip_C Clth_rClthStkDfl_C Clth_rCluStkThd_C Clth_rStkHiThdCC_C Clth_rStkHiThdIS_C Clth_rStkHiThdSIL_C Clth_rStkLoThdCC_C Clth_rStkLoThdIS_C Clth_rStkLoThdSIL_C Clth_stOpn_C Clth_stSetClu_C Clth_stSlipClsd_C Clth_stSlipOpn_C Clth_stSlip_C Clth_stStkActvn_C Clth_swtSig_C Clth_tiEPBComDeb_C Clth_tiRxEPBDeb_C Clth_tiUnderURstStrtReqOff_C /end DEF_CHARACTERISTIC
 /begin IN_MEASUREMENT Clth4_st Clth_st CoEng_st Com_rClthStk Com_stClth Com_stClthPedlFailDet Com_stClthStkFailInfo Com_stRxEPB Gbx_numGear Gbx_stPNPos Strt_stPs T15_st T50_st Tra_numGear Tra_swtCVTSig /end IN_MEASUREMENT
 /begin OUT_MEASUREMENT B_kuppl_msg Clth2_st Clth2_stRaw Clth3_st Clth3_stRaw Clth4_stRaw Clth_bCtrlFlgPrevValGS Clth_flgRxEPBErr Clth_flgRxEPBTout Clth_r Clth_stIntDebVal Clth_stRaw /end OUT_MEASUREMENT
 /begin LOC_MEASUREMENT Clth_rClthStk /end LOC_MEASUREMENT
 FUNCTION_VERSION "70.3.0" /end FUNCTION
/begin FUNCTION Clth_VD "70.3.0    Clutch Position Sensor Virtual Device"
 /begin DEF_CHARACTERISTIC Clth_flgStkSensClthSwtPrs_C Clth_nEngThd_C Clth_nNoGearShftDet_C Clth_rClthStkMaxThres_C Clth_rClthStkMinThres_C Clth_rThd1_C Clth_rThd2_C Clth_rThd3_C Clth_stClthONEEPRepl_C Clth_stDflVal_C Clth_swtCond_C Clth_tiCANDlyClthOff_C Clth_tiCANDlyClthOn_C Clth_tiClth2NrmDet_C Clth_tiClth3NrmDet_C Clth_tiClth4NrmDet_C Clth_tiCluSwtImpsOffDeb_C Clth_tiCluSwtImpsOnDeb_C Clth_tiGearShft_C Clth_tiReOpenDly_C Clth_vNoGearShftDet_C Clth_vVehSpdThd_C /end DEF_CHARACTERISTIC
 /begin REF_CHARACTERISTIC Clth_stStkActvn_C /end REF_CHARACTERISTIC
 /begin IN_MEASUREMENT Clth2_st Clth2_stRaw Clth3_st Clth_flgRxEPBTout Clth_r Clth_stIntDebVal Clth_stRaw Com_rClthStk Com_stClth Com_stClthPedlFailDet Com_stClthStkFailInfo Com_stRxEPB Epm_nEng Gbx_stPNPos SyC_stHistTiPostDrvMax SyC_stSub T15_st Tra_numGear VehV_v /end IN_MEASUREMENT
 /begin OUT_MEASUREMENT Clth4_st Clth_flgCluSwtImps Clth_st Clth_stGSH Clth_stLastGear Clth_stOldGear Clth_stOpnMark Clth_stPlausErr0 Clth_stPlausErr1 /end OUT_MEASUREMENT
 /begin LOC_MEASUREMENT Clth_bClth2ONStuckFlt_mp Clth_bClth3ONStuckFlt_mp Clth_bClth4ONStuckFlt_mp Clth_flgFailr Clth_flgFullDePsd Clth_flgFullPsd Clth_flgFullReld Clth_flgPtlPsd Clth_flgPtlReld Clth_flgPtlReldDebd Clth_stClth2ErrXPostDrv_mp Clth_stClth2ONErrEEP_mp Clth_stClth3ErrXPostDrv_mp Clth_stClth3ONErrEEP_mp Clth_stClth3ONStuckFlt_mp Clth_stClth4ErrXPostDrv_mp Clth_stClth4OFFStuckFlt_mp Clth_stClth4ONErrEEP_mp Clth_stClthOFFStuckFlt_mp Clth_stClthONStuckFlt_mp Clth_tiClth2NrmDetPostDrv_mp Clth_tiClth2NrmDet_mp Clth_tiClth3NrmDetPostDrv_mp Clth_tiClth3NrmDet_mp Clth_tiClth4NrmDetPostDrv_mp Clth_tiClth4NrmDet_mp /end LOC_MEASUREMENT
 FUNCTION_VERSION "70.3.0" /end FUNCTION
/begin FUNCTION CoCTM_Demand "17.0.0    Coordinator of the demands of the Cabin Thermal Management" /begin IN_MEASUREMENT AC_trqDes AC_trqResv /end IN_MEASUREMENT /begin OUT_MEASUREMENT CTM_nMin CTM_trqDes CTM_trqResv /end OUT_MEASUREMENT FUNCTION_VERSION "17.0.0" /end FUNCTION
/begin FUNCTION CodeGen "17.12.0   ASCET Automotive System Library Interface" FUNCTION_VERSION "17.12.0" /end FUNCTION
/begin FUNCTION CodeGen_Simulink "1.18.0    Code generator component for Simulink Coder" FUNCTION_VERSION "1.18.0" /end FUNCTION
/begin FUNCTION CoDsplCtl_OilPresLmp "1.18.0    Oil pressure warning lamp control"
 /begin DEF_CHARACTERISTIC CoDsplCtl_nEngHigh_C CoDsplCtl_nEngLow_C CoDsplCtl_nJdgMIDThd_C CoDsplCtl_nOilPres1Low_C CoDsplCtl_nOilPres2High_C CoDsplCtl_nOilPres2Low_C CoDsplCtl_stOilPSnsrActv_C CoDsplCtl_tiOilPresBrkAwayDly_C CoDsplCtl_tiOilPresDly_C CoDsplCtl_tiOilPresEngRunDly_C CoDsplCtl_tiOilPresRetDly_C CoDsplCtl_tiSuspndMid_C /end DEF_CHARACTERISTIC
 /begin IN_MEASUREMENT CoEng_st CoEng_stMai CoVOM_stRstrtNoPtd Epm_nEng Epm_nEngTooth10ms Oil_bPWarn T15_st /end IN_MEASUREMENT
 /begin OUT_MEASUREMENT CoDsplCtl_stOilLmp CoDsplCtl_stOilLmpInfo /end OUT_MEASUREMENT
 /begin LOC_MEASUREMENT CoDsplCtl_stHiOilP CoDsplCtl_stJdgMID CoDsplCtl_stMIDPrev CoDsplCtl_stOilLmpOut_mp CoDsplCtl_stOilPDlyTmr /end LOC_MEASUREMENT
 FUNCTION_VERSION "1.18.0" /end FUNCTION
/begin FUNCTION CoEng_GlbDef "1.51.0    Global definitions in CoEng" FUNCTION_VERSION "1.51.0" /end FUNCTION
/begin FUNCTION CoEng_ObdSig "1.6.0_2.1.0Calculate and Provides all OBD-Relevant signals from BC:CoEng"
 /begin DEF_CHARACTERISTIC CoEng_nEngStrtCdnMin_C CoEng_tiScneEngStrtStM.CoEng_tiScneEngStrtWait_C /end DEF_CHARACTERISTIC
 /begin IN_MEASUREMENT EngDa_tqInnrMax_f Epm_nEng SyC_stSub /end IN_MEASUREMENT
 /begin OUT_MEASUREMENT CoEng_bObdTmrInctg CoEng_flgObdPreCdn CoEng_tiScneEngStrtPrmIdH1F CoEng_tqEngRefPrmIdH63 CoEng_tqEngRefPrmIdH63_f /end OUT_MEASUREMENT
 /begin LOC_MEASUREMENT CoEng_flgEngStrtCdn CoEng_tiScneEngStrtStM.CoEng_bObdTmrInctg CoEng_tiScneEngStrtStM.CoEng_flgEngStrtCdn CoEng_tiScneEngStrtStM.CoEng_flgObdPreCdn CoEng_tiScneEngStrtStM.CoEng_stStMPrmID1F CoEng_tiScneEngStrtStM.CoEng_tiEngRunDcyc CoEng_tiScneEngStrtStM.CoEng_tiEngRunDcycLoc CoEng_tiScneEngStrtStM.CoEng_tiEngRunPreDcycLoc CoEng_tiScneEngStrtStM.CoEng_tiScneEngStrtWaitLoc CoEng_tiScneEngStrtStM.CoPOM_bHybDrvCycl CoEng_tiScneEngStrtStM.SyC_stSub CoEng_tiScneEngStrtStM.sm CoEng_tiScneEngStrtStM.CoEng_tiScneEngStrtSWT_I.tiStrd CoEng_tiScneEngStrtStM.CoEng_tiScneEngStrtWaitSWT_I.tiStrd /end LOC_MEASUREMENT
 FUNCTION_VERSION "1.6.0_2.1.0" /end FUNCTION
/begin FUNCTION CoEng_StAdpr "1.7.0     Adapter for additional informations about CoEng status" /begin DEF_CHARACTERISTIC CoEng_flgEngStrtT50Use_C /end DEF_CHARACTERISTIC
 /begin IN_MEASUREMENT CoEng_stMai CoEng_stMaiOld CoEng_tiStMaiRed_a CoEng_tiStMai_a CoVeh_stEngStrtOrd EngStrt_stRstrtRsn T50_st /end IN_MEASUREMENT
 /begin OUT_MEASUREMENT CoEng_st CoEng_stOld CoEng_stStopEng CoEng_tiAfterrun CoEng_tiAfterrunRed CoEng_tiCranking CoEng_tiCrankingRed CoEng_tiNormal CoEng_tiNormalRed CoEng_tiStandby CoEng_tiStandbyRed CoEng_tiStart CoEng_tiStartRed /end OUT_MEASUREMENT
 FUNCTION_VERSION "1.7.0" /end FUNCTION
/begin FUNCTION CoEng_StEng "10.12.0   Coordinator Engine - Engine States"
 /begin DEF_CHARACTERISTIC CoEng_bEnaStrt2AutoStop_C CoEng_stRstrtTran_C CoEng_tiPwrStgDiaRdy_C /end DEF_CHARACTERISTIC
 /begin IN_MEASUREMENT CoVeh_stEngStopOrd CoVeh_stEngStrtOrd EngStrt_bStrt EngStrt_bStrtEnd EngStrt_stRstrtRsn EngStrt_stRstrtStgy Epm_stSpd Strt_stStaActv SyC_stSub /end IN_MEASUREMENT
 /begin OUT_MEASUREMENT CoEng_bStalEng CoEng_stMai CoEng_stMaiOld CoEng_stStalEngReas CoEng_tiStMaiRed_a CoEng_tiStMai_a /end OUT_MEASUREMENT
 /begin LOC_MEASUREMENT CoEng_bXPostDrv CoEng_flgSyCDriveERNM_I.oldSignal CoEng_stEngStopOrdLoc CoEng_stEngStrtOrdExtd CoEng_stEngStrtOrdOldStEng CoEng_tiAfterrunBuf CoEng_tiNormalBuf CoEng_tiRunngSumBuf CoEng_tiStartBuf /end LOC_MEASUREMENT
 FUNCTION_VERSION "10.12.0" /end FUNCTION
/begin FUNCTION CoEng_StopEnbl "1.38.0    Enable conditions for engine stops"
 /begin DEF_CHARACTERISTIC CoEng_idxEngTSelStSpStopEna_C CoEng_numMaxStopEnblObsrv_C CoEng_numNoUrgStopPhd_C CoEng_stActvtStopEnblCdn_CA CoEng_stEngRunDmd_CUR CoEng_stNoStspStop16ExhMgT_C CoEng_stNoStspStop21FuPurgCtlDiag_C CoEng_StopEnblLstObsrv_CA CoEng_StopEnblObsrv_C CoEng_stPrioMinNoStopExhMgT_C CoEng_stStopPhdUrgThd_C CoEng_stStopPhdUrg_CUR CoEng_stTestStopEnbl_CA CoEng_tCooltUsMaxStopEnbl_C CoEng_tCooltUsMinStopEnbl_C CoEng_tEngMaxStopEnblDelta_C CoEng_tEngMaxStopEnbl_C CoEng_tEngMinStopEnblDelta_C CoEng_tEngMinStopEnbl_C CoEng_tiDiStopAftEngOff_C CoEng_tiEngOffThdOil_C CoEng_tiTTcDeltaMaxDly_CUR CoEng_tiTTcMinDly_C CoEng_tTcMaxStopEnbl_C CoEng_tTcMinStopEnbl_C /end DEF_CHARACTERISTIC
 /begin IN_MEASUREMENT B_bkvsta_msg B_khakt_msg B_khakw_msg CEngDsT_t CEngUsT_t CoEng_stMai CoEng_stMaiOld CoEng_tiStMai_a ExhMgT_flgNoStopEngCatHeatg ExhMgT_stPrioWpDmdHyb ExhMod_tExhMnfB1 FuPurg_stStopPhdUrgDiag priobbora_msg priobbteh_msg priobbtes_msg TiEngOff_stTi TiEngOff_ti /end IN_MEASUREMENT
 /begin OUT_MEASUREMENT CoEng_bStopEna CoEng_bStopEnblStSp CoEng_flgStopPhdUrg CoEng_stEngRunDmd CoEng_stInhbStopStSp_a /end OUT_MEASUREMENT
 /begin LOC_MEASUREMENT CoEngStopEnbl_TExhMax_TOFFDLY_I.time CoEngStopEnbl_TExhMin_TOFFDLY_I.time CoEng_numStopPhdUrgMax CoEng_stStopEnblActvLstObsrv CoEng_stStopEnblActvObsrv CoEng_stStopEnblLstActvObsrv_a CoEng_stStopPhdUrgMax CoEng_tEngStopEnbl CoEng_tTrbUsCompu /end LOC_MEASUREMENT
 FUNCTION_VERSION "1.38.0" /end FUNCTION
/begin FUNCTION CoEng_StrtDes "1.24.0    Desire conditions for engine starts"
 /begin DEF_CHARACTERISTIC CoEng_numMaxStrtDesObsrv_C CoEng_numNoUrgStrtDmd_C CoEng_stActvtStrtDmdCdn_CA CoEng_StrtDesLstObsrv_CA CoEng_StrtDesObsrv_C CoEng_stStrtDmdUrgThd_C CoEng_stStrtDmdUrg_CUR CoEng_stTestStrtDmd_CA /end DEF_CHARACTERISTIC
 /begin IN_MEASUREMENT B_bkvsta_msg /end IN_MEASUREMENT
 /begin OUT_MEASUREMENT CoEng_bStrtDes CoEng_flgStrtDmdUrg CoEng_stDmdStrtStSp_a /end OUT_MEASUREMENT
 /begin LOC_MEASUREMENT CoEng_numStrtDmdUrgMax CoEng_stStrtDesActvLstObsrv CoEng_stStrtDesActvObsrv CoEng_stStrtDesLstActvObsrv_a CoEng_stStrtDmdUrgMax /end LOC_MEASUREMENT
 FUNCTION_VERSION "1.24.0" /end FUNCTION
/begin FUNCTION CoEng_StrtEnbl "1.5.0     Enable conditions for engine starts" /begin DEF_CHARACTERISTIC CoEng_stTestStrtEnbl_C /end DEF_CHARACTERISTIC /begin OUT_MEASUREMENT CoEng_bStrtEnbl /end OUT_MEASUREMENT /begin LOC_MEASUREMENT CoEng_stInhbStrt_mp /end LOC_MEASUREMENT FUNCTION_VERSION "1.5.0" /end FUNCTION
/begin COMPU_METHOD B_TRUE "" TAB_VERB "%6.3" "" COMPU_TAB_REF B_TRUE /end COMPU_METHOD
/begin COMPU_VTAB B_TRUE "" TAB_VERB 2 0 "FALSE" 1 "TRUE" /end COMPU_VTAB
/begin COMPU_METHOD CoEng_EngOnDmd_VERB "" TAB_VERB "%6.3" "" COMPU_TAB_REF CoEng_EngOnDmd_VERB /end COMPU_METHOD
/begin COMPU_VTAB CoEng_EngOnDmd_VERB "" TAB_VERB 37 0 "OpMode" 1 "TcT" 2 "EngT" 3 "BrkBst" 4 "EngRunTi" 5 "SCR" 6 "EnvP" 7 "ExhT" 8 "SysErr" 9 "HFMCmp" 10 "FuT" 11 "LSU" 12 "PFlt" 13 "CustReq" 14 "AirSys" 15 "HEV" 16 "CatHeatgActv" 17 "CatHeatgDmd" 18 "TqAdpn" 19 "FuMixAdpn" 20 "FuPurgLoad" 21 "FuPurgDiag" 22 "SecAirSysDiag" 23 "FuAged" 24 "EthRatUkwn" 25 "SecFuAdpn" 26 "EvapOil" 27 "NSCDiag" 28 "OscMeas" 29 "BadStrt" 30 "HotStrt" 31 "Dummy" 32 "Camsft" 33 "HalfEngMod" 34 "NSC" 35 "AirT" 36 "NoUrgentDemand" /end COMPU_VTAB
/begin COMPU_METHOD CoEng_PID1F_States_COMPU_VERB "" TAB_VERB "%6.3" "" COMPU_TAB_REF CoEng_PID1F_States_COMPU_VERB /end COMPU_METHOD
/begin COMPU_VTAB CoEng_PID1F_States_COMPU_VERB "" TAB_VERB 5 0 "PID1F_ST_INIT" 1 "PID1F_ST_READY" 2 "PID1F_ST_WAITING" 3 "PID1F_ST_COUNTING" 4 "PID1F_ST_END" /end COMPU_VTAB
/begin COMPU_METHOD CoEng_stMai_VERB "" TAB_VERB "%6.3" "" COMPU_TAB_REF CoEng_stMai_VERB /end COMPU_METHOD
/begin COMPU_VTAB CoEng_stMai_VERB "" TAB_VERB 7 0 "COENG_ST_STANDBY" 4 "COENG_ST_READY" 16 "COENG_ST_STARTING" 64 "COENG_ST_AUTOSTOPPING" 1024 "COENG_ST_RUNNING" 4096 "COENG_ST_STOPPING" 16384 "COENG_ST_FINISH" /end COMPU_VTAB
/begin COMPU_METHOD CoEng_st_COMPU_VERB "" TAB_VERB "%6.3" "" COMPU_TAB_REF CoEng_st_COMPU_VERB /end COMPU_METHOD
/begin COMPU_VTAB CoEng_st_COMPU_VERB "" TAB_VERB 6 0 "COENG_STANDBY" 1 "COENG_READY" 2 "COENG_CRANKING" 3 "COENG_RUNNING" 4 "COENG_STOPPING" 5 "COENG_FINISH" /end COMPU_VTAB
/begin COMPU_METHOD CoEng_tiScneEngStrtStM_sm_VERB "" TAB_VERB "%6.3" "" COMPU_TAB_REF CoEng_tiScneEngStrtStM_sm_VERB /end COMPU_METHOD
/begin COMPU_VTAB CoEng_tiScneEngStrtStM_sm_VERB "" TAB_VERB 5 0 "PID1F_INIT" 1 "PID1F_COUNTING" 2 "PID1F_END" 3 "PID1F_READY" 4 "PID1F_WAITING" /end COMPU_VTAB
/begin COMPU_METHOD DECOMP_SY_Compu "" TAB_VERB "%6.3" "" COMPU_TAB_REF DECOMP_SY_Compu /end COMPU_METHOD
/begin COMPU_VTAB DECOMP_SY_Compu "" TAB_VERB 2 0 "no availibility of drag error compensation in ASDr" 1 "activiation of drag error compensation possible in" /end COMPU_VTAB
/begin COMPU_METHOD DEDIA_DBG_SC_Compu "" TAB_VERB "%6.3" "" COMPU_TAB_REF DEDIA_DBG_SC_Compu /end COMPU_METHOD
/begin COMPU_VTAB DEDIA_DBG_SC_Compu "" TAB_VERB 2 0 "0" 1 "1" /end COMPU_VTAB
/begin COMPU_METHOD DEDIA_VRNTCONF_SY_Compu "" TAB_VERB "%6.3" "" COMPU_TAB_REF DEDIA_VRNTCONF_SY_Compu /end COMPU_METHOD
/begin COMPU_VTAB DEDIA_VRNTCONF_SY_Compu "" TAB_VERB 3 0 "DEDIA_VRNTCONF_ALL" 1 "DEDIA_VRNTCONF_DS" 2 "DEDIA_VRNTCONF_GS" /end COMPU_VTAB
/begin COMPU_METHOD DELIB_ADPVGOVR_SC_Compu "" TAB_VERB "%6.3" "" COMPU_TAB_REF DELIB_ADPVGOVR_SC_Compu /end COMPU_METHOD
/begin COMPU_VTAB DELIB_ADPVGOVR_SC_Compu "" TAB_VERB 2 0 "False" 1 "True" /end COMPU_VTAB
/begin COMPU_METHOD DELIB_DBG_SC_Compu "" RAT_FUNC "%6.2" "" COEFFS 0 1 0 0 0 1 /end COMPU_METHOD
/begin COMPU_METHOD DELIB_DSQACTVT_SC_Compu "" TAB_VERB "%6.3" "" COMPU_TAB_REF DELIB_DSQACTVT_SC_Compu /end COMPU_METHOD
/begin COMPU_VTAB DELIB_DSQACTVT_SC_Compu "" TAB_VERB 2 0 "Inactive" 1 "Active" /end COMPU_VTAB
/begin COMPU_METHOD DELIB_DYNSDLDEACTV_SC_Compu "" TAB_VERB "%6.3" "" COMPU_TAB_REF DELIB_DYNSDLDEACTV_SC_Compu /end COMPU_METHOD
/begin COMPU_VTAB DELIB_DYNSDLDEACTV_SC_Compu "" TAB_VERB 2 0 "False" 1 "True" /end COMPU_VTAB
/begin COMPU_METHOD DELIB_ELECACTRTYPAVL_SC_Compu "" TAB_VERB "%6.3" "" COMPU_TAB_REF DELIB_ELECACTRTYPAVL_SC_Compu /end COMPU_METHOD
/begin COMPU_VTAB DELIB_ELECACTRTYPAVL_SC_Compu "" TAB_VERB 2 0 "False" 1 "True" /end COMPU_VTAB
/begin COMPU_METHOD DELIB_ENGDATENG_TYPAVL_SC_Compu "" TAB_VERB "%6.3" "" COMPU_TAB_REF DELIB_ENGDATENG_TYPAVL_SC_Compu /end COMPU_METHOD
/begin COMPU_VTAB DELIB_ENGDATENG_TYPAVL_SC_Compu "" TAB_VERB 2 0 "False" 1 "True" /end COMPU_VTAB
/begin COMPU_METHOD DELIB_FACPRECTLDWNTEMPCORRSIZECUR_SC_Compu "" RAT_FUNC "%6.2" "" COEFFS 0 1 0 0 0 1 /end COMPU_METHOD
/begin COMPU_METHOD DELIB_FACPRECTLUPTEMPCORRSIZECUR_SC_Compu "" RAT_FUNC "%6.2" "" COEFFS 0 1 0 0 0 1 /end COMPU_METHOD
/begin COMPU_METHOD DELIB_FACTQLOSSCMPSIZECUR_SC_Compu "" RAT_FUNC "%6.2" "" COEFFS 0 1 0 0 0 1 /end COMPU_METHOD
/begin COMPU_METHOD DELIB_HVDDC_TYPAVL_SC_Compu "" TAB_VERB "%6.3" "" COMPU_TAB_REF DELIB_HVDDC_TYPAVL_SC_Compu /end COMPU_METHOD
/begin COMPU_VTAB DELIB_HVDDC_TYPAVL_SC_Compu "" TAB_VERB 2 0 "False" 1 "True" /end COMPU_VTAB
/begin COMPU_METHOD DELIB_MDLEXHSNSRAVL_SC_Compu "" TAB_VERB "%6.3" "" COMPU_TAB_REF DELIB_MDLEXHSNSRAVL_SC_Compu /end COMPU_METHOD
/begin COMPU_VTAB DELIB_MDLEXHSNSRAVL_SC_Compu "" TAB_VERB 2 0 "False" 1 "True" /end COMPU_VTAB
/begin COMPU_METHOD DELIB_PMINLRNSIZECUR_SC_Compu "" RAT_FUNC "%6.2" "" COEFFS 0 1 0 0 0 1 /end COMPU_METHOD
/begin COMPU_METHOD DELIB_RACTRLIM2SIZECUR_SC_Compu "" RAT_FUNC "%6.2" "" COEFFS 0 1 0 0 0 1 /end COMPU_METHOD
/begin COMPU_METHOD DELIB_RPRECTLDWNMAINMAPSIZEX_SC_Compu "" RAT_FUNC "%6.2" "" COEFFS 0 1 0 0 0 1 /end COMPU_METHOD
/begin COMPU_METHOD DELIB_RPRECTLDWNMAINMAPSIZEY_SC_Compu "" RAT_FUNC "%6.2" "" COEFFS 0 1 0 0 0 1 /end COMPU_METHOD
/begin COMPU_METHOD DELIB_RPRECTLDWNMAPSIZEX_SC_Compu "" RAT_FUNC "%6.2" "" COEFFS 0 1 0 0 0 1 /end COMPU_METHOD
/begin COMPU_METHOD DELIB_RPRECTLDWNMAPSIZEY_SC_Compu "" RAT_FUNC "%6.2" "" COEFFS 0 1 0 0 0 1 /end COMPU_METHOD
/begin COMPU_METHOD DELIB_RPRECTLUPMAINMAPSIZEX_SC_Compu "" RAT_FUNC "%6.2" "" COEFFS 0 1 0 0 0 1 /end COMPU_METHOD
/begin COMPU_METHOD DELIB_RPRECTLUPMAINMAPSIZEY_SC_Compu "" RAT_FUNC "%6.2" "" COEFFS 0 1 0 0 0 1 /end COMPU_METHOD
/begin COMPU_METHOD DELIB_RPRECTLUPMAPSIZEX_SC_Compu "" RAT_FUNC "%6.2" "" COEFFS 0 1 0 0 0 1 /end COMPU_METHOD
/begin COMPU_METHOD DELIB_RPRECTLUPMAPSIZEY_SC_Compu "" RAT_FUNC "%6.2" "" COEFFS 0 1 0 0 0 1 /end COMPU_METHOD
/begin COMPU_METHOD DELIB_RPSMAXMAPSIZEX_SC_Compu "" RAT_FUNC "%6.2" "" COEFFS 0 1 0 0 0 1 /end COMPU_METHOD
/begin COMPU_METHOD DELIB_RPSMAXMAPSIZEY_SC_Compu "" RAT_FUNC "%6.2" "" COEFFS 0 1 0 0 0 1 /end COMPU_METHOD
/begin COMPU_METHOD DELIB_SENTCALULINSIZECUR_SC_Compu "" RAT_FUNC "%6.2" "" COEFFS 0 1 0 0 0 1 /end COMPU_METHOD
/begin COMPU_METHOD DELIB_SIMPLEACTRTYPAVL_SC_Compu "" TAB_VERB "%6.3" "" COMPU_TAB_REF DELIB_SIMPLEACTRTYPAVL_SC_Compu /end COMPU_METHOD
/begin COMPU_VTAB DELIB_SIMPLEACTRTYPAVL_SC_Compu "" TAB_VERB 2 0 "False" 1 "True" /end COMPU_VTAB
/begin COMPU_METHOD DELIB_SIMPLESWTAVL_SC_Compu "" TAB_VERB "%6.3" "" COMPU_TAB_REF DELIB_SIMPLESWTAVL_SC_Compu /end COMPU_METHOD
/begin COMPU_VTAB DELIB_SIMPLESWTAVL_SC_Compu "" TAB_VERB 2 0 "deactivated" 1 "activated" /end COMPU_VTAB
/begin COMPU_METHOD DELIB_STDACTRTYPAVL_SC_Compu "" TAB_VERB "%6.3" "" COMPU_TAB_REF DELIB_STDACTRTYPAVL_SC_Compu /end COMPU_METHOD
/begin COMPU_VTAB DELIB_STDACTRTYPAVL_SC_Compu "" TAB_VERB 2 0 "False" 1 "True" /end COMPU_VTAB
/begin COMPU_METHOD DELIB_STDSENSTYPAVL_SC_Compu "" TAB_VERB "%6.3" "" COMPU_TAB_REF DELIB_STDSENSTYPAVL_SC_Compu /end COMPU_METHOD
/begin COMPU_VTAB DELIB_STDSENSTYPAVL_SC_Compu "" TAB_VERB 2 0 "False" 1 "True" /end COMPU_VTAB
/begin COMPU_METHOD DELIB_UTOFFSADJCLSDSIZECRV_SC_Compu "" RAT_FUNC "%6.2" "" COEFFS 0 1 0 0 0 1 /end COMPU_METHOD
/begin COMPU_METHOD DELIB_UTOFFSADJOPENDSIZECRV_SC_Compu "" RAT_FUNC "%6.2" "" COEFFS 0 1 0 0 0 1 /end COMPU_METHOD
/begin COMPU_METHOD Dens "" RAT_FUNC "%6.3" "Kg/m^3" COEFFS 0 10 0 0 0 1 /end COMPU_METHOD
/begin COMPU_METHOD DensFine "" RAT_FUNC "%6.4" "Kg/m^3" COEFFS 0 500 0 0 0 1 /end COMPU_METHOD
/begin COMPU_METHOD DerPresRl_COMPU "" RAT_FUNC "%6.0" "hPa/s" COEFFS 0 0.01 0 0 0 1 /end COMPU_METHOD
/begin COMPU_METHOD DEVLIB_4WINDIACMPNENA_SY_Compu "" TAB_VERB "%6.3" "" COMPU_TAB_REF DEVLIB_4WINDIACMPNENA_SY_Compu /end COMPU_METHOD
/begin COMPU_VTAB DEVLIB_4WINDIACMPNENA_SY_Compu "" TAB_VERB 2 0 "False" 1 "True" /end COMPU_VTAB
/begin COMPU_METHOD DEVLIB_ACTRPRTCMPNENA_SY_Compu "" TAB_VERB "%6.3" "" COMPU_TAB_REF DEVLIB_ACTRPRTCMPNENA_SY_Compu /end COMPU_METHOD
/begin COMPU_VTAB DEVLIB_ACTRPRTCMPNENA_SY_Compu "" TAB_VERB 2 0 "False" 1 "True" /end COMPU_VTAB
/begin COMPU_METHOD DEVLIB_DBG_SY_Compu "" TAB_VERB "%6.3" "" COMPU_TAB_REF DEVLIB_DBG_SY_Compu /end COMPU_METHOD
/begin COMPU_VTAB DEVLIB_DBG_SY_Compu "" TAB_VERB 2 0 "False" 1 "True" /end COMPU_VTAB
/begin COMPU_METHOD DEVLIB_DIACTLLINECMPNENA_SY_Compu "" TAB_VERB "%6.3" "" COMPU_TAB_REF DEVLIB_DIACTLLINECMPNENA_SY_Compu /end COMPU_METHOD
/begin COMPU_VTAB DEVLIB_DIACTLLINECMPNENA_SY_Compu "" TAB_VERB 2 0 "False" 1 "True" /end COMPU_VTAB
/begin COMPU_METHOD DEVLIB_HBRGENA_SY_Compu "" TAB_VERB "%6.3" "" COMPU_TAB_REF DEVLIB_HBRGENA_SY_Compu /end COMPU_METHOD
/begin COMPU_VTAB DEVLIB_HBRGENA_SY_Compu "" TAB_VERB 2 0 "0" 1 "1" /end COMPU_VTAB
/begin COMPU_METHOD DEVLIB_PHYSRNGCHK_SY_Compu "" TAB_VERB "%6.3" "" COMPU_TAB_REF DEVLIB_PHYSRNGCHK_SY_Compu /end COMPU_METHOD
/begin COMPU_VTAB DEVLIB_PHYSRNGCHK_SY_Compu "" TAB_VERB 2 0 "FALSE" 1 "TRUE" /end COMPU_VTAB
/begin COMPU_METHOD DEVLIB_PSOFFOPNLD_SY_Compu "" TAB_VERB "%6.3" "" COMPU_TAB_REF DEVLIB_PSOFFOPNLD_SY_Compu /end COMPU_METHOD
/begin COMPU_VTAB DEVLIB_PSOFFOPNLD_SY_Compu "" TAB_VERB 2 0 "FALSE" 1 "TRUE" /end COMPU_VTAB
/begin COMPU_METHOD DEVLIB_PSSTATEMOCSOPINI_SY_Compu "" TAB_VERB "%6.3" "" COMPU_TAB_REF DEVLIB_PSSTATEMOCSOPINI_SY_Compu /end COMPU_METHOD
/begin COMPU_VTAB DEVLIB_PSSTATEMOCSOPINI_SY_Compu "" TAB_VERB 2 0 "False" 1 "True" /end COMPU_VTAB
/begin COMPU_METHOD DEVLIB_PWRSTGSTATEMOCSOPCHK_SY_Compu "" TAB_VERB "%6.3" "" COMPU_TAB_REF DEVLIB_PWRSTGSTATEMOCSOPCHK_SY_Compu /end COMPU_METHOD
/begin COMPU_VTAB DEVLIB_PWRSTGSTATEMOCSOPCHK_SY_Compu "" TAB_VERB 2 0 "False" 1 "True" /end COMPU_VTAB
/begin COMPU_METHOD dez "" RAT_FUNC "%6.2" "" COEFFS 0 1 0 0 0 1 /end COMPU_METHOD
/begin COMPU_METHOD DFC_CALPRMSTATDISBLMSK_SC_Compu "" TAB_VERB "%6.3" "" COMPU_TAB_REF DFC_CALPRMSTATDISBLMSK_SC_Compu /end COMPU_METHOD
/begin COMPU_VTAB DFC_CALPRMSTATDISBLMSK_SC_Compu "" TAB_VERB 2 0 "Disabled" 1 "Enabled" /end COMPU_VTAB
/begin COMPU_METHOD DFC_CTLDISBLLAYOUT_SY_Compu "" RAT_FUNC "%6.2" "" COEFFS 0 1 0 0 0 1 /end COMPU_METHOD
/begin COMPU_METHOD DFC_CTLMSKBYTES_SY_Compu "" TAB_VERB "%6.3" "" COMPU_TAB_REF DFC_CTLMSKBYTES_SY_Compu /end COMPU_METHOD
/begin COMPU_VTAB DFC_CTLMSKBYTES_SY_Compu "" TAB_VERB 2 1 "SIZE_1_BYTE" 2 "SIZE_2_BYTES" /end COMPU_VTAB
/begin COMPU_METHOD DFC_DISBLMSKBYTES_SY_Compu "" TAB_VERB "%6.3" "" COMPU_TAB_REF DFC_DISBLMSKBYTES_SY_Compu /end COMPU_METHOD
/begin COMPU_VTAB DFC_DISBLMSKBYTES_SY_Compu "" TAB_VERB 3 1 "SIZE_1_BYTE" 2 "SIZE_2_BYTES" 4 "SIZE_4_BYTES" /end COMPU_VTAB
/begin COMPU_METHOD DFC_SETSTATDITHOAPI_SC_Compu "" TAB_VERB "%6.3" "" COMPU_TAB_REF DFC_SETSTATDITHOAPI_SC_Compu /end COMPU_METHOD
/begin COMPU_VTAB DFC_SETSTATDITHOAPI_SC_Compu "" TAB_VERB 2 0 "False" 1 "True" /end COMPU_VTAB
/begin COMPU_METHOD DFES_ACTVENHMTSIMCONDPID9F_SC_Compu "" TAB_VERB "%6.3" "" COMPU_TAB_REF DFES_ACTVENHMTSIMCONDPID9F_SC_Compu /end COMPU_METHOD
/begin COMPU_VTAB DFES_ACTVENHMTSIMCONDPID9F_SC_Compu "" TAB_VERB 2 0 "False" 1 "True" /end COMPU_VTAB
/begin COMPU_METHOD DFES_ACTVSIMRCDNPID03_SC_Compu "" TAB_VERB "%6.3" "" COMPU_TAB_REF DFES_ACTVSIMRCDNPID03_SC_Compu /end COMPU_METHOD
/begin COMPU_VTAB DFES_ACTVSIMRCDNPID03_SC_Compu "" TAB_VERB 2 0 "False" 1 "True" /end COMPU_VTAB
/begin COMPU_METHOD DFES_ADDLMILMOD_SC_Compu "" TAB_VERB "%6.3" "" COMPU_TAB_REF DFES_ADDLMILMOD_SC_Compu /end COMPU_METHOD
/begin COMPU_VTAB DFES_ADDLMILMOD_SC_Compu "" TAB_VERB 2 0 "NO_ADDLMILMOD" 1 "ADDLMILMOD_SET1" /end COMPU_VTAB
/begin COMPU_METHOD DFES_BLKENTRY_SY_Compu "" TAB_VERB "%6.3" "" COMPU_TAB_REF DFES_BLKENTRY_SY_Compu /end COMPU_METHOD
/begin COMPU_VTAB DFES_BLKENTRY_SY_Compu "" TAB_VERB 2 0 "False" 1 "True" /end COMPU_VTAB
/begin COMPU_METHOD DFES_COMMILDEB_SY_Compu "" TAB_VERB "%6.3" "" COMPU_TAB_REF DFES_COMMILDEB_SY_Compu /end COMPU_METHOD
/begin COMPU_VTAB DFES_COMMILDEB_SY_Compu "" TAB_VERB 2 0 "DISABLED" 1 "ENABLED" /end COMPU_VTAB
/begin COMPU_METHOD DFES_DTC_TSTFAIL_SY_Compu "" TAB_VERB "%6.3" "" COMPU_TAB_REF DFES_DTC_TSTFAIL_SY_Compu /end COMPU_METHOD
/begin COMPU_VTAB DFES_DTC_TSTFAIL_SY_Compu "" TAB_VERB 2 0 "0" 1 "1" /end COMPU_VTAB
/begin COMPU_METHOD DFES_EOBDCV_SY_Compu "" TAB_VERB "%6.3" "" COMPU_TAB_REF DFES_EOBDCV_SY_Compu /end COMPU_METHOD
/begin COMPU_VTAB DFES_EOBDCV_SY_Compu "" TAB_VERB 2 0 "FALSE" 1 "TRUE" /end COMPU_VTAB
/begin COMPU_METHOD DFES_EOLCLR_SY_Compu "" TAB_VERB "%6.3" "" COMPU_TAB_REF DFES_EOLCLR_SY_Compu /end COMPU_METHOD
/begin COMPU_VTAB DFES_EOLCLR_SY_Compu "" TAB_VERB 2 0 "False" 1 "True" /end COMPU_VTAB
/begin COMPU_METHOD EngN "" RAT_FUNC "%6.3" "rpm" COEFFS 0 2 0 0 0 1 /end COMPU_METHOD
/begin COMPU_METHOD fak_q1p526Em5 "" RAT_FUNC "%7.6" "-" COEFFS 0 65536 0 0 0 1 /end COMPU_METHOD
/begin COMPU_METHOD fak_ub_b1 "" RAT_FUNC "%6.4" "-" COEFFS 0 256 0 0 0 1 /end COMPU_METHOD
/begin COMPU_METHOD fak_ub_b2 "" RAT_FUNC "%8.5" "-" COEFFS 0 256 0 0 0 2 /end COMPU_METHOD
/begin COMPU_METHOD fak_ub_b5 "" RAT_FUNC "%6.4" "-" COEFFS 0 256 0 0 0 5 /end COMPU_METHOD
/begin COMPU_METHOD m_ub_b1020 "" RAT_FUNC "%6.2" "kg/h" COEFFS 0 1 0 0 0 4 /end COMPU_METHOD
/begin COMPU_METHOD m_ub_b23p3 "" RAT_FUNC "%6.3" "kg" COEFFS 0 2812.5 0 0 0 256 /end COMPU_METHOD
/begin COMPU_METHOD OneToOne "" RAT_FUNC "%6.2" "-" COEFFS 0 1 0 0 0 1 /end COMPU_METHOD
/begin COMPU_METHOD Prc_EGR "" RAT_FUNC "%6.3" "%" COEFFS 0 2.55 0 0 0 1 /end COMPU_METHOD
/begin COMPU_METHOD Prc_Fact256 "" RAT_FUNC "%6.4" "%" COEFFS 0 256 0 0 0 1 /end COMPU_METHOD
/begin COMPU_METHOD RBPtCel_tq_1p0_1 "" RAT_FUNC "%6.2" "Nm" COEFFS 0 1 0 0 0 1 /end COMPU_METHOD
/begin COMPU_METHOD SigQly_COMPU_VERB "" TAB_VERB "%6.3" "" COMPU_TAB_REF SigQly_COMPU_VERB /end COMPU_METHOD
/begin COMPU_VTAB SigQly_COMPU_VERB "" TAB_VERB 16 0 "SIGQLY_NOTCALC" 1 "SIGQLY_INIT" 2 "SIGQLY_OK" 3 "SIGQLY_MODEL" 4 "SIGQLY_REPLACEMENT" 5 "SIGQLY_FROZEN" 6 "SIGQLY_INVALID" 7 "SIGQLY_RESERVED_7" 8 "SIGQLY_RESERVED_8" 9 "SIGQLY_RESERVED_9" 10 "SIGQLY_RESERVED_10" 11 "SIGQLY_RESERVED_11" 12 "SIGQLY_RESERVED_12" 13 "SIGQLY_RESERVED_13" 14 "SIGQLY_RESERVED_14" 15 "SIGQLY_RESERVED_15" /end COMPU_VTAB
/begin COMPU_METHOD TempDiff_Kelv "" RAT_FUNC "%6.3" "K" COEFFS 0 10 0 0 0 1 /end COMPU_METHOD
/begin COMPU_METHOD Temp_Cels "" RAT_FUNC "%6.1" "deg C" COEFFS 0 10 2731.4 0 0 1 /end COMPU_METHOD
/begin COMPU_METHOD Temp_Cels_Diff "" RAT_FUNC "%6.3" "deg C" COEFFS 0 10 0 0 0 1 /end COMPU_METHOD
/begin COMPU_METHOD temp_q0p01172 "" RAT_FUNC "%6.4" "K" COEFFS 0 65536 0 0 0 768 /end COMPU_METHOD
/begin COMPU_METHOD temp_ub_q0p75_o48 "" RAT_FUNC "%6.2" "Grad C" COEFFS 0 1 48 0 0 0.75 /end COMPU_METHOD
/begin COMPU_METHOD temp_ub_q1_o40 "" RAT_FUNC "%6.2" "Grad C" COEFFS 0 1 40 0 0 1 /end COMPU_METHOD
/begin COMPU_METHOD temp_uw_q0p0029_o48 "" RAT_FUNC "%6.2" "Grad C" COEFFS 0 256 12288 0 0 0.75 /end COMPU_METHOD
/begin COMPU_METHOD TimeDeb "" RAT_FUNC "%6.1" "ms" COEFFS 0 0.1 0 0 0 1 /end COMPU_METHOD
/begin COMPU_METHOD TimeDelay_s "" RAT_FUNC "%6.1" "s" COEFFS 0 0 1 0 0.00023283064365387 0 /end COMPU_METHOD
/begin COMPU_METHOD TimeDT "" RAT_FUNC "%6.2" "us" COEFFS 0 1 0 0 0 1 /end COMPU_METHOD
/begin COMPU_METHOD TimeRed "" RAT_FUNC "%6.3" "s" COEFFS 0 6.25 0 0 0 1 /end COMPU_METHOD
/begin COMPU_METHOD Time_Dt "" RAT_FUNC "%9.8" "s" COEFFS 0 1000000 0 0 0 1 /end COMPU_METHOD
/begin COMPU_METHOD Time_ms "" RAT_FUNC "%6.1" "ms" COEFFS 0 0.1 0 0 0 1 /end COMPU_METHOD
/begin COMPU_METHOD Time_s "" RAT_FUNC "%6.4" "s" COEFFS 0 100 0 0 0 1 /end COMPU_METHOD
/begin COMPU_METHOD Time_sec_q1_COMPU "" RAT_FUNC "%6.2" "s" COEFFS 0 1 0 0 0 1 /end COMPU_METHOD
/begin COMPU_METHOD Trq "" RAT_FUNC "%6.3" "Nm" COEFFS 0 10 0 0 0 1 /end COMPU_METHOD
/begin COMPU_METHOD T_degC_q0p1_COMPU "" RAT_FUNC "%6.3" "deg C" COEFFS 0 10 0 0 0 1 /end COMPU_METHOD
/begin COMPU_METHOD t_q0p01 "" RAT_FUNC "%6.4" "s" COEFFS 0 100 0 0 0 1 /end COMPU_METHOD
/begin COMPU_METHOD t_q0p1 "" RAT_FUNC "%6.3" "s" COEFFS 0 10 0 0 0 1 /end COMPU_METHOD
/begin COMPU_METHOD t_q1 "" RAT_FUNC "%6.2" "s" COEFFS 0 1 0 0 0 1 /end COMPU_METHOD
/begin COMPU_METHOD Vel "" RAT_FUNC "%6.4" "km/h" COEFFS 0 100 0 0 0 1 /end COMPU_METHOD
/begin COMPU_METHOD Volt "" RAT_FUNC "%6.3" "mV" COEFFS 0 5 0 0 0 1 /end COMPU_METHOD
/begin RECORD_LAYOUT Kw_Ws16 FNC_VALUES 1 SWORD COLUMN_DIR DIRECT /end RECORD_LAYOUT
/begin RECORD_LAYOUT RB_Curve_S16_S16 NO_AXIS_PTS_X 1 SWORD AXIS_PTS_X 2 SWORD INDEX_INCR DIRECT FNC_VALUES 3 SWORD COLUMN_DIR DIRECT /end RECORD_LAYOUT
/begin RECORD_LAYOUT RB_Curve_S16_U16_Static NO_AXIS_PTS_X 1 SWORD AXIS_PTS_X 2 SWORD INDEX_INCR DIRECT FNC_VALUES 3 UWORD COLUMN_DIR DIRECT STATIC_RECORD_LAYOUT /end RECORD_LAYOUT
/begin RECORD_LAYOUT RB_Curve_S16_U8_Static NO_AXIS_PTS_X 1 SWORD AXIS_PTS_X 2 SWORD INDEX_INCR DIRECT FNC_VALUES 3 UBYTE COLUMN_DIR DIRECT STATIC_RECORD_LAYOUT /end RECORD_LAYOUT
/begin RECORD_LAYOUT RB_Curve_S8_S8 NO_AXIS_PTS_X 1 SBYTE AXIS_PTS_X 2 SBYTE INDEX_INCR DIRECT FNC_VALUES 3 SBYTE COLUMN_DIR DIRECT /end RECORD_LAYOUT
/begin RECORD_LAYOUT RB_Curve_U16_S16_Static NO_AXIS_PTS_X 1 UWORD AXIS_PTS_X 2 UWORD INDEX_INCR DIRECT FNC_VALUES 3 SWORD COLUMN_DIR DIRECT STATIC_RECORD_LAYOUT /end RECORD_LAYOUT
/begin RECORD_LAYOUT RB_Curve_U16_U8_Static NO_AXIS_PTS_X 1 UWORD AXIS_PTS_X 2 UWORD INDEX_INCR DIRECT FNC_VALUES 3 UBYTE COLUMN_DIR DIRECT STATIC_RECORD_LAYOUT /end RECORD_LAYOUT
/begin RECORD_LAYOUT RB_Curve_U8_U8 NO_AXIS_PTS_X 1 UBYTE AXIS_PTS_X 2 UBYTE INDEX_INCR DIRECT FNC_VALUES 3 UBYTE COLUMN_DIR DIRECT /end RECORD_LAYOUT
/begin RECORD_LAYOUT RB_Map_S16S16_S16 NO_AXIS_PTS_X 1 SWORD NO_AXIS_PTS_Y 2 SWORD AXIS_PTS_X 3 SWORD INDEX_INCR DIRECT AXIS_PTS_Y 4 SWORD INDEX_INCR DIRECT FNC_VALUES 5 SWORD COLUMN_DIR DIRECT /end RECORD_LAYOUT
/begin RECORD_LAYOUT RB_Map_S16S16_U16 NO_AXIS_PTS_X 1 SWORD NO_AXIS_PTS_Y 2 SWORD AXIS_PTS_X 3 SWORD INDEX_INCR DIRECT AXIS_PTS_Y 4 SWORD INDEX_INCR DIRECT FNC_VALUES 5 UWORD COLUMN_DIR DIRECT /end RECORD_LAYOUT
/begin RECORD_LAYOUT RB_Map_S16S16_U8 NO_AXIS_PTS_X 1 SWORD NO_AXIS_PTS_Y 2 SWORD AXIS_PTS_X 3 SWORD INDEX_INCR DIRECT AXIS_PTS_Y 4 SWORD INDEX_INCR DIRECT FNC_VALUES 5 UBYTE COLUMN_DIR DIRECT /end RECORD_LAYOUT
/begin RECORD_LAYOUT RB_Map_S16U16_U16 NO_AXIS_PTS_X 1 SWORD NO_AXIS_PTS_Y 2 SWORD AXIS_PTS_X 3 SWORD INDEX_INCR DIRECT AXIS_PTS_Y 4 UWORD INDEX_INCR DIRECT FNC_VALUES 5 UWORD ROW_DIR DIRECT /end RECORD_LAYOUT
/begin RECORD_LAYOUT RB_Map_U8S16_S8 NO_AXIS_PTS_X 1 UBYTE NO_AXIS_PTS_Y 2 UBYTE AXIS_PTS_X 3 UBYTE INDEX_INCR DIRECT AXIS_PTS_Y 4 SWORD INDEX_INCR DIRECT FNC_VALUES 5 SBYTE ROW_DIR DIRECT /end RECORD_LAYOUT
/begin RECORD_LAYOUT RB_Map_U8S16_U16 NO_AXIS_PTS_X 1 UBYTE NO_AXIS_PTS_Y 2 UBYTE AXIS_PTS_X 3 UBYTE INDEX_INCR DIRECT AXIS_PTS_Y 4 SWORD INDEX_INCR DIRECT FNC_VALUES 5 UWORD ROW_DIR DIRECT /end RECORD_LAYOUT
/begin RECORD_LAYOUT RB_ValA_Wu16 FNC_VALUES 1 UWORD COLUMN_DIR DIRECT /end RECORD_LAYOUT
/begin RECORD_LAYOUT RB_ValA_Wu8 FNC_VALUES 1 UBYTE COLUMN_DIR DIRECT /end RECORD_LAYOUT
/begin RECORD_LAYOUT RB_Val_Ws16 FNC_VALUES 1 SWORD COLUMN_DIR DIRECT /end RECORD_LAYOUT
/begin RECORD_LAYOUT RB_Val_Ws32 FNC_VALUES 1 SLONG COLUMN_DIR DIRECT /end RECORD_LAYOUT
/begin RECORD_LAYOUT RB_Val_Wu16 FNC_VALUES 1 UWORD COLUMN_DIR DIRECT /end RECORD_LAYOUT
/begin RECORD_LAYOUT RB_Val_Wu8 FNC_VALUES 1 UBYTE COLUMN_DIR DIRECT /end RECORD_LAYOUT
/begin RECORD_LAYOUT Val_Ws16 FNC_VALUES 1 SWORD COLUMN_DIR DIRECT /end RECORD_LAYOUT
/begin RECORD_LAYOUT Val_Wu16 FNC_VALUES 1 UWORD COLUMN_DIR DIRECT /end RECORD_LAYOUT
/begin RECORD_LAYOUT Val_Wu8 FNC_VALUES 1 UBYTE COLUMN_DIR DIRECT /end RECORD_LAYOUT
/end MODULE
/end PROJECT
