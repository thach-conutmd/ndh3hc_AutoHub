ASAP2_VERSION 1 60
/begin PROJECT MG1CS022 "MG1CS022"
/begin HEADER "" VERSION "MG1CS022_62XSC_V036_TPROT" PROJECT_NO MG1CS022 /end HEADER
/begin MODULE DIM ""
/begin MOD_COMMON "" BYTE_ORDER MSB_LAST ALIGNMENT_BYTE 1 ALIGNMENT_WORD 2 ALIGNMENT_LONG 4 ALIGNMENT_INT64 4 ALIGNMENT_FLOAT32_IEEE 4 ALIGNMENT_FLOAT64_IEEE 4 DATA_SIZE 32 /end MOD_COMMON
/begin MEASUREMENT DINH_stFId.FID_KRREGloc "Inhibit Status of FIds / Status of function identifier FID_KRREGloc" UWORD DFC_OneToOne 1 100 0.00 65535.00 FORMAT "%8.2" ECU_ADDRESS 0x60013644 /end MEASUREMENT
/begin MEASUREMENT DINH_stFId.FID_LRADLSU "Inhibit Status of FIds / Status of function identifier FID_LRADLSU" UWORD DFC_OneToOne 1 100 0.00 65535.00 FORMAT "%8.2" ECU_ADDRESS 0x60013646 /end MEASUREMENT
/begin MEASUREMENT DINH_stFId.FID_LRALSVErr "Inhibit Status of FIds / Status of function identifier FID_LRALSVErr" UWORD DFC_OneToOne 1 100 0.00 65535.00 FORMAT "%8.2" ECU_ADDRESS 0x60013648 /end MEASUREMENT
/begin MEASUREMENT DINH_stFId.FID_LRAPLLSU "Inhibit Status of FIds / Status of function identifier FID_LRAPLLSU" UWORD DFC_OneToOne 1 100 0.00 65535.00 FORMAT "%8.2" ECU_ADDRESS 0x6001364A /end MEASUREMENT
/begin MEASUREMENT DINH_stFId.FID_LUSTP "Inhibit Status of FIds / Status of function identifier FID_LUSTP" UWORD DFC_OneToOne 1 100 0.00 65535.00 FORMAT "%8.2" ECU_ADDRESS 0x6001364C /end MEASUREMENT
/begin MEASUREMENT DINH_stFId.FID_LnKS1 "Inhibit Status of FIds / Status of function identifier FID_LnKS1" UWORD DFC_OneToOne 1 100 0.00 65535.00 FORMAT "%8.2" ECU_ADDRESS 0x6001364E /end MEASUREMENT
/begin MEASUREMENT DINH_stFId.FID_PLSUV "Inhibit Status of FIds / Status of function identifier FID_PLSUV" UWORD DFC_OneToOne 1 100 0.00 65535.00 FORMAT "%8.2" ECU_ADDRESS 0x60013650 /end MEASUREMENT
/begin MEASUREMENT DINH_stFId.FID_PSRMOZDG "Inhibit Status of FIds / Status of function identifier FID_PSRMOZDG" UWORD DFC_OneToOne 1 100 0.00 65535.00 FORMAT "%8.2" ECU_ADDRESS 0x60013652 /end MEASUREMENT
/begin MEASUREMENT DINH_stFId.FID_PSRMOZG "Inhibit Status of FIds / Status of function identifier FID_PSRMOZG" UWORD DFC_OneToOne 1 100 0.00 65535.00 FORMAT "%8.2" ECU_ADDRESS 0x60013654 /end MEASUREMENT
/begin MEASUREMENT DINH_stFId.FID_STRTDIA "Inhibit Status of FIds / Status of function identifier FID_STRTDIA" UWORD DFC_OneToOne 1 100 0.00 65535.00 FORMAT "%8.2" ECU_ADDRESS 0x60013656 /end MEASUREMENT
/begin MEASUREMENT DINH_stFId.FID_STRTSTM "Inhibit Status of FIds / Status of function identifier FID_STRTSTM" UWORD DFC_OneToOne 1 100 0.00 65535.00 FORMAT "%8.2" ECU_ADDRESS 0x60013658 /end MEASUREMENT
/begin MEASUREMENT DINH_stFId.FID_TFA1CSMW "Inhibit Status of FIds / Status of function identifier FID_TFA1CSMW" UWORD DFC_OneToOne 1 100 0.00 65535.00 FORMAT "%8.2" ECU_ADDRESS 0x6001365A /end MEASUREMENT
/begin MEASUREMENT DINH_stFId.FID_TFA2CSMW "Inhibit Status of FIds / Status of function identifier FID_TFA2CSMW" UWORD DFC_OneToOne 1 100 0.00 65535.00 FORMAT "%8.2" ECU_ADDRESS 0x6001365C /end MEASUREMENT
/begin MEASUREMENT DINH_stFId.FID_TKACSMW "Inhibit Status of FIds / Status of function identifier FID_TKACSMW" UWORD DFC_OneToOne 1 100 0.00 65535.00 FORMAT "%8.2" ECU_ADDRESS 0x6001365E /end MEASUREMENT
/begin MEASUREMENT DINH_stFId.FID_TMCSMW "Inhibit Status of FIds / Status of function identifier FID_TMCSMW" UWORD DFC_OneToOne 1 100 0.00 65535.00 FORMAT "%8.2" ECU_ADDRESS 0x60013660 /end MEASUREMENT
/begin MEASUREMENT DINH_stFId.FID_TOCHOilSwmpTQly "Inhibit Status of FIds / Status of function identifier FID_TOCHOilSwmpTQly" UWORD DFC_OneToOne 1 100 0.00 65535.00 FORMAT "%8.2" ECU_ADDRESS 0x60013662 /end MEASUREMENT
/begin MEASUREMENT DINH_stFId.FID_TOCHTME "Inhibit Status of FIds / Status of function identifier FID_TOCHTME" UWORD DFC_OneToOne 1 100 0.00 65535.00 FORMAT "%8.2" ECU_ADDRESS 0x60013664 /end MEASUREMENT
/begin MEASUREMENT DINH_stFId.FID_TOSPCSMW "Inhibit Status of FIds / Status of function identifier FID_TOSPCSMW" UWORD DFC_OneToOne 1 100 0.00 65535.00 FORMAT "%8.2" ECU_ADDRESS 0x60013666 /end MEASUREMENT
/begin MEASUREMENT DINH_stFId.FID_TSRLX "Inhibit Status of FIds / Status of function identifier FID_TSRLX" UWORD DFC_OneToOne 1 100 0.00 65535.00 FORMAT "%8.2" ECU_ADDRESS 0x60013668 /end MEASUREMENT
/begin MEASUREMENT DINH_stFId.FID_UEGOHeatrRlyS1B1 "Inhibit Status of FIds / Status of function identifier FID_UEGOHeatrRlyS1B1" UWORD DFC_OneToOne 1 100 0.00 65535.00 FORMAT "%8.2" ECU_ADDRESS 0x6001366A /end MEASUREMENT
/begin MEASUREMENT DINH_stFId.FID_VehStvSSEOk "Inhibit Status of FIds / Status of function identifier FID_VehStvSSEOk" UWORD DFC_OneToOne 1 100 0.00 65535.00 FORMAT "%8.2" ECU_ADDRESS 0x6001366C /end MEASUREMENT
/begin MEASUREMENT DINH_stFId.FID_VldtLamPlausMaxS1B1 "Inhibit Status of FIds / Status of function identifier FID_VldtLamPlausMaxS1B1" UWORD DFC_OneToOne 1 100 0.00 65535.00 FORMAT "%8.2" ECU_ADDRESS 0x6001366E /end MEASUREMENT
/begin MEASUREMENT DINH_stFId.FID_VldtLamPlausMinS1B1 "Inhibit Status of FIds / Status of function identifier FID_VldtLamPlausMinS1B1" UWORD DFC_OneToOne 1 100 0.00 65535.00 FORMAT "%8.2" ECU_ADDRESS 0x60013670 /end MEASUREMENT
/begin MEASUREMENT DINH_stFId.FId_ACClntPSSPMon "Inhibit Status of FIds / Status of function identifier FId_ACClntPSSPMon" UWORD DFC_OneToOne 1 100 0.00 65535.00 FORMAT "%8.2" ECU_ADDRESS 0x60013672 /end MEASUREMENT
/begin MEASUREMENT DINH_stFId.FId_ACCompComCANBusOff "Inhibit Status of FIds / Status of function identifier FId_ACCompComCANBusOff" UWORD DFC_OneToOne 1 100 0.00 65535.00 FORMAT "%8.2" ECU_ADDRESS 0x60013674 /end MEASUREMENT
/begin MEASUREMENT DINH_stFId.FId_ACCompComCANErrMtr "Inhibit Status of FIds / Status of function identifier FId_ACCompComCANErrMtr" UWORD DFC_OneToOne 1 100 0.00 65535.00 FORMAT "%8.2" ECU_ADDRESS 0x60013676 /end MEASUREMENT
/begin MEASUREMENT DINH_stFId.FId_ACComp_HiUTWSnsrErr "Inhibit Status of FIds / Status of function identifier FId_ACComp_HiUTWSnsrErr" UWORD DFC_OneToOne 1 100 0.00 65535.00 FORMAT "%8.2" ECU_ADDRESS 0x60013678 /end MEASUREMENT
/begin MEASUREMENT DINH_stFId.FId_ACComp_LoUTWSnsrErr "Inhibit Status of FIds / Status of function identifier FId_ACComp_LoUTWSnsrErr" UWORD DFC_OneToOne 1 100 0.00 65535.00 FORMAT "%8.2" ECU_ADDRESS 0x6001367A /end MEASUREMENT
/begin MEASUREMENT DINH_stFId.FId_ACComp_PDSnsrErr "Inhibit Status of FIds / Status of function identifier FId_ACComp_PDSnsrErr" UWORD DFC_OneToOne 1 100 0.00 65535.00 FORMAT "%8.2" ECU_ADDRESS 0x6001367C /end MEASUREMENT
/begin MEASUREMENT DINH_stFId.FId_ACComp_VehSpdSnsrErr "Inhibit Status of FIds / Status of function identifier FId_ACComp_VehSpdSnsrErr" UWORD DFC_OneToOne 1 100 0.00 65535.00 FORMAT "%8.2" ECU_ADDRESS 0x6001367E /end MEASUREMENT
/begin MEASUREMENT DINH_stFId.FId_ACCtl_ACStrtCut "Inhibit Status of FIds / Status of function identifier FId_ACCtl_ACStrtCut" UWORD DFC_OneToOne 1 100 0.00 65535.00 FORMAT "%8.2" ECU_ADDRESS 0x60013680 /end MEASUREMENT
/begin MEASUREMENT DINH_stFId.FId_ACCtl_APP1 "Inhibit Status of FIds / Status of function identifier FId_ACCtl_APP1" UWORD DFC_OneToOne 1 100 0.00 65535.00 FORMAT "%8.2" ECU_ADDRESS 0x60013682 /end MEASUREMENT
/begin MEASUREMENT DINH_stFId.FId_ACCtl_APP2 "Inhibit Status of FIds / Status of function identifier FId_ACCtl_APP2" UWORD DFC_OneToOne 1 100 0.00 65535.00 FORMAT "%8.2" ECU_ADDRESS 0x60013684 /end MEASUREMENT
/begin MEASUREMENT DINH_stFId.FId_ACCtl_APPSync "Inhibit Status of FIds / Status of function identifier FId_ACCtl_APPSync" UWORD DFC_OneToOne 1 100 0.00 65535.00 FORMAT "%8.2" ECU_ADDRESS 0x60013686 /end MEASUREMENT
/begin MEASUREMENT DINH_stFId.FId_ACCtl_AcOff "Inhibit Status of FIds / Status of function identifier FId_ACCtl_AcOff" UWORD DFC_OneToOne 1 100 0.00 65535.00 FORMAT "%8.2" ECU_ADDRESS 0x60013688 /end MEASUREMENT
/begin MEASUREMENT DINH_stFId.FId_ACCtl_Clmb "Inhibit Status of FIds / Status of function identifier FId_ACCtl_Clmb" UWORD DFC_OneToOne 1 100 0.00 65535.00 FORMAT "%8.2" ECU_ADDRESS 0x6001368A /end MEASUREMENT
/begin MEASUREMENT DINH_stFId.FId_ACCtl_DK1 "Inhibit Status of FIds / Status of function identifier FId_ACCtl_DK1" UWORD DFC_OneToOne 1 100 0.00 65535.00 FORMAT "%8.2" ECU_ADDRESS 0x6001368C /end MEASUREMENT
/begin MEASUREMENT DINH_stFId.FId_ACCtl_DK2 "Inhibit Status of FIds / Status of function identifier FId_ACCtl_DK2" UWORD DFC_OneToOne 1 100 0.00 65535.00 FORMAT "%8.2" ECU_ADDRESS 0x6001368E /end MEASUREMENT
/begin MEASUREMENT DINH_stFId.FId_ACCtl_DKSync "Inhibit Status of FIds / Status of function identifier FId_ACCtl_DKSync" UWORD DFC_OneToOne 1 100 0.00 65535.00 FORMAT "%8.2" ECU_ADDRESS 0x60013690 /end MEASUREMENT
/begin MEASUREMENT DINH_stFId.FId_ACCtl_VehSpdSnsrErr "Inhibit Status of FIds / Status of function identifier FId_ACCtl_VehSpdSnsrErr" UWORD DFC_OneToOne 1 100 0.00 65535.00 FORMAT "%8.2" ECU_ADDRESS 0x60013692 /end MEASUREMENT
/begin MEASUREMENT DINH_stFId.FId_ACCtl_pAC "Inhibit Status of FIds / Status of function identifier FId_ACCtl_pAC" UWORD DFC_OneToOne 1 100 0.00 65535.00 FORMAT "%8.2" ECU_ADDRESS 0x60013694 /end MEASUREMENT
/begin MEASUREMENT DINH_stFId.FId_ACEvpTCANErr "Inhibit Status of FIds / Status of function identifier FId_ACEvpTCANErr" UWORD DFC_OneToOne 1 100 0.00 65535.00 FORMAT "%8.2" ECU_ADDRESS 0x60013696 /end MEASUREMENT
/begin MEASUREMENT DINH_stFId.FId_ACEvpTFrzVal "Inhibit Status of FIds / Status of function identifier FId_ACEvpTFrzVal" UWORD DFC_OneToOne 1 100 0.00 65535.00 FORMAT "%8.2" ECU_ADDRESS 0x60013698 /end MEASUREMENT
/begin MEASUREMENT DINH_stFId.FId_ACEvpTPhysRng "Inhibit Status of FIds / Status of function identifier FId_ACEvpTPhysRng" UWORD DFC_OneToOne 1 100 0.00 65535.00 FORMAT "%8.2" ECU_ADDRESS 0x6001369A /end MEASUREMENT
/begin MEASUREMENT DINH_stFId.FId_ACEvpTRplVal "Inhibit Status of FIds / Status of function identifier FId_ACEvpTRplVal" UWORD DFC_OneToOne 1 100 0.00 65535.00 FORMAT "%8.2" ECU_ADDRESS 0x6001369C /end MEASUREMENT
/begin MEASUREMENT DINH_stFId.FId_AFCLFailr "Inhibit Status of FIds / Status of function identifier FId_AFCLFailr" UWORD DFC_OneToOne 1 100 0.00 65535.00 FORMAT "%8.2" ECU_ADDRESS 0x6001369E /end MEASUREMENT
/begin MEASUREMENT DINH_stFId.FId_AFS "Inhibit Status of FIds / Status of function identifier FId_AFS" UWORD DFC_OneToOne 1 100 0.00 65535.00 FORMAT "%8.2" ECU_ADDRESS 0x600136A0 /end MEASUREMENT
/begin MEASUREMENT DINH_stFId.FId_AFSPhyRng "Inhibit Status of FIds / Status of function identifier FId_AFSPhyRng" UWORD DFC_OneToOne 1 100 0.00 65535.00 FORMAT "%8.2" ECU_ADDRESS 0x600136A2 /end MEASUREMENT
/begin MEASUREMENT DINH_stFId.FId_APP1SigPath "Inhibit Status of FIds / Status of function identifier FId_APP1SigPath" UWORD DFC_OneToOne 1 100 0.00 65535.00 FORMAT "%8.2" ECU_ADDRESS 0x600136A4 /end MEASUREMENT
/begin MEASUREMENT DINH_stFId.FId_APP2SigPath "Inhibit Status of FIds / Status of function identifier FId_APP2SigPath" UWORD DFC_OneToOne 1 100 0.00 65535.00 FORMAT "%8.2" ECU_ADDRESS 0x600136A6 /end MEASUREMENT
/begin MEASUREMENT DINH_stFId.FId_APPBrkErr "Inhibit Status of FIds / Status of function identifier FId_APPBrkErr" UWORD DFC_OneToOne 1 100 0.00 65535.00 FORMAT "%8.2" ECU_ADDRESS 0x600136A8 /end MEASUREMENT
/begin MEASUREMENT DINH_stFId.FId_APPLETVldnErr "Inhibit Status of FIds / Status of function identifier FId_APPLETVldnErr" UWORD DFC_OneToOne 1 100 0.00 65535.00 FORMAT "%8.2" ECU_ADDRESS 0x600136AA /end MEASUREMENT
/begin MEASUREMENT DINH_stFId.FId_APPLrn "Inhibit Status of FIds / Status of function identifier FId_APPLrn" UWORD DFC_OneToOne 1 100 0.00 65535.00 FORMAT "%8.2" ECU_ADDRESS 0x600136AC /end MEASUREMENT
/begin MEASUREMENT DINH_stFId.FId_APPVehVErr "Inhibit Status of FIds / Status of function identifier FId_APPVehVErr" UWORD DFC_OneToOne 1 100 0.00 65535.00 FORMAT "%8.2" ECU_ADDRESS 0x600136AE /end MEASUREMENT
/begin MEASUREMENT DINH_stFId.FId_AccPedDrvModComErr "Inhibit Status of FIds / Status of function identifier FId_AccPedDrvModComErr" UWORD DFC_OneToOne 1 100 0.00 65535.00 FORMAT "%8.2" ECU_ADDRESS 0x600136B0 /end MEASUREMENT
/begin MEASUREMENT DINH_stFId.FId_AccPedDrvModFailr "Inhibit Status of FIds / Status of function identifier FId_AccPedDrvModFailr" UWORD DFC_OneToOne 1 100 0.00 65535.00 FORMAT "%8.2" ECU_ADDRESS 0x600136B2 /end MEASUREMENT
/begin MEASUREMENT DINH_stFId.FId_AccPedNMaxLim "Inhibit Status of FIds / Status of function identifier FId_AccPedNMaxLim" UWORD DFC_OneToOne 1 100 0.00 65535.00 FORMAT "%8.2" ECU_ADDRESS 0x600136B4 /end MEASUREMENT
/begin MEASUREMENT DINH_stFId.FId_AccPedNMinLim "Inhibit Status of FIds / Status of function identifier FId_AccPedNMinLim" UWORD DFC_OneToOne 1 100 0.00 65535.00 FORMAT "%8.2" ECU_ADDRESS 0x600136B6 /end MEASUREMENT
/begin MEASUREMENT DINH_stFId.FId_AccPedNMinLimBrkApp "Inhibit Status of FIds / Status of function identifier FId_AccPedNMinLimBrkApp" UWORD DFC_OneToOne 1 100 0.00 65535.00 FORMAT "%8.2" ECU_ADDRESS 0x600136B8 /end MEASUREMENT
/begin MEASUREMENT DINH_stFId.FId_AccPedTrqLim "Inhibit Status of FIds / Status of function identifier FId_AccPedTrqLim" UWORD DFC_OneToOne 1 100 0.00 65535.00 FORMAT "%8.2" ECU_ADDRESS 0x600136BA /end MEASUREMENT
/begin MEASUREMENT DINH_stFId.FId_AfsDdDiag "Inhibit Status of FIds / Status of function identifier FId_AfsDdDiag" UWORD DFC_OneToOne 1 100 0.00 65535.00 FORMAT "%8.2" ECU_ADDRESS 0x600136BC /end MEASUREMENT
/begin MEASUREMENT DINH_stFId.FId_AfsDiagErr "Inhibit Status of FIds / Status of function identifier FId_AfsDiagErr" UWORD DFC_OneToOne 1 100 0.00 65535.00 FORMAT "%8.2" ECU_ADDRESS 0x600136BE /end MEASUREMENT
/begin MEASUREMENT DINH_stFId.FId_AfsDiagTst "Inhibit Status of FIds / Status of function identifier FId_AfsDiagTst" UWORD DFC_OneToOne 1 100 0.00 65535.00 FORMAT "%8.2" ECU_ADDRESS 0x600136C0 /end MEASUREMENT
/begin MEASUREMENT DINH_stFId.FId_AfsPlausDiag "Inhibit Status of FIds / Status of function identifier FId_AfsPlausDiag" UWORD DFC_OneToOne 1 100 0.00 65535.00 FORMAT "%8.2" ECU_ADDRESS 0x600136C2 /end MEASUREMENT
/begin MEASUREMENT DINH_stFId.FId_AfsVrntDiag "Inhibit Status of FIds / Status of function identifier FId_AfsVrntDiag" UWORD DFC_OneToOne 1 100 0.00 65535.00 FORMAT "%8.2" ECU_ADDRESS 0x600136C4 /end MEASUREMENT
/begin MEASUREMENT DINH_stFId.FId_AirCClntPFrzVal "Inhibit Status of FIds / Status of function identifier FId_AirCClntPFrzVal" UWORD DFC_OneToOne 1 100 0.00 65535.00 FORMAT "%8.2" ECU_ADDRESS 0x600136C6 /end MEASUREMENT
/begin MEASUREMENT DINH_stFId.FId_AirCClntPRplVal "Inhibit Status of FIds / Status of function identifier FId_AirCClntPRplVal" UWORD DFC_OneToOne 1 100 0.00 65535.00 FORMAT "%8.2" ECU_ADDRESS 0x600136C8 /end MEASUREMENT
/begin MEASUREMENT DINH_stFId.FId_AirCSwt "Inhibit Status of FIds / Status of function identifier FId_AirCSwt" UWORD DFC_OneToOne 1 100 0.00 65535.00 FORMAT "%8.2" ECU_ADDRESS 0x600136CA /end MEASUREMENT
/begin MEASUREMENT DINH_stFId.FId_AirDvPAdpnPEnv "Inhibit Status of FIds / Status of function identifier FId_AirDvPAdpnPEnv" UWORD DFC_OneToOne 1 100 0.00 65535.00 FORMAT "%8.2" ECU_ADDRESS 0x600136CC /end MEASUREMENT
/begin MEASUREMENT DINH_stFId.FId_AirDvPAdpnPIntkVUsB1 "Inhibit Status of FIds / Status of function identifier FId_AirDvPAdpnPIntkVUsB1" UWORD DFC_OneToOne 1 100 0.00 65535.00 FORMAT "%8.2" ECU_ADDRESS 0x600136CE /end MEASUREMENT
/begin MEASUREMENT DINH_stFId.FId_AirDvPPSnsrAdpn_PModeActv "Inhibit Status of FIds / Status of function identifier FId_AirDvPPSnsrAdpn_PModeActv" UWORD DFC_OneToOne 1 100 0.00 65535.00 FORMAT "%8.2" ECU_ADDRESS 0x600136D0 /end MEASUREMENT
/begin MEASUREMENT DINH_stFId.FId_AltACGFailr "Inhibit Status of FIds / Status of function identifier FId_AltACGFailr" UWORD DFC_OneToOne 1 100 0.00 65535.00 FORMAT "%8.2" ECU_ADDRESS 0x600136D2 /end MEASUREMENT
/begin MEASUREMENT DINH_stFId.FId_AltAPPErrSt "Inhibit Status of FIds / Status of function identifier FId_AltAPPErrSt" UWORD DFC_OneToOne 1 100 0.00 65535.00 FORMAT "%8.2" ECU_ADDRESS 0x600136D4 /end MEASUREMENT
/begin MEASUREMENT DINH_stFId.FId_AltBattMngtFailr "Inhibit Status of FIds / Status of function identifier FId_AltBattMngtFailr" UWORD DFC_OneToOne 1 100 0.00 65535.00 FORMAT "%8.2" ECU_ADDRESS 0x600136D6 /end MEASUREMENT
/begin MEASUREMENT DINH_stFId.FId_AltBrkErrSt "Inhibit Status of FIds / Status of function identifier FId_AltBrkErrSt" UWORD DFC_OneToOne 1 100 0.00 65535.00 FORMAT "%8.2" ECU_ADDRESS 0x600136D8 /end MEASUREMENT
/begin MEASUREMENT DINH_stFId.FId_AltComErr "Inhibit Status of FIds / Status of function identifier FId_AltComErr" UWORD DFC_OneToOne 1 100 0.00 65535.00 FORMAT "%8.2" ECU_ADDRESS 0x600136DA /end MEASUREMENT
/begin MEASUREMENT DINH_stFId.FId_AltENGB "Inhibit Status of FIds / Status of function identifier FId_AltENGB" UWORD DFC_OneToOne 1 100 0.00 65535.00 FORMAT "%8.2" ECU_ADDRESS 0x600136DC /end MEASUREMENT
/begin MEASUREMENT DINH_stFId.FId_AltElecLoadErr "Inhibit Status of FIds / Status of function identifier FId_AltElecLoadErr" UWORD DFC_OneToOne 1 100 0.00 65535.00 FORMAT "%8.2" ECU_ADDRESS 0x600136DE /end MEASUREMENT
/begin MEASUREMENT DINH_stFId.FId_AltEnvTErr "Inhibit Status of FIds / Status of function identifier FId_AltEnvTErr" UWORD DFC_OneToOne 1 100 0.00 65535.00 FORMAT "%8.2" ECU_ADDRESS 0x600136E0 /end MEASUREMENT
/begin MEASUREMENT DINH_stFId.FId_AltFFAltLoadFast "Inhibit Status of FIds / Status of function identifier FId_AltFFAltLoadFast" UWORD DFC_OneToOne 1 100 0.00 65535.00 FORMAT "%8.2" ECU_ADDRESS 0x600136E2 /end MEASUREMENT
/begin MEASUREMENT DINH_stFId.FId_AltFFAltLoadSlow "Inhibit Status of FIds / Status of function identifier FId_AltFFAltLoadSlow" UWORD DFC_OneToOne 1 100 0.00 65535.00 FORMAT "%8.2" ECU_ADDRESS 0x600136E4 /end MEASUREMENT
/begin MEASUREMENT DINH_stFId.FId_AltIOACGErr "Inhibit Status of FIds / Status of function identifier FId_AltIOACGErr" UWORD DFC_OneToOne 1 100 0.00 65535.00 FORMAT "%8.2" ECU_ADDRESS 0x600136E6 /end MEASUREMENT
/begin MEASUREMENT DINH_stFId.FId_AltIOACGLinComFailr "Inhibit Status of FIds / Status of function identifier FId_AltIOACGLinComFailr" UWORD DFC_OneToOne 1 100 0.00 65535.00 FORMAT "%8.2" ECU_ADDRESS 0x600136E8 /end MEASUREMENT
/begin MEASUREMENT DINH_stFId.FId_AltIOComErr "Inhibit Status of FIds / Status of function identifier FId_AltIOComErr" UWORD DFC_OneToOne 1 100 0.00 65535.00 FORMAT "%8.2" ECU_ADDRESS 0x600136EA /end MEASUREMENT
/begin MEASUREMENT DINH_stFId.FId_AltLinErr "Inhibit Status of FIds / Status of function identifier FId_AltLinErr" UWORD DFC_OneToOne 1 100 0.00 65535.00 FORMAT "%8.2" ECU_ADDRESS 0x600136EC /end MEASUREMENT
/begin MEASUREMENT DINH_stFId.FId_AltPwr "Inhibit Status of FIds / Status of function identifier FId_AltPwr" UWORD DFC_OneToOne 1 100 0.00 65535.00 FORMAT "%8.2" ECU_ADDRESS 0x600136EE /end MEASUREMENT
/begin MEASUREMENT DINH_stFId.FId_AltVehVErrSt "Inhibit Status of FIds / Status of function identifier FId_AltVehVErrSt" UWORD DFC_OneToOne 1 100 0.00 65535.00 FORMAT "%8.2" ECU_ADDRESS 0x600136F0 /end MEASUREMENT
/begin MEASUREMENT DINH_stFId.FId_AltvCluFail "Inhibit Status of FIds / Status of function identifier FId_AltvCluFail" UWORD DFC_OneToOne 1 100 0.00 65535.00 FORMAT "%8.2" ECU_ADDRESS 0x600136F2 /end MEASUREMENT
/begin MEASUREMENT DINH_stFId.FId_BGAGRTS "Inhibit Status of FIds / Status of function identifier FId_BGAGRTS" UWORD DFC_OneToOne 1 100 0.00 65535.00 FORMAT "%8.2" ECU_ADDRESS 0x600136F4 /end MEASUREMENT
/begin MEASUREMENT DINH_stFId.FId_BGFKMSEPSR "Inhibit Status of FIds / Status of function identifier FId_BGFKMSEPSR" UWORD DFC_OneToOne 1 100 0.00 65535.00 FORMAT "%8.2" ECU_ADDRESS 0x600136F6 /end MEASUREMENT
/begin MEASUREMENT DINH_stFId.FId_BGFKMSEPU "Inhibit Status of FIds / Status of function identifier FId_BGFKMSEPU" UWORD DFC_OneToOne 1 100 0.00 65535.00 FORMAT "%8.2" ECU_ADDRESS 0x600136F8 /end MEASUREMENT
/begin MEASUREMENT DINH_stFId.FId_BGFKMSESumClr "Inhibit Status of FIds / Status of function identifier FId_BGFKMSESumClr" UWORD DFC_OneToOne 1 100 0.00 65535.00 FORMAT "%8.2" ECU_ADDRESS 0x600136FA /end MEASUREMENT
/begin MEASUREMENT DINH_stFId.FId_BGFKMSHFME "Inhibit Status of FIds / Status of function identifier FId_BGFKMSHFME" UWORD DFC_OneToOne 1 100 0.00 65535.00 FORMAT "%8.2" ECU_ADDRESS 0x600136FC /end MEASUREMENT
/begin MEASUREMENT DINH_stFId.FId_BGFKMSHFMZ "Inhibit Status of FIds / Status of function identifier FId_BGFKMSHFMZ" UWORD DFC_OneToOne 1 100 0.00 65535.00 FORMAT "%8.2" ECU_ADDRESS 0x600136FE /end MEASUREMENT
/begin MEASUREMENT DINH_stFId.FId_BGFKMSZPSR "Inhibit Status of FIds / Status of function identifier FId_BGFKMSZPSR" UWORD DFC_OneToOne 1 100 0.00 65535.00 FORMAT "%8.2" ECU_ADDRESS 0x60013700 /end MEASUREMENT
/begin MEASUREMENT DINH_stFId.FId_BGOSCCat1B1 "Inhibit Status of FIds / Status of function identifier FId_BGOSCCat1B1" UWORD DFC_OneToOne 1 100 0.00 65535.00 FORMAT "%8.2" ECU_ADDRESS 0x60013702 /end MEASUREMENT
/begin MEASUREMENT DINH_stFId.FId_BGOSCCat2B1 "Inhibit Status of FIds / Status of function identifier FId_BGOSCCat2B1" UWORD DFC_OneToOne 1 100 0.00 65535.00 FORMAT "%8.2" ECU_ADDRESS 0x60013704 /end MEASUREMENT
/begin MEASUREMENT DINH_stFId.FId_BattAltFailr "Inhibit Status of FIds / Status of function identifier FId_BattAltFailr" UWORD DFC_OneToOne 1 100 0.00 65535.00 FORMAT "%8.2" ECU_ADDRESS 0x60013706 /end MEASUREMENT
/begin MEASUREMENT DINH_stFId.FId_BattMngtFailr "Inhibit Status of FIds / Status of function identifier FId_BattMngtFailr" UWORD DFC_OneToOne 1 100 0.00 65535.00 FORMAT "%8.2" ECU_ADDRESS 0x60013708 /end MEASUREMENT
/begin MEASUREMENT DINH_stFId.FId_BattSigPtd "Inhibit Status of FIds / Status of function identifier FId_BattSigPtd" UWORD DFC_OneToOne 1 100 0.00 65535.00 FORMAT "%8.2" ECU_ADDRESS 0x6001370A /end MEASUREMENT
/begin MEASUREMENT DINH_stFId.FId_BattU2MEDSRC "Inhibit Status of FIds / Status of function identifier FId_BattU2MEDSRC" UWORD DFC_OneToOne 1 100 0.00 65535.00 FORMAT "%8.2" ECU_ADDRESS 0x6001370C /end MEASUREMENT
/begin MEASUREMENT DINH_stFId.FId_BattUDrpPrvOff "Inhibit Status of FIds / Status of function identifier FId_BattUDrpPrvOff" UWORD DFC_OneToOne 1 100 0.00 65535.00 FORMAT "%8.2" ECU_ADDRESS 0x6001370E /end MEASUREMENT
/begin MEASUREMENT DINH_stFId.FId_BattUFrzVal "Inhibit Status of FIds / Status of function identifier FId_BattUFrzVal" UWORD DFC_OneToOne 1 100 0.00 65535.00 FORMAT "%8.2" ECU_ADDRESS 0x60013710 /end MEASUREMENT
/begin MEASUREMENT DINH_stFId.FId_BattUHiFailrEna "Inhibit Status of FIds / Status of function identifier FId_BattUHiFailrEna" UWORD DFC_OneToOne 1 100 0.00 65535.00 FORMAT "%8.2" ECU_ADDRESS 0x60013712 /end MEASUREMENT
/begin MEASUREMENT DINH_stFId.FId_BattUIMGTCUCANFailr "Inhibit Status of FIds / Status of function identifier FId_BattUIMGTCUCANFailr" UWORD DFC_OneToOne 1 100 0.00 65535.00 FORMAT "%8.2" ECU_ADDRESS 0x60013714 /end MEASUREMENT
/begin MEASUREMENT DINH_stFId.FId_BattULoFailrEna "Inhibit Status of FIds / Status of function identifier FId_BattULoFailrEna" UWORD DFC_OneToOne 1 100 0.00 65535.00 FORMAT "%8.2" ECU_ADDRESS 0x60013716 /end MEASUREMENT
/begin MEASUREMENT DINH_stFId.FId_BattUReplVal "Inhibit Status of FIds / Status of function identifier FId_BattUReplVal" UWORD DFC_OneToOne 1 100 0.00 65535.00 FORMAT "%8.2" ECU_ADDRESS 0x60013718 /end MEASUREMENT
/begin MEASUREMENT DINH_stFId.FId_BattUSRC "Inhibit Status of FIds / Status of function identifier FId_BattUSRC" UWORD DFC_OneToOne 1 100 0.00 65535.00 FORMAT "%8.2" ECU_ADDRESS 0x6001371A /end MEASUREMENT
/begin MEASUREMENT DINH_stFId.FId_BlwrComErr "Inhibit Status of FIds / Status of function identifier FId_BlwrComErr" UWORD DFC_OneToOne 1 100 0.00 65535.00 FORMAT "%8.2" ECU_ADDRESS 0x6001371C /end MEASUREMENT
/begin MEASUREMENT DINH_stFId.FId_BrkBstMdl "Inhibit Status of FIds / Status of function identifier FId_BrkBstMdl" UWORD DFC_OneToOne 1 100 0.00 65535.00 FORMAT "%8.2" ECU_ADDRESS 0x6001371E /end MEASUREMENT
/begin MEASUREMENT DINH_stFId.FId_BrkBstMdlBrkP "Inhibit Status of FIds / Status of function identifier FId_BrkBstMdlBrkP" UWORD DFC_OneToOne 1 100 0.00 65535.00 FORMAT "%8.2" ECU_ADDRESS 0x60013720 /end MEASUREMENT
/begin MEASUREMENT DINH_stFId.FId_BrkBstMdlBrkSt "Inhibit Status of FIds / Status of function identifier FId_BrkBstMdlBrkSt" UWORD DFC_OneToOne 1 100 0.00 65535.00 FORMAT "%8.2" ECU_ADDRESS 0x60013722 /end MEASUREMENT
/begin MEASUREMENT DINH_stFId.FId_BrkBstMdlEnvP "Inhibit Status of FIds / Status of function identifier FId_BrkBstMdlEnvP" UWORD DFC_OneToOne 1 100 0.00 65535.00 FORMAT "%8.2" ECU_ADDRESS 0x60013724 /end MEASUREMENT
/begin MEASUREMENT DINH_stFId.FId_BrkBstPDetnInhbn "Inhibit Status of FIds / Status of function identifier FId_BrkBstPDetnInhbn" UWORD DFC_OneToOne 1 100 0.00 65535.00 FORMAT "%8.2" ECU_ADDRESS 0x60013726 /end MEASUREMENT
/begin MEASUREMENT DINH_stFId.FId_BrkBstPMstCylPSnsrFail "Inhibit Status of FIds / Status of function identifier FId_BrkBstPMstCylPSnsrFail" UWORD DFC_OneToOne 1 100 0.00 65535.00 FORMAT "%8.2" ECU_ADDRESS 0x60013728 /end MEASUREMENT
/begin MEASUREMENT DINH_stFId.FId_BrkBstPSnsrStuckDetn "Inhibit Status of FIds / Status of function identifier FId_BrkBstPSnsrStuckDetn" UWORD DFC_OneToOne 1 100 0.00 65535.00 FORMAT "%8.2" ECU_ADDRESS 0x6001372A /end MEASUREMENT
/begin MEASUREMENT DINH_stFId.FId_BrkBstSigPath "Inhibit Status of FIds / Status of function identifier FId_BrkBstSigPath" UWORD DFC_OneToOne 1 100 0.00 65535.00 FORMAT "%8.2" ECU_ADDRESS 0x6001372C /end MEASUREMENT
/begin MEASUREMENT DINH_stFId.FId_BrkBstVehVv "Inhibit Status of FIds / Status of function identifier FId_BrkBstVehVv" UWORD DFC_OneToOne 1 100 0.00 65535.00 FORMAT "%8.2" ECU_ADDRESS 0x6001372E /end MEASUREMENT
/begin MEASUREMENT DINH_stFId.FId_BrkMnSwtErr "Inhibit Status of FIds / Status of function identifier FId_BrkMnSwtErr" UWORD DFC_OneToOne 1 100 0.00 65535.00 FORMAT "%8.2" ECU_ADDRESS 0x60013730 /end MEASUREMENT
/begin MEASUREMENT DINH_stFId.FId_BrkPFrzVal "Inhibit Status of FIds / Status of function identifier FId_BrkPFrzVal" UWORD DFC_OneToOne 1 100 0.00 65535.00 FORMAT "%8.2" ECU_ADDRESS 0x60013732 /end MEASUREMENT
/begin MEASUREMENT DINH_stFId.FId_BrkPOilPres "Inhibit Status of FIds / Status of function identifier FId_BrkPOilPres" UWORD DFC_OneToOne 1 100 0.00 65535.00 FORMAT "%8.2" ECU_ADDRESS 0x60013734 /end MEASUREMENT
/begin MEASUREMENT DINH_stFId.FId_BrkPReplVal "Inhibit Status of FIds / Status of function identifier FId_BrkPReplVal" UWORD DFC_OneToOne 1 100 0.00 65535.00 FORMAT "%8.2" ECU_ADDRESS 0x60013736 /end MEASUREMENT
/begin MEASUREMENT DINH_stFId.FId_BrkPedEngStopEna "Inhibit Status of FIds / Status of function identifier FId_BrkPedEngStopEna" UWORD DFC_OneToOne 1 100 0.00 65535.00 FORMAT "%8.2" ECU_ADDRESS 0x60013738 /end MEASUREMENT
/begin MEASUREMENT DINH_stFId.FId_BrkRdntSwtErr "Inhibit Status of FIds / Status of function identifier FId_BrkRdntSwtErr" UWORD DFC_OneToOne 1 100 0.00 65535.00 FORMAT "%8.2" ECU_ADDRESS 0x6001373A /end MEASUREMENT
/begin MEASUREMENT DINH_stFId.FId_CAGRSDS "Inhibit Status of FIds / Status of function identifier FId_CAGRSDS" UWORD DFC_OneToOne 1 100 0.00 65535.00 FORMAT "%8.2" ECU_ADDRESS 0x6001373C /end MEASUREMENT
/begin MEASUREMENT DINH_stFId.FId_CEngDsTColdStrt "Inhibit Status of FIds / Status of function identifier FId_CEngDsTColdStrt" UWORD DFC_OneToOne 1 100 0.00 65535.00 FORMAT "%8.2" ECU_ADDRESS 0x6001373E /end MEASUREMENT
/begin MEASUREMENT DINH_stFId.FId_CEngDsTColdStrtErr "Inhibit Status of FIds / Status of function identifier FId_CEngDsTColdStrtErr" UWORD DFC_OneToOne 1 100 0.00 65535.00 FORMAT "%8.2" ECU_ADDRESS 0x60013740 /end MEASUREMENT
/begin MEASUREMENT DINH_stFId.FId_CEngDsTHSC "Inhibit Status of FIds / Status of function identifier FId_CEngDsTHSC" UWORD DFC_OneToOne 1 100 0.00 65535.00 FORMAT "%8.2" ECU_ADDRESS 0x60013742 /end MEASUREMENT
/begin MEASUREMENT DINH_stFId.FId_CEngDsTLSC "Inhibit Status of FIds / Status of function identifier FId_CEngDsTLSC" UWORD DFC_OneToOne 1 100 0.00 65535.00 FORMAT "%8.2" ECU_ADDRESS 0x60013744 /end MEASUREMENT
/begin MEASUREMENT DINH_stFId.FId_CEngDsTPlausErr "Inhibit Status of FIds / Status of function identifier FId_CEngDsTPlausErr" UWORD DFC_OneToOne 1 100 0.00 65535.00 FORMAT "%8.2" ECU_ADDRESS 0x60013746 /end MEASUREMENT
/begin MEASUREMENT DINH_stFId.FId_CEngDsTReplMdlEngStop "Inhibit Status of FIds / Status of function identifier FId_CEngDsTReplMdlEngStop" UWORD DFC_OneToOne 1 100 0.00 65535.00 FORMAT "%8.2" ECU_ADDRESS 0x60013748 /end MEASUREMENT
/begin MEASUREMENT DINH_stFId.FId_CEngDsTSTC "Inhibit Status of FIds / Status of function identifier FId_CEngDsTSTC" UWORD DFC_OneToOne 1 100 0.00 65535.00 FORMAT "%8.2" ECU_ADDRESS 0x6001374A /end MEASUREMENT
/begin MEASUREMENT DINH_stFId.FId_CEngDsTSnsrElec "Inhibit Status of FIds / Status of function identifier FId_CEngDsTSnsrElec" UWORD DFC_OneToOne 1 100 0.00 65535.00 FORMAT "%8.2" ECU_ADDRESS 0x6001374C /end MEASUREMENT
/begin MEASUREMENT DINH_stFId.FId_CEngDsTSwtReplMdl "Inhibit Status of FIds / Status of function identifier FId_CEngDsTSwtReplMdl" UWORD DFC_OneToOne 1 100 0.00 65535.00 FORMAT "%8.2" ECU_ADDRESS 0x6001374E /end MEASUREMENT
/begin MEASUREMENT DINH_stFId.FId_CEngUsTColdChkErr "Inhibit Status of FIds / Status of function identifier FId_CEngUsTColdChkErr" UWORD DFC_OneToOne 1 100 0.00 65535.00 FORMAT "%8.2" ECU_ADDRESS 0x60013750 /end MEASUREMENT
/begin MEASUREMENT DINH_stFId.FId_CEngUsTCrssChk "Inhibit Status of FIds / Status of function identifier FId_CEngUsTCrssChk" UWORD DFC_OneToOne 1 100 0.00 65535.00 FORMAT "%8.2" ECU_ADDRESS 0x60013752 /end MEASUREMENT
/begin MEASUREMENT DINH_stFId.FId_CEngUsTElecErr "Inhibit Status of FIds / Status of function identifier FId_CEngUsTElecErr" UWORD DFC_OneToOne 1 100 0.00 65535.00 FORMAT "%8.2" ECU_ADDRESS 0x60013754 /end MEASUREMENT
/begin MEASUREMENT DINH_stFId.FId_CEngUsTSnsrElecErr "Inhibit Status of FIds / Status of function identifier FId_CEngUsTSnsrElecErr" UWORD DFC_OneToOne 1 100 0.00 65535.00 FORMAT "%8.2" ECU_ADDRESS 0x60013756 /end MEASUREMENT
/begin MEASUREMENT DINH_stFId.FId_CEngUsTSwtReplMdl "Inhibit Status of FIds / Status of function identifier FId_CEngUsTSwtReplMdl" UWORD DFC_OneToOne 1 100 0.00 65535.00 FORMAT "%8.2" ECU_ADDRESS 0x60013758 /end MEASUREMENT
/begin MEASUREMENT DINH_stFId.FId_CInjCatHeatgDiag "Inhibit Status of FIds / Status of function identifier FId_CInjCatHeatgDiag" UWORD DFC_OneToOne 1 100 0.00 65535.00 FORMAT "%8.2" ECU_ADDRESS 0x6001375A /end MEASUREMENT
/begin MEASUREMENT DINH_stFId.FId_CMSUDKSOM1 "Inhibit Status of FIds / Status of function identifier FId_CMSUDKSOM1" UWORD DFC_OneToOne 1 100 0.00 65535.00 FORMAT "%8.2" ECU_ADDRESS 0x6001375C /end MEASUREMENT
/begin MEASUREMENT DINH_stFId.FId_CMSUDKSOM2 "Inhibit Status of FIds / Status of function identifier FId_CMSUDKSOM2" UWORD DFC_OneToOne 1 100 0.00 65535.00 FORMAT "%8.2" ECU_ADDRESS 0x6001375E /end MEASUREMENT
/begin MEASUREMENT DINH_stFId.FId_CatHeatgEomShtrpAct "Inhibit Status of FIds / Status of function identifier FId_CatHeatgEomShtrpAct" UWORD DFC_OneToOne 1 100 0.00 65535.00 FORMAT "%8.2" ECU_ADDRESS 0x60013760 /end MEASUREMENT
/begin MEASUREMENT DINH_stFId.FId_ChrctlAgrsErr "Inhibit Status of FIds / Status of function identifier FId_ChrctlAgrsErr" UWORD DFC_OneToOne 1 100 0.00 65535.00 FORMAT "%8.2" ECU_ADDRESS 0x60013762 /end MEASUREMENT
/begin MEASUREMENT DINH_stFId.FId_ChrctlAgrscf "Inhibit Status of FIds / Status of function identifier FId_ChrctlAgrscf" UWORD DFC_OneToOne 1 100 0.00 65535.00 FORMAT "%8.2" ECU_ADDRESS 0x60013764 /end MEASUREMENT
/begin MEASUREMENT DINH_stFId.FId_ClntTempENGB "Inhibit Status of FIds / Status of function identifier FId_ClntTempENGB" UWORD DFC_OneToOne 1 100 0.00 65535.00 FORMAT "%8.2" ECU_ADDRESS 0x60013766 /end MEASUREMENT
/begin MEASUREMENT DINH_stFId.FId_Clth "Inhibit Status of FIds / Status of function identifier FId_Clth" UWORD DFC_OneToOne 1 100 0.00 65535.00 FORMAT "%8.2" ECU_ADDRESS 0x60013768 /end MEASUREMENT
/begin MEASUREMENT DINH_stFId.FId_Clth2 "Inhibit Status of FIds / Status of function identifier FId_Clth2" UWORD DFC_OneToOne 1 100 0.00 65535.00 FORMAT "%8.2" ECU_ADDRESS 0x6001376A /end MEASUREMENT
/begin MEASUREMENT DINH_stFId.FId_Clth3StuckOn "Inhibit Status of FIds / Status of function identifier FId_Clth3StuckOn" UWORD DFC_OneToOne 1 100 0.00 65535.00 FORMAT "%8.2" ECU_ADDRESS 0x6001376C /end MEASUREMENT
/begin MEASUREMENT DINH_stFId.FId_Clth4 "Inhibit Status of FIds / Status of function identifier FId_Clth4" UWORD DFC_OneToOne 1 100 0.00 65535.00 FORMAT "%8.2" ECU_ADDRESS 0x6001376E /end MEASUREMENT
/begin MEASUREMENT DINH_stFId.FId_ClthCAN "Inhibit Status of FIds / Status of function identifier FId_ClthCAN" UWORD DFC_OneToOne 1 100 0.00 65535.00 FORMAT "%8.2" ECU_ADDRESS 0x60013770 /end MEASUREMENT
/begin MEASUREMENT DINH_stFId.FId_ClthMax "Inhibit Status of FIds / Status of function identifier FId_ClthMax" UWORD DFC_OneToOne 1 100 0.00 65535.00 FORMAT "%8.2" ECU_ADDRESS 0x60013772 /end MEASUREMENT
/begin MEASUREMENT DINH_stFId.FId_ClthStk "Inhibit Status of FIds / Status of function identifier FId_ClthStk" UWORD DFC_OneToOne 1 100 0.00 65535.00 FORMAT "%8.2" ECU_ADDRESS 0x60013774 /end MEASUREMENT
/begin MEASUREMENT DINH_stFId.FId_ClthStkErr "Inhibit Status of FIds / Status of function identifier FId_ClthStkErr" UWORD DFC_OneToOne 1 100 0.00 65535.00 FORMAT "%8.2" ECU_ADDRESS 0x60013776 /end MEASUREMENT
/begin MEASUREMENT DINH_stFId.FId_ClthStkFailr "Inhibit Status of FIds / Status of function identifier FId_ClthStkFailr" UWORD DFC_OneToOne 1 100 0.00 65535.00 FORMAT "%8.2" ECU_ADDRESS 0x60013778 /end MEASUREMENT
/begin MEASUREMENT DINH_stFId.FId_ClthStkOFFStuck "Inhibit Status of FIds / Status of function identifier FId_ClthStkOFFStuck" UWORD DFC_OneToOne 1 100 0.00 65535.00 FORMAT "%8.2" ECU_ADDRESS 0x6001377A /end MEASUREMENT
/begin MEASUREMENT DINH_stFId.FId_ClthStkONStuck "Inhibit Status of FIds / Status of function identifier FId_ClthStkONStuck" UWORD DFC_OneToOne 1 100 0.00 65535.00 FORMAT "%8.2" ECU_ADDRESS 0x6001377C /end MEASUREMENT
/begin MEASUREMENT DINH_stFId.FId_ClthSwtFailr "Inhibit Status of FIds / Status of function identifier FId_ClthSwtFailr" UWORD DFC_OneToOne 1 100 0.00 65535.00 FORMAT "%8.2" ECU_ADDRESS 0x6001377E /end MEASUREMENT
/begin MEASUREMENT DINH_stFId.FId_CntrShaftFailr "Inhibit Status of FIds / Status of function identifier FId_CntrShaftFailr" UWORD DFC_OneToOne 1 100 0.00 65535.00 FORMAT "%8.2" ECU_ADDRESS 0x60013780 /end MEASUREMENT
/begin MEASUREMENT DINH_stFId.FId_CoEOMGdiEomErrLcy "Inhibit Status of FIds / Status of function identifier FId_CoEOMGdiEomErrLcy" UWORD DFC_OneToOne 1 100 0.00 65535.00 FORMAT "%8.2" ECU_ADDRESS 0x60013782 /end MEASUREMENT
/begin MEASUREMENT DINH_stFId.FId_CoESSBlowrVld "Inhibit Status of FIds / Status of function identifier FId_CoESSBlowrVld" UWORD DFC_OneToOne 1 100 0.00 65535.00 FORMAT "%8.2" ECU_ADDRESS 0x60013784 /end MEASUREMENT
/begin MEASUREMENT DINH_stFId.FId_CoETM "Inhibit Status of FIds / Status of function identifier FId_CoETM" UWORD DFC_OneToOne 1 100 0.00 65535.00 FORMAT "%8.2" ECU_ADDRESS 0x60013786 /end MEASUREMENT
/begin MEASUREMENT DINH_stFId.FId_CoETS_StTrqLimErr1 "Inhibit Status of FIds / Status of function identifier FId_CoETS_StTrqLimErr1" UWORD DFC_OneToOne 1 100 0.00 65535.00 FORMAT "%8.2" ECU_ADDRESS 0x60013788 /end MEASUREMENT
/begin MEASUREMENT DINH_stFId.FId_CoETS_StTrqLimErr2 "Inhibit Status of FIds / Status of function identifier FId_CoETS_StTrqLimErr2" UWORD DFC_OneToOne 1 100 0.00 65535.00 FORMAT "%8.2" ECU_ADDRESS 0x6001378A /end MEASUREMENT
/begin MEASUREMENT DINH_stFId.FId_CoEngStopEnblStSpEngT "Inhibit Status of FIds / Status of function identifier FId_CoEngStopEnblStSpEngT" UWORD DFC_OneToOne 1 100 0.00 65535.00 FORMAT "%8.2" ECU_ADDRESS 0x6001378C /end MEASUREMENT
/begin MEASUREMENT DINH_stFId.FId_CoEngStopEnblStSpLSU "Inhibit Status of FIds / Status of function identifier FId_CoEngStopEnblStSpLSU" UWORD DFC_OneToOne 1 100 0.00 65535.00 FORMAT "%8.2" ECU_ADDRESS 0x6001378E /end MEASUREMENT
/begin MEASUREMENT DINH_stFId.FId_CoEngStopEnblStSpTcT "Inhibit Status of FIds / Status of function identifier FId_CoEngStopEnblStSpTcT" UWORD DFC_OneToOne 1 100 0.00 65535.00 FORMAT "%8.2" ECU_ADDRESS 0x60013790 /end MEASUREMENT
/begin MEASUREMENT DINH_stFId.FId_CoEngStopEnblSysErr "Inhibit Status of FIds / Status of function identifier FId_CoEngStopEnblSysErr" UWORD DFC_OneToOne 1 100 0.00 65535.00 FORMAT "%8.2" ECU_ADDRESS 0x60013792 /end MEASUREMENT
/begin MEASUREMENT DINH_stFId.FId_CoEngVlvLftSpIntk "Inhibit Status of FIds / Status of function identifier FId_CoEngVlvLftSpIntk" UWORD DFC_OneToOne 1 100 0.00 65535.00 FORMAT "%8.2" ECU_ADDRESS 0x60013794 /end MEASUREMENT
/begin MEASUREMENT DINH_stFId.FId_CoPOMStrtgDevStrtr "Inhibit Status of FIds / Status of function identifier FId_CoPOMStrtgDevStrtr" UWORD DFC_OneToOne 1 100 0.00 65535.00 FORMAT "%8.2" ECU_ADDRESS 0x60013796 /end MEASUREMENT
/begin MEASUREMENT DINH_stFId.FId_CoPOM_FirstStrtAut "Inhibit Status of FIds / Status of function identifier FId_CoPOM_FirstStrtAut" UWORD DFC_OneToOne 1 100 0.00 65535.00 FORMAT "%8.2" ECU_ADDRESS 0x60013798 /end MEASUREMENT
/begin MEASUREMENT DINH_stFId.FId_CoTS_SwtOff "Inhibit Status of FIds / Status of function identifier FId_CoTS_SwtOff" UWORD DFC_OneToOne 1 100 0.00 65535.00 FORMAT "%8.2" ECU_ADDRESS 0x6001379A /end MEASUREMENT
/begin MEASUREMENT DINH_stFId.FId_CoVOMACCComFailr "Inhibit Status of FIds / Status of function identifier FId_CoVOMACCComFailr" UWORD DFC_OneToOne 1 100 0.00 65535.00 FORMAT "%8.2" ECU_ADDRESS 0x6001379C /end MEASUREMENT
/begin MEASUREMENT DINH_stFId.FId_CoVOMBrkPedISABSigFailr "Inhibit Status of FIds / Status of function identifier FId_CoVOMBrkPedISABSigFailr" UWORD DFC_OneToOne 1 100 0.00 65535.00 FORMAT "%8.2" ECU_ADDRESS 0x6001379E /end MEASUREMENT
/begin MEASUREMENT DINH_stFId.FId_CoVOMEngCrkAbort "Inhibit Status of FIds / Status of function identifier FId_CoVOMEngCrkAbort" UWORD DFC_OneToOne 1 100 0.00 65535.00 FORMAT "%8.2" ECU_ADDRESS 0x600137A0 /end MEASUREMENT
/begin MEASUREMENT DINH_stFId.FId_CoVOMEngRstrtEnaCdn "Inhibit Status of FIds / Status of function identifier FId_CoVOMEngRstrtEnaCdn" UWORD DFC_OneToOne 1 100 0.00 65535.00 FORMAT "%8.2" ECU_ADDRESS 0x600137A2 /end MEASUREMENT
/begin MEASUREMENT DINH_stFId.FId_CoVOMISSEng "Inhibit Status of FIds / Status of function identifier FId_CoVOMISSEng" UWORD DFC_OneToOne 1 100 0.00 65535.00 FORMAT "%8.2" ECU_ADDRESS 0x600137A4 /end MEASUREMENT
/begin MEASUREMENT DINH_stFId.FId_ComACRly "Inhibit Status of FIds / Status of function identifier FId_ComACRly" UWORD DFC_OneToOne 1 100 0.00 65535.00 FORMAT "%8.2" ECU_ADDRESS 0x600137A6 /end MEASUREMENT
/begin MEASUREMENT DINH_stFId.FId_ComAPPSensFail "Inhibit Status of FIds / Status of function identifier FId_ComAPPSensFail" UWORD DFC_OneToOne 1 100 0.00 65535.00 FORMAT "%8.2" ECU_ADDRESS 0x600137A8 /end MEASUREMENT
/begin MEASUREMENT DINH_stFId.FId_ComAPedl "Inhibit Status of FIds / Status of function identifier FId_ComAPedl" UWORD DFC_OneToOne 1 100 0.00 65535.00 FORMAT "%8.2" ECU_ADDRESS 0x600137AA /end MEASUREMENT
/begin MEASUREMENT DINH_stFId.FId_ComAYCA "Inhibit Status of FIds / Status of function identifier FId_ComAYCA" UWORD DFC_OneToOne 1 100 0.00 65535.00 FORMAT "%8.2" ECU_ADDRESS 0x600137AC /end MEASUREMENT
/begin MEASUREMENT DINH_stFId.FId_ComAYCAMon "Inhibit Status of FIds / Status of function identifier FId_ComAYCAMon" UWORD DFC_OneToOne 1 100 0.00 65535.00 FORMAT "%8.2" ECU_ADDRESS 0x600137AE /end MEASUREMENT
/begin MEASUREMENT DINH_stFId.FId_ComAYCD "Inhibit Status of FIds / Status of function identifier FId_ComAYCD" UWORD DFC_OneToOne 1 100 0.00 65535.00 FORMAT "%8.2" ECU_ADDRESS 0x600137B0 /end MEASUREMENT
/begin MEASUREMENT DINH_stFId.FId_ComAYCDMon "Inhibit Status of FIds / Status of function identifier FId_ComAYCDMon" UWORD DFC_OneToOne 1 100 0.00 65535.00 FORMAT "%8.2" ECU_ADDRESS 0x600137B2 /end MEASUREMENT
/begin MEASUREMENT DINH_stFId.FId_ComAYCF "Inhibit Status of FIds / Status of function identifier FId_ComAYCF" UWORD DFC_OneToOne 1 100 0.00 65535.00 FORMAT "%8.2" ECU_ADDRESS 0x600137B4 /end MEASUREMENT
/begin MEASUREMENT DINH_stFId.FId_ComAYCFMon "Inhibit Status of FIds / Status of function identifier FId_ComAYCFMon" UWORD DFC_OneToOne 1 100 0.00 65535.00 FORMAT "%8.2" ECU_ADDRESS 0x600137B6 /end MEASUREMENT
/begin MEASUREMENT DINH_stFId.FId_ComAYCG "Inhibit Status of FIds / Status of function identifier FId_ComAYCG" UWORD DFC_OneToOne 1 100 0.00 65535.00 FORMAT "%8.2" ECU_ADDRESS 0x600137B8 /end MEASUREMENT
/begin MEASUREMENT DINH_stFId.FId_ComAYCGMon "Inhibit Status of FIds / Status of function identifier FId_ComAYCGMon" UWORD DFC_OneToOne 1 100 0.00 65535.00 FORMAT "%8.2" ECU_ADDRESS 0x600137BA /end MEASUREMENT
/begin MEASUREMENT DINH_stFId.FId_ComAYCI "Inhibit Status of FIds / Status of function identifier FId_ComAYCI" UWORD DFC_OneToOne 1 100 0.00 65535.00 FORMAT "%8.2" ECU_ADDRESS 0x600137BC /end MEASUREMENT
/begin MEASUREMENT DINH_stFId.FId_ComAYCIMon "Inhibit Status of FIds / Status of function identifier FId_ComAYCIMon" UWORD DFC_OneToOne 1 100 0.00 65535.00 FORMAT "%8.2" ECU_ADDRESS 0x600137BE /end MEASUREMENT
/begin MEASUREMENT DINH_stFId.FId_ComAirPThrUsSnsrErr "Inhibit Status of FIds / Status of function identifier FId_ComAirPThrUsSnsrErr" UWORD DFC_OneToOne 1 100 0.00 65535.00 FORMAT "%8.2" ECU_ADDRESS 0x600137C0 /end MEASUREMENT
/begin MEASUREMENT DINH_stFId.FId_ComAltFail "Inhibit Status of FIds / Status of function identifier FId_ComAltFail" UWORD DFC_OneToOne 1 100 0.00 65535.00 FORMAT "%8.2" ECU_ADDRESS 0x600137C2 /end MEASUREMENT
/begin MEASUREMENT DINH_stFId.FId_ComAppVehSnsrFailr "Inhibit Status of FIds / Status of function identifier FId_ComAppVehSnsrFailr" UWORD DFC_OneToOne 1 100 0.00 65535.00 FORMAT "%8.2" ECU_ADDRESS 0x600137C4 /end MEASUREMENT
/begin MEASUREMENT DINH_stFId.FId_ComBCM1 "Inhibit Status of FIds / Status of function identifier FId_ComBCM1" UWORD DFC_OneToOne 1 100 0.00 65535.00 FORMAT "%8.2" ECU_ADDRESS 0x600137C6 /end MEASUREMENT
/begin MEASUREMENT DINH_stFId.FId_ComBCM1Mon "Inhibit Status of FIds / Status of function identifier FId_ComBCM1Mon" UWORD DFC_OneToOne 1 100 0.00 65535.00 FORMAT "%8.2" ECU_ADDRESS 0x600137C8 /end MEASUREMENT
/begin MEASUREMENT DINH_stFId.FId_ComBCMUnitCfmdErr "Inhibit Status of FIds / Status of function identifier FId_ComBCMUnitCfmdErr" UWORD DFC_OneToOne 1 100 0.00 65535.00 FORMAT "%8.2" ECU_ADDRESS 0x600137CA /end MEASUREMENT
/begin MEASUREMENT DINH_stFId.FId_ComBCMUnitNotTstd "Inhibit Status of FIds / Status of function identifier FId_ComBCMUnitNotTstd" UWORD DFC_OneToOne 1 100 0.00 65535.00 FORMAT "%8.2" ECU_ADDRESS 0x600137CC /end MEASUREMENT
/begin MEASUREMENT DINH_stFId.FId_ComBstCtrl "Inhibit Status of FIds / Status of function identifier FId_ComBstCtrl" UWORD DFC_OneToOne 1 100 0.00 65535.00 FORMAT "%8.2" ECU_ADDRESS 0x600137CE /end MEASUREMENT
/begin MEASUREMENT DINH_stFId.FId_ComCANVEHICLEBusOff "Inhibit Status of FIds / Status of function identifier FId_ComCANVEHICLEBusOff" UWORD DFC_OneToOne 1 100 0.00 65535.00 FORMAT "%8.2" ECU_ADDRESS 0x600137D0 /end MEASUREMENT
/begin MEASUREMENT DINH_stFId.FId_ComCGW1 "Inhibit Status of FIds / Status of function identifier FId_ComCGW1" UWORD DFC_OneToOne 1 100 0.00 65535.00 FORMAT "%8.2" ECU_ADDRESS 0x600137D2 /end MEASUREMENT
/begin MEASUREMENT DINH_stFId.FId_ComCGW1Mon "Inhibit Status of FIds / Status of function identifier FId_ComCGW1Mon" UWORD DFC_OneToOne 1 100 0.00 65535.00 FORMAT "%8.2" ECU_ADDRESS 0x600137D4 /end MEASUREMENT
/begin MEASUREMENT DINH_stFId.FId_ComClthSt "Inhibit Status of FIds / Status of function identifier FId_ComClthSt" UWORD DFC_OneToOne 1 100 0.00 65535.00 FORMAT "%8.2" ECU_ADDRESS 0x600137D6 /end MEASUREMENT
/begin MEASUREMENT DINH_stFId.FId_ComConvClth "Inhibit Status of FIds / Status of function identifier FId_ComConvClth" UWORD DFC_OneToOne 1 100 0.00 65535.00 FORMAT "%8.2" ECU_ADDRESS 0x600137D8 /end MEASUREMENT
/begin MEASUREMENT DINH_stFId.FId_ComCrCtlReq "Inhibit Status of FIds / Status of function identifier FId_ComCrCtlReq" UWORD DFC_OneToOne 1 100 0.00 65535.00 FORMAT "%8.2" ECU_ADDRESS 0x600137DA /end MEASUREMENT
/begin MEASUREMENT DINH_stFId.FId_ComCrsMaiIndcnLampReq "Inhibit Status of FIds / Status of function identifier FId_ComCrsMaiIndcnLampReq" UWORD DFC_OneToOne 1 100 0.00 65535.00 FORMAT "%8.2" ECU_ADDRESS 0x600137DC /end MEASUREMENT
/begin MEASUREMENT DINH_stFId.FId_ComCrsSetIndcnLampReq "Inhibit Status of FIds / Status of function identifier FId_ComCrsSetIndcnLampReq" UWORD DFC_OneToOne 1 100 0.00 65535.00 FORMAT "%8.2" ECU_ADDRESS 0x600137DE /end MEASUREMENT
/begin MEASUREMENT DINH_stFId.FId_ComDCDCCdn "Inhibit Status of FIds / Status of function identifier FId_ComDCDCCdn" UWORD DFC_OneToOne 1 100 0.00 65535.00 FORMAT "%8.2" ECU_ADDRESS 0x600137E0 /end MEASUREMENT
/begin MEASUREMENT DINH_stFId.FId_ComDCDCErr "Inhibit Status of FIds / Status of function identifier FId_ComDCDCErr" UWORD DFC_OneToOne 1 100 0.00 65535.00 FORMAT "%8.2" ECU_ADDRESS 0x600137E2 /end MEASUREMENT
/begin MEASUREMENT DINH_stFId.FId_ComDesGearCurr "Inhibit Status of FIds / Status of function identifier FId_ComDesGearCurr" UWORD DFC_OneToOne 1 100 0.00 65535.00 FORMAT "%8.2" ECU_ADDRESS 0x600137E4 /end MEASUREMENT
/begin MEASUREMENT DINH_stFId.FId_ComDetrmAirM "Inhibit Status of FIds / Status of function identifier FId_ComDetrmAirM" UWORD DFC_OneToOne 1 100 0.00 65535.00 FORMAT "%8.2" ECU_ADDRESS 0x600137E6 /end MEASUREMENT
/begin MEASUREMENT DINH_stFId.FId_ComDwnShiftCtrlReq "Inhibit Status of FIds / Status of function identifier FId_ComDwnShiftCtrlReq" UWORD DFC_OneToOne 1 100 0.00 65535.00 FORMAT "%8.2" ECU_ADDRESS 0x600137E8 /end MEASUREMENT
/begin MEASUREMENT DINH_stFId.FId_ComEAT1 "Inhibit Status of FIds / Status of function identifier FId_ComEAT1" UWORD DFC_OneToOne 1 100 0.00 65535.00 FORMAT "%8.2" ECU_ADDRESS 0x600137EA /end MEASUREMENT
/begin MEASUREMENT DINH_stFId.FId_ComEAT10 "Inhibit Status of FIds / Status of function identifier FId_ComEAT10" UWORD DFC_OneToOne 1 100 0.00 65535.00 FORMAT "%8.2" ECU_ADDRESS 0x600137EC /end MEASUREMENT
/begin MEASUREMENT DINH_stFId.FId_ComEAT10Mon "Inhibit Status of FIds / Status of function identifier FId_ComEAT10Mon" UWORD DFC_OneToOne 1 100 0.00 65535.00 FORMAT "%8.2" ECU_ADDRESS 0x600137EE /end MEASUREMENT
/begin MEASUREMENT DINH_stFId.FId_ComEAT11 "Inhibit Status of FIds / Status of function identifier FId_ComEAT11" UWORD DFC_OneToOne 1 100 0.00 65535.00 FORMAT "%8.2" ECU_ADDRESS 0x600137F0 /end MEASUREMENT
/begin MEASUREMENT DINH_stFId.FId_ComEAT11Mon "Inhibit Status of FIds / Status of function identifier FId_ComEAT11Mon" UWORD DFC_OneToOne 1 100 0.00 65535.00 FORMAT "%8.2" ECU_ADDRESS 0x600137F2 /end MEASUREMENT
/begin MEASUREMENT DINH_stFId.FId_ComEAT12 "Inhibit Status of FIds / Status of function identifier FId_ComEAT12" UWORD DFC_OneToOne 1 100 0.00 65535.00 FORMAT "%8.2" ECU_ADDRESS 0x600137F4 /end MEASUREMENT
/begin MEASUREMENT DINH_stFId.FId_ComEAT12Mon "Inhibit Status of FIds / Status of function identifier FId_ComEAT12Mon" UWORD DFC_OneToOne 1 100 0.00 65535.00 FORMAT "%8.2" ECU_ADDRESS 0x600137F6 /end MEASUREMENT
/begin MEASUREMENT DINH_stFId.FId_ComEAT13 "Inhibit Status of FIds / Status of function identifier FId_ComEAT13" UWORD DFC_OneToOne 1 100 0.00 65535.00 FORMAT "%8.2" ECU_ADDRESS 0x600137F8 /end MEASUREMENT
/begin MEASUREMENT DINH_stFId.FId_ComEAT13Mon "Inhibit Status of FIds / Status of function identifier FId_ComEAT13Mon" UWORD DFC_OneToOne 1 100 0.00 65535.00 FORMAT "%8.2" ECU_ADDRESS 0x600137FA /end MEASUREMENT
/begin MEASUREMENT DINH_stFId.FId_ComEAT1Mon "Inhibit Status of FIds / Status of function identifier FId_ComEAT1Mon" UWORD DFC_OneToOne 1 100 0.00 65535.00 FORMAT "%8.2" ECU_ADDRESS 0x600137FC /end MEASUREMENT
/begin MEASUREMENT DINH_stFId.FId_ComEAT2 "Inhibit Status of FIds / Status of function identifier FId_ComEAT2" UWORD DFC_OneToOne 1 100 0.00 65535.00 FORMAT "%8.2" ECU_ADDRESS 0x600137FE /end MEASUREMENT
/begin MEASUREMENT DINH_stFId.FId_ComEAT2Mon "Inhibit Status of FIds / Status of function identifier FId_ComEAT2Mon" UWORD DFC_OneToOne 1 100 0.00 65535.00 FORMAT "%8.2" ECU_ADDRESS 0x60013800 /end MEASUREMENT
/begin MEASUREMENT DINH_stFId.FId_ComEAT4 "Inhibit Status of FIds / Status of function identifier FId_ComEAT4" UWORD DFC_OneToOne 1 100 0.00 65535.00 FORMAT "%8.2" ECU_ADDRESS 0x60013802 /end MEASUREMENT
/begin MEASUREMENT DINH_stFId.FId_ComEAT4Mon "Inhibit Status of FIds / Status of function identifier FId_ComEAT4Mon" UWORD DFC_OneToOne 1 100 0.00 65535.00 FORMAT "%8.2" ECU_ADDRESS 0x60013804 /end MEASUREMENT
/begin MEASUREMENT DINH_stFId.FId_ComEAT6 "Inhibit Status of FIds / Status of function identifier FId_ComEAT6" UWORD DFC_OneToOne 1 100 0.00 65535.00 FORMAT "%8.2" ECU_ADDRESS 0x60013806 /end MEASUREMENT
/begin MEASUREMENT DINH_stFId.FId_ComEAT6Mon "Inhibit Status of FIds / Status of function identifier FId_ComEAT6Mon" UWORD DFC_OneToOne 1 100 0.00 65535.00 FORMAT "%8.2" ECU_ADDRESS 0x60013808 /end MEASUREMENT
/begin MEASUREMENT DINH_stFId.FId_ComEAT7 "Inhibit Status of FIds / Status of function identifier FId_ComEAT7" UWORD DFC_OneToOne 1 100 0.00 65535.00 FORMAT "%8.2" ECU_ADDRESS 0x6001380A /end MEASUREMENT
/begin MEASUREMENT DINH_stFId.FId_ComEAT7Mon "Inhibit Status of FIds / Status of function identifier FId_ComEAT7Mon" UWORD DFC_OneToOne 1 100 0.00 65535.00 FORMAT "%8.2" ECU_ADDRESS 0x6001380C /end MEASUREMENT
/begin MEASUREMENT DINH_stFId.FId_ComEAT8 "Inhibit Status of FIds / Status of function identifier FId_ComEAT8" UWORD DFC_OneToOne 1 100 0.00 65535.00 FORMAT "%8.2" ECU_ADDRESS 0x6001380E /end MEASUREMENT
/begin MEASUREMENT DINH_stFId.FId_ComEAT8Mon "Inhibit Status of FIds / Status of function identifier FId_ComEAT8Mon" UWORD DFC_OneToOne 1 100 0.00 65535.00 FORMAT "%8.2" ECU_ADDRESS 0x60013810 /end MEASUREMENT
/begin MEASUREMENT DINH_stFId.FId_ComEATA "Inhibit Status of FIds / Status of function identifier FId_ComEATA" UWORD DFC_OneToOne 1 100 0.00 65535.00 FORMAT "%8.2" ECU_ADDRESS 0x60013812 /end MEASUREMENT
/begin MEASUREMENT DINH_stFId.FId_ComEATAMon "Inhibit Status of FIds / Status of function identifier FId_ComEATAMon" UWORD DFC_OneToOne 1 100 0.00 65535.00 FORMAT "%8.2" ECU_ADDRESS 0x60013814 /end MEASUREMENT
/begin MEASUREMENT DINH_stFId.FId_ComEATB "Inhibit Status of FIds / Status of function identifier FId_ComEATB" UWORD DFC_OneToOne 1 100 0.00 65535.00 FORMAT "%8.2" ECU_ADDRESS 0x60013816 /end MEASUREMENT
/begin MEASUREMENT DINH_stFId.FId_ComEATBMon "Inhibit Status of FIds / Status of function identifier FId_ComEATBMon" UWORD DFC_OneToOne 1 100 0.00 65535.00 FORMAT "%8.2" ECU_ADDRESS 0x60013818 /end MEASUREMENT
/begin MEASUREMENT DINH_stFId.FId_ComEATC "Inhibit Status of FIds / Status of function identifier FId_ComEATC" UWORD DFC_OneToOne 1 100 0.00 65535.00 FORMAT "%8.2" ECU_ADDRESS 0x6001381A /end MEASUREMENT
/begin MEASUREMENT DINH_stFId.FId_ComEATCMon "Inhibit Status of FIds / Status of function identifier FId_ComEATCMon" UWORD DFC_OneToOne 1 100 0.00 65535.00 FORMAT "%8.2" ECU_ADDRESS 0x6001381C /end MEASUREMENT
/begin MEASUREMENT DINH_stFId.FId_ComEBSSelfDiagErr "Inhibit Status of FIds / Status of function identifier FId_ComEBSSelfDiagErr" UWORD DFC_OneToOne 1 100 0.00 65535.00 FORMAT "%8.2" ECU_ADDRESS 0x6001381E /end MEASUREMENT
/begin MEASUREMENT DINH_stFId.FId_ComECUHwErr "Inhibit Status of FIds / Status of function identifier FId_ComECUHwErr" UWORD DFC_OneToOne 1 100 0.00 65535.00 FORMAT "%8.2" ECU_ADDRESS 0x60013820 /end MEASUREMENT
/begin MEASUREMENT DINH_stFId.FId_ComEGRVlvErr "Inhibit Status of FIds / Status of function identifier FId_ComEGRVlvErr" UWORD DFC_OneToOne 1 100 0.00 65535.00 FORMAT "%8.2" ECU_ADDRESS 0x60013822 /end MEASUREMENT
/begin MEASUREMENT DINH_stFId.FId_ComEMSIntAirTemp "Inhibit Status of FIds / Status of function identifier FId_ComEMSIntAirTemp" UWORD DFC_OneToOne 1 100 0.00 65535.00 FORMAT "%8.2" ECU_ADDRESS 0x60013824 /end MEASUREMENT
/begin MEASUREMENT DINH_stFId.FId_ComEPB "Inhibit Status of FIds / Status of function identifier FId_ComEPB" UWORD DFC_OneToOne 1 100 0.00 65535.00 FORMAT "%8.2" ECU_ADDRESS 0x60013826 /end MEASUREMENT
/begin MEASUREMENT DINH_stFId.FId_ComEPBB "Inhibit Status of FIds / Status of function identifier FId_ComEPBB" UWORD DFC_OneToOne 1 100 0.00 65535.00 FORMAT "%8.2" ECU_ADDRESS 0x60013828 /end MEASUREMENT
/begin MEASUREMENT DINH_stFId.FId_ComEPBBMon "Inhibit Status of FIds / Status of function identifier FId_ComEPBBMon" UWORD DFC_OneToOne 1 100 0.00 65535.00 FORMAT "%8.2" ECU_ADDRESS 0x6001382A /end MEASUREMENT
/begin MEASUREMENT DINH_stFId.FId_ComEPBMon "Inhibit Status of FIds / Status of function identifier FId_ComEPBMon" UWORD DFC_OneToOne 1 100 0.00 65535.00 FORMAT "%8.2" ECU_ADDRESS 0x6001382C /end MEASUREMENT
/begin MEASUREMENT DINH_stFId.FId_ComEPS1 "Inhibit Status of FIds / Status of function identifier FId_ComEPS1" UWORD DFC_OneToOne 1 100 0.00 65535.00 FORMAT "%8.2" ECU_ADDRESS 0x6001382E /end MEASUREMENT
/begin MEASUREMENT DINH_stFId.FId_ComEPS1Mon "Inhibit Status of FIds / Status of function identifier FId_ComEPS1Mon" UWORD DFC_OneToOne 1 100 0.00 65535.00 FORMAT "%8.2" ECU_ADDRESS 0x60013830 /end MEASUREMENT
/begin MEASUREMENT DINH_stFId.FId_ComEPSUnitCfmdErr "Inhibit Status of FIds / Status of function identifier FId_ComEPSUnitCfmdErr" UWORD DFC_OneToOne 1 100 0.00 65535.00 FORMAT "%8.2" ECU_ADDRESS 0x60013832 /end MEASUREMENT
/begin MEASUREMENT DINH_stFId.FId_ComEPSUnitNotTstd "Inhibit Status of FIds / Status of function identifier FId_ComEPSUnitNotTstd" UWORD DFC_OneToOne 1 100 0.00 65535.00 FORMAT "%8.2" ECU_ADDRESS 0x60013834 /end MEASUREMENT
/begin MEASUREMENT DINH_stFId.FId_ComEngBrkOvrdInfo "Inhibit Status of FIds / Status of function identifier FId_ComEngBrkOvrdInfo" UWORD DFC_OneToOne 1 100 0.00 65535.00 FORMAT "%8.2" ECU_ADDRESS 0x60013836 /end MEASUREMENT
/begin MEASUREMENT DINH_stFId.FId_ComEngBrkOvrdMtr "Inhibit Status of FIds / Status of function identifier FId_ComEngBrkOvrdMtr" UWORD DFC_OneToOne 1 100 0.00 65535.00 FORMAT "%8.2" ECU_ADDRESS 0x60013838 /end MEASUREMENT
/begin MEASUREMENT DINH_stFId.FId_ComEngBrkSwErr "Inhibit Status of FIds / Status of function identifier FId_ComEngBrkSwErr" UWORD DFC_OneToOne 1 100 0.00 65535.00 FORMAT "%8.2" ECU_ADDRESS 0x6001383A /end MEASUREMENT
/begin MEASUREMENT DINH_stFId.FId_ComEngPosng "Inhibit Status of FIds / Status of function identifier FId_ComEngPosng" UWORD DFC_OneToOne 1 100 0.00 65535.00 FORMAT "%8.2" ECU_ADDRESS 0x6001383C /end MEASUREMENT
/begin MEASUREMENT DINH_stFId.FId_ComEngRPMLim "Inhibit Status of FIds / Status of function identifier FId_ComEngRPMLim" UWORD DFC_OneToOne 1 100 0.00 65535.00 FORMAT "%8.2" ECU_ADDRESS 0x6001383E /end MEASUREMENT
/begin MEASUREMENT DINH_stFId.FId_ComEngTrqLim "Inhibit Status of FIds / Status of function identifier FId_ComEngTrqLim" UWORD DFC_OneToOne 1 100 0.00 65535.00 FORMAT "%8.2" ECU_ADDRESS 0x60013840 /end MEASUREMENT
/begin MEASUREMENT DINH_stFId.FId_ComEnvtlAirPSnsrErr "Inhibit Status of FIds / Status of function identifier FId_ComEnvtlAirPSnsrErr" UWORD DFC_OneToOne 1 100 0.00 65535.00 FORMAT "%8.2" ECU_ADDRESS 0x60013842 /end MEASUREMENT
/begin MEASUREMENT DINH_stFId.FId_ComEstmTqNormJdg "Inhibit Status of FIds / Status of function identifier FId_ComEstmTqNormJdg" UWORD DFC_OneToOne 1 100 0.00 65535.00 FORMAT "%8.2" ECU_ADDRESS 0x60013844 /end MEASUREMENT
/begin MEASUREMENT DINH_stFId.FId_ComEthnlSErr "Inhibit Status of FIds / Status of function identifier FId_ComEthnlSErr" UWORD DFC_OneToOne 1 100 0.00 65535.00 FORMAT "%8.2" ECU_ADDRESS 0x60013846 /end MEASUREMENT
/begin MEASUREMENT DINH_stFId.FId_ComFlSply "Inhibit Status of FIds / Status of function identifier FId_ComFlSply" UWORD DFC_OneToOne 1 100 0.00 65535.00 FORMAT "%8.2" ECU_ADDRESS 0x60013848 /end MEASUREMENT
/begin MEASUREMENT DINH_stFId.FId_ComFuCnsBitDurgIdleStop "Inhibit Status of FIds / Status of function identifier FId_ComFuCnsBitDurgIdleStop" UWORD DFC_OneToOne 1 100 0.00 65535.00 FORMAT "%8.2" ECU_ADDRESS 0x6001384A /end MEASUREMENT
/begin MEASUREMENT DINH_stFId.FId_ComGEVCntrl "Inhibit Status of FIds / Status of function identifier FId_ComGEVCntrl" UWORD DFC_OneToOne 1 100 0.00 65535.00 FORMAT "%8.2" ECU_ADDRESS 0x6001384C /end MEASUREMENT
/begin MEASUREMENT DINH_stFId.FId_ComGbxNPosFail "Inhibit Status of FIds / Status of function identifier FId_ComGbxNPosFail" UWORD DFC_OneToOne 1 100 0.00 65535.00 FORMAT "%8.2" ECU_ADDRESS 0x6001384E /end MEASUREMENT
/begin MEASUREMENT DINH_stFId.FId_ComGbxTemp "Inhibit Status of FIds / Status of function identifier FId_ComGbxTemp" UWORD DFC_OneToOne 1 100 0.00 65535.00 FORMAT "%8.2" ECU_ADDRESS 0x60013850 /end MEASUREMENT
/begin MEASUREMENT DINH_stFId.FId_ComGwIMG1 "Inhibit Status of FIds / Status of function identifier FId_ComGwIMG1" UWORD DFC_OneToOne 1 100 0.00 65535.00 FORMAT "%8.2" ECU_ADDRESS 0x60013852 /end MEASUREMENT
/begin MEASUREMENT DINH_stFId.FId_ComGwIMG1Mon "Inhibit Status of FIds / Status of function identifier FId_ComGwIMG1Mon" UWORD DFC_OneToOne 1 100 0.00 65535.00 FORMAT "%8.2" ECU_ADDRESS 0x60013854 /end MEASUREMENT
/begin MEASUREMENT DINH_stFId.FId_ComGwIMG3 "Inhibit Status of FIds / Status of function identifier FId_ComGwIMG3" UWORD DFC_OneToOne 1 100 0.00 65535.00 FORMAT "%8.2" ECU_ADDRESS 0x60013856 /end MEASUREMENT
/begin MEASUREMENT DINH_stFId.FId_ComGwIMG3Mon "Inhibit Status of FIds / Status of function identifier FId_ComGwIMG3Mon" UWORD DFC_OneToOne 1 100 0.00 65535.00 FORMAT "%8.2" ECU_ADDRESS 0x60013858 /end MEASUREMENT
/begin MEASUREMENT DINH_stFId.FId_ComGwIMG4 "Inhibit Status of FIds / Status of function identifier FId_ComGwIMG4" UWORD DFC_OneToOne 1 100 0.00 65535.00 FORMAT "%8.2" ECU_ADDRESS 0x6001385A /end MEASUREMENT
/begin MEASUREMENT DINH_stFId.FId_ComGwIMG4Mon "Inhibit Status of FIds / Status of function identifier FId_ComGwIMG4Mon" UWORD DFC_OneToOne 1 100 0.00 65535.00 FORMAT "%8.2" ECU_ADDRESS 0x6001385C /end MEASUREMENT
/begin MEASUREMENT DINH_stFId.FId_ComGwIMG5 "Inhibit Status of FIds / Status of function identifier FId_ComGwIMG5" UWORD DFC_OneToOne 1 100 0.00 65535.00 FORMAT "%8.2" ECU_ADDRESS 0x6001385E /end MEASUREMENT
/begin MEASUREMENT DINH_stFId.FId_ComGwIMG5Mon "Inhibit Status of FIds / Status of function identifier FId_ComGwIMG5Mon" UWORD DFC_OneToOne 1 100 0.00 65535.00 FORMAT "%8.2" ECU_ADDRESS 0x60013860 /end MEASUREMENT
/begin MEASUREMENT DINH_stFId.FId_ComGwIMG6 "Inhibit Status of FIds / Status of function identifier FId_ComGwIMG6" UWORD DFC_OneToOne 1 100 0.00 65535.00 FORMAT "%8.2" ECU_ADDRESS 0x60013862 /end MEASUREMENT
/begin MEASUREMENT DINH_stFId.FId_ComGwIMG6Mon "Inhibit Status of FIds / Status of function identifier FId_ComGwIMG6Mon" UWORD DFC_OneToOne 1 100 0.00 65535.00 FORMAT "%8.2" ECU_ADDRESS 0x60013864 /end MEASUREMENT
/begin MEASUREMENT DINH_stFId.FId_ComHFMSnsrErr "Inhibit Status of FIds / Status of function identifier FId_ComHFMSnsrErr" UWORD DFC_OneToOne 1 100 0.00 65535.00 FORMAT "%8.2" ECU_ADDRESS 0x60013866 /end MEASUREMENT
/begin MEASUREMENT DINH_stFId.FId_ComIDASB "Inhibit Status of FIds / Status of function identifier FId_ComIDASB" UWORD DFC_OneToOne 1 100 0.00 65535.00 FORMAT "%8.2" ECU_ADDRESS 0x60013868 /end MEASUREMENT
/begin MEASUREMENT DINH_stFId.FId_ComIDASBMon "Inhibit Status of FIds / Status of function identifier FId_ComIDASBMon" UWORD DFC_OneToOne 1 100 0.00 65535.00 FORMAT "%8.2" ECU_ADDRESS 0x6001386A /end MEASUREMENT
/begin MEASUREMENT DINH_stFId.FId_ComIDASBUnitCfmdErr "Inhibit Status of FIds / Status of function identifier FId_ComIDASBUnitCfmdErr" UWORD DFC_OneToOne 1 100 0.00 65535.00 FORMAT "%8.2" ECU_ADDRESS 0x6001386C /end MEASUREMENT
/begin MEASUREMENT DINH_stFId.FId_ComIDASBUnitNotTstd "Inhibit Status of FIds / Status of function identifier FId_ComIDASBUnitNotTstd" UWORD DFC_OneToOne 1 100 0.00 65535.00 FORMAT "%8.2" ECU_ADDRESS 0x6001386E /end MEASUREMENT
/begin MEASUREMENT DINH_stFId.FId_ComIDASEngFail "Inhibit Status of FIds / Status of function identifier FId_ComIDASEngFail" UWORD DFC_OneToOne 1 100 0.00 65535.00 FORMAT "%8.2" ECU_ADDRESS 0x60013870 /end MEASUREMENT
/begin MEASUREMENT DINH_stFId.FId_ComIDASEngFailMil "Inhibit Status of FIds / Status of function identifier FId_ComIDASEngFailMil" UWORD DFC_OneToOne 1 100 0.00 65535.00 FORMAT "%8.2" ECU_ADDRESS 0x60013872 /end MEASUREMENT
/begin MEASUREMENT DINH_stFId.FId_ComIMGUnitCfmdErr "Inhibit Status of FIds / Status of function identifier FId_ComIMGUnitCfmdErr" UWORD DFC_OneToOne 1 100 0.00 65535.00 FORMAT "%8.2" ECU_ADDRESS 0x60013874 /end MEASUREMENT
/begin MEASUREMENT DINH_stFId.FId_ComIMGUnitNotTstd "Inhibit Status of FIds / Status of function identifier FId_ComIMGUnitNotTstd" UWORD DFC_OneToOne 1 100 0.00 65535.00 FORMAT "%8.2" ECU_ADDRESS 0x60013876 /end MEASUREMENT
/begin MEASUREMENT DINH_stFId.FId_ComISG2 "Inhibit Status of FIds / Status of function identifier FId_ComISG2" UWORD DFC_OneToOne 1 100 0.00 65535.00 FORMAT "%8.2" ECU_ADDRESS 0x60013878 /end MEASUREMENT
/begin MEASUREMENT DINH_stFId.FId_ComIgnCtrl "Inhibit Status of FIds / Status of function identifier FId_ComIgnCtrl" UWORD DFC_OneToOne 1 100 0.00 65535.00 FORMAT "%8.2" ECU_ADDRESS 0x6001387A /end MEASUREMENT
/begin MEASUREMENT DINH_stFId.FId_ComInjCtrl "Inhibit Status of FIds / Status of function identifier FId_ComInjCtrl" UWORD DFC_OneToOne 1 100 0.00 65535.00 FORMAT "%8.2" ECU_ADDRESS 0x6001387C /end MEASUREMENT
/begin MEASUREMENT DINH_stFId.FId_ComIntkAirPSnsrErr "Inhibit Status of FIds / Status of function identifier FId_ComIntkAirPSnsrErr" UWORD DFC_OneToOne 1 100 0.00 65535.00 FORMAT "%8.2" ECU_ADDRESS 0x6001387E /end MEASUREMENT
/begin MEASUREMENT DINH_stFId.FId_ComLamCtrl "Inhibit Status of FIds / Status of function identifier FId_ComLamCtrl" UWORD DFC_OneToOne 1 100 0.00 65535.00 FORMAT "%8.2" ECU_ADDRESS 0x60013880 /end MEASUREMENT
/begin MEASUREMENT DINH_stFId.FId_ComMETA "Inhibit Status of FIds / Status of function identifier FId_ComMETA" UWORD DFC_OneToOne 1 100 0.00 65535.00 FORMAT "%8.2" ECU_ADDRESS 0x60013882 /end MEASUREMENT
/begin MEASUREMENT DINH_stFId.FId_ComMETAMon "Inhibit Status of FIds / Status of function identifier FId_ComMETAMon" UWORD DFC_OneToOne 1 100 0.00 65535.00 FORMAT "%8.2" ECU_ADDRESS 0x60013884 /end MEASUREMENT
/begin MEASUREMENT DINH_stFId.FId_ComMETC "Inhibit Status of FIds / Status of function identifier FId_ComMETC" UWORD DFC_OneToOne 1 100 0.00 65535.00 FORMAT "%8.2" ECU_ADDRESS 0x60013886 /end MEASUREMENT
/begin MEASUREMENT DINH_stFId.FId_ComMETCMon "Inhibit Status of FIds / Status of function identifier FId_ComMETCMon" UWORD DFC_OneToOne 1 100 0.00 65535.00 FORMAT "%8.2" ECU_ADDRESS 0x60013888 /end MEASUREMENT
/begin MEASUREMENT DINH_stFId.FId_ComMETD "Inhibit Status of FIds / Status of function identifier FId_ComMETD" UWORD DFC_OneToOne 1 100 0.00 65535.00 FORMAT "%8.2" ECU_ADDRESS 0x6001388A /end MEASUREMENT
/begin MEASUREMENT DINH_stFId.FId_ComMETDMon "Inhibit Status of FIds / Status of function identifier FId_ComMETDMon" UWORD DFC_OneToOne 1 100 0.00 65535.00 FORMAT "%8.2" ECU_ADDRESS 0x6001388C /end MEASUREMENT
/begin MEASUREMENT DINH_stFId.FId_ComMETE2 "Inhibit Status of FIds / Status of function identifier FId_ComMETE2" UWORD DFC_OneToOne 1 100 0.00 65535.00 FORMAT "%8.2" ECU_ADDRESS 0x6001388E /end MEASUREMENT
/begin MEASUREMENT DINH_stFId.FId_ComMETE2Mon "Inhibit Status of FIds / Status of function identifier FId_ComMETE2Mon" UWORD DFC_OneToOne 1 100 0.00 65535.00 FORMAT "%8.2" ECU_ADDRESS 0x60013890 /end MEASUREMENT
/begin MEASUREMENT DINH_stFId.FId_ComMETF "Inhibit Status of FIds / Status of function identifier FId_ComMETF" UWORD DFC_OneToOne 1 100 0.00 65535.00 FORMAT "%8.2" ECU_ADDRESS 0x60013892 /end MEASUREMENT
/begin MEASUREMENT DINH_stFId.FId_ComMETFMon "Inhibit Status of FIds / Status of function identifier FId_ComMETFMon" UWORD DFC_OneToOne 1 100 0.00 65535.00 FORMAT "%8.2" ECU_ADDRESS 0x60013894 /end MEASUREMENT
/begin MEASUREMENT DINH_stFId.FId_ComMETG "Inhibit Status of FIds / Status of function identifier FId_ComMETG" UWORD DFC_OneToOne 1 100 0.00 65535.00 FORMAT "%8.2" ECU_ADDRESS 0x60013896 /end MEASUREMENT
/begin MEASUREMENT DINH_stFId.FId_ComMETGMon "Inhibit Status of FIds / Status of function identifier FId_ComMETGMon" UWORD DFC_OneToOne 1 100 0.00 65535.00 FORMAT "%8.2" ECU_ADDRESS 0x60013898 /end MEASUREMENT
/begin MEASUREMENT DINH_stFId.FId_ComMETH "Inhibit Status of FIds / Status of function identifier FId_ComMETH" UWORD DFC_OneToOne 1 100 0.00 65535.00 FORMAT "%8.2" ECU_ADDRESS 0x6001389A /end MEASUREMENT
/begin MEASUREMENT DINH_stFId.FId_ComMETH2 "Inhibit Status of FIds / Status of function identifier FId_ComMETH2" UWORD DFC_OneToOne 1 100 0.00 65535.00 FORMAT "%8.2" ECU_ADDRESS 0x6001389C /end MEASUREMENT
/begin MEASUREMENT DINH_stFId.FId_ComMETH2Mon "Inhibit Status of FIds / Status of function identifier FId_ComMETH2Mon" UWORD DFC_OneToOne 1 100 0.00 65535.00 FORMAT "%8.2" ECU_ADDRESS 0x6001389E /end MEASUREMENT
/begin MEASUREMENT DINH_stFId.FId_ComMETHMon "Inhibit Status of FIds / Status of function identifier FId_ComMETHMon" UWORD DFC_OneToOne 1 100 0.00 65535.00 FORMAT "%8.2" ECU_ADDRESS 0x600138A0 /end MEASUREMENT
/begin MEASUREMENT DINH_stFId.FId_ComMETI "Inhibit Status of FIds / Status of function identifier FId_ComMETI" UWORD DFC_OneToOne 1 100 0.00 65535.00 FORMAT "%8.2" ECU_ADDRESS 0x600138A2 /end MEASUREMENT
/begin MEASUREMENT DINH_stFId.FId_ComMETIMon "Inhibit Status of FIds / Status of function identifier FId_ComMETIMon" UWORD DFC_OneToOne 1 100 0.00 65535.00 FORMAT "%8.2" ECU_ADDRESS 0x600138A4 /end MEASUREMENT
/begin MEASUREMENT DINH_stFId.FId_ComMETK "Inhibit Status of FIds / Status of function identifier FId_ComMETK" UWORD DFC_OneToOne 1 100 0.00 65535.00 FORMAT "%8.2" ECU_ADDRESS 0x600138A6 /end MEASUREMENT
/begin MEASUREMENT DINH_stFId.FId_ComMETKMon "Inhibit Status of FIds / Status of function identifier FId_ComMETKMon" UWORD DFC_OneToOne 1 100 0.00 65535.00 FORMAT "%8.2" ECU_ADDRESS 0x600138A8 /end MEASUREMENT
/begin MEASUREMENT DINH_stFId.FId_ComMETL "Inhibit Status of FIds / Status of function identifier FId_ComMETL" UWORD DFC_OneToOne 1 100 0.00 65535.00 FORMAT "%8.2" ECU_ADDRESS 0x600138AA /end MEASUREMENT
/begin MEASUREMENT DINH_stFId.FId_ComMETLMon "Inhibit Status of FIds / Status of function identifier FId_ComMETLMon" UWORD DFC_OneToOne 1 100 0.00 65535.00 FORMAT "%8.2" ECU_ADDRESS 0x600138AC /end MEASUREMENT
/begin MEASUREMENT DINH_stFId.FId_ComMETM "Inhibit Status of FIds / Status of function identifier FId_ComMETM" UWORD DFC_OneToOne 1 100 0.00 65535.00 FORMAT "%8.2" ECU_ADDRESS 0x600138AE /end MEASUREMENT
/begin MEASUREMENT DINH_stFId.FId_ComMETMMon "Inhibit Status of FIds / Status of function identifier FId_ComMETMMon" UWORD DFC_OneToOne 1 100 0.00 65535.00 FORMAT "%8.2" ECU_ADDRESS 0x600138B0 /end MEASUREMENT
/begin MEASUREMENT DINH_stFId.FId_ComMETN "Inhibit Status of FIds / Status of function identifier FId_ComMETN" UWORD DFC_OneToOne 1 100 0.00 65535.00 FORMAT "%8.2" ECU_ADDRESS 0x600138B2 /end MEASUREMENT
/begin MEASUREMENT DINH_stFId.FId_ComMETNMon "Inhibit Status of FIds / Status of function identifier FId_ComMETNMon" UWORD DFC_OneToOne 1 100 0.00 65535.00 FORMAT "%8.2" ECU_ADDRESS 0x600138B4 /end MEASUREMENT
/begin MEASUREMENT DINH_stFId.FId_ComMETUnitCfmdErr "Inhibit Status of FIds / Status of function identifier FId_ComMETUnitCfmdErr" UWORD DFC_OneToOne 1 100 0.00 65535.00 FORMAT "%8.2" ECU_ADDRESS 0x600138B6 /end MEASUREMENT
/begin MEASUREMENT DINH_stFId.FId_ComMETUnitNotTstd "Inhibit Status of FIds / Status of function identifier FId_ComMETUnitNotTstd" UWORD DFC_OneToOne 1 100 0.00 65535.00 FORMAT "%8.2" ECU_ADDRESS 0x600138B8 /end MEASUREMENT
/begin MEASUREMENT DINH_stFId.FId_ComMisf "Inhibit Status of FIds / Status of function identifier FId_ComMisf" UWORD DFC_OneToOne 1 100 0.00 65535.00 FORMAT "%8.2" ECU_ADDRESS 0x600138BA /end MEASUREMENT
/begin MEASUREMENT DINH_stFId.FId_ComMon "Inhibit Status of FIds / Status of function identifier FId_ComMon" UWORD DFC_OneToOne 1 100 0.00 65535.00 FORMAT "%8.2" ECU_ADDRESS 0x600138BC /end MEASUREMENT
/begin MEASUREMENT DINH_stFId.FId_ComNTrbn "Inhibit Status of FIds / Status of function identifier FId_ComNTrbn" UWORD DFC_OneToOne 1 100 0.00 65535.00 FORMAT "%8.2" ECU_ADDRESS 0x600138BE /end MEASUREMENT
/begin MEASUREMENT DINH_stFId.FId_ComODOff "Inhibit Status of FIds / Status of function identifier FId_ComODOff" UWORD DFC_OneToOne 1 100 0.00 65535.00 FORMAT "%8.2" ECU_ADDRESS 0x600138C0 /end MEASUREMENT
/begin MEASUREMENT DINH_stFId.FId_ComOilLvlLamp "Inhibit Status of FIds / Status of function identifier FId_ComOilLvlLamp" UWORD DFC_OneToOne 1 100 0.00 65535.00 FORMAT "%8.2" ECU_ADDRESS 0x600138C2 /end MEASUREMENT
/begin MEASUREMENT DINH_stFId.FId_ComOilPWarnLamp "Inhibit Status of FIds / Status of function identifier FId_ComOilPWarnLamp" UWORD DFC_OneToOne 1 100 0.00 65535.00 FORMAT "%8.2" ECU_ADDRESS 0x600138C4 /end MEASUREMENT
/begin MEASUREMENT DINH_stFId.FId_ComPASensFail "Inhibit Status of FIds / Status of function identifier FId_ComPASensFail" UWORD DFC_OneToOne 1 100 0.00 65535.00 FORMAT "%8.2" ECU_ADDRESS 0x600138C6 /end MEASUREMENT
/begin MEASUREMENT DINH_stFId.FId_ComPBSensFail "Inhibit Status of FIds / Status of function identifier FId_ComPBSensFail" UWORD DFC_OneToOne 1 100 0.00 65535.00 FORMAT "%8.2" ECU_ADDRESS 0x600138C8 /end MEASUREMENT
/begin MEASUREMENT DINH_stFId.FId_ComPCU "Inhibit Status of FIds / Status of function identifier FId_ComPCU" UWORD DFC_OneToOne 1 100 0.00 65535.00 FORMAT "%8.2" ECU_ADDRESS 0x600138CA /end MEASUREMENT
/begin MEASUREMENT DINH_stFId.FId_ComPCUMon "Inhibit Status of FIds / Status of function identifier FId_ComPCUMon" UWORD DFC_OneToOne 1 100 0.00 65535.00 FORMAT "%8.2" ECU_ADDRESS 0x600138CC /end MEASUREMENT
/begin MEASUREMENT DINH_stFId.FId_ComPosActnSpdLimrFctReq "Inhibit Status of FIds / Status of function identifier FId_ComPosActnSpdLimrFctReq" UWORD DFC_OneToOne 1 100 0.00 65535.00 FORMAT "%8.2" ECU_ADDRESS 0x600138CE /end MEASUREMENT
/begin MEASUREMENT DINH_stFId.FId_ComSRS "Inhibit Status of FIds / Status of function identifier FId_ComSRS" UWORD DFC_OneToOne 1 100 0.00 65535.00 FORMAT "%8.2" ECU_ADDRESS 0x600138D0 /end MEASUREMENT
/begin MEASUREMENT DINH_stFId.FId_ComSRSA "Inhibit Status of FIds / Status of function identifier FId_ComSRSA" UWORD DFC_OneToOne 1 100 0.00 65535.00 FORMAT "%8.2" ECU_ADDRESS 0x600138D2 /end MEASUREMENT
/begin MEASUREMENT DINH_stFId.FId_ComSRSAMon "Inhibit Status of FIds / Status of function identifier FId_ComSRSAMon" UWORD DFC_OneToOne 1 100 0.00 65535.00 FORMAT "%8.2" ECU_ADDRESS 0x600138D4 /end MEASUREMENT
/begin MEASUREMENT DINH_stFId.FId_ComSRSB "Inhibit Status of FIds / Status of function identifier FId_ComSRSB" UWORD DFC_OneToOne 1 100 0.00 65535.00 FORMAT "%8.2" ECU_ADDRESS 0x600138D6 /end MEASUREMENT
/begin MEASUREMENT DINH_stFId.FId_ComSRSBMon "Inhibit Status of FIds / Status of function identifier FId_ComSRSBMon" UWORD DFC_OneToOne 1 100 0.00 65535.00 FORMAT "%8.2" ECU_ADDRESS 0x600138D8 /end MEASUREMENT
/begin MEASUREMENT DINH_stFId.FId_ComSRSMon "Inhibit Status of FIds / Status of function identifier FId_ComSRSMon" UWORD DFC_OneToOne 1 100 0.00 65535.00 FORMAT "%8.2" ECU_ADDRESS 0x600138DA /end MEASUREMENT
/begin MEASUREMENT DINH_stFId.FId_ComSRSUnitCfmdErr "Inhibit Status of FIds / Status of function identifier FId_ComSRSUnitCfmdErr" UWORD DFC_OneToOne 1 100 0.00 65535.00 FORMAT "%8.2" ECU_ADDRESS 0x600138DC /end MEASUREMENT
/begin MEASUREMENT DINH_stFId.FId_ComSRSUnitNotTstd "Inhibit Status of FIds / Status of function identifier FId_ComSRSUnitNotTstd" UWORD DFC_OneToOne 1 100 0.00 65535.00 FORMAT "%8.2" ECU_ADDRESS 0x600138DE /end MEASUREMENT
/begin MEASUREMENT DINH_stFId.FId_ComSTFlt "Inhibit Status of FIds / Status of function identifier FId_ComSTFlt" UWORD DFC_OneToOne 1 100 0.00 65535.00 FORMAT "%8.2" ECU_ADDRESS 0x600138E0 /end MEASUREMENT
/begin MEASUREMENT DINH_stFId.FId_ComSpdLimrDevActvn "Inhibit Status of FIds / Status of function identifier FId_ComSpdLimrDevActvn" UWORD DFC_OneToOne 1 100 0.00 65535.00 FORMAT "%8.2" ECU_ADDRESS 0x600138E2 /end MEASUREMENT
/begin MEASUREMENT DINH_stFId.FId_ComTCU01 "Inhibit Status of FIds / Status of function identifier FId_ComTCU01" UWORD DFC_OneToOne 1 100 0.00 65535.00 FORMAT "%8.2" ECU_ADDRESS 0x600138E4 /end MEASUREMENT
/begin MEASUREMENT DINH_stFId.FId_ComTCU02 "Inhibit Status of FIds / Status of function identifier FId_ComTCU02" UWORD DFC_OneToOne 1 100 0.00 65535.00 FORMAT "%8.2" ECU_ADDRESS 0x600138E6 /end MEASUREMENT
/begin MEASUREMENT DINH_stFId.FId_ComTCU1 "Inhibit Status of FIds / Status of function identifier FId_ComTCU1" UWORD DFC_OneToOne 1 100 0.00 65535.00 FORMAT "%8.2" ECU_ADDRESS 0x600138E8 /end MEASUREMENT
/begin MEASUREMENT DINH_stFId.FId_ComTCU11 "Inhibit Status of FIds / Status of function identifier FId_ComTCU11" UWORD DFC_OneToOne 1 100 0.00 65535.00 FORMAT "%8.2" ECU_ADDRESS 0x600138EA /end MEASUREMENT
/begin MEASUREMENT DINH_stFId.FId_ComTCU12 "Inhibit Status of FIds / Status of function identifier FId_ComTCU12" UWORD DFC_OneToOne 1 100 0.00 65535.00 FORMAT "%8.2" ECU_ADDRESS 0x600138EC /end MEASUREMENT
/begin MEASUREMENT DINH_stFId.FId_ComTCU13 "Inhibit Status of FIds / Status of function identifier FId_ComTCU13" UWORD DFC_OneToOne 1 100 0.00 65535.00 FORMAT "%8.2" ECU_ADDRESS 0x600138EE /end MEASUREMENT
/begin MEASUREMENT DINH_stFId.FId_ComTCU14 "Inhibit Status of FIds / Status of function identifier FId_ComTCU14" UWORD DFC_OneToOne 1 100 0.00 65535.00 FORMAT "%8.2" ECU_ADDRESS 0x600138F0 /end MEASUREMENT
/begin MEASUREMENT DINH_stFId.FId_ComTCU2 "Inhibit Status of FIds / Status of function identifier FId_ComTCU2" UWORD DFC_OneToOne 1 100 0.00 65535.00 FORMAT "%8.2" ECU_ADDRESS 0x600138F2 /end MEASUREMENT
/begin MEASUREMENT DINH_stFId.FId_ComTCU3 "Inhibit Status of FIds / Status of function identifier FId_ComTCU3" UWORD DFC_OneToOne 1 100 0.00 65535.00 FORMAT "%8.2" ECU_ADDRESS 0x600138F4 /end MEASUREMENT
/begin MEASUREMENT DINH_stFId.FId_ComTCU4 "Inhibit Status of FIds / Status of function identifier FId_ComTCU4" UWORD DFC_OneToOne 1 100 0.00 65535.00 FORMAT "%8.2" ECU_ADDRESS 0x600138F6 /end MEASUREMENT
/begin MEASUREMENT DINH_stFId.FId_ComTCUGear "Inhibit Status of FIds / Status of function identifier FId_ComTCUGear" UWORD DFC_OneToOne 1 100 0.00 65535.00 FORMAT "%8.2" ECU_ADDRESS 0x600138F8 /end MEASUREMENT
/begin MEASUREMENT DINH_stFId.FId_ComTarGearDwnShift "Inhibit Status of FIds / Status of function identifier FId_ComTarGearDwnShift" UWORD DFC_OneToOne 1 100 0.00 65535.00 FORMAT "%8.2" ECU_ADDRESS 0x600138FA /end MEASUREMENT
/begin MEASUREMENT DINH_stFId.FId_ComTarGearUpShift "Inhibit Status of FIds / Status of function identifier FId_ComTarGearUpShift" UWORD DFC_OneToOne 1 100 0.00 65535.00 FORMAT "%8.2" ECU_ADDRESS 0x600138FC /end MEASUREMENT
/begin MEASUREMENT DINH_stFId.FId_ComThrPosnFail "Inhibit Status of FIds / Status of function identifier FId_ComThrPosnFail" UWORD DFC_OneToOne 1 100 0.00 65535.00 FORMAT "%8.2" ECU_ADDRESS 0x600138FE /end MEASUREMENT
/begin MEASUREMENT DINH_stFId.FId_ComThrVlv "Inhibit Status of FIds / Status of function identifier FId_ComThrVlv" UWORD DFC_OneToOne 1 100 0.00 65535.00 FORMAT "%8.2" ECU_ADDRESS 0x60013900 /end MEASUREMENT
/begin MEASUREMENT DINH_stFId.FId_ComTrboChrgnErr "Inhibit Status of FIds / Status of function identifier FId_ComTrboChrgnErr" UWORD DFC_OneToOne 1 100 0.00 65535.00 FORMAT "%8.2" ECU_ADDRESS 0x60013902 /end MEASUREMENT
/begin MEASUREMENT DINH_stFId.FId_ComTrqAccuracySlow "Inhibit Status of FIds / Status of function identifier FId_ComTrqAccuracySlow" UWORD DFC_OneToOne 1 100 0.00 65535.00 FORMAT "%8.2" ECU_ADDRESS 0x60013904 /end MEASUREMENT
/begin MEASUREMENT DINH_stFId.FId_ComTrqReqFast "Inhibit Status of FIds / Status of function identifier FId_ComTrqReqFast" UWORD DFC_OneToOne 1 100 0.00 65535.00 FORMAT "%8.2" ECU_ADDRESS 0x60013906 /end MEASUREMENT
/begin MEASUREMENT DINH_stFId.FId_ComTrqReqSlow "Inhibit Status of FIds / Status of function identifier FId_ComTrqReqSlow" UWORD DFC_OneToOne 1 100 0.00 65535.00 FORMAT "%8.2" ECU_ADDRESS 0x60013908 /end MEASUREMENT
/begin MEASUREMENT DINH_stFId.FId_ComVSAErr "Inhibit Status of FIds / Status of function identifier FId_ComVSAErr" UWORD DFC_OneToOne 1 100 0.00 65535.00 FORMAT "%8.2" ECU_ADDRESS 0x6001390A /end MEASUREMENT
/begin MEASUREMENT DINH_stFId.FId_ComVSAUnitCfmdErr "Inhibit Status of FIds / Status of function identifier FId_ComVSAUnitCfmdErr" UWORD DFC_OneToOne 1 100 0.00 65535.00 FORMAT "%8.2" ECU_ADDRESS 0x6001390C /end MEASUREMENT
/begin MEASUREMENT DINH_stFId.FId_ComVSAUnitNotTstd "Inhibit Status of FIds / Status of function identifier FId_ComVSAUnitNotTstd" UWORD DFC_OneToOne 1 100 0.00 65535.00 FORMAT "%8.2" ECU_ADDRESS 0x6001390E /end MEASUREMENT
/begin MEASUREMENT DINH_stFId.FId_ComVehSpdFlLvl "Inhibit Status of FIds / Status of function identifier FId_ComVehSpdFlLvl" UWORD DFC_OneToOne 1 100 0.00 65535.00 FORMAT "%8.2" ECU_ADDRESS 0x60013910 /end MEASUREMENT
/begin MEASUREMENT DINH_stFId.FId_ComVehSpdFltChk "Inhibit Status of FIds / Status of function identifier FId_ComVehSpdFltChk" UWORD DFC_OneToOne 1 100 0.00 65535.00 FORMAT "%8.2" ECU_ADDRESS 0x60013912 /end MEASUREMENT
/begin MEASUREMENT DINH_stFId.FId_ComVehSpdImpsErr "Inhibit Status of FIds / Status of function identifier FId_ComVehSpdImpsErr" UWORD DFC_OneToOne 1 100 0.00 65535.00 FORMAT "%8.2" ECU_ADDRESS 0x60013914 /end MEASUREMENT
/begin MEASUREMENT DINH_stFId.FId_ComVlvLftCtrl "Inhibit Status of FIds / Status of function identifier FId_ComVlvLftCtrl" UWORD DFC_OneToOne 1 100 0.00 65535.00 FORMAT "%8.2" ECU_ADDRESS 0x60013916 /end MEASUREMENT
/begin MEASUREMENT DINH_stFId.FId_ComvolEng "Inhibit Status of FIds / Status of function identifier FId_ComvolEng" UWORD DFC_OneToOne 1 100 0.00 65535.00 FORMAT "%8.2" ECU_ADDRESS 0x60013918 /end MEASUREMENT
/begin MEASUREMENT DINH_stFId.FId_ConvLdCalcLvrPos "Inhibit Status of FIds / Status of function identifier FId_ConvLdCalcLvrPos" UWORD DFC_OneToOne 1 100 0.00 65535.00 FORMAT "%8.2" ECU_ADDRESS 0x6001391A /end MEASUREMENT
/begin MEASUREMENT DINH_stFId.FId_ConvLdNTrbnCan "Inhibit Status of FIds / Status of function identifier FId_ConvLdNTrbnCan" UWORD DFC_OneToOne 1 100 0.00 65535.00 FORMAT "%8.2" ECU_ADDRESS 0x6001391C /end MEASUREMENT
/begin MEASUREMENT DINH_stFId.FId_ConvLdOilCoolrPmp "Inhibit Status of FIds / Status of function identifier FId_ConvLdOilCoolrPmp" UWORD DFC_OneToOne 1 100 0.00 65535.00 FORMAT "%8.2" ECU_ADDRESS 0x6001391E /end MEASUREMENT
/begin MEASUREMENT DINH_stFId.FId_ConvLdOilTemp "Inhibit Status of FIds / Status of function identifier FId_ConvLdOilTemp" UWORD DFC_OneToOne 1 100 0.00 65535.00 FORMAT "%8.2" ECU_ADDRESS 0x60013920 /end MEASUREMENT
/begin MEASUREMENT DINH_stFId.FId_ConvLdTrqLdCan "Inhibit Status of FIds / Status of function identifier FId_ConvLdTrqLdCan" UWORD DFC_OneToOne 1 100 0.00 65535.00 FORMAT "%8.2" ECU_ADDRESS 0x60013922 /end MEASUREMENT
/begin MEASUREMENT DINH_stFId.FId_ConvLdVel "Inhibit Status of FIds / Status of function identifier FId_ConvLdVel" UWORD DFC_OneToOne 1 100 0.00 65535.00 FORMAT "%8.2" ECU_ADDRESS 0x60013924 /end MEASUREMENT
/begin MEASUREMENT DINH_stFId.FId_CooltTVldyTMdl "Inhibit Status of FIds / Status of function identifier FId_CooltTVldyTMdl" UWORD DFC_OneToOne 1 100 0.00 65535.00 FORMAT "%8.2" ECU_ADDRESS 0x60013926 /end MEASUREMENT
/begin MEASUREMENT DINH_stFId.FId_CptProtnCamsft "Inhibit Status of FIds / Status of function identifier FId_CptProtnCamsft" UWORD DFC_OneToOne 1 100 0.00 65535.00 FORMAT "%8.2" ECU_ADDRESS 0x60013928 /end MEASUREMENT
/begin MEASUREMENT DINH_stFId.FId_CptProtnExhTempMdl "Inhibit Status of FIds / Status of function identifier FId_CptProtnExhTempMdl" UWORD DFC_OneToOne 1 100 0.00 65535.00 FORMAT "%8.2" ECU_ADDRESS 0x6001392A /end MEASUREMENT
/begin MEASUREMENT DINH_stFId.FId_CptProtnO2SnsrB1 "Inhibit Status of FIds / Status of function identifier FId_CptProtnO2SnsrB1" UWORD DFC_OneToOne 1 100 0.00 65535.00 FORMAT "%8.2" ECU_ADDRESS 0x6001392C /end MEASUREMENT
/begin MEASUREMENT DINH_stFId.FId_CptProtnVVeh "Inhibit Status of FIds / Status of function identifier FId_CptProtnVVeh" UWORD DFC_OneToOne 1 100 0.00 65535.00 FORMAT "%8.2" ECU_ADDRESS 0x6001392E /end MEASUREMENT
/begin MEASUREMENT DINH_stFId.FId_CrCUI1EFRxErr "Inhibit Status of FIds / Status of function identifier FId_CrCUI1EFRxErr" UWORD DFC_OneToOne 1 100 0.00 65535.00 FORMAT "%8.2" ECU_ADDRESS 0x60013930 /end MEASUREMENT
/begin MEASUREMENT DINH_stFId.FId_CrCUICANRxErr "Inhibit Status of FIds / Status of function identifier FId_CrCUICANRxErr" UWORD DFC_OneToOne 1 100 0.00 65535.00 FORMAT "%8.2" ECU_ADDRESS 0x60013932 /end MEASUREMENT
/begin MEASUREMENT DINH_stFId.FId_CrCUIFCMRxErr "Inhibit Status of FIds / Status of function identifier FId_CrCUIFCMRxErr" UWORD DFC_OneToOne 1 100 0.00 65535.00 FORMAT "%8.2" ECU_ADDRESS 0x60013934 /end MEASUREMENT
/begin MEASUREMENT DINH_stFId.FId_CrCUIMETDRxErr "Inhibit Status of FIds / Status of function identifier FId_CrCUIMETDRxErr" UWORD DFC_OneToOne 1 100 0.00 65535.00 FORMAT "%8.2" ECU_ADDRESS 0x60013936 /end MEASUREMENT
/begin MEASUREMENT DINH_stFId.FId_CrCtlACCRxErr "Inhibit Status of FIds / Status of function identifier FId_CrCtlACCRxErr" UWORD DFC_OneToOne 1 100 0.00 65535.00 FORMAT "%8.2" ECU_ADDRESS 0x60013938 /end MEASUREMENT
/begin MEASUREMENT DINH_stFId.FId_CrCtlAppSnsrErr "Inhibit Status of FIds / Status of function identifier FId_CrCtlAppSnsrErr" UWORD DFC_OneToOne 1 100 0.00 65535.00 FORMAT "%8.2" ECU_ADDRESS 0x6001393A /end MEASUREMENT
/begin MEASUREMENT DINH_stFId.FId_CrCtlShutOffEng "Inhibit Status of FIds / Status of function identifier FId_CrCtlShutOffEng" UWORD DFC_OneToOne 1 100 0.00 65535.00 FORMAT "%8.2" ECU_ADDRESS 0x6001393C /end MEASUREMENT
/begin MEASUREMENT DINH_stFId.FId_CstrPurgGnrlTstrReq "Inhibit Status of FIds / Status of function identifier FId_CstrPurgGnrlTstrReq" UWORD DFC_OneToOne 1 100 0.00 65535.00 FORMAT "%8.2" ECU_ADDRESS 0x6001393E /end MEASUREMENT
/begin MEASUREMENT DINH_stFId.FId_DAGRS "Inhibit Status of FIds / Status of function identifier FId_DAGRS" UWORD DFC_OneToOne 1 100 0.00 65535.00 FORMAT "%8.2" ECU_ADDRESS 0x60013940 /end MEASUREMENT
/begin MEASUREMENT DINH_stFId.FId_DELibBrkBstP "Inhibit Status of FIds / Status of function identifier FId_DELibBrkBstP" UWORD DFC_OneToOne 1 100 0.00 65535.00 FORMAT "%8.2" ECU_ADDRESS 0x60013942 /end MEASUREMENT
/begin MEASUREMENT DINH_stFId.FId_DELibCEngDsT "Inhibit Status of FIds / Status of function identifier FId_DELibCEngDsT" UWORD DFC_OneToOne 1 100 0.00 65535.00 FORMAT "%8.2" ECU_ADDRESS 0x60013944 /end MEASUREMENT
/begin MEASUREMENT DINH_stFId.FId_DELibCEngUsT "Inhibit Status of FIds / Status of function identifier FId_DELibCEngUsT" UWORD DFC_OneToOne 1 100 0.00 65535.00 FORMAT "%8.2" ECU_ADDRESS 0x60013946 /end MEASUREMENT
/begin MEASUREMENT DINH_stFId.FId_DELibEngDatEng "Inhibit Status of FIds / Status of function identifier FId_DELibEngDatEng" UWORD DFC_OneToOne 1 100 0.00 65535.00 FORMAT "%8.2" ECU_ADDRESS 0x60013948 /end MEASUREMENT
/begin MEASUREMENT DINH_stFId.FId_DELibEnvP "Inhibit Status of FIds / Status of function identifier FId_DELibEnvP" UWORD DFC_OneToOne 1 100 0.00 65535.00 FORMAT "%8.2" ECU_ADDRESS 0x6001394A /end MEASUREMENT
/begin MEASUREMENT DINH_stFId.FId_DELibEnvT "Inhibit Status of FIds / Status of function identifier FId_DELibEnvT" UWORD DFC_OneToOne 1 100 0.00 65535.00 FORMAT "%8.2" ECU_ADDRESS 0x6001394C /end MEASUREMENT
/begin MEASUREMENT DINH_stFId.FId_DELibFuelT "Inhibit Status of FIds / Status of function identifier FId_DELibFuelT" UWORD DFC_OneToOne 1 100 0.00 65535.00 FORMAT "%8.2" ECU_ADDRESS 0x6001394E /end MEASUREMENT
/begin MEASUREMENT DINH_stFId.FId_DELibIntkAirT "Inhibit Status of FIds / Status of function identifier FId_DELibIntkAirT" UWORD DFC_OneToOne 1 100 0.00 65535.00 FORMAT "%8.2" ECU_ADDRESS 0x60013950 /end MEASUREMENT
/begin MEASUREMENT DINH_stFId.FId_DELibNRCat "Inhibit Status of FIds / Status of function identifier FId_DELibNRCat" UWORD DFC_OneToOne 1 100 0.00 65535.00 FORMAT "%8.2" ECU_ADDRESS 0x60013952 /end MEASUREMENT
/begin MEASUREMENT DINH_stFId.FId_DELibOilP "Inhibit Status of FIds / Status of function identifier FId_DELibOilP" UWORD DFC_OneToOne 1 100 0.00 65535.00 FORMAT "%8.2" ECU_ADDRESS 0x60013954 /end MEASUREMENT
/begin MEASUREMENT DINH_stFId.FId_DELibOilSwmpT "Inhibit Status of FIds / Status of function identifier FId_DELibOilSwmpT" UWORD DFC_OneToOne 1 100 0.00 65535.00 FORMAT "%8.2" ECU_ADDRESS 0x60013956 /end MEASUREMENT
/begin MEASUREMENT DINH_stFId.FId_DELibPRelPfilDs "Inhibit Status of FIds / Status of function identifier FId_DELibPRelPfilDs" UWORD DFC_OneToOne 1 100 0.00 65535.00 FORMAT "%8.2" ECU_ADDRESS 0x60013958 /end MEASUREMENT
/begin MEASUREMENT DINH_stFId.FId_DELibTEGRClrLPDs "Inhibit Status of FIds / Status of function identifier FId_DELibTEGRClrLPDs" UWORD DFC_OneToOne 1 100 0.00 65535.00 FORMAT "%8.2" ECU_ADDRESS 0x6001395A /end MEASUREMENT
/begin MEASUREMENT DINH_stFId.FId_DEONVEBPEnv "Inhibit Status of FIds / Status of function identifier FId_DEONVEBPEnv" UWORD DFC_OneToOne 1 100 0.00 65535.00 FORMAT "%8.2" ECU_ADDRESS 0x6001395C /end MEASUREMENT
/begin MEASUREMENT DINH_stFId.FId_DEONVTCCpv1DteskLoLoadStuckClsd "Inhibit Status of FIds / Status of function identifier FId_DEONVTCCpv1DteskLoLoadStuckClsd" UWORD DFC_OneToOne 1 100 0.00 65535.00 FORMAT "%8.2" ECU_ADDRESS 0x6001395E /end MEASUREMENT
/begin MEASUREMENT DINH_stFId.FId_DEONVTCCpv1DteskLoLoadStuckOpen "Inhibit Status of FIds / Status of function identifier FId_DEONVTCCpv1DteskLoLoadStuckOpen" UWORD DFC_OneToOne 1 100 0.00 65535.00 FORMAT "%8.2" ECU_ADDRESS 0x60013960 /end MEASUREMENT
/begin MEASUREMENT DINH_stFId.FId_DIUMPRCldStrtMon "Inhibit Status of FIds / Status of function identifier FId_DIUMPRCldStrtMon" UWORD DFC_OneToOne 1 100 0.00 65535.00 FORMAT "%8.2" ECU_ADDRESS 0x60013962 /end MEASUREMENT
/begin MEASUREMENT DINH_stFId.FId_DIUMPREvapMon "Inhibit Status of FIds / Status of function identifier FId_DIUMPREvapMon" UWORD DFC_OneToOne 1 100 0.00 65535.00 FORMAT "%8.2" ECU_ADDRESS 0x60013964 /end MEASUREMENT
/begin MEASUREMENT DINH_stFId.FId_DIUMPRGenDenom1 "Inhibit Status of FIds / Status of function identifier FId_DIUMPRGenDenom1" UWORD DFC_OneToOne 1 100 0.00 65535.00 FORMAT "%8.2" ECU_ADDRESS 0x60013966 /end MEASUREMENT
/begin MEASUREMENT DINH_stFId.FId_DIUMPRGenDenom1PDTC "Inhibit Status of FIds / Status of function identifier FId_DIUMPRGenDenom1PDTC" UWORD DFC_OneToOne 1 100 0.00 65535.00 FORMAT "%8.2" ECU_ADDRESS 0x60013968 /end MEASUREMENT
/begin MEASUREMENT DINH_stFId.FId_DIUMPRGenDenom2 "Inhibit Status of FIds / Status of function identifier FId_DIUMPRGenDenom2" UWORD DFC_OneToOne 1 100 0.00 65535.00 FORMAT "%8.2" ECU_ADDRESS 0x6001396A /end MEASUREMENT
/begin MEASUREMENT DINH_stFId.FId_DIUMPRGenDenom3 "Inhibit Status of FIds / Status of function identifier FId_DIUMPRGenDenom3" UWORD DFC_OneToOne 1 100 0.00 65535.00 FORMAT "%8.2" ECU_ADDRESS 0x6001396C /end MEASUREMENT
/begin MEASUREMENT DINH_stFId.FId_DIUMPRIgn "Inhibit Status of FIds / Status of function identifier FId_DIUMPRIgn" UWORD DFC_OneToOne 1 100 0.00 65535.00 FORMAT "%8.2" ECU_ADDRESS 0x6001396E /end MEASUREMENT
/begin MEASUREMENT DINH_stFId.FId_DOGov "Inhibit Status of FIds / Status of function identifier FId_DOGov" UWORD DFC_OneToOne 1 100 0.00 65535.00 FORMAT "%8.2" ECU_ADDRESS 0x60013970 /end MEASUREMENT
/begin MEASUREMENT DINH_stFId.FId_DSMWarmUpCycle "Inhibit Status of FIds / Status of function identifier FId_DSMWarmUpCycle" UWORD DFC_OneToOne 1 100 0.00 65535.00 FORMAT "%8.2" ECU_ADDRESS 0x60013972 /end MEASUREMENT
/begin MEASUREMENT DINH_stFId.FId_DTESKEBCpv1DteskLoLoadStuckClsd "Inhibit Status of FIds / Status of function identifier FId_DTESKEBCpv1DteskLoLoadStuckClsd" UWORD DFC_OneToOne 1 100 0.00 65535.00 FORMAT "%8.2" ECU_ADDRESS 0x60013974 /end MEASUREMENT
/begin MEASUREMENT DINH_stFId.FId_DTESKEBCpv1DteskLoLoadStuckOpen "Inhibit Status of FIds / Status of function identifier FId_DTESKEBCpv1DteskLoLoadStuckOpen" UWORD DFC_OneToOne 1 100 0.00 65535.00 FORMAT "%8.2" ECU_ADDRESS 0x60013976 /end MEASUREMENT
/begin MEASUREMENT DINH_stFId.FId_DTESKEnvCondVld "Inhibit Status of FIds / Status of function identifier FId_DTESKEnvCondVld" UWORD DFC_OneToOne 1 100 0.00 65535.00 FORMAT "%8.2" ECU_ADDRESS 0x60013978 /end MEASUREMENT
/begin MEASUREMENT DINH_stFId.FId_DTESKFuLvlCondVld "Inhibit Status of FIds / Status of function identifier FId_DTESKFuLvlCondVld" UWORD DFC_OneToOne 1 100 0.00 65535.00 FORMAT "%8.2" ECU_ADDRESS 0x6001397A /end MEASUREMENT
/begin MEASUREMENT DINH_stFId.FId_DTESKvfz "Inhibit Status of FIds / Status of function identifier FId_DTESKvfz" UWORD DFC_OneToOne 1 100 0.00 65535.00 FORMAT "%8.2" ECU_ADDRESS 0x6001397C /end MEASUREMENT
/begin MEASUREMENT DINH_stFId.FId_DdskvFraTstd "Inhibit Status of FIds / Status of function identifier FId_DdskvFraTstd" UWORD DFC_OneToOne 1 100 0.00 65535.00 FORMAT "%8.2" ECU_ADDRESS 0x6001397E /end MEASUREMENT
/begin MEASUREMENT DINH_stFId.FId_DdskvOraTstd "Inhibit Status of FIds / Status of function identifier FId_DdskvOraTstd" UWORD DFC_OneToOne 1 100 0.00 65535.00 FORMAT "%8.2" ECU_ADDRESS 0x60013980 /end MEASUREMENT
/begin MEASUREMENT DINH_stFId.FId_DewDetTKAMax "Inhibit Status of FIds / Status of function identifier FId_DewDetTKAMax" UWORD DFC_OneToOne 1 100 0.00 65535.00 FORMAT "%8.2" ECU_ADDRESS 0x60013982 /end MEASUREMENT
/begin MEASUREMENT DINH_stFId.FId_DiagBlkdLine "Inhibit Status of FIds / Status of function identifier FId_DiagBlkdLine" UWORD DFC_OneToOne 1 100 0.00 65535.00 FORMAT "%8.2" ECU_ADDRESS 0x60013984 /end MEASUREMENT
/begin MEASUREMENT DINH_stFId.FId_DiagCpv1DteskLoLoad "Inhibit Status of FIds / Status of function identifier FId_DiagCpv1DteskLoLoad" UWORD DFC_OneToOne 1 100 0.00 65535.00 FORMAT "%8.2" ECU_ADDRESS 0x60013986 /end MEASUREMENT
/begin MEASUREMENT DINH_stFId.FId_DkrsaEpmNoSig "Inhibit Status of FIds / Status of function identifier FId_DkrsaEpmNoSig" UWORD DFC_OneToOne 1 100 0.00 65535.00 FORMAT "%8.2" ECU_ADDRESS 0x60013988 /end MEASUREMENT
/begin MEASUREMENT DINH_stFId.FId_EBBCANErrFrzVal "Inhibit Status of FIds / Status of function identifier FId_EBBCANErrFrzVal" UWORD DFC_OneToOne 1 100 0.00 65535.00 FORMAT "%8.2" ECU_ADDRESS 0x6001398A /end MEASUREMENT
/begin MEASUREMENT DINH_stFId.FId_EBBCANErrReplVal "Inhibit Status of FIds / Status of function identifier FId_EBBCANErrReplVal" UWORD DFC_OneToOne 1 100 0.00 65535.00 FORMAT "%8.2" ECU_ADDRESS 0x6001398C /end MEASUREMENT
/begin MEASUREMENT DINH_stFId.FId_EGLZSR "Inhibit Status of FIds / Status of function identifier FId_EGLZSR" UWORD DFC_OneToOne 1 100 0.00 65535.00 FORMAT "%8.2" ECU_ADDRESS 0x6001398E /end MEASUREMENT
/begin MEASUREMENT DINH_stFId.FId_EGRVlvActrOff "Inhibit Status of FIds / Status of function identifier FId_EGRVlvActrOff" UWORD DFC_OneToOne 1 100 0.00 65535.00 FORMAT "%8.2" ECU_ADDRESS 0x60013990 /end MEASUREMENT
/begin MEASUREMENT DINH_stFId.FId_EGRVlvCldStrt "Inhibit Status of FIds / Status of function identifier FId_EGRVlvCldStrt" UWORD DFC_OneToOne 1 100 0.00 65535.00 FORMAT "%8.2" ECU_ADDRESS 0x60013992 /end MEASUREMENT
/begin MEASUREMENT DINH_stFId.FId_EGRVlvClnVrfy "Inhibit Status of FIds / Status of function identifier FId_EGRVlvClnVrfy" UWORD DFC_OneToOne 1 100 0.00 65535.00 FORMAT "%8.2" ECU_ADDRESS 0x60013994 /end MEASUREMENT
/begin MEASUREMENT DINH_stFId.FId_EGRVlvCtrlErr "Inhibit Status of FIds / Status of function identifier FId_EGRVlvCtrlErr" UWORD DFC_OneToOne 1 100 0.00 65535.00 FORMAT "%8.2" ECU_ADDRESS 0x60013996 /end MEASUREMENT
/begin MEASUREMENT DINH_stFId.FId_EGRVlvEngTempDef "Inhibit Status of FIds / Status of function identifier FId_EGRVlvEngTempDef" UWORD DFC_OneToOne 1 100 0.00 65535.00 FORMAT "%8.2" ECU_ADDRESS 0x60013998 /end MEASUREMENT
/begin MEASUREMENT DINH_stFId.FId_EGRVlvFailSafeActv "Inhibit Status of FIds / Status of function identifier FId_EGRVlvFailSafeActv" UWORD DFC_OneToOne 1 100 0.00 65535.00 FORMAT "%8.2" ECU_ADDRESS 0x6001399A /end MEASUREMENT
/begin MEASUREMENT DINH_stFId.FId_EGRVlvFrzVal "Inhibit Status of FIds / Status of function identifier FId_EGRVlvFrzVal" UWORD DFC_OneToOne 1 100 0.00 65535.00 FORMAT "%8.2" ECU_ADDRESS 0x6001399C /end MEASUREMENT
/begin MEASUREMENT DINH_stFId.FId_EGRVlvGovOn "Inhibit Status of FIds / Status of function identifier FId_EGRVlvGovOn" UWORD DFC_OneToOne 1 100 0.00 65535.00 FORMAT "%8.2" ECU_ADDRESS 0x6001399E /end MEASUREMENT
/begin MEASUREMENT DINH_stFId.FId_EGRVlvGovOnCld "Inhibit Status of FIds / Status of function identifier FId_EGRVlvGovOnCld" UWORD DFC_OneToOne 1 100 0.00 65535.00 FORMAT "%8.2" ECU_ADDRESS 0x600139A0 /end MEASUREMENT
/begin MEASUREMENT DINH_stFId.FId_EGRVlvGovrOnRelsFct "Inhibit Status of FIds / Status of function identifier FId_EGRVlvGovrOnRelsFct" UWORD DFC_OneToOne 1 100 0.00 65535.00 FORMAT "%8.2" ECU_ADDRESS 0x600139A2 /end MEASUREMENT
/begin MEASUREMENT DINH_stFId.FId_EGRVlvILimn "Inhibit Status of FIds / Status of function identifier FId_EGRVlvILimn" UWORD DFC_OneToOne 1 100 0.00 65535.00 FORMAT "%8.2" ECU_ADDRESS 0x600139A4 /end MEASUREMENT
/begin MEASUREMENT DINH_stFId.FId_EGRVlvIni "Inhibit Status of FIds / Status of function identifier FId_EGRVlvIni" UWORD DFC_OneToOne 1 100 0.00 65535.00 FORMAT "%8.2" ECU_ADDRESS 0x600139A6 /end MEASUREMENT
/begin MEASUREMENT DINH_stFId.FId_EGRVlvMon "Inhibit Status of FIds / Status of function identifier FId_EGRVlvMon" UWORD DFC_OneToOne 1 100 0.00 65535.00 FORMAT "%8.2" ECU_ADDRESS 0x600139A8 /end MEASUREMENT
/begin MEASUREMENT DINH_stFId.FId_EGRVlvOfsLrnInhib "Inhibit Status of FIds / Status of function identifier FId_EGRVlvOfsLrnInhib" UWORD DFC_OneToOne 1 100 0.00 65535.00 FORMAT "%8.2" ECU_ADDRESS 0x600139AA /end MEASUREMENT
/begin MEASUREMENT DINH_stFId.FId_EGRVlvPhysRng "Inhibit Status of FIds / Status of function identifier FId_EGRVlvPhysRng" UWORD DFC_OneToOne 1 100 0.00 65535.00 FORMAT "%8.2" ECU_ADDRESS 0x600139AC /end MEASUREMENT
/begin MEASUREMENT DINH_stFId.FId_EGRVlvPsSwtOff "Inhibit Status of FIds / Status of function identifier FId_EGRVlvPsSwtOff" UWORD DFC_OneToOne 1 100 0.00 65535.00 FORMAT "%8.2" ECU_ADDRESS 0x600139AE /end MEASUREMENT
/begin MEASUREMENT DINH_stFId.FId_EGRVlvPwrStgMonDis "Inhibit Status of FIds / Status of function identifier FId_EGRVlvPwrStgMonDis" UWORD DFC_OneToOne 1 100 0.00 65535.00 FORMAT "%8.2" ECU_ADDRESS 0x600139B0 /end MEASUREMENT
/begin MEASUREMENT DINH_stFId.FId_EGRVlvRplVal "Inhibit Status of FIds / Status of function identifier FId_EGRVlvRplVal" UWORD DFC_OneToOne 1 100 0.00 65535.00 FORMAT "%8.2" ECU_ADDRESS 0x600139B2 /end MEASUREMENT
/begin MEASUREMENT DINH_stFId.FId_EGRVlvSSpMon "Inhibit Status of FIds / Status of function identifier FId_EGRVlvSSpMon" UWORD DFC_OneToOne 1 100 0.00 65535.00 FORMAT "%8.2" ECU_ADDRESS 0x600139B4 /end MEASUREMENT
/begin MEASUREMENT DINH_stFId.FId_EGRVlvSnsrErr "Inhibit Status of FIds / Status of function identifier FId_EGRVlvSnsrErr" UWORD DFC_OneToOne 1 100 0.00 65535.00 FORMAT "%8.2" ECU_ADDRESS 0x600139B6 /end MEASUREMENT
/begin MEASUREMENT DINH_stFId.FId_EGRVlvTempCmp "Inhibit Status of FIds / Status of function identifier FId_EGRVlvTempCmp" UWORD DFC_OneToOne 1 100 0.00 65535.00 FORMAT "%8.2" ECU_ADDRESS 0x600139B8 /end MEASUREMENT
/begin MEASUREMENT DINH_stFId.FId_EGRVlvTempMdlEEPErr "Inhibit Status of FIds / Status of function identifier FId_EGRVlvTempMdlEEPErr" UWORD DFC_OneToOne 1 100 0.00 65535.00 FORMAT "%8.2" ECU_ADDRESS 0x600139BA /end MEASUREMENT
/begin MEASUREMENT DINH_stFId.FId_EGRVlvTmpErrCnt "Inhibit Status of FIds / Status of function identifier FId_EGRVlvTmpErrCnt" UWORD DFC_OneToOne 1 100 0.00 65535.00 FORMAT "%8.2" ECU_ADDRESS 0x600139BC /end MEASUREMENT
/begin MEASUREMENT DINH_stFId.FId_EGRVlvTrlPtr "Inhibit Status of FIds / Status of function identifier FId_EGRVlvTrlPtr" UWORD DFC_OneToOne 1 100 0.00 65535.00 FORMAT "%8.2" ECU_ADDRESS 0x600139BE /end MEASUREMENT
/begin MEASUREMENT DINH_stFId.FId_EGRVlv_VehvErr "Inhibit Status of FIds / Status of function identifier FId_EGRVlv_VehvErr" UWORD DFC_OneToOne 1 100 0.00 65535.00 FORMAT "%8.2" ECU_ADDRESS 0x600139C0 /end MEASUREMENT
/begin MEASUREMENT DINH_stFId.FId_EGRVlviActIEfcLimn "Inhibit Status of FIds / Status of function identifier FId_EGRVlviActIEfcLimn" UWORD DFC_OneToOne 1 100 0.00 65535.00 FORMAT "%8.2" ECU_ADDRESS 0x600139C2 /end MEASUREMENT
/begin MEASUREMENT DINH_stFId.FId_EGRVlvpDsbcInvld "Inhibit Status of FIds / Status of function identifier FId_EGRVlvpDsbcInvld" UWORD DFC_OneToOne 1 100 0.00 65535.00 FORMAT "%8.2" ECU_ADDRESS 0x600139C4 /end MEASUREMENT
/begin MEASUREMENT DINH_stFId.FId_EGSDO2OffsRstDsmS1B1 "Inhibit Status of FIds / Status of function identifier FId_EGSDO2OffsRstDsmS1B1" UWORD DFC_OneToOne 1 100 0.00 65535.00 FORMAT "%8.2" ECU_ADDRESS 0x600139C6 /end MEASUREMENT
/begin MEASUREMENT DINH_stFId.FId_EGSDO2_LamOffsSlowS1 "Inhibit Status of FIds / Status of function identifier FId_EGSDO2_LamOffsSlowS1" UWORD DFC_OneToOne 1 100 0.00 65535.00 FORMAT "%8.2" ECU_ADDRESS 0x600139C8 /end MEASUREMENT
/begin MEASUREMENT DINH_stFId.FId_EGSDO2_RstFltSuspcnOffsB1 "Inhibit Status of FIds / Status of function identifier FId_EGSDO2_RstFltSuspcnOffsB1" UWORD DFC_OneToOne 1 100 0.00 65535.00 FORMAT "%8.2" ECU_ADDRESS 0x600139CA /end MEASUREMENT
/begin MEASUREMENT DINH_stFId.FId_EGSDUS2B1DlyEvln "Inhibit Status of FIds / Status of function identifier FId_EGSDUS2B1DlyEvln" UWORD DFC_OneToOne 1 100 0.00 65535.00 FORMAT "%8.2" ECU_ADDRESS 0x600139CC /end MEASUREMENT
/begin MEASUREMENT DINH_stFId.FId_EGSDUS2B1LtrDly "Inhibit Status of FIds / Status of function identifier FId_EGSDUS2B1LtrDly" UWORD DFC_OneToOne 1 100 0.00 65535.00 FORMAT "%8.2" ECU_ADDRESS 0x600139CE /end MEASUREMENT
/begin MEASUREMENT DINH_stFId.FId_EGSDUS2B1LtrPT1 "Inhibit Status of FIds / Status of function identifier FId_EGSDUS2B1LtrPT1" UWORD DFC_OneToOne 1 100 0.00 65535.00 FORMAT "%8.2" ECU_ADDRESS 0x600139D0 /end MEASUREMENT
/begin MEASUREMENT DINH_stFId.FId_EGSDUS2B1PT1Evln "Inhibit Status of FIds / Status of function identifier FId_EGSDUS2B1PT1Evln" UWORD DFC_OneToOne 1 100 0.00 65535.00 FORMAT "%8.2" ECU_ADDRESS 0x600139D2 /end MEASUREMENT
/begin MEASUREMENT DINH_stFId.FId_EGSDUS2B1RtlDly "Inhibit Status of FIds / Status of function identifier FId_EGSDUS2B1RtlDly" UWORD DFC_OneToOne 1 100 0.00 65535.00 FORMAT "%8.2" ECU_ADDRESS 0x600139D4 /end MEASUREMENT
/begin MEASUREMENT DINH_stFId.FId_EGSDUS2B1RtlPT1 "Inhibit Status of FIds / Status of function identifier FId_EGSDUS2B1RtlPT1" UWORD DFC_OneToOne 1 100 0.00 65535.00 FORMAT "%8.2" ECU_ADDRESS 0x600139D6 /end MEASUREMENT
/begin MEASUREMENT DINH_stFId.FId_EGSDUS2B1TarEvln "Inhibit Status of FIds / Status of function identifier FId_EGSDUS2B1TarEvln" UWORD DFC_OneToOne 1 100 0.00 65535.00 FORMAT "%8.2" ECU_ADDRESS 0x600139D8 /end MEASUREMENT
/begin MEASUREMENT DINH_stFId.FId_EGSDUS2B1TarLean "Inhibit Status of FIds / Status of function identifier FId_EGSDUS2B1TarLean" UWORD DFC_OneToOne 1 100 0.00 65535.00 FORMAT "%8.2" ECU_ADDRESS 0x600139DA /end MEASUREMENT
/begin MEASUREMENT DINH_stFId.FId_EGSDUS2B1TarRich "Inhibit Status of FIds / Status of function identifier FId_EGSDUS2B1TarRich" UWORD DFC_OneToOne 1 100 0.00 65535.00 FORMAT "%8.2" ECU_ADDRESS 0x600139DC /end MEASUREMENT
/begin MEASUREMENT DINH_stFId.FId_EGSSigO2S1B1 "Inhibit Status of FIds / Status of function identifier FId_EGSSigO2S1B1" UWORD DFC_OneToOne 1 100 0.00 65535.00 FORMAT "%8.2" ECU_ADDRESS 0x600139DE /end MEASUREMENT
/begin MEASUREMENT DINH_stFId.FId_ELZSR "Inhibit Status of FIds / Status of function identifier FId_ELZSR" UWORD DFC_OneToOne 1 100 0.00 65535.00 FORMAT "%8.2" ECU_ADDRESS 0x600139E0 /end MEASUREMENT
/begin MEASUREMENT DINH_stFId.FId_EPBErr "Inhibit Status of FIds / Status of function identifier FId_EPBErr" UWORD DFC_OneToOne 1 100 0.00 65535.00 FORMAT "%8.2" ECU_ADDRESS 0x600139E2 /end MEASUREMENT
/begin MEASUREMENT DINH_stFId.FId_EPBFrmErr "Inhibit Status of FIds / Status of function identifier FId_EPBFrmErr" UWORD DFC_OneToOne 1 100 0.00 65535.00 FORMAT "%8.2" ECU_ADDRESS 0x600139E4 /end MEASUREMENT
/begin MEASUREMENT DINH_stFId.FId_EPBFrmErrClth "Inhibit Status of FIds / Status of function identifier FId_EPBFrmErrClth" UWORD DFC_OneToOne 1 100 0.00 65535.00 FORMAT "%8.2" ECU_ADDRESS 0x600139E6 /end MEASUREMENT
/begin MEASUREMENT DINH_stFId.FId_ETHSCPErrDrvCyc "Inhibit Status of FIds / Status of function identifier FId_ETHSCPErrDrvCyc" UWORD DFC_OneToOne 1 100 0.00 65535.00 FORMAT "%8.2" ECU_ADDRESS 0x600139E8 /end MEASUREMENT
/begin MEASUREMENT DINH_stFId.FId_EVPComFailr "Inhibit Status of FIds / Status of function identifier FId_EVPComFailr" UWORD DFC_OneToOne 1 100 0.00 65535.00 FORMAT "%8.2" ECU_ADDRESS 0x600139EA /end MEASUREMENT
/begin MEASUREMENT DINH_stFId.FId_EbsLinErr "Inhibit Status of FIds / Status of function identifier FId_EbsLinErr" UWORD DFC_OneToOne 1 100 0.00 65535.00 FORMAT "%8.2" ECU_ADDRESS 0x600139EC /end MEASUREMENT
/begin MEASUREMENT DINH_stFId.FId_ElecLdComErr "Inhibit Status of FIds / Status of function identifier FId_ElecLdComErr" UWORD DFC_OneToOne 1 100 0.00 65535.00 FORMAT "%8.2" ECU_ADDRESS 0x600139EE /end MEASUREMENT
/begin MEASUREMENT DINH_stFId.FId_ElecLdFrzVal "Inhibit Status of FIds / Status of function identifier FId_ElecLdFrzVal" UWORD DFC_OneToOne 1 100 0.00 65535.00 FORMAT "%8.2" ECU_ADDRESS 0x600139F0 /end MEASUREMENT
/begin MEASUREMENT DINH_stFId.FId_ElecLdHdLiComErr "Inhibit Status of FIds / Status of function identifier FId_ElecLdHdLiComErr" UWORD DFC_OneToOne 1 100 0.00 65535.00 FORMAT "%8.2" ECU_ADDRESS 0x600139F2 /end MEASUREMENT
/begin MEASUREMENT DINH_stFId.FId_ElecLdRplVal "Inhibit Status of FIds / Status of function identifier FId_ElecLdRplVal" UWORD DFC_OneToOne 1 100 0.00 65535.00 FORMAT "%8.2" ECU_ADDRESS 0x600139F4 /end MEASUREMENT
/begin MEASUREMENT DINH_stFId.FId_ElecLoadEPSComErr "Inhibit Status of FIds / Status of function identifier FId_ElecLoadEPSComErr" UWORD DFC_OneToOne 1 100 0.00 65535.00 FORMAT "%8.2" ECU_ADDRESS 0x600139F6 /end MEASUREMENT
/begin MEASUREMENT DINH_stFId.FId_EngBlkTWrn "Inhibit Status of FIds / Status of function identifier FId_EngBlkTWrn" UWORD DFC_OneToOne 1 100 0.00 65535.00 FORMAT "%8.2" ECU_ADDRESS 0x600139F8 /end MEASUREMENT
/begin MEASUREMENT DINH_stFId.FId_EngCooltTFail "Inhibit Status of FIds / Status of function identifier FId_EngCooltTFail" UWORD DFC_OneToOne 1 100 0.00 65535.00 FORMAT "%8.2" ECU_ADDRESS 0x600139FA /end MEASUREMENT
/begin MEASUREMENT DINH_stFId.FId_EngDemTqLimnCamsftErr "Inhibit Status of FIds / Status of function identifier FId_EngDemTqLimnCamsftErr" UWORD DFC_OneToOne 1 100 0.00 65535.00 FORMAT "%8.2" ECU_ADDRESS 0x600139FC /end MEASUREMENT
/begin MEASUREMENT DINH_stFId.FId_EngDemTqLimnErrThmstHeatCtrlCirc "Inhibit Status of FIds / Status of function identifier FId_EngDemTqLimnErrThmstHeatCtrlCirc" UWORD DFC_OneToOne 1 100 0.00 65535.00 FORMAT "%8.2" ECU_ADDRESS 0x600139FE /end MEASUREMENT
/begin MEASUREMENT DINH_stFId.FId_EngDemTqLimnOilPmp "Inhibit Status of FIds / Status of function identifier FId_EngDemTqLimnOilPmp" UWORD DFC_OneToOne 1 100 0.00 65535.00 FORMAT "%8.2" ECU_ADDRESS 0x60013A00 /end MEASUREMENT
/begin MEASUREMENT DINH_stFId.FId_EngDemTrqLimErrAPP "Inhibit Status of FIds / Status of function identifier FId_EngDemTrqLimErrAPP" UWORD DFC_OneToOne 1 100 0.00 65535.00 FORMAT "%8.2" ECU_ADDRESS 0x60013A02 /end MEASUREMENT
/begin MEASUREMENT DINH_stFId.FId_EngIntkAirFail "Inhibit Status of FIds / Status of function identifier FId_EngIntkAirFail" UWORD DFC_OneToOne 1 100 0.00 65535.00 FORMAT "%8.2" ECU_ADDRESS 0x60013A04 /end MEASUREMENT
/begin MEASUREMENT DINH_stFId.FId_EngPrtErrVehV "Inhibit Status of FIds / Status of function identifier FId_EngPrtErrVehV" UWORD DFC_OneToOne 1 100 0.00 65535.00 FORMAT "%8.2" ECU_ADDRESS 0x60013A06 /end MEASUREMENT
/begin MEASUREMENT DINH_stFId.FId_EngSpd30DegFail "Inhibit Status of FIds / Status of function identifier FId_EngSpd30DegFail" UWORD DFC_OneToOne 1 100 0.00 65535.00 FORMAT "%8.2" ECU_ADDRESS 0x60013A08 /end MEASUREMENT
/begin MEASUREMENT DINH_stFId.FId_EngStrtEnaEthAdap "Inhibit Status of FIds / Status of function identifier FId_EngStrtEnaEthAdap" UWORD DFC_OneToOne 1 100 0.00 65535.00 FORMAT "%8.2" ECU_ADDRESS 0x60013A0A /end MEASUREMENT
/begin MEASUREMENT DINH_stFId.FId_EngStrt_EnaCep "Inhibit Status of FIds / Status of function identifier FId_EngStrt_EnaCep" UWORD DFC_OneToOne 1 100 0.00 65535.00 FORMAT "%8.2" ECU_ADDRESS 0x60013A0C /end MEASUREMENT
/begin MEASUREMENT DINH_stFId.FId_EngStrt_InjProhb "Inhibit Status of FIds / Status of function identifier FId_EngStrt_InjProhb" UWORD DFC_OneToOne 1 100 0.00 65535.00 FORMAT "%8.2" ECU_ADDRESS 0x60013A0E /end MEASUREMENT
/begin MEASUREMENT DINH_stFId.FId_EngStrt_VehVInhb "Inhibit Status of FIds / Status of function identifier FId_EngStrt_VehVInhb" UWORD DFC_OneToOne 1 100 0.00 65535.00 FORMAT "%8.2" ECU_ADDRESS 0x60013A10 /end MEASUREMENT
/begin MEASUREMENT DINH_stFId.FId_EngTqRvsnEnaFlg "Inhibit Status of FIds / Status of function identifier FId_EngTqRvsnEnaFlg" UWORD DFC_OneToOne 1 100 0.00 65535.00 FORMAT "%8.2" ECU_ADDRESS 0x60013A12 /end MEASUREMENT
/begin MEASUREMENT DINH_stFId.FId_EnvTPrimMod "Inhibit Status of FIds / Status of function identifier FId_EnvTPrimMod" UWORD DFC_OneToOne 1 100 0.00 65535.00 FORMAT "%8.2" ECU_ADDRESS 0x60013A14 /end MEASUREMENT
/begin MEASUREMENT DINH_stFId.FId_EnvTPrimModIniVal "Inhibit Status of FIds / Status of function identifier FId_EnvTPrimModIniVal" UWORD DFC_OneToOne 1 100 0.00 65535.00 FORMAT "%8.2" ECU_ADDRESS 0x60013A16 /end MEASUREMENT
/begin MEASUREMENT DINH_stFId.FId_EnvTSensSum "Inhibit Status of FIds / Status of function identifier FId_EnvTSensSum" UWORD DFC_OneToOne 1 100 0.00 65535.00 FORMAT "%8.2" ECU_ADDRESS 0x60013A18 /end MEASUREMENT
/begin MEASUREMENT DINH_stFId.FId_EnvTtAirFltDs "Inhibit Status of FIds / Status of function identifier FId_EnvTtAirFltDs" UWORD DFC_OneToOne 1 100 0.00 65535.00 FORMAT "%8.2" ECU_ADDRESS 0x60013A1A /end MEASUREMENT
/begin MEASUREMENT DINH_stFId.FId_EnvTtCEngDsT "Inhibit Status of FIds / Status of function identifier FId_EnvTtCEngDsT" UWORD DFC_OneToOne 1 100 0.00 65535.00 FORMAT "%8.2" ECU_ADDRESS 0x60013A1C /end MEASUREMENT
/begin MEASUREMENT DINH_stFId.FId_EnvTtIntkMnfld "Inhibit Status of FIds / Status of function identifier FId_EnvTtIntkMnfld" UWORD DFC_OneToOne 1 100 0.00 65535.00 FORMAT "%8.2" ECU_ADDRESS 0x60013A1E /end MEASUREMENT
/begin MEASUREMENT DINH_stFId.FId_EomCvoAllwd "Inhibit Status of FIds / Status of function identifier FId_EomCvoAllwd" UWORD DFC_OneToOne 1 100 0.00 65535.00 FORMAT "%8.2" ECU_ADDRESS 0x60013A20 /end MEASUREMENT
/begin MEASUREMENT DINH_stFId.FId_EpmBCr "Inhibit Status of FIds / Status of function identifier FId_EpmBCr" UWORD DFC_OneToOne 1 100 0.00 65535.00 FORMAT "%8.2" ECU_ADDRESS 0x60013A22 /end MEASUREMENT
/begin MEASUREMENT DINH_stFId.FId_EpmCaSAdapCaSI1 "Inhibit Status of FIds / Status of function identifier FId_EpmCaSAdapCaSI1" UWORD DFC_OneToOne 1 100 0.00 65535.00 FORMAT "%8.2" ECU_ADDRESS 0x60013A24 /end MEASUREMENT
/begin MEASUREMENT DINH_stFId.FId_EpmCaSAdapRstI1 "Inhibit Status of FIds / Status of function identifier FId_EpmCaSAdapRstI1" UWORD DFC_OneToOne 1 100 0.00 65535.00 FORMAT "%8.2" ECU_ADDRESS 0x60013A26 /end MEASUREMENT
/begin MEASUREMENT DINH_stFId.FId_EpmCaSDiagI1 "Inhibit Status of FIds / Status of function identifier FId_EpmCaSDiagI1" UWORD DFC_OneToOne 1 100 0.00 65535.00 FORMAT "%8.2" ECU_ADDRESS 0x60013A28 /end MEASUREMENT
/begin MEASUREMENT DINH_stFId.FId_EpmCaSErrCaSI1 "Inhibit Status of FIds / Status of function identifier FId_EpmCaSErrCaSI1" UWORD DFC_OneToOne 1 100 0.00 65535.00 FORMAT "%8.2" ECU_ADDRESS 0x60013A2A /end MEASUREMENT
/begin MEASUREMENT DINH_stFId.FId_EpmCaSOfsDiagCaSI1 "Inhibit Status of FIds / Status of function identifier FId_EpmCaSOfsDiagCaSI1" UWORD DFC_OneToOne 1 100 0.00 65535.00 FORMAT "%8.2" ECU_ADDRESS 0x60013A2C /end MEASUREMENT
/begin MEASUREMENT DINH_stFId.FId_EpmCaSOfsErrCaSI1 "Inhibit Status of FIds / Status of function identifier FId_EpmCaSOfsErrCaSI1" UWORD DFC_OneToOne 1 100 0.00 65535.00 FORMAT "%8.2" ECU_ADDRESS 0x60013A2E /end MEASUREMENT
/begin MEASUREMENT DINH_stFId.FId_EpmCaSSegI1 "Inhibit Status of FIds / Status of function identifier FId_EpmCaSSegI1" UWORD DFC_OneToOne 1 100 0.00 65535.00 FORMAT "%8.2" ECU_ADDRESS 0x60013A30 /end MEASUREMENT
/begin MEASUREMENT DINH_stFId.FId_EpmCaSSpdPlausI1 "Inhibit Status of FIds / Status of function identifier FId_EpmCaSSpdPlausI1" UWORD DFC_OneToOne 1 100 0.00 65535.00 FORMAT "%8.2" ECU_ADDRESS 0x60013A32 /end MEASUREMENT
/begin MEASUREMENT DINH_stFId.FId_EpmCrSDiag "Inhibit Status of FIds / Status of function identifier FId_EpmCrSDiag" UWORD DFC_OneToOne 1 100 0.00 65535.00 FORMAT "%8.2" ECU_ADDRESS 0x60013A34 /end MEASUREMENT
/begin MEASUREMENT DINH_stFId.FId_EpmCrSDiagVeh "Inhibit Status of FIds / Status of function identifier FId_EpmCrSDiagVeh" UWORD DFC_OneToOne 1 100 0.00 65535.00 FORMAT "%8.2" ECU_ADDRESS 0x60013A36 /end MEASUREMENT
/begin MEASUREMENT DINH_stFId.FId_EpmCrSErr "Inhibit Status of FIds / Status of function identifier FId_EpmCrSErr" UWORD DFC_OneToOne 1 100 0.00 65535.00 FORMAT "%8.2" ECU_ADDRESS 0x60013A38 /end MEASUREMENT
/begin MEASUREMENT DINH_stFId.FId_EpmOpMode_ALELock "Inhibit Status of FIds / Status of function identifier FId_EpmOpMode_ALELock" UWORD DFC_OneToOne 1 100 0.00 65535.00 FORMAT "%8.2" ECU_ADDRESS 0x60013A3A /end MEASUREMENT
/begin MEASUREMENT DINH_stFId.FId_EpmOpMode_DirStLock "Inhibit Status of FIds / Status of function identifier FId_EpmOpMode_DirStLock" UWORD DFC_OneToOne 1 100 0.00 65535.00 FORMAT "%8.2" ECU_ADDRESS 0x60013A3C /end MEASUREMENT
/begin MEASUREMENT DINH_stFId.FId_EpmRRSCrSFaultCheck "Inhibit Status of FIds / Status of function identifier FId_EpmRRSCrSFaultCheck" UWORD DFC_OneToOne 1 100 0.00 65535.00 FORMAT "%8.2" ECU_ADDRESS 0x60013A3E /end MEASUREMENT
/begin MEASUREMENT DINH_stFId.FId_EpmRRSDGIFaultCheck "Inhibit Status of FIds / Status of function identifier FId_EpmRRSDGIFaultCheck" UWORD DFC_OneToOne 1 100 0.00 65535.00 FORMAT "%8.2" ECU_ADDRESS 0x60013A40 /end MEASUREMENT
/begin MEASUREMENT DINH_stFId.FId_EpmRRSRdCheck "Inhibit Status of FIds / Status of function identifier FId_EpmRRSRdCheck" UWORD DFC_OneToOne 1 100 0.00 65535.00 FORMAT "%8.2" ECU_ADDRESS 0x60013A42 /end MEASUREMENT
/begin MEASUREMENT DINH_stFId.FId_EpmRRSVehVFaultChck "Inhibit Status of FIds / Status of function identifier FId_EpmRRSVehVFaultChck" UWORD DFC_OneToOne 1 100 0.00 65535.00 FORMAT "%8.2" ECU_ADDRESS 0x60013A44 /end MEASUREMENT
/begin MEASUREMENT DINH_stFId.FId_EpmSynLockCaSSync "Inhibit Status of FIds / Status of function identifier FId_EpmSynLockCaSSync" UWORD DFC_OneToOne 1 100 0.00 65535.00 FORMAT "%8.2" ECU_ADDRESS 0x60013A46 /end MEASUREMENT
/begin MEASUREMENT DINH_stFId.FId_EpmTmpSuppRvsRotCASI1 "Inhibit Status of FIds / Status of function identifier FId_EpmTmpSuppRvsRotCASI1" UWORD DFC_OneToOne 1 100 0.00 65535.00 FORMAT "%8.2" ECU_ADDRESS 0x60013A48 /end MEASUREMENT
/begin MEASUREMENT DINH_stFId.FId_EtaEngIdleNonCsers "Inhibit Status of FIds / Status of function identifier FId_EtaEngIdleNonCsers" UWORD DFC_OneToOne 1 100 0.00 65535.00 FORMAT "%8.2" ECU_ADDRESS 0x60013A4A /end MEASUREMENT
/begin MEASUREMENT DINH_stFId.FId_EtaEngPtlNonCsers "Inhibit Status of FIds / Status of function identifier FId_EtaEngPtlNonCsers" UWORD DFC_OneToOne 1 100 0.00 65535.00 FORMAT "%8.2" ECU_ADDRESS 0x60013A4C /end MEASUREMENT
/begin MEASUREMENT DINH_stFId.FId_EthnlSnsrErrCdn "Inhibit Status of FIds / Status of function identifier FId_EthnlSnsrErrCdn" UWORD DFC_OneToOne 1 100 0.00 65535.00 FORMAT "%8.2" ECU_ADDRESS 0x60013A4E /end MEASUREMENT
/begin MEASUREMENT DINH_stFId.FId_EvapActrCcvElecDiag "Inhibit Status of FIds / Status of function identifier FId_EvapActrCcvElecDiag" UWORD DFC_OneToOne 1 100 0.00 65535.00 FORMAT "%8.2" ECU_ADDRESS 0x60013A50 /end MEASUREMENT
/begin MEASUREMENT DINH_stFId.FId_EvapPSnsrTankPhyRngChk "Inhibit Status of FIds / Status of function identifier FId_EvapPSnsrTankPhyRngChk" UWORD DFC_OneToOne 1 100 0.00 65535.00 FORMAT "%8.2" ECU_ADDRESS 0x60013A52 /end MEASUREMENT
/begin MEASUREMENT DINH_stFId.FId_FanCtlACClntP "Inhibit Status of FIds / Status of function identifier FId_FanCtlACClntP" UWORD DFC_OneToOne 1 100 0.00 65535.00 FORMAT "%8.2" ECU_ADDRESS 0x60013A54 /end MEASUREMENT
/begin MEASUREMENT DINH_stFId.FId_FanCtlACGModFail "Inhibit Status of FIds / Status of function identifier FId_FanCtlACGModFail" UWORD DFC_OneToOne 1 100 0.00 65535.00 FORMAT "%8.2" ECU_ADDRESS 0x60013A56 /end MEASUREMENT
/begin MEASUREMENT DINH_stFId.FId_FanCtlAPP1 "Inhibit Status of FIds / Status of function identifier FId_FanCtlAPP1" UWORD DFC_OneToOne 1 100 0.00 65535.00 FORMAT "%8.2" ECU_ADDRESS 0x60013A58 /end MEASUREMENT
/begin MEASUREMENT DINH_stFId.FId_FanCtlAPP2 "Inhibit Status of FIds / Status of function identifier FId_FanCtlAPP2" UWORD DFC_OneToOne 1 100 0.00 65535.00 FORMAT "%8.2" ECU_ADDRESS 0x60013A5A /end MEASUREMENT
/begin MEASUREMENT DINH_stFId.FId_FanCtlAPPSync "Inhibit Status of FIds / Status of function identifier FId_FanCtlAPPSync" UWORD DFC_OneToOne 1 100 0.00 65535.00 FORMAT "%8.2" ECU_ADDRESS 0x60013A5C /end MEASUREMENT
/begin MEASUREMENT DINH_stFId.FId_FanCtlBlowrU "Inhibit Status of FIds / Status of function identifier FId_FanCtlBlowrU" UWORD DFC_OneToOne 1 100 0.00 65535.00 FORMAT "%8.2" ECU_ADDRESS 0x60013A5E /end MEASUREMENT
/begin MEASUREMENT DINH_stFId.FId_FanCtlCooltT "Inhibit Status of FIds / Status of function identifier FId_FanCtlCooltT" UWORD DFC_OneToOne 1 100 0.00 65535.00 FORMAT "%8.2" ECU_ADDRESS 0x60013A60 /end MEASUREMENT
/begin MEASUREMENT DINH_stFId.FId_FanCtlCooltT2 "Inhibit Status of FIds / Status of function identifier FId_FanCtlCooltT2" UWORD DFC_OneToOne 1 100 0.00 65535.00 FORMAT "%8.2" ECU_ADDRESS 0x60013A62 /end MEASUREMENT
/begin MEASUREMENT DINH_stFId.FId_FanCtlEnvT "Inhibit Status of FIds / Status of function identifier FId_FanCtlEnvT" UWORD DFC_OneToOne 1 100 0.00 65535.00 FORMAT "%8.2" ECU_ADDRESS 0x60013A64 /end MEASUREMENT
/begin MEASUREMENT DINH_stFId.FId_FanCtlLiSwtInfo "Inhibit Status of FIds / Status of function identifier FId_FanCtlLiSwtInfo" UWORD DFC_OneToOne 1 100 0.00 65535.00 FORMAT "%8.2" ECU_ADDRESS 0x60013A66 /end MEASUREMENT
/begin MEASUREMENT DINH_stFId.FId_FanCtlSpd "Inhibit Status of FIds / Status of function identifier FId_FanCtlSpd" UWORD DFC_OneToOne 1 100 0.00 65535.00 FORMAT "%8.2" ECU_ADDRESS 0x60013A68 /end MEASUREMENT
/begin MEASUREMENT DINH_stFId.FId_FanCtlTSnsrErr "Inhibit Status of FIds / Status of function identifier FId_FanCtlTSnsrErr" UWORD DFC_OneToOne 1 100 0.00 65535.00 FORMAT "%8.2" ECU_ADDRESS 0x60013A6A /end MEASUREMENT
/begin MEASUREMENT DINH_stFId.FId_FanCtlThr1 "Inhibit Status of FIds / Status of function identifier FId_FanCtlThr1" UWORD DFC_OneToOne 1 100 0.00 65535.00 FORMAT "%8.2" ECU_ADDRESS 0x60013A6C /end MEASUREMENT
/begin MEASUREMENT DINH_stFId.FId_FanCtlThr2 "Inhibit Status of FIds / Status of function identifier FId_FanCtlThr2" UWORD DFC_OneToOne 1 100 0.00 65535.00 FORMAT "%8.2" ECU_ADDRESS 0x60013A6E /end MEASUREMENT
/begin MEASUREMENT DINH_stFId.FId_FcoReq "Inhibit Status of FIds / Status of function identifier FId_FcoReq" UWORD DFC_OneToOne 1 100 0.00 65535.00 FORMAT "%8.2" ECU_ADDRESS 0x60013A70 /end MEASUREMENT
/begin MEASUREMENT DINH_stFId.FId_FiMFID_rba_MRly_Diag_Stk "Inhibit Status of FIds / Status of function identifier FId_FiMFID_rba_MRly_Diag_Stk" UWORD DFC_OneToOne 1 100 0.00 65535.00 FORMAT "%8.2" ECU_ADDRESS 0x60013A72 /end MEASUREMENT
/begin MEASUREMENT DINH_stFId.FId_FlComErr "Inhibit Status of FIds / Status of function identifier FId_FlComErr" UWORD DFC_OneToOne 1 100 0.00 65535.00 FORMAT "%8.2" ECU_ADDRESS 0x60013A74 /end MEASUREMENT
/begin MEASUREMENT DINH_stFId.FId_FlDevPlauDiagFuSnsr "Inhibit Status of FIds / Status of function identifier FId_FlDevPlauDiagFuSnsr" UWORD DFC_OneToOne 1 100 0.00 65535.00 FORMAT "%8.2" ECU_ADDRESS 0x60013A76 /end MEASUREMENT
/begin MEASUREMENT DINH_stFId.FId_FlLvlNoSigErr "Inhibit Status of FIds / Status of function identifier FId_FlLvlNoSigErr" UWORD DFC_OneToOne 1 100 0.00 65535.00 FORMAT "%8.2" ECU_ADDRESS 0x60013A78 /end MEASUREMENT
/begin MEASUREMENT DINH_stFId.FId_FlLvlVehSpdSigErr "Inhibit Status of FIds / Status of function identifier FId_FlLvlVehSpdSigErr" UWORD DFC_OneToOne 1 100 0.00 65535.00 FORMAT "%8.2" ECU_ADDRESS 0x60013A7A /end MEASUREMENT
/begin MEASUREMENT DINH_stFId.FId_FlLvlVehVErr "Inhibit Status of FIds / Status of function identifier FId_FlLvlVehVErr" UWORD DFC_OneToOne 1 100 0.00 65535.00 FORMAT "%8.2" ECU_ADDRESS 0x60013A7C /end MEASUREMENT
/begin MEASUREMENT DINH_stFId.FId_FlMALamDynDiag "Inhibit Status of FIds / Status of function identifier FId_FlMALamDynDiag" UWORD DFC_OneToOne 1 100 0.00 65535.00 FORMAT "%8.2" ECU_ADDRESS 0x60013A7E /end MEASUREMENT
/begin MEASUREMENT DINH_stFId.FId_FlSplGAltLin "Inhibit Status of FIds / Status of function identifier FId_FlSplGAltLin" UWORD DFC_OneToOne 1 100 0.00 65535.00 FORMAT "%8.2" ECU_ADDRESS 0x60013A80 /end MEASUREMENT
/begin MEASUREMENT DINH_stFId.FId_FlTnkQnt "Inhibit Status of FIds / Status of function identifier FId_FlTnkQnt" UWORD DFC_OneToOne 1 100 0.00 65535.00 FORMAT "%8.2" ECU_ADDRESS 0x60013A82 /end MEASUREMENT
/begin MEASUREMENT DINH_stFId.FId_FuMixHotFilmErr "Inhibit Status of FIds / Status of function identifier FId_FuMixHotFilmErr" UWORD DFC_OneToOne 1 100 0.00 65535.00 FORMAT "%8.2" ECU_ADDRESS 0x60013A84 /end MEASUREMENT
/begin MEASUREMENT DINH_stFId.FId_FuMixUegoErrExcl "Inhibit Status of FIds / Status of function identifier FId_FuMixUegoErrExcl" UWORD DFC_OneToOne 1 100 0.00 65535.00 FORMAT "%8.2" ECU_ADDRESS 0x60013A86 /end MEASUREMENT
/begin MEASUREMENT DINH_stFId.FId_FuPHiRailEthnlSnsrErr "Inhibit Status of FIds / Status of function identifier FId_FuPHiRailEthnlSnsrErr" UWORD DFC_OneToOne 1 100 0.00 65535.00 FORMAT "%8.2" ECU_ADDRESS 0x60013A88 /end MEASUREMENT
/begin MEASUREMENT DINH_stFId.FId_FuPurg_TEVError "Inhibit Status of FIds / Status of function identifier FId_FuPurg_TEVError" UWORD DFC_OneToOne 1 100 0.00 65535.00 FORMAT "%8.2" ECU_ADDRESS 0x60013A8A /end MEASUREMENT
/begin MEASUREMENT DINH_stFId.FId_FuSnsrPhyRngErr "Inhibit Status of FIds / Status of function identifier FId_FuSnsrPhyRngErr" UWORD DFC_OneToOne 1 100 0.00 65535.00 FORMAT "%8.2" ECU_ADDRESS 0x60013A8C /end MEASUREMENT
/begin MEASUREMENT DINH_stFId.FId_GEVCtlAVCAdprCBBNWEErrIntk "Inhibit Status of FIds / Status of function identifier FId_GEVCtlAVCAdprCBBNWEErrIntk" UWORD DFC_OneToOne 1 100 0.00 65535.00 FORMAT "%8.2" ECU_ADDRESS 0x60013A8E /end MEASUREMENT
/begin MEASUREMENT DINH_stFId.FId_GEVCtlAVCAdprIntkB1 "Inhibit Status of FIds / Status of function identifier FId_GEVCtlAVCAdprIntkB1" UWORD DFC_OneToOne 1 100 0.00 65535.00 FORMAT "%8.2" ECU_ADDRESS 0x60013A90 /end MEASUREMENT
/begin MEASUREMENT DINH_stFId.FId_GEVCtlAVCAdprNWSEErrIntk "Inhibit Status of FIds / Status of function identifier FId_GEVCtlAVCAdprNWSEErrIntk" UWORD DFC_OneToOne 1 100 0.00 65535.00 FORMAT "%8.2" ECU_ADDRESS 0x60013A92 /end MEASUREMENT
/begin MEASUREMENT DINH_stFId.FId_GEVCtlAdpnEnaIntk "Inhibit Status of FIds / Status of function identifier FId_GEVCtlAdpnEnaIntk" UWORD DFC_OneToOne 1 100 0.00 65535.00 FORMAT "%8.2" ECU_ADDRESS 0x60013A94 /end MEASUREMENT
/begin MEASUREMENT DINH_stFId.FId_GEVCtlAdpnEnaShtrpActv "Inhibit Status of FIds / Status of function identifier FId_GEVCtlAdpnEnaShtrpActv" UWORD DFC_OneToOne 1 100 0.00 65535.00 FORMAT "%8.2" ECU_ADDRESS 0x60013A96 /end MEASUREMENT
/begin MEASUREMENT DINH_stFId.FId_GEVCtlClngIntk "Inhibit Status of FIds / Status of function identifier FId_GEVCtlClngIntk" UWORD DFC_OneToOne 1 100 0.00 65535.00 FORMAT "%8.2" ECU_ADDRESS 0x60013A98 /end MEASUREMENT
/begin MEASUREMENT DINH_stFId.FId_GEVCtlMinOvlIntk "Inhibit Status of FIds / Status of function identifier FId_GEVCtlMinOvlIntk" UWORD DFC_OneToOne 1 100 0.00 65535.00 FORMAT "%8.2" ECU_ADDRESS 0x60013A9A /end MEASUREMENT
/begin MEASUREMENT DINH_stFId.FId_GEVCtlPOilSnsr "Inhibit Status of FIds / Status of function identifier FId_GEVCtlPOilSnsr" UWORD DFC_OneToOne 1 100 0.00 65535.00 FORMAT "%8.2" ECU_ADDRESS 0x60013A9C /end MEASUREMENT
/begin MEASUREMENT DINH_stFId.FId_GEVCtlPhaEnaIntk "Inhibit Status of FIds / Status of function identifier FId_GEVCtlPhaEnaIntk" UWORD DFC_OneToOne 1 100 0.00 65535.00 FORMAT "%8.2" ECU_ADDRESS 0x60013A9E /end MEASUREMENT
/begin MEASUREMENT DINH_stFId.FId_GEVCtlPhaSpTstrIntk "Inhibit Status of FIds / Status of function identifier FId_GEVCtlPhaSpTstrIntk" UWORD DFC_OneToOne 1 100 0.00 65535.00 FORMAT "%8.2" ECU_ADDRESS 0x60013AA0 /end MEASUREMENT
/begin MEASUREMENT DINH_stFId.FId_GEVCtlRefAdpnMntChck "Inhibit Status of FIds / Status of function identifier FId_GEVCtlRefAdpnMntChck" UWORD DFC_OneToOne 1 100 0.00 65535.00 FORMAT "%8.2" ECU_ADDRESS 0x60013AA2 /end MEASUREMENT
/begin MEASUREMENT DINH_stFId.FId_GEVCtlRefAdpnMntChckTstd "Inhibit Status of FIds / Status of function identifier FId_GEVCtlRefAdpnMntChckTstd" UWORD DFC_OneToOne 1 100 0.00 65535.00 FORMAT "%8.2" ECU_ADDRESS 0x60013AA4 /end MEASUREMENT
/begin MEASUREMENT DINH_stFId.FId_GEVCtlReqRefAdpnTstrIntk "Inhibit Status of FIds / Status of function identifier FId_GEVCtlReqRefAdpnTstrIntk" UWORD DFC_OneToOne 1 100 0.00 65535.00 FORMAT "%8.2" ECU_ADDRESS 0x60013AA6 /end MEASUREMENT
/begin MEASUREMENT DINH_stFId.FId_GEVCtlReqRefAdpnTstrIntkTstd "Inhibit Status of FIds / Status of function identifier FId_GEVCtlReqRefAdpnTstrIntkTstd" UWORD DFC_OneToOne 1 100 0.00 65535.00 FORMAT "%8.2" ECU_ADDRESS 0x60013AA8 /end MEASUREMENT
/begin MEASUREMENT DINH_stFId.FId_GEVCtlVlvLftEnaIntk "Inhibit Status of FIds / Status of function identifier FId_GEVCtlVlvLftEnaIntk" UWORD DFC_OneToOne 1 100 0.00 65535.00 FORMAT "%8.2" ECU_ADDRESS 0x60013AAA /end MEASUREMENT
/begin MEASUREMENT DINH_stFId.FId_GEVCtlVlvOpenClsdIntkB1 "Inhibit Status of FIds / Status of function identifier FId_GEVCtlVlvOpenClsdIntkB1" UWORD DFC_OneToOne 1 100 0.00 65535.00 FORMAT "%8.2" ECU_ADDRESS 0x60013AAC /end MEASUREMENT
/begin MEASUREMENT DINH_stFId.FId_GEVlvLockPinDiagIntkB1 "Inhibit Status of FIds / Status of function identifier FId_GEVlvLockPinDiagIntkB1" UWORD DFC_OneToOne 1 100 0.00 65535.00 FORMAT "%8.2" ECU_ADDRESS 0x60013AAE /end MEASUREMENT
/begin MEASUREMENT DINH_stFId.FId_GEVlvPhaDiagEnaCsersIntkB1 "Inhibit Status of FIds / Status of function identifier FId_GEVlvPhaDiagEnaCsersIntkB1" UWORD DFC_OneToOne 1 100 0.00 65535.00 FORMAT "%8.2" ECU_ADDRESS 0x60013AB0 /end MEASUREMENT
/begin MEASUREMENT DINH_stFId.FId_GEVlvPhaDiagEnaIntkB1 "Inhibit Status of FIds / Status of function identifier FId_GEVlvPhaDiagEnaIntkB1" UWORD DFC_OneToOne 1 100 0.00 65535.00 FORMAT "%8.2" ECU_ADDRESS 0x60013AB2 /end MEASUREMENT
/begin MEASUREMENT DINH_stFId.FId_GEVlvPhaPsIntkB1 "Inhibit Status of FIds / Status of function identifier FId_GEVlvPhaPsIntkB1" UWORD DFC_OneToOne 1 100 0.00 65535.00 FORMAT "%8.2" ECU_ADDRESS 0x60013AB4 /end MEASUREMENT
/begin MEASUREMENT DINH_stFId.FId_GbxAnNeutPosnErr "Inhibit Status of FIds / Status of function identifier FId_GbxAnNeutPosnErr" UWORD DFC_OneToOne 1 100 0.00 65535.00 FORMAT "%8.2" ECU_ADDRESS 0x60013AB6 /end MEASUREMENT
/begin MEASUREMENT DINH_stFId.FId_GbxCANDigPlausErr "Inhibit Status of FIds / Status of function identifier FId_GbxCANDigPlausErr" UWORD DFC_OneToOne 1 100 0.00 65535.00 FORMAT "%8.2" ECU_ADDRESS 0x60013AB8 /end MEASUREMENT
/begin MEASUREMENT DINH_stFId.FId_GbxCANNeutSigErr "Inhibit Status of FIds / Status of function identifier FId_GbxCANNeutSigErr" UWORD DFC_OneToOne 1 100 0.00 65535.00 FORMAT "%8.2" ECU_ADDRESS 0x60013ABA /end MEASUREMENT
/begin MEASUREMENT DINH_stFId.FId_GbxPNPosSig "Inhibit Status of FIds / Status of function identifier FId_GbxPNPosSig" UWORD DFC_OneToOne 1 100 0.00 65535.00 FORMAT "%8.2" ECU_ADDRESS 0x60013ABC /end MEASUREMENT
/begin MEASUREMENT DINH_stFId.FId_GbxPNPosnComErr "Inhibit Status of FIds / Status of function identifier FId_GbxPNPosnComErr" UWORD DFC_OneToOne 1 100 0.00 65535.00 FORMAT "%8.2" ECU_ADDRESS 0x60013ABE /end MEASUREMENT
/begin MEASUREMENT DINH_stFId.FId_GbxPNPosnDiagDrvCdnRels "Inhibit Status of FIds / Status of function identifier FId_GbxPNPosnDiagDrvCdnRels" UWORD DFC_OneToOne 1 100 0.00 65535.00 FORMAT "%8.2" ECU_ADDRESS 0x60013AC0 /end MEASUREMENT
/begin MEASUREMENT DINH_stFId.FId_GbxPNPosnDiagDrvCodnHealRels "Inhibit Status of FIds / Status of function identifier FId_GbxPNPosnDiagDrvCodnHealRels" UWORD DFC_OneToOne 1 100 0.00 65535.00 FORMAT "%8.2" ECU_ADDRESS 0x60013AC2 /end MEASUREMENT
/begin MEASUREMENT DINH_stFId.FId_GbxPNPosnDiagPlausyRels "Inhibit Status of FIds / Status of function identifier FId_GbxPNPosnDiagPlausyRels" UWORD DFC_OneToOne 1 100 0.00 65535.00 FORMAT "%8.2" ECU_ADDRESS 0x60013AC4 /end MEASUREMENT
/begin MEASUREMENT DINH_stFId.FId_GbxPNPosnSubsVal "Inhibit Status of FIds / Status of function identifier FId_GbxPNPosnSubsVal" UWORD DFC_OneToOne 1 100 0.00 65535.00 FORMAT "%8.2" ECU_ADDRESS 0x60013AC6 /end MEASUREMENT
/begin MEASUREMENT DINH_stFId.FId_GbxRvsSwtStk "Inhibit Status of FIds / Status of function identifier FId_GbxRvsSwtStk" UWORD DFC_OneToOne 1 100 0.00 65535.00 FORMAT "%8.2" ECU_ADDRESS 0x60013AC8 /end MEASUREMENT
/begin MEASUREMENT DINH_stFId.FId_GbxSnsrSplyUErr "Inhibit Status of FIds / Status of function identifier FId_GbxSnsrSplyUErr" UWORD DFC_OneToOne 1 100 0.00 65535.00 FORMAT "%8.2" ECU_ADDRESS 0x60013ACA /end MEASUREMENT
/begin MEASUREMENT DINH_stFId.FId_GbxSpstReqOk "Inhibit Status of FIds / Status of function identifier FId_GbxSpstReqOk" UWORD DFC_OneToOne 1 100 0.00 65535.00 FORMAT "%8.2" ECU_ADDRESS 0x60013ACC /end MEASUREMENT
/begin MEASUREMENT DINH_stFId.FId_GlbDaLSumvXPtd "Inhibit Status of FIds / Status of function identifier FId_GlbDaLSumvXPtd" UWORD DFC_OneToOne 1 100 0.00 65535.00 FORMAT "%8.2" ECU_ADDRESS 0x60013ACE /end MEASUREMENT
/begin MEASUREMENT DINH_stFId.FId_GslThrVlvSnsrDiagB1 "Inhibit Status of FIds / Status of function identifier FId_GslThrVlvSnsrDiagB1" UWORD DFC_OneToOne 1 100 0.00 65535.00 FORMAT "%8.2" ECU_ADDRESS 0x60013AD0 /end MEASUREMENT
/begin MEASUREMENT DINH_stFId.FId_HEGOS2B1DElec "Inhibit Status of FIds / Status of function identifier FId_HEGOS2B1DElec" UWORD DFC_OneToOne 1 100 0.00 65535.00 FORMAT "%8.2" ECU_ADDRESS 0x60013AD2 /end MEASUREMENT
/begin MEASUREMENT DINH_stFId.FId_HEGOS2B1DHtg "Inhibit Status of FIds / Status of function identifier FId_HEGOS2B1DHtg" UWORD DFC_OneToOne 1 100 0.00 65535.00 FORMAT "%8.2" ECU_ADDRESS 0x60013AD4 /end MEASUREMENT
/begin MEASUREMENT DINH_stFId.FId_HEGOS2B1Htg "Inhibit Status of FIds / Status of function identifier FId_HEGOS2B1Htg" UWORD DFC_OneToOne 1 100 0.00 65535.00 FORMAT "%8.2" ECU_ADDRESS 0x60013AD6 /end MEASUREMENT
/begin MEASUREMENT DINH_stFId.FId_HEGOS2B1HtrPsSt "Inhibit Status of FIds / Status of function identifier FId_HEGOS2B1HtrPsSt" UWORD DFC_OneToOne 1 100 0.00 65535.00 FORMAT "%8.2" ECU_ADDRESS 0x60013AD8 /end MEASUREMENT
/begin MEASUREMENT DINH_stFId.FId_HEGOS2B1InVld "Inhibit Status of FIds / Status of function identifier FId_HEGOS2B1InVld" UWORD DFC_OneToOne 1 100 0.00 65535.00 FORMAT "%8.2" ECU_ADDRESS 0x60013ADA /end MEASUREMENT
/begin MEASUREMENT DINH_stFId.FId_HEGOS2B1LSPsDiaDi "Inhibit Status of FIds / Status of function identifier FId_HEGOS2B1LSPsDiaDi" UWORD DFC_OneToOne 1 100 0.00 65535.00 FORMAT "%8.2" ECU_ADDRESS 0x60013ADC /end MEASUREMENT
/begin MEASUREMENT DINH_stFId.FId_HLSDemBrkFlt "Inhibit Status of FIds / Status of function identifier FId_HLSDemBrkFlt" UWORD DFC_OneToOne 1 100 0.00 65535.00 FORMAT "%8.2" ECU_ADDRESS 0x60013ADE /end MEASUREMENT
/begin MEASUREMENT DINH_stFId.FId_HLSDemErr1 "Inhibit Status of FIds / Status of function identifier FId_HLSDemErr1" UWORD DFC_OneToOne 1 100 0.00 65535.00 FORMAT "%8.2" ECU_ADDRESS 0x60013AE0 /end MEASUREMENT
/begin MEASUREMENT DINH_stFId.FId_HLSDemErr2 "Inhibit Status of FIds / Status of function identifier FId_HLSDemErr2" UWORD DFC_OneToOne 1 100 0.00 65535.00 FORMAT "%8.2" ECU_ADDRESS 0x60013AE2 /end MEASUREMENT
/begin MEASUREMENT DINH_stFId.FId_HLSDemIntkAirTemp "Inhibit Status of FIds / Status of function identifier FId_HLSDemIntkAirTemp" UWORD DFC_OneToOne 1 100 0.00 65535.00 FORMAT "%8.2" ECU_ADDRESS 0x60013AE4 /end MEASUREMENT
/begin MEASUREMENT DINH_stFId.FId_HLSDemMotTemp "Inhibit Status of FIds / Status of function identifier FId_HLSDemMotTemp" UWORD DFC_OneToOne 1 100 0.00 65535.00 FORMAT "%8.2" ECU_ADDRESS 0x60013AE6 /end MEASUREMENT
/begin MEASUREMENT DINH_stFId.FId_HLSDemMstCyldpVld "Inhibit Status of FIds / Status of function identifier FId_HLSDemMstCyldpVld" UWORD DFC_OneToOne 1 100 0.00 65535.00 FORMAT "%8.2" ECU_ADDRESS 0x60013AE8 /end MEASUREMENT
/begin MEASUREMENT DINH_stFId.FId_HLSDemSpdClthGearAccrSigErr "Inhibit Status of FIds / Status of function identifier FId_HLSDemSpdClthGearAccrSigErr" UWORD DFC_OneToOne 1 100 0.00 65535.00 FORMAT "%8.2" ECU_ADDRESS 0x60013AEA /end MEASUREMENT
/begin MEASUREMENT DINH_stFId.FId_HLSDem_DrvOffSuprt "Inhibit Status of FIds / Status of function identifier FId_HLSDem_DrvOffSuprt" UWORD DFC_OneToOne 1 100 0.00 65535.00 FORMAT "%8.2" ECU_ADDRESS 0x60013AEC /end MEASUREMENT
/begin MEASUREMENT DINH_stFId.FId_HLSDem_DrvOffSuprtBrkHldSys "Inhibit Status of FIds / Status of function identifier FId_HLSDem_DrvOffSuprtBrkHldSys" UWORD DFC_OneToOne 1 100 0.00 65535.00 FORMAT "%8.2" ECU_ADDRESS 0x60013AEE /end MEASUREMENT
/begin MEASUREMENT DINH_stFId.FId_HLSDem_DrvOffSuprtLAS "Inhibit Status of FIds / Status of function identifier FId_HLSDem_DrvOffSuprtLAS" UWORD DFC_OneToOne 1 100 0.00 65535.00 FORMAT "%8.2" ECU_ADDRESS 0x60013AF0 /end MEASUREMENT
/begin MEASUREMENT DINH_stFId.FId_HLSDem_PModeActv "Inhibit Status of FIds / Status of function identifier FId_HLSDem_PModeActv" UWORD DFC_OneToOne 1 100 0.00 65535.00 FORMAT "%8.2" ECU_ADDRESS 0x60013AF2 /end MEASUREMENT
/begin MEASUREMENT DINH_stFId.FId_HLSDem_TModeActv "Inhibit Status of FIds / Status of function identifier FId_HLSDem_TModeActv" UWORD DFC_OneToOne 1 100 0.00 65535.00 FORMAT "%8.2" ECU_ADDRESS 0x60013AF4 /end MEASUREMENT
/begin MEASUREMENT DINH_stFId.FId_HLSDem_TraSubFcn "Inhibit Status of FIds / Status of function identifier FId_HLSDem_TraSubFcn" UWORD DFC_OneToOne 1 100 0.00 65535.00 FORMAT "%8.2" ECU_ADDRESS 0x60013AF6 /end MEASUREMENT
/begin MEASUREMENT DINH_stFId.FId_HLSDem_nMaxLimErr1 "Inhibit Status of FIds / Status of function identifier FId_HLSDem_nMaxLimErr1" UWORD DFC_OneToOne 1 100 0.00 65535.00 FORMAT "%8.2" ECU_ADDRESS 0x60013AF8 /end MEASUREMENT
/begin MEASUREMENT DINH_stFId.FId_HLSDem_nMaxLimErr2 "Inhibit Status of FIds / Status of function identifier FId_HLSDem_nMaxLimErr2" UWORD DFC_OneToOne 1 100 0.00 65535.00 FORMAT "%8.2" ECU_ADDRESS 0x60013AFA /end MEASUREMENT
/begin MEASUREMENT DINH_stFId.FId_HLSDem_nMaxLimErr3 "Inhibit Status of FIds / Status of function identifier FId_HLSDem_nMaxLimErr3" UWORD DFC_OneToOne 1 100 0.00 65535.00 FORMAT "%8.2" ECU_ADDRESS 0x60013AFC /end MEASUREMENT
/begin MEASUREMENT DINH_stFId.FId_HLSDem_nMaxVErr "Inhibit Status of FIds / Status of function identifier FId_HLSDem_nMaxVErr" UWORD DFC_OneToOne 1 100 0.00 65535.00 FORMAT "%8.2" ECU_ADDRESS 0x60013AFE /end MEASUREMENT
/begin MEASUREMENT DINH_stFId.FId_I14229APP "Inhibit Status of FIds / Status of function identifier FId_I14229APP" UWORD DFC_OneToOne 1 100 0.00 65535.00 FORMAT "%8.2" ECU_ADDRESS 0x60013B00 /end MEASUREMENT
/begin MEASUREMENT DINH_stFId.FId_I14229CANErr "Inhibit Status of FIds / Status of function identifier FId_I14229CANErr" UWORD DFC_OneToOne 1 100 0.00 65535.00 FORMAT "%8.2" ECU_ADDRESS 0x60013B02 /end MEASUREMENT
/begin MEASUREMENT DINH_stFId.FId_I14229FlLvlFltComErr "Inhibit Status of FIds / Status of function identifier FId_I14229FlLvlFltComErr" UWORD DFC_OneToOne 1 100 0.00 65535.00 FORMAT "%8.2" ECU_ADDRESS 0x60013B04 /end MEASUREMENT
/begin MEASUREMENT DINH_stFId.FId_I14229VTCErr "Inhibit Status of FIds / Status of function identifier FId_I14229VTCErr" UWORD DFC_OneToOne 1 100 0.00 65535.00 FORMAT "%8.2" ECU_ADDRESS 0x60013B06 /end MEASUREMENT
/begin MEASUREMENT DINH_stFId.FId_IMGISABComErr "Inhibit Status of FIds / Status of function identifier FId_IMGISABComErr" UWORD DFC_OneToOne 1 100 0.00 65535.00 FORMAT "%8.2" ECU_ADDRESS 0x60013B08 /end MEASUREMENT
/begin MEASUREMENT DINH_stFId.FId_InhbLamDynS1B1 "Inhibit Status of FIds / Status of function identifier FId_InhbLamDynS1B1" UWORD DFC_OneToOne 1 100 0.00 65535.00 FORMAT "%8.2" ECU_ADDRESS 0x60013B0A /end MEASUREMENT
/begin MEASUREMENT DINH_stFId.FId_InhbnBlkdLineDiag "Inhibit Status of FIds / Status of function identifier FId_InhbnBlkdLineDiag" UWORD DFC_OneToOne 1 100 0.00 65535.00 FORMAT "%8.2" ECU_ADDRESS 0x60013B0C /end MEASUREMENT
/begin MEASUREMENT DINH_stFId.FId_InhibitAlways "Inhibit Status of FIds / Status of function identifier FId_InhibitAlways" UWORD DFC_OneToOne 1 100 0.00 65535.00 FORMAT "%8.2" ECU_ADDRESS 0x60013B0E /end MEASUREMENT
/begin MEASUREMENT DINH_stFId.FId_InhibitNever "Inhibit Status of FIds / Status of function identifier FId_InhibitNever" UWORD DFC_OneToOne 1 100 0.00 65535.00 FORMAT "%8.2" ECU_ADDRESS 0x60013B10 /end MEASUREMENT
/begin MEASUREMENT DINH_stFId.FId_InjSysMulInjDiagErr "Inhibit Status of FIds / Status of function identifier FId_InjSysMulInjDiagErr" UWORD DFC_OneToOne 1 100 0.00 65535.00 FORMAT "%8.2" ECU_ADDRESS 0x60013B12 /end MEASUREMENT
/begin MEASUREMENT DINH_stFId.FId_InjVlvPs_Bank1OnlyErr "Inhibit Status of FIds / Status of function identifier FId_InjVlvPs_Bank1OnlyErr" UWORD DFC_OneToOne 1 100 0.00 65535.00 FORMAT "%8.2" ECU_ADDRESS 0x60013B14 /end MEASUREMENT
/begin MEASUREMENT DINH_stFId.FId_InjVlvPs_Bank1Tested "Inhibit Status of FIds / Status of function identifier FId_InjVlvPs_Bank1Tested" UWORD DFC_OneToOne 1 100 0.00 65535.00 FORMAT "%8.2" ECU_ADDRESS 0x60013B16 /end MEASUREMENT
/begin MEASUREMENT DINH_stFId.FId_InjVlvPs_Bank2OnlyErr "Inhibit Status of FIds / Status of function identifier FId_InjVlvPs_Bank2OnlyErr" UWORD DFC_OneToOne 1 100 0.00 65535.00 FORMAT "%8.2" ECU_ADDRESS 0x60013B18 /end MEASUREMENT
/begin MEASUREMENT DINH_stFId.FId_InjVlvPs_Bank2Tested "Inhibit Status of FIds / Status of function identifier FId_InjVlvPs_Bank2Tested" UWORD DFC_OneToOne 1 100 0.00 65535.00 FORMAT "%8.2" ECU_ADDRESS 0x60013B1A /end MEASUREMENT
/begin MEASUREMENT DINH_stFId.FId_InjVlvPs_Bank3OnlyErr "Inhibit Status of FIds / Status of function identifier FId_InjVlvPs_Bank3OnlyErr" UWORD DFC_OneToOne 1 100 0.00 65535.00 FORMAT "%8.2" ECU_ADDRESS 0x60013B1C /end MEASUREMENT
/begin MEASUREMENT DINH_stFId.FId_InjVlvPs_Bank3Tested "Inhibit Status of FIds / Status of function identifier FId_InjVlvPs_Bank3Tested" UWORD DFC_OneToOne 1 100 0.00 65535.00 FORMAT "%8.2" ECU_ADDRESS 0x60013B1E /end MEASUREMENT
/begin MEASUREMENT DINH_stFId.FId_IntkAirTAirFltDsCrssChk "Inhibit Status of FIds / Status of function identifier FId_IntkAirTAirFltDsCrssChk" UWORD DFC_OneToOne 1 100 0.00 65535.00 FORMAT "%8.2" ECU_ADDRESS 0x60013B20 /end MEASUREMENT
/begin MEASUREMENT DINH_stFId.FId_IntkAirTAirFltDsPlausChk "Inhibit Status of FIds / Status of function identifier FId_IntkAirTAirFltDsPlausChk" UWORD DFC_OneToOne 1 100 0.00 65535.00 FORMAT "%8.2" ECU_ADDRESS 0x60013B22 /end MEASUREMENT
/begin MEASUREMENT DINH_stFId.FId_IntkAirTIntkMnfldCrssChk "Inhibit Status of FIds / Status of function identifier FId_IntkAirTIntkMnfldCrssChk" UWORD DFC_OneToOne 1 100 0.00 65535.00 FORMAT "%8.2" ECU_ADDRESS 0x60013B24 /end MEASUREMENT
/begin MEASUREMENT DINH_stFId.FId_IntkAirTIntkMnfldPlausChk "Inhibit Status of FIds / Status of function identifier FId_IntkAirTIntkMnfldPlausChk" UWORD DFC_OneToOne 1 100 0.00 65535.00 FORMAT "%8.2" ECU_ADDRESS 0x60013B26 /end MEASUREMENT
/begin MEASUREMENT DINH_stFId.FId_IntkAirTIntkMnfldRepl "Inhibit Status of FIds / Status of function identifier FId_IntkAirTIntkMnfldRepl" UWORD DFC_OneToOne 1 100 0.00 65535.00 FORMAT "%8.2" ECU_ADDRESS 0x60013B28 /end MEASUREMENT
/begin MEASUREMENT DINH_stFId.FId_IntkAirTSnsr1Elec "Inhibit Status of FIds / Status of function identifier FId_IntkAirTSnsr1Elec" UWORD DFC_OneToOne 1 100 0.00 65535.00 FORMAT "%8.2" ECU_ADDRESS 0x60013B2A /end MEASUREMENT
/begin MEASUREMENT DINH_stFId.FId_IntkAirTSnsr1PRC "Inhibit Status of FIds / Status of function identifier FId_IntkAirTSnsr1PRC" UWORD DFC_OneToOne 1 100 0.00 65535.00 FORMAT "%8.2" ECU_ADDRESS 0x60013B2C /end MEASUREMENT
/begin MEASUREMENT DINH_stFId.FId_IntkAirTSnsr1Sum "Inhibit Status of FIds / Status of function identifier FId_IntkAirTSnsr1Sum" UWORD DFC_OneToOne 1 100 0.00 65535.00 FORMAT "%8.2" ECU_ADDRESS 0x60013B2E /end MEASUREMENT
/begin MEASUREMENT DINH_stFId.FId_IntkAirTSnsr2Elec "Inhibit Status of FIds / Status of function identifier FId_IntkAirTSnsr2Elec" UWORD DFC_OneToOne 1 100 0.00 65535.00 FORMAT "%8.2" ECU_ADDRESS 0x60013B30 /end MEASUREMENT
/begin MEASUREMENT DINH_stFId.FId_IntkAirTSnsr2PRC "Inhibit Status of FIds / Status of function identifier FId_IntkAirTSnsr2PRC" UWORD DFC_OneToOne 1 100 0.00 65535.00 FORMAT "%8.2" ECU_ADDRESS 0x60013B32 /end MEASUREMENT
/begin MEASUREMENT DINH_stFId.FId_IntkAirTSnsr2Sum "Inhibit Status of FIds / Status of function identifier FId_IntkAirTSnsr2Sum" UWORD DFC_OneToOne 1 100 0.00 65535.00 FORMAT "%8.2" ECU_ADDRESS 0x60013B34 /end MEASUREMENT
/begin MEASUREMENT DINH_stFId.FId_IntkArTempENGB "Inhibit Status of FIds / Status of function identifier FId_IntkArTempENGB" UWORD DFC_OneToOne 1 100 0.00 65535.00 FORMAT "%8.2" ECU_ADDRESS 0x60013B36 /end MEASUREMENT
/begin MEASUREMENT DINH_stFId.FId_LIGovDfrstI "Inhibit Status of FIds / Status of function identifier FId_LIGovDfrstI" UWORD DFC_OneToOne 1 100 0.00 65535.00 FORMAT "%8.2" ECU_ADDRESS 0x60013B38 /end MEASUREMENT
/begin MEASUREMENT DINH_stFId.FId_LIGovUndrBrk "Inhibit Status of FIds / Status of function identifier FId_LIGovUndrBrk" UWORD DFC_OneToOne 1 100 0.00 65535.00 FORMAT "%8.2" ECU_ADDRESS 0x60013B3A /end MEASUREMENT
/begin MEASUREMENT DINH_stFId.FId_LINDCDCRxErr "Inhibit Status of FIds / Status of function identifier FId_LINDCDCRxErr" UWORD DFC_OneToOne 1 100 0.00 65535.00 FORMAT "%8.2" ECU_ADDRESS 0x60013B3C /end MEASUREMENT
/begin MEASUREMENT DINH_stFId.FId_LLimAppSnsrErr "Inhibit Status of FIds / Status of function identifier FId_LLimAppSnsrErr" UWORD DFC_OneToOne 1 100 0.00 65535.00 FORMAT "%8.2" ECU_ADDRESS 0x60013B3E /end MEASUREMENT
/begin MEASUREMENT DINH_stFId.FId_LLimAppSnsrSyncErr "Inhibit Status of FIds / Status of function identifier FId_LLimAppSnsrSyncErr" UWORD DFC_OneToOne 1 100 0.00 65535.00 FORMAT "%8.2" ECU_ADDRESS 0x60013B40 /end MEASUREMENT
/begin MEASUREMENT DINH_stFId.FId_LLimMTVehSpdSnsrErr "Inhibit Status of FIds / Status of function identifier FId_LLimMTVehSpdSnsrErr" UWORD DFC_OneToOne 1 100 0.00 65535.00 FORMAT "%8.2" ECU_ADDRESS 0x60013B42 /end MEASUREMENT
/begin MEASUREMENT DINH_stFId.FId_LLimShutOffEng "Inhibit Status of FIds / Status of function identifier FId_LLimShutOffEng" UWORD DFC_OneToOne 1 100 0.00 65535.00 FORMAT "%8.2" ECU_ADDRESS 0x60013B44 /end MEASUREMENT
/begin MEASUREMENT DINH_stFId.FId_LRSEBMisf "Inhibit Status of FIds / Status of function identifier FId_LRSEBMisf" UWORD DFC_OneToOne 1 100 0.00 65535.00 FORMAT "%8.2" ECU_ADDRESS 0x60013B46 /end MEASUREMENT
/begin MEASUREMENT DINH_stFId.FId_LZSR "Inhibit Status of FIds / Status of function identifier FId_LZSR" UWORD DFC_OneToOne 1 100 0.00 65535.00 FORMAT "%8.2" ECU_ADDRESS 0x60013B48 /end MEASUREMENT
/begin MEASUREMENT DINH_stFId.FId_LeakToMnfld "Inhibit Status of FIds / Status of function identifier FId_LeakToMnfld" UWORD DFC_OneToOne 1 100 0.00 65535.00 FORMAT "%8.2" ECU_ADDRESS 0x60013B4A /end MEASUREMENT
/begin MEASUREMENT DINH_stFId.FId_LeakToMnfldTstd "Inhibit Status of FIds / Status of function identifier FId_LeakToMnfldTstd" UWORD DFC_OneToOne 1 100 0.00 65535.00 FORMAT "%8.2" ECU_ADDRESS 0x60013B4C /end MEASUREMENT
/begin MEASUREMENT DINH_stFId.FId_LimpHomPsErrInjtr "Inhibit Status of FIds / Status of function identifier FId_LimpHomPsErrInjtr" UWORD DFC_OneToOne 1 100 0.00 65535.00 FORMAT "%8.2" ECU_ADDRESS 0x60013B4E /end MEASUREMENT
/begin MEASUREMENT DINH_stFId.FId_LinACGUnitCfmdErr "Inhibit Status of FIds / Status of function identifier FId_LinACGUnitCfmdErr" UWORD DFC_OneToOne 1 100 0.00 65535.00 FORMAT "%8.2" ECU_ADDRESS 0x60013B50 /end MEASUREMENT
/begin MEASUREMENT DINH_stFId.FId_LinACGUnitNotTstd "Inhibit Status of FIds / Status of function identifier FId_LinACGUnitNotTstd" UWORD DFC_OneToOne 1 100 0.00 65535.00 FORMAT "%8.2" ECU_ADDRESS 0x60013B52 /end MEASUREMENT
/begin MEASUREMENT DINH_stFId.FId_LinAEVUnitCfmdErr "Inhibit Status of FIds / Status of function identifier FId_LinAEVUnitCfmdErr" UWORD DFC_OneToOne 1 100 0.00 65535.00 FORMAT "%8.2" ECU_ADDRESS 0x60013B54 /end MEASUREMENT
/begin MEASUREMENT DINH_stFId.FId_LinAEVUnitNotTstd "Inhibit Status of FIds / Status of function identifier FId_LinAEVUnitNotTstd" UWORD DFC_OneToOne 1 100 0.00 65535.00 FORMAT "%8.2" ECU_ADDRESS 0x60013B56 /end MEASUREMENT
/begin MEASUREMENT DINH_stFId.FId_LinEBSUnitCfmdErr "Inhibit Status of FIds / Status of function identifier FId_LinEBSUnitCfmdErr" UWORD DFC_OneToOne 1 100 0.00 65535.00 FORMAT "%8.2" ECU_ADDRESS 0x60013B58 /end MEASUREMENT
/begin MEASUREMENT DINH_stFId.FId_LinEBSUnitNotTstd "Inhibit Status of FIds / Status of function identifier FId_LinEBSUnitNotTstd" UWORD DFC_OneToOne 1 100 0.00 65535.00 FORMAT "%8.2" ECU_ADDRESS 0x60013B5A /end MEASUREMENT
/begin MEASUREMENT DINH_stFId.FId_LowPresOilP "Inhibit Status of FIds / Status of function identifier FId_LowPresOilP" UWORD DFC_OneToOne 1 100 0.00 65535.00 FORMAT "%8.2" ECU_ADDRESS 0x60013B5C /end MEASUREMENT
/begin MEASUREMENT DINH_stFId.FId_MFlowAirCrkcsSubVal "Inhibit Status of FIds / Status of function identifier FId_MFlowAirCrkcsSubVal" UWORD DFC_OneToOne 1 100 0.00 65535.00 FORMAT "%8.2" ECU_ADDRESS 0x60013B5E /end MEASUREMENT
/begin MEASUREMENT DINH_stFId.FId_MFuOilMax "Inhibit Status of FIds / Status of function identifier FId_MFuOilMax" UWORD DFC_OneToOne 1 100 0.00 65535.00 FORMAT "%8.2" ECU_ADDRESS 0x60013B60 /end MEASUREMENT
/begin MEASUREMENT DINH_stFId.FId_MaiLoadSnsr "Inhibit Status of FIds / Status of function identifier FId_MaiLoadSnsr" UWORD DFC_OneToOne 1 100 0.00 65535.00 FORMAT "%8.2" ECU_ADDRESS 0x60013B62 /end MEASUREMENT
/begin MEASUREMENT DINH_stFId.FId_MaiShaftFailr "Inhibit Status of FIds / Status of function identifier FId_MaiShaftFailr" UWORD DFC_OneToOne 1 100 0.00 65535.00 FORMAT "%8.2" ECU_ADDRESS 0x60013B64 /end MEASUREMENT
/begin MEASUREMENT DINH_stFId.FId_MfPsDia1 "Inhibit Status of FIds / Status of function identifier FId_MfPsDia1" UWORD DFC_OneToOne 1 100 0.00 65535.00 FORMAT "%8.2" ECU_ADDRESS 0x60013B66 /end MEASUREMENT
/begin MEASUREMENT DINH_stFId.FId_MisfDetDnAdpn "Inhibit Status of FIds / Status of function identifier FId_MisfDetDnAdpn" UWORD DFC_OneToOne 1 100 0.00 65535.00 FORMAT "%8.2" ECU_ADDRESS 0x60013B68 /end MEASUREMENT
/begin MEASUREMENT DINH_stFId.FId_MisfDetDnAdpnPlaus "Inhibit Status of FIds / Status of function identifier FId_MisfDetDnAdpnPlaus" UWORD DFC_OneToOne 1 100 0.00 65535.00 FORMAT "%8.2" ECU_ADDRESS 0x60013B6A /end MEASUREMENT
/begin MEASUREMENT DINH_stFId.FId_MisfDetEnvP "Inhibit Status of FIds / Status of function identifier FId_MisfDetEnvP" UWORD DFC_OneToOne 1 100 0.00 65535.00 FORMAT "%8.2" ECU_ADDRESS 0x60013B6C /end MEASUREMENT
/begin MEASUREMENT DINH_stFId.FId_MisfDetSegTiAdpnFco "Inhibit Status of FIds / Status of function identifier FId_MisfDetSegTiAdpnFco" UWORD DFC_OneToOne 1 100 0.00 65535.00 FORMAT "%8.2" ECU_ADDRESS 0x60013B6E /end MEASUREMENT
/begin MEASUREMENT DINH_stFId.FId_MisfDetShtrpAct "Inhibit Status of FIds / Status of function identifier FId_MisfDetShtrpAct" UWORD DFC_OneToOne 1 100 0.00 65535.00 FORMAT "%8.2" ECU_ADDRESS 0x60013B70 /end MEASUREMENT
/begin MEASUREMENT DINH_stFId.FId_MisfDetStc "Inhibit Status of FIds / Status of function identifier FId_MisfDetStc" UWORD DFC_OneToOne 1 100 0.00 65535.00 FORMAT "%8.2" ECU_ADDRESS 0x60013B72 /end MEASUREMENT
/begin MEASUREMENT DINH_stFId.FId_MisfDetV "Inhibit Status of FIds / Status of function identifier FId_MisfDetV" UWORD DFC_OneToOne 1 100 0.00 65535.00 FORMAT "%8.2" ECU_ADDRESS 0x60013B74 /end MEASUREMENT
/begin MEASUREMENT DINH_stFId.FId_MisfDetVWhlFrntLe "Inhibit Status of FIds / Status of function identifier FId_MisfDetVWhlFrntLe" UWORD DFC_OneToOne 1 100 0.00 65535.00 FORMAT "%8.2" ECU_ADDRESS 0x60013B76 /end MEASUREMENT
/begin MEASUREMENT DINH_stFId.FId_MisfDetVWhlFrntRi "Inhibit Status of FIds / Status of function identifier FId_MisfDetVWhlFrntRi" UWORD DFC_OneToOne 1 100 0.00 65535.00 FORMAT "%8.2" ECU_ADDRESS 0x60013B78 /end MEASUREMENT
/begin MEASUREMENT DINH_stFId.FId_MisfDetVWhlReLe "Inhibit Status of FIds / Status of function identifier FId_MisfDetVWhlReLe" UWORD DFC_OneToOne 1 100 0.00 65535.00 FORMAT "%8.2" ECU_ADDRESS 0x60013B7A /end MEASUREMENT
/begin MEASUREMENT DINH_stFId.FId_MisfDetVWhlReRi "Inhibit Status of FIds / Status of function identifier FId_MisfDetVWhlReRi" UWORD DFC_OneToOne 1 100 0.00 65535.00 FORMAT "%8.2" ECU_ADDRESS 0x60013B7C /end MEASUREMENT
/begin MEASUREMENT DINH_stFId.FId_NLimVehHalt "Inhibit Status of FIds / Status of function identifier FId_NLimVehHalt" UWORD DFC_OneToOne 1 100 0.00 65535.00 FORMAT "%8.2" ECU_ADDRESS 0x60013B7E /end MEASUREMENT
/begin MEASUREMENT DINH_stFId.FId_NSHTDAmbT "Inhibit Status of FIds / Status of function identifier FId_NSHTDAmbT" UWORD DFC_OneToOne 1 100 0.00 65535.00 FORMAT "%8.2" ECU_ADDRESS 0x60013B80 /end MEASUREMENT
/begin MEASUREMENT DINH_stFId.FId_NSHTDEngT "Inhibit Status of FIds / Status of function identifier FId_NSHTDEngT" UWORD DFC_OneToOne 1 100 0.00 65535.00 FORMAT "%8.2" ECU_ADDRESS 0x60013B82 /end MEASUREMENT
/begin MEASUREMENT DINH_stFId.FId_NSHTILimHiAltiLoIdleSp "Inhibit Status of FIds / Status of function identifier FId_NSHTILimHiAltiLoIdleSp" UWORD DFC_OneToOne 1 100 0.00 65535.00 FORMAT "%8.2" ECU_ADDRESS 0x60013B84 /end MEASUREMENT
/begin MEASUREMENT DINH_stFId.FId_NeutPosnFailr "Inhibit Status of FIds / Status of function identifier FId_NeutPosnFailr" UWORD DFC_OneToOne 1 100 0.00 65535.00 FORMAT "%8.2" ECU_ADDRESS 0x60013B86 /end MEASUREMENT
/begin MEASUREMENT DINH_stFId.FId_O2StorgMdlMD "Inhibit Status of FIds / Status of function identifier FId_O2StorgMdlMD" UWORD DFC_OneToOne 1 100 0.00 65535.00 FORMAT "%8.2" ECU_ADDRESS 0x60013B88 /end MEASUREMENT
/begin MEASUREMENT DINH_stFId.FId_OilCmbdSen_LvlDfctHW "Inhibit Status of FIds / Status of function identifier FId_OilCmbdSen_LvlDfctHW" UWORD DFC_OneToOne 1 100 0.00 65535.00 FORMAT "%8.2" ECU_ADDRESS 0x60013B8A /end MEASUREMENT
/begin MEASUREMENT DINH_stFId.FId_OilPCtrlVlvNpl "Inhibit Status of FIds / Status of function identifier FId_OilPCtrlVlvNpl" UWORD DFC_OneToOne 1 100 0.00 65535.00 FORMAT "%8.2" ECU_ADDRESS 0x60013B8C /end MEASUREMENT
/begin MEASUREMENT DINH_stFId.FId_OilPFrzVal "Inhibit Status of FIds / Status of function identifier FId_OilPFrzVal" UWORD DFC_OneToOne 1 100 0.00 65535.00 FORMAT "%8.2" ECU_ADDRESS 0x60013B8E /end MEASUREMENT
/begin MEASUREMENT DINH_stFId.FId_OilPPlaus "Inhibit Status of FIds / Status of function identifier FId_OilPPlaus" UWORD DFC_OneToOne 1 100 0.00 65535.00 FORMAT "%8.2" ECU_ADDRESS 0x60013B90 /end MEASUREMENT
/begin MEASUREMENT DINH_stFId.FId_OilPPlausAftRun "Inhibit Status of FIds / Status of function identifier FId_OilPPlausAftRun" UWORD DFC_OneToOne 1 100 0.00 65535.00 FORMAT "%8.2" ECU_ADDRESS 0x60013B92 /end MEASUREMENT
/begin MEASUREMENT DINH_stFId.FId_OilPPlausMax "Inhibit Status of FIds / Status of function identifier FId_OilPPlausMax" UWORD DFC_OneToOne 1 100 0.00 65535.00 FORMAT "%8.2" ECU_ADDRESS 0x60013B94 /end MEASUREMENT
/begin MEASUREMENT DINH_stFId.FId_OilPPlausMin "Inhibit Status of FIds / Status of function identifier FId_OilPPlausMin" UWORD DFC_OneToOne 1 100 0.00 65535.00 FORMAT "%8.2" ECU_ADDRESS 0x60013B96 /end MEASUREMENT
/begin MEASUREMENT DINH_stFId.FId_OilPPlausT15 "Inhibit Status of FIds / Status of function identifier FId_OilPPlausT15" UWORD DFC_OneToOne 1 100 0.00 65535.00 FORMAT "%8.2" ECU_ADDRESS 0x60013B98 /end MEASUREMENT
/begin MEASUREMENT DINH_stFId.FId_OilPRplVal "Inhibit Status of FIds / Status of function identifier FId_OilPRplVal" UWORD DFC_OneToOne 1 100 0.00 65535.00 FORMAT "%8.2" ECU_ADDRESS 0x60013B9A /end MEASUREMENT
/begin MEASUREMENT DINH_stFId.FId_OilPSnsrErr "Inhibit Status of FIds / Status of function identifier FId_OilPSnsrErr" UWORD DFC_OneToOne 1 100 0.00 65535.00 FORMAT "%8.2" ECU_ADDRESS 0x60013B9C /end MEASUREMENT
/begin MEASUREMENT DINH_stFId.FId_OilPSwmpSRC "Inhibit Status of FIds / Status of function identifier FId_OilPSwmpSRC" UWORD DFC_OneToOne 1 100 0.00 65535.00 FORMAT "%8.2" ECU_ADDRESS 0x60013B9E /end MEASUREMENT
/begin MEASUREMENT DINH_stFId.FId_OilSwmpTCEngDsTWrmUp "Inhibit Status of FIds / Status of function identifier FId_OilSwmpTCEngDsTWrmUp" UWORD DFC_OneToOne 1 100 0.00 65535.00 FORMAT "%8.2" ECU_ADDRESS 0x60013BA0 /end MEASUREMENT
/begin MEASUREMENT DINH_stFId.FId_OilSwmpT_B_tospg "Inhibit Status of FIds / Status of function identifier FId_OilSwmpT_B_tospg" UWORD DFC_OneToOne 1 100 0.00 65535.00 FORMAT "%8.2" ECU_ADDRESS 0x60013BA2 /end MEASUREMENT
/begin MEASUREMENT DINH_stFId.FId_OilSwmpT_B_tospgg "Inhibit Status of FIds / Status of function identifier FId_OilSwmpT_B_tospgg" UWORD DFC_OneToOne 1 100 0.00 65535.00 FORMAT "%8.2" ECU_ADDRESS 0x60013BA4 /end MEASUREMENT
/begin MEASUREMENT DINH_stFId.FId_OilSwmpT_CmbdSnsrErr "Inhibit Status of FIds / Status of function identifier FId_OilSwmpT_CmbdSnsrErr" UWORD DFC_OneToOne 1 100 0.00 65535.00 FORMAT "%8.2" ECU_ADDRESS 0x60013BA6 /end MEASUREMENT
/begin MEASUREMENT DINH_stFId.FId_OilSwmpT_CmbdSnsrTiTErr "Inhibit Status of FIds / Status of function identifier FId_OilSwmpT_CmbdSnsrTiTErr" UWORD DFC_OneToOne 1 100 0.00 65535.00 FORMAT "%8.2" ECU_ADDRESS 0x60013BA8 /end MEASUREMENT
/begin MEASUREMENT DINH_stFId.FId_OilSwmpT_EnvT "Inhibit Status of FIds / Status of function identifier FId_OilSwmpT_EnvT" UWORD DFC_OneToOne 1 100 0.00 65535.00 FORMAT "%8.2" ECU_ADDRESS 0x60013BAA /end MEASUREMENT
/begin MEASUREMENT DINH_stFId.FId_OilSwmpT_TSnsrErr "Inhibit Status of FIds / Status of function identifier FId_OilSwmpT_TSnsrErr" UWORD DFC_OneToOne 1 100 0.00 65535.00 FORMAT "%8.2" ECU_ADDRESS 0x60013BAC /end MEASUREMENT
/begin MEASUREMENT DINH_stFId.FId_PEnvMeasVld "Inhibit Status of FIds / Status of function identifier FId_PEnvMeasVld" UWORD DFC_OneToOne 1 100 0.00 65535.00 FORMAT "%8.2" ECU_ADDRESS 0x60013BAE /end MEASUREMENT
/begin MEASUREMENT DINH_stFId.FId_PEnvModel "Inhibit Status of FIds / Status of function identifier FId_PEnvModel" UWORD DFC_OneToOne 1 100 0.00 65535.00 FORMAT "%8.2" ECU_ADDRESS 0x60013BB0 /end MEASUREMENT
/begin MEASUREMENT DINH_stFId.FId_PEnvPlausDiagVDD "Inhibit Status of FIds / Status of function identifier FId_PEnvPlausDiagVDD" UWORD DFC_OneToOne 1 100 0.00 65535.00 FORMAT "%8.2" ECU_ADDRESS 0x60013BB2 /end MEASUREMENT
/begin MEASUREMENT DINH_stFId.FId_PEnvRawVldVDD "Inhibit Status of FIds / Status of function identifier FId_PEnvRawVldVDD" UWORD DFC_OneToOne 1 100 0.00 65535.00 FORMAT "%8.2" ECU_ADDRESS 0x60013BB4 /end MEASUREMENT
/begin MEASUREMENT DINH_stFId.FId_PEnvRefSnsr "Inhibit Status of FIds / Status of function identifier FId_PEnvRefSnsr" UWORD DFC_OneToOne 1 100 0.00 65535.00 FORMAT "%8.2" ECU_ADDRESS 0x60013BB6 /end MEASUREMENT
/begin MEASUREMENT DINH_stFId.FId_PEnvSigRngVld "Inhibit Status of FIds / Status of function identifier FId_PEnvSigRngVld" UWORD DFC_OneToOne 1 100 0.00 65535.00 FORMAT "%8.2" ECU_ADDRESS 0x60013BB8 /end MEASUREMENT
/begin MEASUREMENT DINH_stFId.FId_PEnvSnsrPlausVDD "Inhibit Status of FIds / Status of function identifier FId_PEnvSnsrPlausVDD" UWORD DFC_OneToOne 1 100 0.00 65535.00 FORMAT "%8.2" ECU_ADDRESS 0x60013BBA /end MEASUREMENT
/begin MEASUREMENT DINH_stFId.FId_PEnvVldVDD "Inhibit Status of FIds / Status of function identifier FId_PEnvVldVDD" UWORD DFC_OneToOne 1 100 0.00 65535.00 FORMAT "%8.2" ECU_ADDRESS 0x60013BBC /end MEASUREMENT
/begin MEASUREMENT DINH_stFId.FId_PIDA6SigSrcErr "Inhibit Status of FIds / Status of function identifier FId_PIDA6SigSrcErr" UWORD DFC_OneToOne 1 100 0.00 65535.00 FORMAT "%8.2" ECU_ADDRESS 0x60013BBE /end MEASUREMENT
/begin MEASUREMENT DINH_stFId.FId_PIntkMnfldPlaus "Inhibit Status of FIds / Status of function identifier FId_PIntkMnfldPlaus" UWORD DFC_OneToOne 1 100 0.00 65535.00 FORMAT "%8.2" ECU_ADDRESS 0x60013BC0 /end MEASUREMENT
/begin MEASUREMENT DINH_stFId.FId_PIntkVUsElecDiagB1 "Inhibit Status of FIds / Status of function identifier FId_PIntkVUsElecDiagB1" UWORD DFC_OneToOne 1 100 0.00 65535.00 FORMAT "%8.2" ECU_ADDRESS 0x60013BC2 /end MEASUREMENT
/begin MEASUREMENT DINH_stFId.FId_PSPCtlDisbl "Inhibit Status of FIds / Status of function identifier FId_PSPCtlDisbl" UWORD DFC_OneToOne 1 100 0.00 65535.00 FORMAT "%8.2" ECU_ADDRESS 0x60013BC4 /end MEASUREMENT
/begin MEASUREMENT DINH_stFId.FId_PSPCtlIntkAirVapLock "Inhibit Status of FIds / Status of function identifier FId_PSPCtlIntkAirVapLock" UWORD DFC_OneToOne 1 100 0.00 65535.00 FORMAT "%8.2" ECU_ADDRESS 0x60013BC6 /end MEASUREMENT
/begin MEASUREMENT DINH_stFId.FId_PSPCtlPreRun "Inhibit Status of FIds / Status of function identifier FId_PSPCtlPreRun" UWORD DFC_OneToOne 1 100 0.00 65535.00 FORMAT "%8.2" ECU_ADDRESS 0x60013BC8 /end MEASUREMENT
/begin MEASUREMENT DINH_stFId.FId_PSPCtlVapLock "Inhibit Status of FIds / Status of function identifier FId_PSPCtlVapLock" UWORD DFC_OneToOne 1 100 0.00 65535.00 FORMAT "%8.2" ECU_ADDRESS 0x60013BCA /end MEASUREMENT
/begin MEASUREMENT DINH_stFId.FId_PSPDiagDisbl "Inhibit Status of FIds / Status of function identifier FId_PSPDiagDisbl" UWORD DFC_OneToOne 1 100 0.00 65535.00 FORMAT "%8.2" ECU_ADDRESS 0x60013BCC /end MEASUREMENT
/begin MEASUREMENT DINH_stFId.FId_PTGripConv "Inhibit Status of FIds / Status of function identifier FId_PTGripConv" UWORD DFC_OneToOne 1 100 0.00 65535.00 FORMAT "%8.2" ECU_ADDRESS 0x60013BCE /end MEASUREMENT
/begin MEASUREMENT DINH_stFId.FId_PTGripConvStrt "Inhibit Status of FIds / Status of function identifier FId_PTGripConvStrt" UWORD DFC_OneToOne 1 100 0.00 65535.00 FORMAT "%8.2" ECU_ADDRESS 0x60013BD0 /end MEASUREMENT
/begin MEASUREMENT DINH_stFId.FId_PTGripMnlClth "Inhibit Status of FIds / Status of function identifier FId_PTGripMnlClth" UWORD DFC_OneToOne 1 100 0.00 65535.00 FORMAT "%8.2" ECU_ADDRESS 0x60013BD2 /end MEASUREMENT
/begin MEASUREMENT DINH_stFId.FId_PTGripMnlClthStrt "Inhibit Status of FIds / Status of function identifier FId_PTGripMnlClthStrt" UWORD DFC_OneToOne 1 100 0.00 65535.00 FORMAT "%8.2" ECU_ADDRESS 0x60013BD4 /end MEASUREMENT
/begin MEASUREMENT DINH_stFId.FId_PTTrqRatCANPtd "Inhibit Status of FIds / Status of function identifier FId_PTTrqRatCANPtd" UWORD DFC_OneToOne 1 100 0.00 65535.00 FORMAT "%8.2" ECU_ADDRESS 0x60013BD6 /end MEASUREMENT
/begin MEASUREMENT DINH_stFId.FId_PThrVlVUsVldB1 "Inhibit Status of FIds / Status of function identifier FId_PThrVlVUsVldB1" UWORD DFC_OneToOne 1 100 0.00 65535.00 FORMAT "%8.2" ECU_ADDRESS 0x60013BD8 /end MEASUREMENT
/begin MEASUREMENT DINH_stFId.FId_PThrVlvUsMeasdVldB1 "Inhibit Status of FIds / Status of function identifier FId_PThrVlvUsMeasdVldB1" UWORD DFC_OneToOne 1 100 0.00 65535.00 FORMAT "%8.2" ECU_ADDRESS 0x60013BDA /end MEASUREMENT
/begin MEASUREMENT DINH_stFId.FId_P_VSE11_Diag "Inhibit Status of FIds / Status of function identifier FId_P_VSE11_Diag" UWORD DFC_OneToOne 1 100 0.00 65535.00 FORMAT "%8.2" ECU_ADDRESS 0x60013BDC /end MEASUREMENT
/begin MEASUREMENT DINH_stFId.FId_PrmId03_FltRdnS1B1 "Inhibit Status of FIds / Status of function identifier FId_PrmId03_FltRdnS1B1" UWORD DFC_OneToOne 1 100 0.00 65535.00 FORMAT "%8.2" ECU_ADDRESS 0x60013BDE /end MEASUREMENT
/begin MEASUREMENT DINH_stFId.FId_PrmId03_FltUegoS1B1 "Inhibit Status of FIds / Status of function identifier FId_PrmId03_FltUegoS1B1" UWORD DFC_OneToOne 1 100 0.00 65535.00 FORMAT "%8.2" ECU_ADDRESS 0x60013BE0 /end MEASUREMENT
/begin MEASUREMENT DINH_stFId.FId_RevLck "Inhibit Status of FIds / Status of function identifier FId_RevLck" UWORD DFC_OneToOne 1 100 0.00 65535.00 FORMAT "%8.2" ECU_ADDRESS 0x60013BE2 /end MEASUREMENT
/begin MEASUREMENT DINH_stFId.FId_RstAdpnPIntkMnfldAfs "Inhibit Status of FIds / Status of function identifier FId_RstAdpnPIntkMnfldAfs" UWORD DFC_OneToOne 1 100 0.00 65535.00 FORMAT "%8.2" ECU_ADDRESS 0x60013BE4 /end MEASUREMENT
/begin MEASUREMENT DINH_stFId.FId_RvsPosnFailr "Inhibit Status of FIds / Status of function identifier FId_RvsPosnFailr" UWORD DFC_OneToOne 1 100 0.00 65535.00 FORMAT "%8.2" ECU_ADDRESS 0x60013BE6 /end MEASUREMENT
/begin MEASUREMENT DINH_stFId.FId_SSEEPBRelease "Inhibit Status of FIds / Status of function identifier FId_SSEEPBRelease" UWORD DFC_OneToOne 1 100 0.00 65535.00 FORMAT "%8.2" ECU_ADDRESS 0x60013BE8 /end MEASUREMENT
/begin MEASUREMENT DINH_stFId.FId_SSEFCANPRelease "Inhibit Status of FIds / Status of function identifier FId_SSEFCANPRelease" UWORD DFC_OneToOne 1 100 0.00 65535.00 FORMAT "%8.2" ECU_ADDRESS 0x60013BEA /end MEASUREMENT
/begin MEASUREMENT DINH_stFId.FId_SSEPTCANPRelease "Inhibit Status of FIds / Status of function identifier FId_SSEPTCANPRelease" UWORD DFC_OneToOne 1 100 0.00 65535.00 FORMAT "%8.2" ECU_ADDRESS 0x60013BEC /end MEASUREMENT
/begin MEASUREMENT DINH_stFId.FId_SSEStartRelease "Inhibit Status of FIds / Status of function identifier FId_SSEStartRelease" UWORD DFC_OneToOne 1 100 0.00 65535.00 FORMAT "%8.2" ECU_ADDRESS 0x60013BEE /end MEASUREMENT
/begin MEASUREMENT DINH_stFId.FId_SSEStartReleaseMTCl10 "Inhibit Status of FIds / Status of function identifier FId_SSEStartReleaseMTCl10" UWORD DFC_OneToOne 1 100 0.00 65535.00 FORMAT "%8.2" ECU_ADDRESS 0x60013BF0 /end MEASUREMENT
/begin MEASUREMENT DINH_stFId.FId_SSEStartReleaseMTCl100 "Inhibit Status of FIds / Status of function identifier FId_SSEStartReleaseMTCl100" UWORD DFC_OneToOne 1 100 0.00 65535.00 FORMAT "%8.2" ECU_ADDRESS 0x60013BF2 /end MEASUREMENT
/begin MEASUREMENT DINH_stFId.FId_SSEStartReleaseMTCl20 "Inhibit Status of FIds / Status of function identifier FId_SSEStartReleaseMTCl20" UWORD DFC_OneToOne 1 100 0.00 65535.00 FORMAT "%8.2" ECU_ADDRESS 0x60013BF4 /end MEASUREMENT
/begin MEASUREMENT DINH_stFId.FId_SSEStartReleaseMTCl90 "Inhibit Status of FIds / Status of function identifier FId_SSEStartReleaseMTCl90" UWORD DFC_OneToOne 1 100 0.00 65535.00 FORMAT "%8.2" ECU_ADDRESS 0x60013BF6 /end MEASUREMENT
/begin MEASUREMENT DINH_stFId.FId_SSEStartRequest "Inhibit Status of FIds / Status of function identifier FId_SSEStartRequest" UWORD DFC_OneToOne 1 100 0.00 65535.00 FORMAT "%8.2" ECU_ADDRESS 0x60013BF8 /end MEASUREMENT
/begin MEASUREMENT DINH_stFId.FId_SSEStopRelease "Inhibit Status of FIds / Status of function identifier FId_SSEStopRelease" UWORD DFC_OneToOne 1 100 0.00 65535.00 FORMAT "%8.2" ECU_ADDRESS 0x60013BFA /end MEASUREMENT
/begin MEASUREMENT DINH_stFId.FId_SSEStrtStopRelease "Inhibit Status of FIds / Status of function identifier FId_SSEStrtStopRelease" UWORD DFC_OneToOne 1 100 0.00 65535.00 FORMAT "%8.2" ECU_ADDRESS 0x60013BFC /end MEASUREMENT
/begin MEASUREMENT DINH_stFId.FId_SSESysOff "Inhibit Status of FIds / Status of function identifier FId_SSESysOff" UWORD DFC_OneToOne 1 100 0.00 65535.00 FORMAT "%8.2" ECU_ADDRESS 0x60013BFE /end MEASUREMENT
/begin MEASUREMENT DINH_stFId.FId_SSEUI2DCSysFailr "Inhibit Status of FIds / Status of function identifier FId_SSEUI2DCSysFailr" UWORD DFC_OneToOne 1 100 0.00 65535.00 FORMAT "%8.2" ECU_ADDRESS 0x60013C00 /end MEASUREMENT
/begin MEASUREMENT DINH_stFId.FId_SSEUIBCANErr "Inhibit Status of FIds / Status of function identifier FId_SSEUIBCANErr" UWORD DFC_OneToOne 1 100 0.00 65535.00 FORMAT "%8.2" ECU_ADDRESS 0x60013C02 /end MEASUREMENT
/begin MEASUREMENT DINH_stFId.FId_SSEUISysFail "Inhibit Status of FIds / Status of function identifier FId_SSEUISysFail" UWORD DFC_OneToOne 1 100 0.00 65535.00 FORMAT "%8.2" ECU_ADDRESS 0x60013C04 /end MEASUREMENT
/begin MEASUREMENT DINH_stFId.FId_SiaEEPErr "Inhibit Status of FIds / Status of function identifier FId_SiaEEPErr" UWORD DFC_OneToOne 1 100 0.00 65535.00 FORMAT "%8.2" ECU_ADDRESS 0x60013C06 /end MEASUREMENT
/begin MEASUREMENT DINH_stFId.FId_SnglWhlErrDiagEna "Inhibit Status of FIds / Status of function identifier FId_SnglWhlErrDiagEna" UWORD DFC_OneToOne 1 100 0.00 65535.00 FORMAT "%8.2" ECU_ADDRESS 0x60013C08 /end MEASUREMENT
/begin MEASUREMENT DINH_stFId.FId_StrtCtlAutoCrkModeCdn "Inhibit Status of FIds / Status of function identifier FId_StrtCtlAutoCrkModeCdn" UWORD DFC_OneToOne 1 100 0.00 65535.00 FORMAT "%8.2" ECU_ADDRESS 0x60013C0A /end MEASUREMENT
/begin MEASUREMENT DINH_stFId.FId_StrtCtlComEngStrtErr "Inhibit Status of FIds / Status of function identifier FId_StrtCtlComEngStrtErr" UWORD DFC_OneToOne 1 100 0.00 65535.00 FORMAT "%8.2" ECU_ADDRESS 0x60013C0C /end MEASUREMENT
/begin MEASUREMENT DINH_stFId.FId_StrtCtlNPCdnCncl "Inhibit Status of FIds / Status of function identifier FId_StrtCtlNPCdnCncl" UWORD DFC_OneToOne 1 100 0.00 65535.00 FORMAT "%8.2" ECU_ADDRESS 0x60013C0E /end MEASUREMENT
/begin MEASUREMENT DINH_stFId.FId_StrtCtlNoCpuFailr "Inhibit Status of FIds / Status of function identifier FId_StrtCtlNoCpuFailr" UWORD DFC_OneToOne 1 100 0.00 65535.00 FORMAT "%8.2" ECU_ADDRESS 0x60013C10 /end MEASUREMENT
/begin MEASUREMENT DINH_stFId.FId_StrtCtlNoFailCanLine "Inhibit Status of FIds / Status of function identifier FId_StrtCtlNoFailCanLine" UWORD DFC_OneToOne 1 100 0.00 65535.00 FORMAT "%8.2" ECU_ADDRESS 0x60013C12 /end MEASUREMENT
/begin MEASUREMENT DINH_stFId.FId_StrtCtlNoFailPTCanLine "Inhibit Status of FIds / Status of function identifier FId_StrtCtlNoFailPTCanLine" UWORD DFC_OneToOne 1 100 0.00 65535.00 FORMAT "%8.2" ECU_ADDRESS 0x60013C14 /end MEASUREMENT
/begin MEASUREMENT DINH_stFId.FId_StrtCtlPNPosnSubsVal "Inhibit Status of FIds / Status of function identifier FId_StrtCtlPNPosnSubsVal" UWORD DFC_OneToOne 1 100 0.00 65535.00 FORMAT "%8.2" ECU_ADDRESS 0x60013C16 /end MEASUREMENT
/begin MEASUREMENT DINH_stFId.FId_StrtCtlSTMFailr "Inhibit Status of FIds / Status of function identifier FId_StrtCtlSTMFailr" UWORD DFC_OneToOne 1 100 0.00 65535.00 FORMAT "%8.2" ECU_ADDRESS 0x60013C18 /end MEASUREMENT
/begin MEASUREMENT DINH_stFId.FId_StrtErrShaft "Inhibit Status of FIds / Status of function identifier FId_StrtErrShaft" UWORD DFC_OneToOne 1 100 0.00 65535.00 FORMAT "%8.2" ECU_ADDRESS 0x60013C1A /end MEASUREMENT
/begin MEASUREMENT DINH_stFId.FId_SumErrHndlg "Inhibit Status of FIds / Status of function identifier FId_SumErrHndlg" UWORD DFC_OneToOne 1 100 0.00 65535.00 FORMAT "%8.2" ECU_ADDRESS 0x60013C1C /end MEASUREMENT
/begin MEASUREMENT DINH_stFId.FId_SysDiagComErr "Inhibit Status of FIds / Status of function identifier FId_SysDiagComErr" UWORD DFC_OneToOne 1 100 0.00 65535.00 FORMAT "%8.2" ECU_ADDRESS 0x60013C1E /end MEASUREMENT
/begin MEASUREMENT DINH_stFId.FId_SysDiagModInhbErr "Inhibit Status of FIds / Status of function identifier FId_SysDiagModInhbErr" UWORD DFC_OneToOne 1 100 0.00 65535.00 FORMAT "%8.2" ECU_ADDRESS 0x60013C20 /end MEASUREMENT
/begin MEASUREMENT DINH_stFId.FId_TOSPM "Inhibit Status of FIds / Status of function identifier FId_TOSPM" UWORD DFC_OneToOne 1 100 0.00 65535.00 FORMAT "%8.2" ECU_ADDRESS 0x60013C22 /end MEASUREMENT
/begin MEASUREMENT DINH_stFId.FId_TWCCILck "Inhibit Status of FIds / Status of function identifier FId_TWCCILck" UWORD DFC_OneToOne 1 100 0.00 65535.00 FORMAT "%8.2" ECU_ADDRESS 0x60013C24 /end MEASUREMENT
/begin MEASUREMENT DINH_stFId.FId_TWCCILckExtd "Inhibit Status of FIds / Status of function identifier FId_TWCCILckExtd" UWORD DFC_OneToOne 1 100 0.00 65535.00 FORMAT "%8.2" ECU_ADDRESS 0x60013C26 /end MEASUREMENT
/begin MEASUREMENT DINH_stFId.FId_TWCCIRstB1 "Inhibit Status of FIds / Status of function identifier FId_TWCCIRstB1" UWORD DFC_OneToOne 1 100 0.00 65535.00 FORMAT "%8.2" ECU_ADDRESS 0x60013C28 /end MEASUREMENT
/begin MEASUREMENT DINH_stFId.FId_TWCCIRstDSMClearB1 "Inhibit Status of FIds / Status of function identifier FId_TWCCIRstDSMClearB1" UWORD DFC_OneToOne 1 100 0.00 65535.00 FORMAT "%8.2" ECU_ADDRESS 0x60013C2A /end MEASUREMENT
/begin MEASUREMENT DINH_stFId.FId_TWCCLsuB1 "Inhibit Status of FIds / Status of function identifier FId_TWCCLsuB1" UWORD DFC_OneToOne 1 100 0.00 65535.00 FORMAT "%8.2" ECU_ADDRESS 0x60013C2C /end MEASUREMENT
/begin MEASUREMENT DINH_stFId.FId_TWCCLsuCyc "Inhibit Status of FIds / Status of function identifier FId_TWCCLsuCyc" UWORD DFC_OneToOne 1 100 0.00 65535.00 FORMAT "%8.2" ECU_ADDRESS 0x60013C2E /end MEASUREMENT
/begin MEASUREMENT DINH_stFId.FId_TWCCLsuDynB1 "Inhibit Status of FIds / Status of function identifier FId_TWCCLsuDynB1" UWORD DFC_OneToOne 1 100 0.00 65535.00 FORMAT "%8.2" ECU_ADDRESS 0x60013C30 /end MEASUREMENT
/begin MEASUREMENT DINH_stFId.FId_TWCCMisfDetn "Inhibit Status of FIds / Status of function identifier FId_TWCCMisfDetn" UWORD DFC_OneToOne 1 100 0.00 65535.00 FORMAT "%8.2" ECU_ADDRESS 0x60013C32 /end MEASUREMENT
/begin MEASUREMENT DINH_stFId.FId_TWCDPriCatParB1 "Inhibit Status of FIds / Status of function identifier FId_TWCDPriCatParB1" UWORD DFC_OneToOne 1 100 0.00 65535.00 FORMAT "%8.2" ECU_ADDRESS 0x60013C34 /end MEASUREMENT
/begin MEASUREMENT DINH_stFId.FId_TWCDPriCatVldnB1 "Inhibit Status of FIds / Status of function identifier FId_TWCDPriCatVldnB1" UWORD DFC_OneToOne 1 100 0.00 65535.00 FORMAT "%8.2" ECU_ADDRESS 0x60013C36 /end MEASUREMENT
/begin MEASUREMENT DINH_stFId.FId_TankPCpv1DteskLoLoadStuckClsd "Inhibit Status of FIds / Status of function identifier FId_TankPCpv1DteskLoLoadStuckClsd" UWORD DFC_OneToOne 1 100 0.00 65535.00 FORMAT "%8.2" ECU_ADDRESS 0x60013C38 /end MEASUREMENT
/begin MEASUREMENT DINH_stFId.FId_TankPCpv1DteskLoLoadStuckOpen "Inhibit Status of FIds / Status of function identifier FId_TankPCpv1DteskLoLoadStuckOpen" UWORD DFC_OneToOne 1 100 0.00 65535.00 FORMAT "%8.2" ECU_ADDRESS 0x60013C3A /end MEASUREMENT
/begin MEASUREMENT DINH_stFId.FId_TankPSnsrElecChkVld "Inhibit Status of FIds / Status of function identifier FId_TankPSnsrElecChkVld" UWORD DFC_OneToOne 1 100 0.00 65535.00 FORMAT "%8.2" ECU_ADDRESS 0x60013C3C /end MEASUREMENT
/begin MEASUREMENT DINH_stFId.FId_ThrVlvMon "Inhibit Status of FIds / Status of function identifier FId_ThrVlvMon" UWORD DFC_OneToOne 1 100 0.00 65535.00 FORMAT "%8.2" ECU_ADDRESS 0x60013C3E /end MEASUREMENT
/begin MEASUREMENT DINH_stFId.FId_ThrVlvOffsLrnPrmsB1 "Inhibit Status of FIds / Status of function identifier FId_ThrVlvOffsLrnPrmsB1" UWORD DFC_OneToOne 1 100 0.00 65535.00 FORMAT "%8.2" ECU_ADDRESS 0x60013C40 /end MEASUREMENT
/begin MEASUREMENT DINH_stFId.FId_TiOffTBasdChkFast "Inhibit Status of FIds / Status of function identifier FId_TiOffTBasdChkFast" UWORD DFC_OneToOne 1 100 0.00 65535.00 FORMAT "%8.2" ECU_ADDRESS 0x60013C42 /end MEASUREMENT
/begin MEASUREMENT DINH_stFId.FId_TiOffTBasdChkSlow "Inhibit Status of FIds / Status of function identifier FId_TiOffTBasdChkSlow" UWORD DFC_OneToOne 1 100 0.00 65535.00 FORMAT "%8.2" ECU_ADDRESS 0x60013C44 /end MEASUREMENT
/begin MEASUREMENT DINH_stFId.FId_TiOffVdClk "Inhibit Status of FIds / Status of function identifier FId_TiOffVdClk" UWORD DFC_OneToOne 1 100 0.00 65535.00 FORMAT "%8.2" ECU_ADDRESS 0x60013C46 /end MEASUREMENT
/begin MEASUREMENT DINH_stFId.FId_TqDecelOffsInhb "Inhibit Status of FIds / Status of function identifier FId_TqDecelOffsInhb" UWORD DFC_OneToOne 1 100 0.00 65535.00 FORMAT "%8.2" ECU_ADDRESS 0x60013C48 /end MEASUREMENT
/begin MEASUREMENT DINH_stFId.FId_TraAddAirCANPtd "Inhibit Status of FIds / Status of function identifier FId_TraAddAirCANPtd" UWORD DFC_OneToOne 1 100 0.00 65535.00 FORMAT "%8.2" ECU_ADDRESS 0x60013C4A /end MEASUREMENT
/begin MEASUREMENT DINH_stFId.FId_TraAddClntCANPtd "Inhibit Status of FIds / Status of function identifier FId_TraAddClntCANPtd" UWORD DFC_OneToOne 1 100 0.00 65535.00 FORMAT "%8.2" ECU_ADDRESS 0x60013C4C /end MEASUREMENT
/begin MEASUREMENT DINH_stFId.FId_TraFwdRvsCluInfo "Inhibit Status of FIds / Status of function identifier FId_TraFwdRvsCluInfo" UWORD DFC_OneToOne 1 100 0.00 65535.00 FORMAT "%8.2" ECU_ADDRESS 0x60013C4E /end MEASUREMENT
/begin MEASUREMENT DINH_stFId.FId_TraGbxNPos "Inhibit Status of FIds / Status of function identifier FId_TraGbxNPos" UWORD DFC_OneToOne 1 100 0.00 65535.00 FORMAT "%8.2" ECU_ADDRESS 0x60013C50 /end MEASUREMENT
/begin MEASUREMENT DINH_stFId.FId_TraGearInfoCanCom "Inhibit Status of FIds / Status of function identifier FId_TraGearInfoCanCom" UWORD DFC_OneToOne 1 100 0.00 65535.00 FORMAT "%8.2" ECU_ADDRESS 0x60013C52 /end MEASUREMENT
/begin MEASUREMENT DINH_stFId.FId_TraGearInfoDet "Inhibit Status of FIds / Status of function identifier FId_TraGearInfoDet" UWORD DFC_OneToOne 1 100 0.00 65535.00 FORMAT "%8.2" ECU_ADDRESS 0x60013C54 /end MEASUREMENT
/begin MEASUREMENT DINH_stFId.FId_TraGearInfoGearShftActv "Inhibit Status of FIds / Status of function identifier FId_TraGearInfoGearShftActv" UWORD DFC_OneToOne 1 100 0.00 65535.00 FORMAT "%8.2" ECU_ADDRESS 0x60013C56 /end MEASUREMENT
/begin MEASUREMENT DINH_stFId.FId_TraGearInfoInfoCan "Inhibit Status of FIds / Status of function identifier FId_TraGearInfoInfoCan" UWORD DFC_OneToOne 1 100 0.00 65535.00 FORMAT "%8.2" ECU_ADDRESS 0x60013C58 /end MEASUREMENT
/begin MEASUREMENT DINH_stFId.FId_TraGearInfoLevPos "Inhibit Status of FIds / Status of function identifier FId_TraGearInfoLevPos" UWORD DFC_OneToOne 1 100 0.00 65535.00 FORMAT "%8.2" ECU_ADDRESS 0x60013C5A /end MEASUREMENT
/begin MEASUREMENT DINH_stFId.FId_TraGearInfoLoRng "Inhibit Status of FIds / Status of function identifier FId_TraGearInfoLoRng" UWORD DFC_OneToOne 1 100 0.00 65535.00 FORMAT "%8.2" ECU_ADDRESS 0x60013C5C /end MEASUREMENT
/begin MEASUREMENT DINH_stFId.FId_TraGearInfoRTra "Inhibit Status of FIds / Status of function identifier FId_TraGearInfoRTra" UWORD DFC_OneToOne 1 100 0.00 65535.00 FORMAT "%8.2" ECU_ADDRESS 0x60013C5E /end MEASUREMENT
/begin MEASUREMENT DINH_stFId.FId_TraGearInfoRevGear "Inhibit Status of FIds / Status of function identifier FId_TraGearInfoRevGear" UWORD DFC_OneToOne 1 100 0.00 65535.00 FORMAT "%8.2" ECU_ADDRESS 0x60013C60 /end MEASUREMENT
/begin MEASUREMENT DINH_stFId.FId_TraGearReq "Inhibit Status of FIds / Status of function identifier FId_TraGearReq" UWORD DFC_OneToOne 1 100 0.00 65535.00 FORMAT "%8.2" ECU_ADDRESS 0x60013C62 /end MEASUREMENT
/begin MEASUREMENT DINH_stFId.FId_TraNoShftIdctr "Inhibit Status of FIds / Status of function identifier FId_TraNoShftIdctr" UWORD DFC_OneToOne 1 100 0.00 65535.00 FORMAT "%8.2" ECU_ADDRESS 0x60013C64 /end MEASUREMENT
/begin MEASUREMENT DINH_stFId.FId_TraPrtGearCANPtd "Inhibit Status of FIds / Status of function identifier FId_TraPrtGearCANPtd" UWORD DFC_OneToOne 1 100 0.00 65535.00 FORMAT "%8.2" ECU_ADDRESS 0x60013C66 /end MEASUREMENT
/begin MEASUREMENT DINH_stFId.FId_TraPrtGearIndpdtProblem "Inhibit Status of FIds / Status of function identifier FId_TraPrtGearIndpdtProblem" UWORD DFC_OneToOne 1 100 0.00 65535.00 FORMAT "%8.2" ECU_ADDRESS 0x60013C68 /end MEASUREMENT
/begin MEASUREMENT DINH_stFId.FId_TraRPosn "Inhibit Status of FIds / Status of function identifier FId_TraRPosn" UWORD DFC_OneToOne 1 100 0.00 65535.00 FORMAT "%8.2" ECU_ADDRESS 0x60013C6A /end MEASUREMENT
/begin MEASUREMENT DINH_stFId.FId_TraRtnIntfcASTIntv "Inhibit Status of FIds / Status of function identifier FId_TraRtnIntfcASTIntv" UWORD DFC_OneToOne 1 100 0.00 65535.00 FORMAT "%8.2" ECU_ADDRESS 0x60013C6C /end MEASUREMENT
/begin MEASUREMENT DINH_stFId.FId_TraRtnIntfcIdlSetP "Inhibit Status of FIds / Status of function identifier FId_TraRtnIntfcIdlSetP" UWORD DFC_OneToOne 1 100 0.00 65535.00 FORMAT "%8.2" ECU_ADDRESS 0x60013C6E /end MEASUREMENT
/begin MEASUREMENT DINH_stFId.FId_TraRtnIntfcNMaxCan "Inhibit Status of FIds / Status of function identifier FId_TraRtnIntfcNMaxCan" UWORD DFC_OneToOne 1 100 0.00 65535.00 FORMAT "%8.2" ECU_ADDRESS 0x60013C70 /end MEASUREMENT
/begin MEASUREMENT DINH_stFId.FId_TraRtnIntfcNMaxVel "Inhibit Status of FIds / Status of function identifier FId_TraRtnIntfcNMaxVel" UWORD DFC_OneToOne 1 100 0.00 65535.00 FORMAT "%8.2" ECU_ADDRESS 0x60013C72 /end MEASUREMENT
/begin MEASUREMENT DINH_stFId.FId_TraTrqRedLmpHmeDec "Inhibit Status of FIds / Status of function identifier FId_TraTrqRedLmpHmeDec" UWORD DFC_OneToOne 1 100 0.00 65535.00 FORMAT "%8.2" ECU_ADDRESS 0x60013C74 /end MEASUREMENT
/begin MEASUREMENT DINH_stFId.FId_TraTrqRedLmpHmeInc "Inhibit Status of FIds / Status of function identifier FId_TraTrqRedLmpHmeInc" UWORD DFC_OneToOne 1 100 0.00 65535.00 FORMAT "%8.2" ECU_ADDRESS 0x60013C76 /end MEASUREMENT
/begin MEASUREMENT DINH_stFId.FId_TraTrqRedPTCanErr "Inhibit Status of FIds / Status of function identifier FId_TraTrqRedPTCanErr" UWORD DFC_OneToOne 1 100 0.00 65535.00 FORMAT "%8.2" ECU_ADDRESS 0x60013C78 /end MEASUREMENT
/begin MEASUREMENT DINH_stFId.FId_TraTrqRedTIIntvDes "Inhibit Status of FIds / Status of function identifier FId_TraTrqRedTIIntvDes" UWORD DFC_OneToOne 1 100 0.00 65535.00 FORMAT "%8.2" ECU_ADDRESS 0x60013C7A /end MEASUREMENT
/begin MEASUREMENT DINH_stFId.FId_TraTrqRedTIIntvLead "Inhibit Status of FIds / Status of function identifier FId_TraTrqRedTIIntvLead" UWORD DFC_OneToOne 1 100 0.00 65535.00 FORMAT "%8.2" ECU_ADDRESS 0x60013C7C /end MEASUREMENT
/begin MEASUREMENT DINH_stFId.FId_TraTrqRedTSCIntvDes "Inhibit Status of FIds / Status of function identifier FId_TraTrqRedTSCIntvDes" UWORD DFC_OneToOne 1 100 0.00 65535.00 FORMAT "%8.2" ECU_ADDRESS 0x60013C7E /end MEASUREMENT
/begin MEASUREMENT DINH_stFId.FId_TraTrqRedTSCIntvLead "Inhibit Status of FIds / Status of function identifier FId_TraTrqRedTSCIntvLead" UWORD DFC_OneToOne 1 100 0.00 65535.00 FORMAT "%8.2" ECU_ADDRESS 0x60013C80 /end MEASUREMENT
/begin MEASUREMENT DINH_stFId.FId_TraTrsmTypHw "Inhibit Status of FIds / Status of function identifier FId_TraTrsmTypHw" UWORD DFC_OneToOne 1 100 0.00 65535.00 FORMAT "%8.2" ECU_ADDRESS 0x60013C82 /end MEASUREMENT
/begin MEASUREMENT DINH_stFId.FId_TranIdleDes "Inhibit Status of FIds / Status of function identifier FId_TranIdleDes" UWORD DFC_OneToOne 1 100 0.00 65535.00 FORMAT "%8.2" ECU_ADDRESS 0x60013C84 /end MEASUREMENT
/begin MEASUREMENT DINH_stFId.FId_UEGOHeatgUpRglS1B1 "Inhibit Status of FIds / Status of function identifier FId_UEGOHeatgUpRglS1B1" UWORD DFC_OneToOne 1 100 0.00 65535.00 FORMAT "%8.2" ECU_ADDRESS 0x60013C86 /end MEASUREMENT
/begin MEASUREMENT DINH_stFId.FId_UEGOHeatrCtrlS1B1 "Inhibit Status of FIds / Status of function identifier FId_UEGOHeatrCtrlS1B1" UWORD DFC_OneToOne 1 100 0.00 65535.00 FORMAT "%8.2" ECU_ADDRESS 0x60013C88 /end MEASUREMENT
/begin MEASUREMENT DINH_stFId.FId_UEGOHeatrPrfmncDiagRelsS1B1 "Inhibit Status of FIds / Status of function identifier FId_UEGOHeatrPrfmncDiagRelsS1B1" UWORD DFC_OneToOne 1 100 0.00 65535.00 FORMAT "%8.2" ECU_ADDRESS 0x60013C8A /end MEASUREMENT
/begin FUNCTION DINH "30000.27.0_1.0.0Diagnostic Inhibit Handler"
 /begin LOC_MEASUREMENT DINH_stFId.FID_KRREGloc DINH_stFId.FID_LRADLSU DINH_stFId.FID_LRALSVErr DINH_stFId.FID_LRAPLLSU DINH_stFId.FID_LUSTP DINH_stFId.FID_LnKS1 DINH_stFId.FID_PLSUV DINH_stFId.FID_PSRMOZDG DINH_stFId.FID_PSRMOZG DINH_stFId.FID_STRTDIA DINH_stFId.FID_STRTSTM DINH_stFId.FID_TFA1CSMW DINH_stFId.FID_TFA2CSMW DINH_stFId.FID_TKACSMW DINH_stFId.FID_TMCSMW DINH_stFId.FID_TOCHOilSwmpTQly DINH_stFId.FID_TOCHTME DINH_stFId.FID_TOSPCSMW DINH_stFId.FID_TSRLX DINH_stFId.FID_UEGOHeatrRlyS1B1 DINH_stFId.FID_VehStvSSEOk DINH_stFId.FID_VldtLamPlausMaxS1B1 DINH_stFId.FID_VldtLamPlausMinS1B1 DINH_stFId.FId_ACClntPSSPMon DINH_stFId.FId_ACCompComCANBusOff DINH_stFId.FId_ACCompComCANErrMtr DINH_stFId.FId_ACComp_HiUTWSnsrErr DINH_stFId.FId_ACComp_LoUTWSnsrErr DINH_stFId.FId_ACComp_PDSnsrErr DINH_stFId.FId_ACComp_VehSpdSnsrErr DINH_stFId.FId_ACCtl_ACStrtCut DINH_stFId.FId_ACCtl_APP1 DINH_stFId.FId_ACCtl_APP2 DINH_stFId.FId_ACCtl_APPSync DINH_stFId.FId_ACCtl_AcOff DINH_stFId.FId_ACCtl_Clmb DINH_stFId.FId_ACCtl_DK1 DINH_stFId.FId_ACCtl_DK2 DINH_stFId.FId_ACCtl_DKSync DINH_stFId.FId_ACCtl_VehSpdSnsrErr DINH_stFId.FId_ACCtl_pAC DINH_stFId.FId_ACEvpTCANErr DINH_stFId.FId_ACEvpTFrzVal DINH_stFId.FId_ACEvpTPhysRng DINH_stFId.FId_ACEvpTRplVal DINH_stFId.FId_AFCLFailr DINH_stFId.FId_AFS DINH_stFId.FId_AFSPhyRng DINH_stFId.FId_APP1SigPath DINH_stFId.FId_APP2SigPath DINH_stFId.FId_APPBrkErr DINH_stFId.FId_APPLETVldnErr DINH_stFId.FId_APPLrn DINH_stFId.FId_APPVehVErr DINH_stFId.FId_AccPedDrvModComErr DINH_stFId.FId_AccPedDrvModFailr DINH_stFId.FId_AccPedNMaxLim DINH_stFId.FId_AccPedNMinLim DINH_stFId.FId_AccPedNMinLimBrkApp DINH_stFId.FId_AccPedTrqLim DINH_stFId.FId_AfsDdDiag DINH_stFId.FId_AfsDiagErr DINH_stFId.FId_AfsDiagTst DINH_stFId.FId_AfsPlausDiag DINH_stFId.FId_AfsVrntDiag DINH_stFId.FId_AirCClntPFrzVal DINH_stFId.FId_AirCClntPRplVal DINH_stFId.FId_AirCSwt DINH_stFId.FId_AirDvPAdpnPEnv DINH_stFId.FId_AirDvPAdpnPIntkVUsB1 DINH_stFId.FId_AirDvPPSnsrAdpn_PModeActv DINH_stFId.FId_AltACGFailr DINH_stFId.FId_AltAPPErrSt DINH_stFId.FId_AltBattMngtFailr DINH_stFId.FId_AltBrkErrSt DINH_stFId.FId_AltComErr DINH_stFId.FId_AltENGB DINH_stFId.FId_AltElecLoadErr DINH_stFId.FId_AltEnvTErr DINH_stFId.FId_AltFFAltLoadFast DINH_stFId.FId_AltFFAltLoadSlow DINH_stFId.FId_AltIOACGErr DINH_stFId.FId_AltIOACGLinComFailr DINH_stFId.FId_AltIOComErr DINH_stFId.FId_AltLinErr DINH_stFId.FId_AltPwr DINH_stFId.FId_AltVehVErrSt DINH_stFId.FId_AltvCluFail DINH_stFId.FId_BGAGRTS DINH_stFId.FId_BGFKMSEPSR DINH_stFId.FId_BGFKMSEPU DINH_stFId.FId_BGFKMSESumClr DINH_stFId.FId_BGFKMSHFME DINH_stFId.FId_BGFKMSHFMZ DINH_stFId.FId_BGFKMSZPSR DINH_stFId.FId_BGOSCCat1B1 DINH_stFId.FId_BGOSCCat2B1 DINH_stFId.FId_BattAltFailr DINH_stFId.FId_BattMngtFailr DINH_stFId.FId_BattSigPtd DINH_stFId.FId_BattU2MEDSRC DINH_stFId.FId_BattUDrpPrvOff DINH_stFId.FId_BattUFrzVal DINH_stFId.FId_BattUHiFailrEna DINH_stFId.FId_BattUIMGTCUCANFailr DINH_stFId.FId_BattULoFailrEna DINH_stFId.FId_BattUReplVal DINH_stFId.FId_BattUSRC DINH_stFId.FId_BlwrComErr DINH_stFId.FId_BrkBstMdl DINH_stFId.FId_BrkBstMdlBrkP DINH_stFId.FId_BrkBstMdlBrkSt DINH_stFId.FId_BrkBstMdlEnvP DINH_stFId.FId_BrkBstPDetnInhbn DINH_stFId.FId_BrkBstPMstCylPSnsrFail DINH_stFId.FId_BrkBstPSnsrStuckDetn DINH_stFId.FId_BrkBstSigPath DINH_stFId.FId_BrkBstVehVv DINH_stFId.FId_BrkMnSwtErr DINH_stFId.FId_BrkPFrzVal DINH_stFId.FId_BrkPOilPres DINH_stFId.FId_BrkPReplVal DINH_stFId.FId_BrkPedEngStopEna DINH_stFId.FId_BrkRdntSwtErr DINH_stFId.FId_CAGRSDS DINH_stFId.FId_CEngDsTColdStrt DINH_stFId.FId_CEngDsTColdStrtErr DINH_stFId.FId_CEngDsTHSC DINH_stFId.FId_CEngDsTLSC DINH_stFId.FId_CEngDsTPlausErr DINH_stFId.FId_CEngDsTReplMdlEngStop DINH_stFId.FId_CEngDsTSTC DINH_stFId.FId_CEngDsTSnsrElec DINH_stFId.FId_CEngDsTSwtReplMdl DINH_stFId.FId_CEngUsTColdChkErr DINH_stFId.FId_CEngUsTCrssChk DINH_stFId.FId_CEngUsTElecErr DINH_stFId.FId_CEngUsTSnsrElecErr DINH_stFId.FId_CEngUsTSwtReplMdl DINH_stFId.FId_CInjCatHeatgDiag DINH_stFId.FId_CMSUDKSOM1 DINH_stFId.FId_CMSUDKSOM2 DINH_stFId.FId_CatHeatgEomShtrpAct DINH_stFId.FId_ChrctlAgrsErr DINH_stFId.FId_ChrctlAgrscf DINH_stFId.FId_ClntTempENGB DINH_stFId.FId_Clth DINH_stFId.FId_Clth2 DINH_stFId.FId_Clth3StuckOn DINH_stFId.FId_Clth4 DINH_stFId.FId_ClthCAN DINH_stFId.FId_ClthMax DINH_stFId.FId_ClthStk DINH_stFId.FId_ClthStkErr DINH_stFId.FId_ClthStkFailr DINH_stFId.FId_ClthStkOFFStuck DINH_stFId.FId_ClthStkONStuck DINH_stFId.FId_ClthSwtFailr DINH_stFId.FId_CntrShaftFailr DINH_stFId.FId_CoEOMGdiEomErrLcy DINH_stFId.FId_CoESSBlowrVld DINH_stFId.FId_CoETM DINH_stFId.FId_CoETS_StTrqLimErr1 DINH_stFId.FId_CoETS_StTrqLimErr2 DINH_stFId.FId_CoEngStopEnblStSpEngT DINH_stFId.FId_CoEngStopEnblStSpLSU DINH_stFId.FId_CoEngStopEnblStSpTcT DINH_stFId.FId_CoEngStopEnblSysErr DINH_stFId.FId_CoEngVlvLftSpIntk DINH_stFId.FId_CoPOMStrtgDevStrtr DINH_stFId.FId_CoPOM_FirstStrtAut DINH_stFId.FId_CoTS_SwtOff DINH_stFId.FId_CoVOMACCComFailr DINH_stFId.FId_CoVOMBrkPedISABSigFailr DINH_stFId.FId_CoVOMEngCrkAbort DINH_stFId.FId_CoVOMEngRstrtEnaCdn DINH_stFId.FId_CoVOMISSEng DINH_stFId.FId_ComACRly DINH_stFId.FId_ComAPPSensFail DINH_stFId.FId_ComAPedl DINH_stFId.FId_ComAYCA DINH_stFId.FId_ComAYCAMon DINH_stFId.FId_ComAYCD DINH_stFId.FId_ComAYCDMon DINH_stFId.FId_ComAYCF DINH_stFId.FId_ComAYCFMon DINH_stFId.FId_ComAYCG DINH_stFId.FId_ComAYCGMon DINH_stFId.FId_ComAYCI DINH_stFId.FId_ComAYCIMon DINH_stFId.FId_ComAirPThrUsSnsrErr DINH_stFId.FId_ComAltFail DINH_stFId.FId_ComAppVehSnsrFailr DINH_stFId.FId_ComBCM1 DINH_stFId.FId_ComBCM1Mon DINH_stFId.FId_ComBCMUnitCfmdErr DINH_stFId.FId_ComBCMUnitNotTstd DINH_stFId.FId_ComBstCtrl DINH_stFId.FId_ComCANVEHICLEBusOff DINH_stFId.FId_ComCGW1 DINH_stFId.FId_ComCGW1Mon DINH_stFId.FId_ComClthSt DINH_stFId.FId_ComConvClth DINH_stFId.FId_ComCrCtlReq DINH_stFId.FId_ComCrsMaiIndcnLampReq DINH_stFId.FId_ComCrsSetIndcnLampReq DINH_stFId.FId_ComDCDCCdn DINH_stFId.FId_ComDCDCErr DINH_stFId.FId_ComDesGearCurr DINH_stFId.FId_ComDetrmAirM DINH_stFId.FId_ComDwnShiftCtrlReq DINH_stFId.FId_ComEAT1 DINH_stFId.FId_ComEAT10 DINH_stFId.FId_ComEAT10Mon DINH_stFId.FId_ComEAT11 DINH_stFId.FId_ComEAT11Mon DINH_stFId.FId_ComEAT12 DINH_stFId.FId_ComEAT12Mon DINH_stFId.FId_ComEAT13 DINH_stFId.FId_ComEAT13Mon DINH_stFId.FId_ComEAT1Mon DINH_stFId.FId_ComEAT2 DINH_stFId.FId_ComEAT2Mon DINH_stFId.FId_ComEAT4 DINH_stFId.FId_ComEAT4Mon DINH_stFId.FId_ComEAT6 DINH_stFId.FId_ComEAT6Mon DINH_stFId.FId_ComEAT7 DINH_stFId.FId_ComEAT7Mon DINH_stFId.FId_ComEAT8 DINH_stFId.FId_ComEAT8Mon DINH_stFId.FId_ComEATA DINH_stFId.FId_ComEATAMon DINH_stFId.FId_ComEATB DINH_stFId.FId_ComEATBMon DINH_stFId.FId_ComEATC DINH_stFId.FId_ComEATCMon DINH_stFId.FId_ComEBSSelfDiagErr DINH_stFId.FId_ComECUHwErr DINH_stFId.FId_ComEGRVlvErr DINH_stFId.FId_ComEMSIntAirTemp DINH_stFId.FId_ComEPB DINH_stFId.FId_ComEPBB DINH_stFId.FId_ComEPBBMon DINH_stFId.FId_ComEPBMon DINH_stFId.FId_ComEPS1 DINH_stFId.FId_ComEPS1Mon DINH_stFId.FId_ComEPSUnitCfmdErr DINH_stFId.FId_ComEPSUnitNotTstd DINH_stFId.FId_ComEngBrkOvrdInfo DINH_stFId.FId_ComEngBrkOvrdMtr DINH_stFId.FId_ComEngBrkSwErr DINH_stFId.FId_ComEngPosng DINH_stFId.FId_ComEngRPMLim DINH_stFId.FId_ComEngTrqLim DINH_stFId.FId_ComEnvtlAirPSnsrErr DINH_stFId.FId_ComEstmTqNormJdg DINH_stFId.FId_ComEthnlSErr DINH_stFId.FId_ComFlSply DINH_stFId.FId_ComFuCnsBitDurgIdleStop DINH_stFId.FId_ComGEVCntrl DINH_stFId.FId_ComGbxNPosFail DINH_stFId.FId_ComGbxTemp DINH_stFId.FId_ComGwIMG1 DINH_stFId.FId_ComGwIMG1Mon DINH_stFId.FId_ComGwIMG3 DINH_stFId.FId_ComGwIMG3Mon DINH_stFId.FId_ComGwIMG4 DINH_stFId.FId_ComGwIMG4Mon DINH_stFId.FId_ComGwIMG5 DINH_stFId.FId_ComGwIMG5Mon DINH_stFId.FId_ComGwIMG6 DINH_stFId.FId_ComGwIMG6Mon DINH_stFId.FId_ComHFMSnsrErr DINH_stFId.FId_ComIDASB DINH_stFId.FId_ComIDASBMon DINH_stFId.FId_ComIDASBUnitCfmdErr DINH_stFId.FId_ComIDASBUnitNotTstd DINH_stFId.FId_ComIDASEngFail DINH_stFId.FId_ComIDASEngFailMil DINH_stFId.FId_ComIMGUnitCfmdErr DINH_stFId.FId_ComIMGUnitNotTstd DINH_stFId.FId_ComISG2 DINH_stFId.FId_ComIgnCtrl DINH_stFId.FId_ComInjCtrl DINH_stFId.FId_ComIntkAirPSnsrErr DINH_stFId.FId_ComLamCtrl DINH_stFId.FId_ComMETA DINH_stFId.FId_ComMETAMon DINH_stFId.FId_ComMETC DINH_stFId.FId_ComMETCMon DINH_stFId.FId_ComMETD DINH_stFId.FId_ComMETDMon DINH_stFId.FId_ComMETE2 DINH_stFId.FId_ComMETE2Mon DINH_stFId.FId_ComMETF DINH_stFId.FId_ComMETFMon DINH_stFId.FId_ComMETG DINH_stFId.FId_ComMETGMon DINH_stFId.FId_ComMETH DINH_stFId.FId_ComMETH2 DINH_stFId.FId_ComMETH2Mon DINH_stFId.FId_ComMETHMon DINH_stFId.FId_ComMETI DINH_stFId.FId_ComMETIMon DINH_stFId.FId_ComMETK DINH_stFId.FId_ComMETKMon DINH_stFId.FId_ComMETL DINH_stFId.FId_ComMETLMon DINH_stFId.FId_ComMETM DINH_stFId.FId_ComMETMMon DINH_stFId.FId_ComMETN DINH_stFId.FId_ComMETNMon DINH_stFId.FId_ComMETUnitCfmdErr DINH_stFId.FId_ComMETUnitNotTstd DINH_stFId.FId_ComMisf DINH_stFId.FId_ComMon DINH_stFId.FId_ComNTrbn DINH_stFId.FId_ComODOff DINH_stFId.FId_ComOilLvlLamp DINH_stFId.FId_ComOilPWarnLamp DINH_stFId.FId_ComPASensFail DINH_stFId.FId_ComPBSensFail DINH_stFId.FId_ComPCU DINH_stFId.FId_ComPCUMon DINH_stFId.FId_ComPosActnSpdLimrFctReq DINH_stFId.FId_ComSRS DINH_stFId.FId_ComSRSA DINH_stFId.FId_ComSRSAMon DINH_stFId.FId_ComSRSB DINH_stFId.FId_ComSRSBMon DINH_stFId.FId_ComSRSMon DINH_stFId.FId_ComSRSUnitCfmdErr DINH_stFId.FId_ComSRSUnitNotTstd DINH_stFId.FId_ComSTFlt DINH_stFId.FId_ComSpdLimrDevActvn DINH_stFId.FId_ComTCU01 DINH_stFId.FId_ComTCU02 DINH_stFId.FId_ComTCU1 DINH_stFId.FId_ComTCU11 DINH_stFId.FId_ComTCU12 DINH_stFId.FId_ComTCU13 DINH_stFId.FId_ComTCU14 DINH_stFId.FId_ComTCU2 DINH_stFId.FId_ComTCU3 DINH_stFId.FId_ComTCU4 DINH_stFId.FId_ComTCUGear DINH_stFId.FId_ComTarGearDwnShift DINH_stFId.FId_ComTarGearUpShift DINH_stFId.FId_ComThrPosnFail DINH_stFId.FId_ComThrVlv DINH_stFId.FId_ComTrboChrgnErr DINH_stFId.FId_ComTrqAccuracySlow DINH_stFId.FId_ComTrqReqFast DINH_stFId.FId_ComTrqReqSlow DINH_stFId.FId_ComVSAErr DINH_stFId.FId_ComVSAUnitCfmdErr DINH_stFId.FId_ComVSAUnitNotTstd DINH_stFId.FId_ComVehSpdFlLvl DINH_stFId.FId_ComVehSpdFltChk DINH_stFId.FId_ComVehSpdImpsErr DINH_stFId.FId_ComVlvLftCtrl DINH_stFId.FId_ComvolEng DINH_stFId.FId_ConvLdCalcLvrPos DINH_stFId.FId_ConvLdNTrbnCan DINH_stFId.FId_ConvLdOilCoolrPmp DINH_stFId.FId_ConvLdOilTemp DINH_stFId.FId_ConvLdTrqLdCan DINH_stFId.FId_ConvLdVel DINH_stFId.FId_CooltTVldyTMdl DINH_stFId.FId_CptProtnCamsft DINH_stFId.FId_CptProtnExhTempMdl DINH_stFId.FId_CptProtnO2SnsrB1 DINH_stFId.FId_CptProtnVVeh DINH_stFId.FId_CrCUI1EFRxErr DINH_stFId.FId_CrCUICANRxErr DINH_stFId.FId_CrCUIFCMRxErr DINH_stFId.FId_CrCUIMETDRxErr DINH_stFId.FId_CrCtlACCRxErr DINH_stFId.FId_CrCtlAppSnsrErr DINH_stFId.FId_CrCtlShutOffEng DINH_stFId.FId_CstrPurgGnrlTstrReq DINH_stFId.FId_DAGRS DINH_stFId.FId_DELibBrkBstP DINH_stFId.FId_DELibCEngDsT DINH_stFId.FId_DELibCEngUsT DINH_stFId.FId_DELibEngDatEng DINH_stFId.FId_DELibEnvP DINH_stFId.FId_DELibEnvT DINH_stFId.FId_DELibFuelT DINH_stFId.FId_DELibIntkAirT DINH_stFId.FId_DELibNRCat DINH_stFId.FId_DELibOilP DINH_stFId.FId_DELibOilSwmpT DINH_stFId.FId_DELibPRelPfilDs DINH_stFId.FId_DELibTEGRClrLPDs DINH_stFId.FId_DEONVEBPEnv DINH_stFId.FId_DEONVTCCpv1DteskLoLoadStuckClsd DINH_stFId.FId_DEONVTCCpv1DteskLoLoadStuckOpen DINH_stFId.FId_DIUMPRCldStrtMon DINH_stFId.FId_DIUMPREvapMon DINH_stFId.FId_DIUMPRGenDenom1 DINH_stFId.FId_DIUMPRGenDenom1PDTC DINH_stFId.FId_DIUMPRGenDenom2 DINH_stFId.FId_DIUMPRGenDenom3 DINH_stFId.FId_DIUMPRIgn DINH_stFId.FId_DOGov DINH_stFId.FId_DSMWarmUpCycle DINH_stFId.FId_DTESKEBCpv1DteskLoLoadStuckClsd DINH_stFId.FId_DTESKEBCpv1DteskLoLoadStuckOpen DINH_stFId.FId_DTESKEnvCondVld DINH_stFId.FId_DTESKFuLvlCondVld DINH_stFId.FId_DTESKvfz DINH_stFId.FId_DdskvFraTstd DINH_stFId.FId_DdskvOraTstd DINH_stFId.FId_DewDetTKAMax DINH_stFId.FId_DiagBlkdLine DINH_stFId.FId_DiagCpv1DteskLoLoad DINH_stFId.FId_DkrsaEpmNoSig DINH_stFId.FId_EBBCANErrFrzVal DINH_stFId.FId_EBBCANErrReplVal DINH_stFId.FId_EGLZSR DINH_stFId.FId_EGRVlvActrOff DINH_stFId.FId_EGRVlvCldStrt DINH_stFId.FId_EGRVlvClnVrfy DINH_stFId.FId_EGRVlvCtrlErr DINH_stFId.FId_EGRVlvEngTempDef DINH_stFId.FId_EGRVlvFailSafeActv DINH_stFId.FId_EGRVlvFrzVal DINH_stFId.FId_EGRVlvGovOn DINH_stFId.FId_EGRVlvGovOnCld DINH_stFId.FId_EGRVlvGovrOnRelsFct DINH_stFId.FId_EGRVlvILimn DINH_stFId.FId_EGRVlvIni DINH_stFId.FId_EGRVlvMon DINH_stFId.FId_EGRVlvOfsLrnInhib DINH_stFId.FId_EGRVlvPhysRng DINH_stFId.FId_EGRVlvPsSwtOff DINH_stFId.FId_EGRVlvPwrStgMonDis DINH_stFId.FId_EGRVlvRplVal DINH_stFId.FId_EGRVlvSSpMon DINH_stFId.FId_EGRVlvSnsrErr DINH_stFId.FId_EGRVlvTempCmp DINH_stFId.FId_EGRVlvTempMdlEEPErr DINH_stFId.FId_EGRVlvTmpErrCnt DINH_stFId.FId_EGRVlvTrlPtr DINH_stFId.FId_EGRVlv_VehvErr DINH_stFId.FId_EGRVlviActIEfcLimn DINH_stFId.FId_EGRVlvpDsbcInvld DINH_stFId.FId_EGSDO2OffsRstDsmS1B1 DINH_stFId.FId_EGSDO2_LamOffsSlowS1 DINH_stFId.FId_EGSDO2_RstFltSuspcnOffsB1 DINH_stFId.FId_EGSDUS2B1DlyEvln DINH_stFId.FId_EGSDUS2B1LtrDly DINH_stFId.FId_EGSDUS2B1LtrPT1 DINH_stFId.FId_EGSDUS2B1PT1Evln DINH_stFId.FId_EGSDUS2B1RtlDly DINH_stFId.FId_EGSDUS2B1RtlPT1 DINH_stFId.FId_EGSDUS2B1TarEvln DINH_stFId.FId_EGSDUS2B1TarLean DINH_stFId.FId_EGSDUS2B1TarRich DINH_stFId.FId_EGSSigO2S1B1 DINH_stFId.FId_ELZSR DINH_stFId.FId_EPBErr DINH_stFId.FId_EPBFrmErr DINH_stFId.FId_EPBFrmErrClth DINH_stFId.FId_ETHSCPErrDrvCyc DINH_stFId.FId_EVPComFailr DINH_stFId.FId_EbsLinErr DINH_stFId.FId_ElecLdComErr DINH_stFId.FId_ElecLdFrzVal DINH_stFId.FId_ElecLdHdLiComErr DINH_stFId.FId_ElecLdRplVal DINH_stFId.FId_ElecLoadEPSComErr DINH_stFId.FId_EngBlkTWrn DINH_stFId.FId_EngCooltTFail DINH_stFId.FId_EngDemTqLimnCamsftErr DINH_stFId.FId_EngDemTqLimnErrThmstHeatCtrlCirc DINH_stFId.FId_EngDemTqLimnOilPmp DINH_stFId.FId_EngDemTrqLimErrAPP DINH_stFId.FId_EngIntkAirFail DINH_stFId.FId_EngPrtErrVehV DINH_stFId.FId_EngSpd30DegFail DINH_stFId.FId_EngStrtEnaEthAdap DINH_stFId.FId_EngStrt_EnaCep DINH_stFId.FId_EngStrt_InjProhb DINH_stFId.FId_EngStrt_VehVInhb DINH_stFId.FId_EngTqRvsnEnaFlg DINH_stFId.FId_EnvTPrimMod DINH_stFId.FId_EnvTPrimModIniVal DINH_stFId.FId_EnvTSensSum DINH_stFId.FId_EnvTtAirFltDs DINH_stFId.FId_EnvTtCEngDsT DINH_stFId.FId_EnvTtIntkMnfld DINH_stFId.FId_EomCvoAllwd DINH_stFId.FId_EpmBCr DINH_stFId.FId_EpmCaSAdapCaSI1 DINH_stFId.FId_EpmCaSAdapRstI1 DINH_stFId.FId_EpmCaSDiagI1 DINH_stFId.FId_EpmCaSErrCaSI1 DINH_stFId.FId_EpmCaSOfsDiagCaSI1 DINH_stFId.FId_EpmCaSOfsErrCaSI1 DINH_stFId.FId_EpmCaSSegI1 DINH_stFId.FId_EpmCaSSpdPlausI1 DINH_stFId.FId_EpmCrSDiag DINH_stFId.FId_EpmCrSDiagVeh DINH_stFId.FId_EpmCrSErr DINH_stFId.FId_EpmOpMode_ALELock DINH_stFId.FId_EpmOpMode_DirStLock DINH_stFId.FId_EpmRRSCrSFaultCheck DINH_stFId.FId_EpmRRSDGIFaultCheck DINH_stFId.FId_EpmRRSRdCheck DINH_stFId.FId_EpmRRSVehVFaultChck DINH_stFId.FId_EpmSynLockCaSSync DINH_stFId.FId_EpmTmpSuppRvsRotCASI1 DINH_stFId.FId_EtaEngIdleNonCsers DINH_stFId.FId_EtaEngPtlNonCsers DINH_stFId.FId_EthnlSnsrErrCdn DINH_stFId.FId_EvapActrCcvElecDiag DINH_stFId.FId_EvapPSnsrTankPhyRngChk DINH_stFId.FId_FanCtlACClntP DINH_stFId.FId_FanCtlACGModFail DINH_stFId.FId_FanCtlAPP1 DINH_stFId.FId_FanCtlAPP2 DINH_stFId.FId_FanCtlAPPSync DINH_stFId.FId_FanCtlBlowrU DINH_stFId.FId_FanCtlCooltT DINH_stFId.FId_FanCtlCooltT2 DINH_stFId.FId_FanCtlEnvT DINH_stFId.FId_FanCtlLiSwtInfo DINH_stFId.FId_FanCtlSpd DINH_stFId.FId_FanCtlTSnsrErr DINH_stFId.FId_FanCtlThr1 DINH_stFId.FId_FanCtlThr2 DINH_stFId.FId_FcoReq DINH_stFId.FId_FiMFID_rba_MRly_Diag_Stk DINH_stFId.FId_FlComErr DINH_stFId.FId_FlDevPlauDiagFuSnsr DINH_stFId.FId_FlLvlNoSigErr DINH_stFId.FId_FlLvlVehSpdSigErr DINH_stFId.FId_FlLvlVehVErr DINH_stFId.FId_FlMALamDynDiag DINH_stFId.FId_FlSplGAltLin DINH_stFId.FId_FlTnkQnt DINH_stFId.FId_FuMixHotFilmErr DINH_stFId.FId_FuMixUegoErrExcl DINH_stFId.FId_FuPHiRailEthnlSnsrErr DINH_stFId.FId_FuPurg_TEVError DINH_stFId.FId_FuSnsrPhyRngErr DINH_stFId.FId_GEVCtlAVCAdprCBBNWEErrIntk DINH_stFId.FId_GEVCtlAVCAdprIntkB1 DINH_stFId.FId_GEVCtlAVCAdprNWSEErrIntk DINH_stFId.FId_GEVCtlAdpnEnaIntk DINH_stFId.FId_GEVCtlAdpnEnaShtrpActv DINH_stFId.FId_GEVCtlClngIntk DINH_stFId.FId_GEVCtlMinOvlIntk DINH_stFId.FId_GEVCtlPOilSnsr DINH_stFId.FId_GEVCtlPhaEnaIntk DINH_stFId.FId_GEVCtlPhaSpTstrIntk DINH_stFId.FId_GEVCtlRefAdpnMntChck DINH_stFId.FId_GEVCtlRefAdpnMntChckTstd DINH_stFId.FId_GEVCtlReqRefAdpnTstrIntk DINH_stFId.FId_GEVCtlReqRefAdpnTstrIntkTstd DINH_stFId.FId_GEVCtlVlvLftEnaIntk DINH_stFId.FId_GEVCtlVlvOpenClsdIntkB1 DINH_stFId.FId_GEVlvLockPinDiagIntkB1 DINH_stFId.FId_GEVlvPhaDiagEnaCsersIntkB1 DINH_stFId.FId_GEVlvPhaDiagEnaIntkB1 DINH_stFId.FId_GEVlvPhaPsIntkB1 DINH_stFId.FId_GbxAnNeutPosnErr DINH_stFId.FId_GbxCANDigPlausErr DINH_stFId.FId_GbxCANNeutSigErr DINH_stFId.FId_GbxPNPosSig DINH_stFId.FId_GbxPNPosnComErr DINH_stFId.FId_GbxPNPosnDiagDrvCdnRels DINH_stFId.FId_GbxPNPosnDiagDrvCodnHealRels DINH_stFId.FId_GbxPNPosnDiagPlausyRels DINH_stFId.FId_GbxPNPosnSubsVal DINH_stFId.FId_GbxRvsSwtStk DINH_stFId.FId_GbxSnsrSplyUErr DINH_stFId.FId_GbxSpstReqOk DINH_stFId.FId_GlbDaLSumvXPtd DINH_stFId.FId_GslThrVlvSnsrDiagB1 DINH_stFId.FId_HEGOS2B1DElec DINH_stFId.FId_HEGOS2B1DHtg DINH_stFId.FId_HEGOS2B1Htg DINH_stFId.FId_HEGOS2B1HtrPsSt DINH_stFId.FId_HEGOS2B1InVld DINH_stFId.FId_HEGOS2B1LSPsDiaDi DINH_stFId.FId_HLSDemBrkFlt DINH_stFId.FId_HLSDemErr1 DINH_stFId.FId_HLSDemErr2 DINH_stFId.FId_HLSDemIntkAirTemp DINH_stFId.FId_HLSDemMotTemp DINH_stFId.FId_HLSDemMstCyldpVld DINH_stFId.FId_HLSDemSpdClthGearAccrSigErr DINH_stFId.FId_HLSDem_DrvOffSuprt DINH_stFId.FId_HLSDem_DrvOffSuprtBrkHldSys DINH_stFId.FId_HLSDem_DrvOffSuprtLAS DINH_stFId.FId_HLSDem_PModeActv DINH_stFId.FId_HLSDem_TModeActv DINH_stFId.FId_HLSDem_TraSubFcn DINH_stFId.FId_HLSDem_nMaxLimErr1 DINH_stFId.FId_HLSDem_nMaxLimErr2 DINH_stFId.FId_HLSDem_nMaxLimErr3 DINH_stFId.FId_HLSDem_nMaxVErr DINH_stFId.FId_I14229APP DINH_stFId.FId_I14229CANErr DINH_stFId.FId_I14229FlLvlFltComErr DINH_stFId.FId_I14229VTCErr DINH_stFId.FId_IMGISABComErr DINH_stFId.FId_InhbLamDynS1B1 DINH_stFId.FId_InhbnBlkdLineDiag DINH_stFId.FId_InhibitAlways DINH_stFId.FId_InhibitNever DINH_stFId.FId_InjSysMulInjDiagErr DINH_stFId.FId_InjVlvPs_Bank1OnlyErr DINH_stFId.FId_InjVlvPs_Bank1Tested DINH_stFId.FId_InjVlvPs_Bank2OnlyErr DINH_stFId.FId_InjVlvPs_Bank2Tested DINH_stFId.FId_InjVlvPs_Bank3OnlyErr DINH_stFId.FId_InjVlvPs_Bank3Tested DINH_stFId.FId_IntkAirTAirFltDsCrssChk DINH_stFId.FId_IntkAirTAirFltDsPlausChk DINH_stFId.FId_IntkAirTIntkMnfldCrssChk DINH_stFId.FId_IntkAirTIntkMnfldPlausChk DINH_stFId.FId_IntkAirTIntkMnfldRepl DINH_stFId.FId_IntkAirTSnsr1Elec DINH_stFId.FId_IntkAirTSnsr1PRC DINH_stFId.FId_IntkAirTSnsr1Sum DINH_stFId.FId_IntkAirTSnsr2Elec DINH_stFId.FId_IntkAirTSnsr2PRC DINH_stFId.FId_IntkAirTSnsr2Sum DINH_stFId.FId_IntkArTempENGB DINH_stFId.FId_LIGovDfrstI DINH_stFId.FId_LIGovUndrBrk DINH_stFId.FId_LINDCDCRxErr DINH_stFId.FId_LLimAppSnsrErr DINH_stFId.FId_LLimAppSnsrSyncErr DINH_stFId.FId_LLimMTVehSpdSnsrErr DINH_stFId.FId_LLimShutOffEng DINH_stFId.FId_LRSEBMisf DINH_stFId.FId_LZSR DINH_stFId.FId_LeakToMnfld DINH_stFId.FId_LeakToMnfldTstd DINH_stFId.FId_LimpHomPsErrInjtr DINH_stFId.FId_LinACGUnitCfmdErr DINH_stFId.FId_LinACGUnitNotTstd DINH_stFId.FId_LinAEVUnitCfmdErr DINH_stFId.FId_LinAEVUnitNotTstd DINH_stFId.FId_LinEBSUnitCfmdErr DINH_stFId.FId_LinEBSUnitNotTstd DINH_stFId.FId_LowPresOilP DINH_stFId.FId_MFlowAirCrkcsSubVal DINH_stFId.FId_MFuOilMax DINH_stFId.FId_MaiLoadSnsr DINH_stFId.FId_MaiShaftFailr DINH_stFId.FId_MfPsDia1 DINH_stFId.FId_MisfDetDnAdpn DINH_stFId.FId_MisfDetDnAdpnPlaus DINH_stFId.FId_MisfDetEnvP DINH_stFId.FId_MisfDetSegTiAdpnFco DINH_stFId.FId_MisfDetShtrpAct DINH_stFId.FId_MisfDetStc DINH_stFId.FId_MisfDetV DINH_stFId.FId_MisfDetVWhlFrntLe DINH_stFId.FId_MisfDetVWhlFrntRi DINH_stFId.FId_MisfDetVWhlReLe DINH_stFId.FId_MisfDetVWhlReRi DINH_stFId.FId_NLimVehHalt DINH_stFId.FId_NSHTDAmbT DINH_stFId.FId_NSHTDEngT DINH_stFId.FId_NSHTILimHiAltiLoIdleSp DINH_stFId.FId_NeutPosnFailr DINH_stFId.FId_O2StorgMdlMD DINH_stFId.FId_OilCmbdSen_LvlDfctHW DINH_stFId.FId_OilPCtrlVlvNpl DINH_stFId.FId_OilPFrzVal DINH_stFId.FId_OilPPlaus DINH_stFId.FId_OilPPlausAftRun DINH_stFId.FId_OilPPlausMax DINH_stFId.FId_OilPPlausMin DINH_stFId.FId_OilPPlausT15 DINH_stFId.FId_OilPRplVal DINH_stFId.FId_OilPSnsrErr DINH_stFId.FId_OilPSwmpSRC DINH_stFId.FId_OilSwmpTCEngDsTWrmUp DINH_stFId.FId_OilSwmpT_B_tospg DINH_stFId.FId_OilSwmpT_B_tospgg DINH_stFId.FId_OilSwmpT_CmbdSnsrErr DINH_stFId.FId_OilSwmpT_CmbdSnsrTiTErr DINH_stFId.FId_OilSwmpT_EnvT DINH_stFId.FId_OilSwmpT_TSnsrErr DINH_stFId.FId_PEnvMeasVld DINH_stFId.FId_PEnvModel DINH_stFId.FId_PEnvPlausDiagVDD DINH_stFId.FId_PEnvRawVldVDD DINH_stFId.FId_PEnvRefSnsr DINH_stFId.FId_PEnvSigRngVld DINH_stFId.FId_PEnvSnsrPlausVDD DINH_stFId.FId_PEnvVldVDD DINH_stFId.FId_PIDA6SigSrcErr DINH_stFId.FId_PIntkMnfldPlaus DINH_stFId.FId_PIntkVUsElecDiagB1 DINH_stFId.FId_PSPCtlDisbl DINH_stFId.FId_PSPCtlIntkAirVapLock DINH_stFId.FId_PSPCtlPreRun DINH_stFId.FId_PSPCtlVapLock DINH_stFId.FId_PSPDiagDisbl DINH_stFId.FId_PTGripConv DINH_stFId.FId_PTGripConvStrt DINH_stFId.FId_PTGripMnlClth DINH_stFId.FId_PTGripMnlClthStrt DINH_stFId.FId_PTTrqRatCANPtd DINH_stFId.FId_PThrVlVUsVldB1 DINH_stFId.FId_PThrVlvUsMeasdVldB1 DINH_stFId.FId_P_VSE11_Diag DINH_stFId.FId_PrmId03_FltRdnS1B1 DINH_stFId.FId_PrmId03_FltUegoS1B1 DINH_stFId.FId_RevLck DINH_stFId.FId_RstAdpnPIntkMnfldAfs DINH_stFId.FId_RvsPosnFailr DINH_stFId.FId_SSEEPBRelease DINH_stFId.FId_SSEFCANPRelease DINH_stFId.FId_SSEPTCANPRelease DINH_stFId.FId_SSEStartRelease DINH_stFId.FId_SSEStartReleaseMTCl10 DINH_stFId.FId_SSEStartReleaseMTCl100 DINH_stFId.FId_SSEStartReleaseMTCl20 DINH_stFId.FId_SSEStartReleaseMTCl90 DINH_stFId.FId_SSEStartRequest DINH_stFId.FId_SSEStopRelease DINH_stFId.FId_SSEStrtStopRelease DINH_stFId.FId_SSESysOff DINH_stFId.FId_SSEUI2DCSysFailr DINH_stFId.FId_SSEUIBCANErr DINH_stFId.FId_SSEUISysFail DINH_stFId.FId_SiaEEPErr DINH_stFId.FId_SnglWhlErrDiagEna DINH_stFId.FId_StrtCtlAutoCrkModeCdn DINH_stFId.FId_StrtCtlComEngStrtErr DINH_stFId.FId_StrtCtlNPCdnCncl DINH_stFId.FId_StrtCtlNoCpuFailr DINH_stFId.FId_StrtCtlNoFailCanLine DINH_stFId.FId_StrtCtlNoFailPTCanLine DINH_stFId.FId_StrtCtlPNPosnSubsVal DINH_stFId.FId_StrtCtlSTMFailr DINH_stFId.FId_StrtErrShaft DINH_stFId.FId_SumErrHndlg DINH_stFId.FId_SysDiagComErr DINH_stFId.FId_SysDiagModInhbErr DINH_stFId.FId_TOSPM DINH_stFId.FId_TWCCILck DINH_stFId.FId_TWCCILckExtd DINH_stFId.FId_TWCCIRstB1 DINH_stFId.FId_TWCCIRstDSMClearB1 DINH_stFId.FId_TWCCLsuB1 DINH_stFId.FId_TWCCLsuCyc DINH_stFId.FId_TWCCLsuDynB1 DINH_stFId.FId_TWCCMisfDetn DINH_stFId.FId_TWCDPriCatParB1 DINH_stFId.FId_TWCDPriCatVldnB1 DINH_stFId.FId_TankPCpv1DteskLoLoadStuckClsd DINH_stFId.FId_TankPCpv1DteskLoLoadStuckOpen DINH_stFId.FId_TankPSnsrElecChkVld DINH_stFId.FId_ThrVlvMon DINH_stFId.FId_ThrVlvOffsLrnPrmsB1 DINH_stFId.FId_TiOffTBasdChkFast DINH_stFId.FId_TiOffTBasdChkSlow DINH_stFId.FId_TiOffVdClk DINH_stFId.FId_TqDecelOffsInhb DINH_stFId.FId_TraAddAirCANPtd DINH_stFId.FId_TraAddClntCANPtd DINH_stFId.FId_TraFwdRvsCluInfo DINH_stFId.FId_TraGbxNPos DINH_stFId.FId_TraGearInfoCanCom DINH_stFId.FId_TraGearInfoDet DINH_stFId.FId_TraGearInfoGearShftActv DINH_stFId.FId_TraGearInfoInfoCan DINH_stFId.FId_TraGearInfoLevPos DINH_stFId.FId_TraGearInfoLoRng DINH_stFId.FId_TraGearInfoRTra DINH_stFId.FId_TraGearInfoRevGear DINH_stFId.FId_TraGearReq DINH_stFId.FId_TraNoShftIdctr DINH_stFId.FId_TraPrtGearCANPtd DINH_stFId.FId_TraPrtGearIndpdtProblem DINH_stFId.FId_TraRPosn DINH_stFId.FId_TraRtnIntfcASTIntv DINH_stFId.FId_TraRtnIntfcIdlSetP DINH_stFId.FId_TraRtnIntfcNMaxCan DINH_stFId.FId_TraRtnIntfcNMaxVel DINH_stFId.FId_TraTrqRedLmpHmeDec DINH_stFId.FId_TraTrqRedLmpHmeInc DINH_stFId.FId_TraTrqRedPTCanErr DINH_stFId.FId_TraTrqRedTIIntvDes DINH_stFId.FId_TraTrqRedTIIntvLead DINH_stFId.FId_TraTrqRedTSCIntvDes DINH_stFId.FId_TraTrqRedTSCIntvLead DINH_stFId.FId_TraTrsmTypHw DINH_stFId.FId_TranIdleDes DINH_stFId.FId_UEGOHeatgUpRglS1B1 DINH_stFId.FId_UEGOHeatrCtrlS1B1 DINH_stFId.FId_UEGOHeatrPrfmncDiagRelsS1B1 /end LOC_MEASUREMENT
 FUNCTION_VERSION "30000.27.0_1.0.0" /end FUNCTION
/begin COMPU_METHOD DFC_OneToOne "" RAT_FUNC "%6.2" "-" COEFFS 0 1 0 0 0 1 /end COMPU_METHOD
/end MODULE
/end PROJECT
