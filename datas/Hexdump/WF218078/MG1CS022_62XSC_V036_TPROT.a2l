ASAP2_VERSION 1 60
/begin PROJECT MG1CS022 "MG1CS022"
/begin HEADER "" VERSION "MG1CS022_62XSC_V036_TPROT" PROJECT_NO MG1CS022 /end HEADER
/begin MODULE DIM ""
/begin MOD_COMMON "" BYTE_ORDER MSB_LAST ALIGNMENT_BYTE 1 ALIGNMENT_WORD 2 ALIGNMENT_LONG 4 ALIGNMENT_INT64 4 ALIGNMENT_FLOAT32_IEEE 4 ALIGNMENT_FLOAT64_IEEE 4 DATA_SIZE 32 /end MOD_COMMON
/begin CHARACTERISTIC DFES_EnvRef.DFC_OilPPlaus_C "used environment signals / Reference to used environment condition set for check DFC_OilPPlaus" VALUE 0x805046F6 Val_Wu8 1.00000000000 DFES_EnvTabVerb 0.00 1.00000000000 FORMAT "%13.11" /end CHARACTERISTIC
/begin CHARACTERISTIC DFES_EnvRef.DFC_PLLSUmax_C "used environment signals / Reference to used environment condition set for check DFC_PLLSUmax" VALUE 0x805046F7 Val_Wu8 1.00000000000 DFES_EnvTabVerb 0.00 1.00000000000 FORMAT "%13.11" /end CHARACTERISTIC
/begin CHARACTERISTIC DFES_EnvRef.DFC_PLLSUmin_C "used environment signals / Reference to used environment condition set for check DFC_PLLSUmin" VALUE 0x805046F8 Val_Wu8 1.00000000000 DFES_EnvTabVerb 0.00 1.00000000000 FORMAT "%13.11" /end CHARACTERISTIC
/begin CHARACTERISTIC DFES_EnvRef.DFC_PSR1max_C "used environment signals / Reference to used environment condition set for check DFC_PSR1max" VALUE 0x805046F9 Val_Wu8 1.00000000000 DFES_EnvTabVerb 0.00 1.00000000000 FORMAT "%13.11" /end CHARACTERISTIC
/begin CHARACTERISTIC DFES_EnvRef.DFC_PSRBmax_C "used environment signals / Reference to used environment condition set for check DFC_PSRBmax" VALUE 0x805046FA Val_Wu8 1.00000000000 DFES_EnvTabVerb 0.00 1.00000000000 FORMAT "%13.11" /end CHARACTERISTIC
/begin CHARACTERISTIC DFES_EnvRef.DFC_PSRBmin_C "used environment signals / Reference to used environment condition set for check DFC_PSRBmin" VALUE 0x805046FB Val_Wu8 1.00000000000 DFES_EnvTabVerb 0.00 1.00000000000 FORMAT "%13.11" /end CHARACTERISTIC
/begin CHARACTERISTIC DFES_EnvRef.DFC_PSRPmax_C "used environment signals / Reference to used environment condition set for check DFC_PSRPmax" VALUE 0x805046FC Val_Wu8 1.00000000000 DFES_EnvTabVerb 0.00 1.00000000000 FORMAT "%13.11" /end CHARACTERISTIC
/begin CHARACTERISTIC DFES_EnvRef.DFC_PSRPmin_C "used environment signals / Reference to used environment condition set for check DFC_PSRPmin" VALUE 0x805046FD Val_Wu8 1.00000000000 DFES_EnvTabVerb 0.00 1.00000000000 FORMAT "%13.11" /end CHARACTERISTIC
/begin CHARACTERISTIC DFES_EnvRef.DFC_PSRPsig_C "used environment signals / Reference to used environment condition set for check DFC_PSRPsig" VALUE 0x805046FE Val_Wu8 1.00000000000 DFES_EnvTabVerb 0.00 1.00000000000 FORMAT "%13.11" /end CHARACTERISTIC
/begin CHARACTERISTIC DFES_EnvRef.DFC_PSRmax_C "used environment signals / Reference to used environment condition set for check DFC_PSRmax" VALUE 0x805046FF Val_Wu8 1.00000000000 DFES_EnvTabVerb 0.00 1.00000000000 FORMAT "%13.11" /end CHARACTERISTIC
/begin CHARACTERISTIC DFES_EnvRef.DFC_PUmax_C "used environment signals / Reference to used environment condition set for check DFC_PUmax" VALUE 0x80504700 Val_Wu8 1.00000000000 DFES_EnvTabVerb 0.00 1.00000000000 FORMAT "%13.11" /end CHARACTERISTIC
/begin CHARACTERISTIC DFES_EnvRef.DFC_P_VSE11_OL_C "used environment signals / Reference to used environment condition set for check DFC_P_VSE11_OL" VALUE 0x80504701 Val_Wu8 1.00000000000 DFES_EnvTabVerb 0.00 1.00000000000 FORMAT "%13.11" /end CHARACTERISTIC
/begin CHARACTERISTIC DFES_EnvRef.DFC_P_VSE11_SCB_C "used environment signals / Reference to used environment condition set for check DFC_P_VSE11_SCB" VALUE 0x80504702 Val_Wu8 1.00000000000 DFES_EnvTabVerb 0.00 1.00000000000 FORMAT "%13.11" /end CHARACTERISTIC
/begin CHARACTERISTIC DFES_EnvRef.DFC_P_VSE11_SCG_C "used environment signals / Reference to used environment condition set for check DFC_P_VSE11_SCG" VALUE 0x80504703 Val_Wu8 1.00000000000 DFES_EnvTabVerb 0.00 1.00000000000 FORMAT "%13.11" /end CHARACTERISTIC
/begin CHARACTERISTIC DFES_EnvRef.DFC_PhyHighAPP1_C "used environment signals / Reference to used environment condition set for check DFC_PhyHighAPP1" VALUE 0x80504704 Val_Wu8 1.00000000000 DFES_EnvTabVerb 0.00 1.00000000000 FORMAT "%13.11" /end CHARACTERISTIC
/begin CHARACTERISTIC DFES_EnvRef.DFC_PhyHighAPP2_C "used environment signals / Reference to used environment condition set for check DFC_PhyHighAPP2" VALUE 0x80504705 Val_Wu8 1.00000000000 DFES_EnvTabVerb 0.00 1.00000000000 FORMAT "%13.11" /end CHARACTERISTIC
/begin CHARACTERISTIC DFES_EnvRef.DFC_PhyLowAPP1_C "used environment signals / Reference to used environment condition set for check DFC_PhyLowAPP1" VALUE 0x80504706 Val_Wu8 1.00000000000 DFES_EnvTabVerb 0.00 1.00000000000 FORMAT "%13.11" /end CHARACTERISTIC
/begin CHARACTERISTIC DFES_EnvRef.DFC_PhyLowAPP2_C "used environment signals / Reference to used environment condition set for check DFC_PhyLowAPP2" VALUE 0x80504707 Val_Wu8 1.00000000000 DFES_EnvTabVerb 0.00 1.00000000000 FORMAT "%13.11" /end CHARACTERISTIC
/begin CHARACTERISTIC DFES_EnvRef.DFC_SRCHighAPP1_C "used environment signals / Reference to used environment condition set for check DFC_SRCHighAPP1" VALUE 0x80504708 Val_Wu8 1.00000000000 DFES_EnvTabVerb 0.00 1.00000000000 FORMAT "%13.11" /end CHARACTERISTIC
/begin CHARACTERISTIC DFES_EnvRef.DFC_SRCHighAPP2_C "used environment signals / Reference to used environment condition set for check DFC_SRCHighAPP2" VALUE 0x80504709 Val_Wu8 1.00000000000 DFES_EnvTabVerb 0.00 1.00000000000 FORMAT "%13.11" /end CHARACTERISTIC
/begin CHARACTERISTIC DFES_EnvRef.DFC_SRCLowAPP1_C "used environment signals / Reference to used environment condition set for check DFC_SRCLowAPP1" VALUE 0x8050470A Val_Wu8 1.00000000000 DFES_EnvTabVerb 0.00 1.00000000000 FORMAT "%13.11" /end CHARACTERISTIC
/begin CHARACTERISTIC DFES_EnvRef.DFC_SRCLowAPP2_C "used environment signals / Reference to used environment condition set for check DFC_SRCLowAPP2" VALUE 0x8050470B Val_Wu8 1.00000000000 DFES_EnvTabVerb 0.00 1.00000000000 FORMAT "%13.11" /end CHARACTERISTIC
/begin CHARACTERISTIC DFES_EnvRef.DFC_SSpMon2_C "used environment signals / Reference to used environment condition set for check DFC_SSpMon2" VALUE 0x8050470C Val_Wu8 1.00000000000 DFES_EnvTabVerb 0.00 1.00000000000 FORMAT "%13.11" /end CHARACTERISTIC
/begin CHARACTERISTIC DFES_EnvRef.DFC_STHDRmax_C "used environment signals / Reference to used environment condition set for check DFC_STHDRmax" VALUE 0x8050470D Val_Wu8 1.00000000000 DFES_EnvTabVerb 0.00 1.00000000000 FORMAT "%13.11" /end CHARACTERISTIC
/begin CHARACTERISTIC DFES_EnvRef.DFC_SWReset_0_C "used environment signals / Reference to used environment condition set for check DFC_SWReset_0" VALUE 0x8050470E Val_Wu8 1.00000000000 DFES_EnvTabVerb 0.00 1.00000000000 FORMAT "%13.11" /end CHARACTERISTIC
/begin CHARACTERISTIC DFES_EnvRef.DFC_SWReset_1_C "used environment signals / Reference to used environment condition set for check DFC_SWReset_1" VALUE 0x8050470F Val_Wu8 1.00000000000 DFES_EnvTabVerb 0.00 1.00000000000 FORMAT "%13.11" /end CHARACTERISTIC
/begin CHARACTERISTIC DFES_EnvRef.DFC_SWReset_2_C "used environment signals / Reference to used environment condition set for check DFC_SWReset_2" VALUE 0x80504710 Val_Wu8 1.00000000000 DFES_EnvTabVerb 0.00 1.00000000000 FORMAT "%13.11" /end CHARACTERISTIC
/begin CHARACTERISTIC DFES_EnvRef.DFC_SyncAPP_C "used environment signals / Reference to used environment condition set for check DFC_SyncAPP" VALUE 0x80504711 Val_Wu8 1.00000000000 DFES_EnvTabVerb 0.00 1.00000000000 FORMAT "%13.11" /end CHARACTERISTIC
/begin CHARACTERISTIC DFES_EnvRef.DFC_TANKLnpl_C "used environment signals / Reference to used environment condition set for check DFC_TANKLnpl" VALUE 0x80504712 Val_Wu8 1.00000000000 DFES_EnvTabVerb 0.00 1.00000000000 FORMAT "%13.11" /end CHARACTERISTIC
/begin CHARACTERISTIC DFES_EnvRef.DFC_TAmax_Dummy_C "used environment signals / Reference to used environment condition set for check DFC_TAmax_Dummy" VALUE 0x80504713 Val_Wu8 1.00000000000 DFES_EnvTabVerb 0.00 1.00000000000 FORMAT "%13.11" /end CHARACTERISTIC
/begin CHARACTERISTIC DFES_EnvRef.DFC_TESFmax_C "used environment signals / Reference to used environment condition set for check DFC_TESFmax" VALUE 0x80504714 Val_Wu8 1.00000000000 DFES_EnvTabVerb 0.00 1.00000000000 FORMAT "%13.11" /end CHARACTERISTIC
/begin CHARACTERISTIC DFES_EnvRef.DFC_TESGmax_C "used environment signals / Reference to used environment condition set for check DFC_TESGmax" VALUE 0x80504715 Val_Wu8 1.00000000000 DFES_EnvTabVerb 0.00 1.00000000000 FORMAT "%13.11" /end CHARACTERISTIC
/begin CHARACTERISTIC DFES_EnvRef.DFC_TKAEmax_C "used environment signals / Reference to used environment condition set for check DFC_TKAEmax" VALUE 0x80504716 Val_Wu8 1.00000000000 DFES_EnvTabVerb 0.00 1.00000000000 FORMAT "%13.11" /end CHARACTERISTIC
/begin CHARACTERISTIC DFES_EnvRef.DFC_TKAEmin_C "used environment signals / Reference to used environment condition set for check DFC_TKAEmin" VALUE 0x80504717 Val_Wu8 1.00000000000 DFES_EnvTabVerb 0.00 1.00000000000 FORMAT "%13.11" /end CHARACTERISTIC
/begin CHARACTERISTIC DFES_EnvRef.DFC_TKARmax_C "used environment signals / Reference to used environment condition set for check DFC_TKARmax" VALUE 0x80504718 Val_Wu8 1.00000000000 DFES_EnvTabVerb 0.00 1.00000000000 FORMAT "%13.11" /end CHARACTERISTIC
/begin CHARACTERISTIC DFES_EnvRef.DFC_TKARnpl_C "used environment signals / Reference to used environment condition set for check DFC_TKARnpl" VALUE 0x80504719 Val_Wu8 1.00000000000 DFES_EnvTabVerb 0.00 1.00000000000 FORMAT "%13.11" /end CHARACTERISTIC
/begin CHARACTERISTIC DFES_EnvRef.DFC_TMmax_Dummy_C "used environment signals / Reference to used environment condition set for check DFC_TMmax_Dummy" VALUE 0x8050471A Val_Wu8 1.00000000000 DFES_EnvTabVerb 0.00 1.00000000000 FORMAT "%13.11" /end CHARACTERISTIC
/begin CHARACTERISTIC DFES_EnvRef.DFC_TUMmax_Dummy_C "used environment signals / Reference to used environment condition set for check DFC_TUMmax_Dummy" VALUE 0x8050471B Val_Wu8 1.00000000000 DFES_EnvTabVerb 0.00 1.00000000000 FORMAT "%13.11" /end CHARACTERISTIC
/begin CHARACTERISTIC DFES_EnvRef.DFC_TWCDPriCatB1_C "used environment signals / Reference to used environment condition set for check DFC_TWCDPriCatB1" VALUE 0x8050471C Val_Wu8 1.00000000000 DFES_EnvTabVerb 0.00 1.00000000000 FORMAT "%13.11" /end CHARACTERISTIC
/begin CHARACTERISTIC DFES_EnvRef.DFC_ThrVlvClsdPosnFirstOffsLrnImpoB1_C "used environment signals / Reference to used environment condition set for check DFC_ThrVlvClsdPosnFirstOffsLrnImpoB1" VALUE 0x8050471D Val_Wu8 1.00000000000 DFES_EnvTabVerb 0.00 1.00000000000 FORMAT "%13.11" /end CHARACTERISTIC
/begin CHARACTERISTIC DFES_EnvRef.DFC_ThrVlvClsdPosnOffsLrnImpoB1_C "used environment signals / Reference to used environment condition set for check DFC_ThrVlvClsdPosnOffsLrnImpoB1" VALUE 0x8050471E Val_Wu8 1.00000000000 DFES_EnvTabVerb 0.00 1.00000000000 FORMAT "%13.11" /end CHARACTERISTIC
/begin CHARACTERISTIC DFES_EnvRef.DFC_ThrVlvClsdPosnOffsLrnMaxB1_C "used environment signals / Reference to used environment condition set for check DFC_ThrVlvClsdPosnOffsLrnMaxB1" VALUE 0x8050471F Val_Wu8 1.00000000000 DFES_EnvTabVerb 0.00 1.00000000000 FORMAT "%13.11" /end CHARACTERISTIC
/begin CHARACTERISTIC DFES_EnvRef.DFC_ThrVlvClsdPosnOffsLrnMinB1_C "used environment signals / Reference to used environment condition set for check DFC_ThrVlvClsdPosnOffsLrnMinB1" VALUE 0x80504720 Val_Wu8 1.00000000000 DFES_EnvTabVerb 0.00 1.00000000000 FORMAT "%13.11" /end CHARACTERISTIC
/begin CHARACTERISTIC DFES_EnvRef.DFC_ThrVlvCtrlDeB1_C "used environment signals / Reference to used environment condition set for check DFC_ThrVlvCtrlDeB1" VALUE 0x80504721 Val_Wu8 1.00000000000 DFES_EnvTabVerb 0.00 1.00000000000 FORMAT "%13.11" /end CHARACTERISTIC
/begin CHARACTERISTIC DFES_EnvRef.DFC_ThrVlvDycB1_C "used environment signals / Reference to used environment condition set for check DFC_ThrVlvDycB1" VALUE 0x80504722 Val_Wu8 1.00000000000 DFES_EnvTabVerb 0.00 1.00000000000 FORMAT "%13.11" /end CHARACTERISTIC
/begin CHARACTERISTIC DFES_EnvRef.DFC_ThrVlvLimpAirPosnMaxAbsltDriftB1_C "used environment signals / Reference to used environment condition set for check DFC_ThrVlvLimpAirPosnMaxAbsltDriftB1" VALUE 0x80504723 Val_Wu8 1.00000000000 DFES_EnvTabVerb 0.00 1.00000000000 FORMAT "%13.11" /end CHARACTERISTIC
/begin CHARACTERISTIC DFES_EnvRef.DFC_ThrVlvLimpAirPosnMaxB1_C "used environment signals / Reference to used environment condition set for check DFC_ThrVlvLimpAirPosnMaxB1" VALUE 0x80504724 Val_Wu8 1.00000000000 DFES_EnvTabVerb 0.00 1.00000000000 FORMAT "%13.11" /end CHARACTERISTIC
/begin CHARACTERISTIC DFES_EnvRef.DFC_ThrVlvLimpAirPosnMaxRelDriftB1_C "used environment signals / Reference to used environment condition set for check DFC_ThrVlvLimpAirPosnMaxRelDriftB1" VALUE 0x80504725 Val_Wu8 1.00000000000 DFES_EnvTabVerb 0.00 1.00000000000 FORMAT "%13.11" /end CHARACTERISTIC
/begin CHARACTERISTIC DFES_EnvRef.DFC_ThrVlvLimpAirPosnMinB1_C "used environment signals / Reference to used environment condition set for check DFC_ThrVlvLimpAirPosnMinB1" VALUE 0x80504726 Val_Wu8 1.00000000000 DFES_EnvTabVerb 0.00 1.00000000000 FORMAT "%13.11" /end CHARACTERISTIC
/begin CHARACTERISTIC DFES_EnvRef.DFC_ThrVlvOpenLoadB1_C "used environment signals / Reference to used environment condition set for check DFC_ThrVlvOpenLoadB1" VALUE 0x80504727 Val_Wu8 1.00000000000 DFES_EnvTabVerb 0.00 1.00000000000 FORMAT "%13.11" /end CHARACTERISTIC
/begin CHARACTERISTIC DFES_EnvRef.DFC_ThrVlvOpenSprgB1_C "used environment signals / Reference to used environment condition set for check DFC_ThrVlvOpenSprgB1" VALUE 0x80504728 Val_Wu8 1.00000000000 DFES_EnvTabVerb 0.00 1.00000000000 FORMAT "%13.11" /end CHARACTERISTIC
/begin CHARACTERISTIC DFES_EnvRef.DFC_ThrVlvOpenSprgSprdB1_C "used environment signals / Reference to used environment condition set for check DFC_ThrVlvOpenSprgSprdB1" VALUE 0x80504729 Val_Wu8 1.00000000000 DFES_EnvTabVerb 0.00 1.00000000000 FORMAT "%13.11" /end CHARACTERISTIC
/begin CHARACTERISTIC DFES_EnvRef.DFC_ThrVlvOpenSprgTwnB1_C "used environment signals / Reference to used environment condition set for check DFC_ThrVlvOpenSprgTwnB1" VALUE 0x8050472A Val_Wu8 1.00000000000 DFES_EnvTabVerb 0.00 1.00000000000 FORMAT "%13.11" /end CHARACTERISTIC
/begin CHARACTERISTIC DFES_EnvRef.DFC_ThrVlvOverTB1_C "used environment signals / Reference to used environment condition set for check DFC_ThrVlvOverTB1" VALUE 0x8050472B Val_Wu8 1.00000000000 DFES_EnvTabVerb 0.00 1.00000000000 FORMAT "%13.11" /end CHARACTERISTIC
/begin CHARACTERISTIC DFES_EnvRef.DFC_ThrVlvRetSprgB1_C "used environment signals / Reference to used environment condition set for check DFC_ThrVlvRetSprgB1" VALUE 0x8050472C Val_Wu8 1.00000000000 DFES_EnvTabVerb 0.00 1.00000000000 FORMAT "%13.11" /end CHARACTERISTIC
/begin CHARACTERISTIC DFES_EnvRef.DFC_ThrVlvRetSprgSprdB1_C "used environment signals / Reference to used environment condition set for check DFC_ThrVlvRetSprgSprdB1" VALUE 0x8050472D Val_Wu8 1.00000000000 DFES_EnvTabVerb 0.00 1.00000000000 FORMAT "%13.11" /end CHARACTERISTIC
/begin CHARACTERISTIC DFES_EnvRef.DFC_ThrVlvRetSprgTwnB1_C "used environment signals / Reference to used environment condition set for check DFC_ThrVlvRetSprgTwnB1" VALUE 0x8050472E Val_Wu8 1.00000000000 DFES_EnvTabVerb 0.00 1.00000000000 FORMAT "%13.11" /end CHARACTERISTIC
/begin CHARACTERISTIC DFES_EnvRef.DFC_ThrVlvSens1MaxB1_C "used environment signals / Reference to used environment condition set for check DFC_ThrVlvSens1MaxB1" VALUE 0x8050472F Val_Wu8 1.00000000000 DFES_EnvTabVerb 0.00 1.00000000000 FORMAT "%13.11" /end CHARACTERISTIC
/begin CHARACTERISTIC DFES_EnvRef.DFC_ThrVlvSens1NplB1_C "used environment signals / Reference to used environment condition set for check DFC_ThrVlvSens1NplB1" VALUE 0x80504730 Val_Wu8 1.00000000000 DFES_EnvTabVerb 0.00 1.00000000000 FORMAT "%13.11" /end CHARACTERISTIC
/begin CHARACTERISTIC DFES_EnvRef.DFC_ThrVlvSens2MaxB1_C "used environment signals / Reference to used environment condition set for check DFC_ThrVlvSens2MaxB1" VALUE 0x80504731 Val_Wu8 1.00000000000 DFES_EnvTabVerb 0.00 1.00000000000 FORMAT "%13.11" /end CHARACTERISTIC
/begin CHARACTERISTIC DFES_EnvRef.DFC_ThrVlvSens2MinB1_C "used environment signals / Reference to used environment condition set for check DFC_ThrVlvSens2MinB1" VALUE 0x80504732 Val_Wu8 1.00000000000 DFES_EnvTabVerb 0.00 1.00000000000 FORMAT "%13.11" /end CHARACTERISTIC
/begin CHARACTERISTIC DFES_EnvRef.DFC_ThrVlvSens2NplB1_C "used environment signals / Reference to used environment condition set for check DFC_ThrVlvSens2NplB1" VALUE 0x80504733 Val_Wu8 1.00000000000 DFES_EnvTabVerb 0.00 1.00000000000 FORMAT "%13.11" /end CHARACTERISTIC
/begin CHARACTERISTIC DFES_EnvRef.DFC_ThrVlvShoCircB1_C "used environment signals / Reference to used environment condition set for check DFC_ThrVlvShoCircB1" VALUE 0x80504734 Val_Wu8 1.00000000000 DFES_EnvTabVerb 0.00 1.00000000000 FORMAT "%13.11" /end CHARACTERISTIC
/begin CHARACTERISTIC DFES_EnvRef.DFC_ThrVlvSpiErrB1_C "used environment signals / Reference to used environment condition set for check DFC_ThrVlvSpiErrB1" VALUE 0x80504735 Val_Wu8 1.00000000000 DFES_EnvTabVerb 0.00 1.00000000000 FORMAT "%13.11" /end CHARACTERISTIC
/begin CHARACTERISTIC DFES_EnvRef.DFC_ThrvlvSens1MinB1_C "used environment signals / Reference to used environment condition set for check DFC_ThrvlvSens1MinB1" VALUE 0x80504736 Val_Wu8 1.00000000000 DFES_EnvTabVerb 0.00 1.00000000000 FORMAT "%13.11" /end CHARACTERISTIC
/begin CHARACTERISTIC DFES_EnvRef.DFC_TiOffTBasdChkFast_C "used environment signals / Reference to used environment condition set for check DFC_TiOffTBasdChkFast" VALUE 0x80504737 Val_Wu8 1.00000000000 DFES_EnvTabVerb 0.00 1.00000000000 FORMAT "%13.11" /end CHARACTERISTIC
/begin CHARACTERISTIC DFES_EnvRef.DFC_TiOffTBasdChkSlow_C "used environment signals / Reference to used environment condition set for check DFC_TiOffTBasdChkSlow" VALUE 0x80504738 Val_Wu8 1.00000000000 DFES_EnvTabVerb 0.00 1.00000000000 FORMAT "%13.11" /end CHARACTERISTIC
/begin CHARACTERISTIC DFES_EnvRef.DFC_UEGOSnsrMntdS1B1_C "used environment signals / Reference to used environment condition set for check DFC_UEGOSnsrMntdS1B1" VALUE 0x80504739 Val_Wu8 1.00000000000 DFES_EnvTabVerb 0.00 1.00000000000 FORMAT "%13.11" /end CHARACTERISTIC
/begin CHARACTERISTIC DFES_EnvRef.DFC_VehVSig_C "used environment signals / Reference to used environment condition set for check DFC_VehVSig" VALUE 0x8050473A Val_Wu8 1.00000000000 DFES_EnvTabVerb 0.00 1.00000000000 FORMAT "%13.11" /end CHARACTERISTIC
/begin CHARACTERISTIC DFES_EnvRef.DFC_VlvLftFbSwtIntk11SpclFail_C "used environment signals / Reference to used environment condition set for check DFC_VlvLftFbSwtIntk11SpclFail" VALUE 0x8050473B Val_Wu8 1.00000000000 DFES_EnvTabVerb 0.00 1.00000000000 FORMAT "%13.11" /end CHARACTERISTIC
/begin CHARACTERISTIC DFES_EnvRef.DFC_VlvLftFbSwtIntk11StdFail_C "used environment signals / Reference to used environment condition set for check DFC_VlvLftFbSwtIntk11StdFail" VALUE 0x8050473C Val_Wu8 1.00000000000 DFES_EnvTabVerb 0.00 1.00000000000 FORMAT "%13.11" /end CHARACTERISTIC
/begin CHARACTERISTIC DFES_FaultTyp.DFC_Unused_C "assigned fault type / " VALUE 0x8050473E Val_Wu8 255.0 DFES_OneToOne 0.00 255.0 FORMAT "%5.1" READ_ONLY /end CHARACTERISTIC
/begin CHARACTERISTIC DFES_FaultTyp.DFC_AAVEmax_C "assigned fault type / Fault type assignment for check DFC_AAVEmax" VALUE 0x8050473F Val_Wu8 255.0 DFES_OneToOne 0.00 255.0 FORMAT "%5.1" /end CHARACTERISTIC
/begin CHARACTERISTIC DFES_FaultTyp.DFC_AAVEmin_C "assigned fault type / Fault type assignment for check DFC_AAVEmin" VALUE 0x80504740 Val_Wu8 255.0 DFES_OneToOne 0.00 255.0 FORMAT "%5.1" /end CHARACTERISTIC
/begin CHARACTERISTIC DFES_FaultTyp.DFC_AAVEsig_C "assigned fault type / Fault type assignment for check DFC_AAVEsig" VALUE 0x80504741 Val_Wu8 255.0 DFES_OneToOne 0.00 255.0 FORMAT "%5.1" /end CHARACTERISTIC
/begin CHARACTERISTIC DFES_FaultTyp.DFC_AltIOACGFailr_C "assigned fault type / Fault type assignment for check DFC_AltIOACGFailr" VALUE 0x80504742 Val_Wu8 255.0 DFES_OneToOne 0.00 255.0 FORMAT "%5.1" /end CHARACTERISTIC
/begin CHARACTERISTIC DFES_FaultTyp.DFC_AltIOACGHiVltg_C "assigned fault type / Fault type assignment for check DFC_AltIOACGHiVltg" VALUE 0x80504743 Val_Wu8 255.0 DFES_OneToOne 0.00 255.0 FORMAT "%5.1" /end CHARACTERISTIC
/begin CHARACTERISTIC DFES_FaultTyp.DFC_AltIOACGLoVltg_C "assigned fault type / Fault type assignment for check DFC_AltIOACGLoVltg" VALUE 0x80504744 Val_Wu8 255.0 DFES_OneToOne 0.00 255.0 FORMAT "%5.1" /end CHARACTERISTIC
/begin CHARACTERISTIC DFES_FaultTyp.DFC_AltIOACGTHi_C "assigned fault type / Fault type assignment for check DFC_AltIOACGTHi" VALUE 0x80504745 Val_Wu8 255.0 DFES_OneToOne 0.00 255.0 FORMAT "%5.1" /end CHARACTERISTIC
/begin CHARACTERISTIC DFES_FaultTyp.DFC_AltIODConnACG_C "assigned fault type / Fault type assignment for check DFC_AltIODConnACG" VALUE 0x80504746 Val_Wu8 255.0 DFES_OneToOne 0.00 255.0 FORMAT "%5.1" /end CHARACTERISTIC
/begin CHARACTERISTIC DFES_FaultTyp.DFC_BGOELWAF_C "assigned fault type / Fault type assignment for check DFC_BGOELWAF" VALUE 0x80504747 Val_Wu8 255.0 DFES_OneToOne 0.00 255.0 FORMAT "%5.1" /end CHARACTERISTIC
/begin CHARACTERISTIC DFES_FaultTyp.DFC_BattUHiFailr_C "assigned fault type / Fault type assignment for check DFC_BattUHiFailr" VALUE 0x80504748 Val_Wu8 255.0 DFES_OneToOne 0.00 255.0 FORMAT "%5.1" /end CHARACTERISTIC
/begin CHARACTERISTIC DFES_FaultTyp.DFC_BattULoFailr_C "assigned fault type / Fault type assignment for check DFC_BattULoFailr" VALUE 0x80504749 Val_Wu8 255.0 DFES_OneToOne 0.00 255.0 FORMAT "%5.1" /end CHARACTERISTIC
/begin CHARACTERISTIC DFES_FaultTyp.DFC_BrkBstPDriftHiErr_C "assigned fault type / Fault type assignment for check DFC_BrkBstPDriftHiErr" VALUE 0x8050474A Val_Wu8 255.0 DFES_OneToOne 0.00 255.0 FORMAT "%5.1" /end CHARACTERISTIC
/begin CHARACTERISTIC DFES_FaultTyp.DFC_BrkBstPDriftLoErr_C "assigned fault type / Fault type assignment for check DFC_BrkBstPDriftLoErr" VALUE 0x8050474B Val_Wu8 255.0 DFES_OneToOne 0.00 255.0 FORMAT "%5.1" /end CHARACTERISTIC
/begin CHARACTERISTIC DFES_FaultTyp.DFC_BrkBstPSnsrStuck_C "assigned fault type / Fault type assignment for check DFC_BrkBstPSnsrStuck" VALUE 0x8050474C Val_Wu8 255.0 DFES_OneToOne 0.00 255.0 FORMAT "%5.1" /end CHARACTERISTIC
/begin CHARACTERISTIC DFES_FaultTyp.DFC_BrkMnSwtContOn_C "assigned fault type / Fault type assignment for check DFC_BrkMnSwtContOn" VALUE 0x8050474D Val_Wu8 255.0 DFES_OneToOne 0.00 255.0 FORMAT "%5.1" /end CHARACTERISTIC
/begin CHARACTERISTIC DFES_FaultTyp.DFC_BrkMnSwtNotStp_C "assigned fault type / Fault type assignment for check DFC_BrkMnSwtNotStp" VALUE 0x8050474E Val_Wu8 255.0 DFES_OneToOne 0.00 255.0 FORMAT "%5.1" /end CHARACTERISTIC
/begin CHARACTERISTIC DFES_FaultTyp.DFC_BrkNpl_C "assigned fault type / Fault type assignment for check DFC_BrkNpl" VALUE 0x8050474F Val_Wu8 255.0 DFES_OneToOne 0.00 255.0 FORMAT "%5.1" /end CHARACTERISTIC
/begin CHARACTERISTIC DFES_FaultTyp.DFC_BrkRdntSwtContOn_C "assigned fault type / Fault type assignment for check DFC_BrkRdntSwtContOn" VALUE 0x80504750 Val_Wu8 255.0 DFES_OneToOne 0.00 255.0 FORMAT "%5.1" /end CHARACTERISTIC
/begin CHARACTERISTIC DFES_FaultTyp.DFC_BrkRdntSwtNotStp_C "assigned fault type / Fault type assignment for check DFC_BrkRdntSwtNotStp" VALUE 0x80504751 Val_Wu8 255.0 DFES_OneToOne 0.00 255.0 FORMAT "%5.1" /end CHARACTERISTIC
/begin CHARACTERISTIC DFES_FaultTyp.DFC_Clth3ONStuck_C "assigned fault type / Fault type assignment for check DFC_Clth3ONStuck" VALUE 0x80504752 Val_Wu8 255.0 DFES_OneToOne 0.00 255.0 FORMAT "%5.1" /end CHARACTERISTIC
/begin CHARACTERISTIC DFES_FaultTyp.DFC_Clth4OFFStuck_C "assigned fault type / Fault type assignment for check DFC_Clth4OFFStuck" VALUE 0x80504753 Val_Wu8 255.0 DFES_OneToOne 0.00 255.0 FORMAT "%5.1" /end CHARACTERISTIC
/begin CHARACTERISTIC DFES_FaultTyp.DFC_ClthOFFStuck_C "assigned fault type / Fault type assignment for check DFC_ClthOFFStuck" VALUE 0x80504754 Val_Wu8 255.0 DFES_OneToOne 0.00 255.0 FORMAT "%5.1" /end CHARACTERISTIC
/begin CHARACTERISTIC DFES_FaultTyp.DFC_ClthONStuck_C "assigned fault type / Fault type assignment for check DFC_ClthONStuck" VALUE 0x80504755 Val_Wu8 255.0 DFES_OneToOne 0.00 255.0 FORMAT "%5.1" /end CHARACTERISTIC
/begin CHARACTERISTIC DFES_FaultTyp.DFC_ClthStkFailInfo_C "assigned fault type / Fault type assignment for check DFC_ClthStkFailInfo" VALUE 0x80504756 Val_Wu8 255.0 DFES_OneToOne 0.00 255.0 FORMAT "%5.1" /end CHARACTERISTIC
/begin CHARACTERISTIC DFES_FaultTyp.DFC_ComACFailInfo_C "assigned fault type / Fault type assignment for check DFC_ComACFailInfo" VALUE 0x80504757 Val_Wu8 255.0 DFES_OneToOne 0.00 255.0 FORMAT "%5.1" /end CHARACTERISTIC
/begin CHARACTERISTIC DFES_FaultTyp.DFC_ComATFTValErr_C "assigned fault type / Fault type assignment for check DFC_ComATFTValErr" VALUE 0x80504758 Val_Wu8 255.0 DFES_OneToOne 0.00 255.0 FORMAT "%5.1" /end CHARACTERISTIC
/begin CHARACTERISTIC DFES_FaultTyp.DFC_ComATMILReq_C "assigned fault type / Fault type assignment for check DFC_ComATMILReq" VALUE 0x80504759 Val_Wu8 255.0 DFES_OneToOne 0.00 255.0 FORMAT "%5.1" /end CHARACTERISTIC
/begin CHARACTERISTIC DFES_FaultTyp.DFC_ComAYCAChksum_C "assigned fault type / Fault type assignment for check DFC_ComAYCAChksum" VALUE 0x8050475A Val_Wu8 255.0 DFES_OneToOne 0.00 255.0 FORMAT "%5.1" /end CHARACTERISTIC
/begin CHARACTERISTIC DFES_FaultTyp.DFC_ComAYCARingCnt_C "assigned fault type / Fault type assignment for check DFC_ComAYCARingCnt" VALUE 0x8050475B Val_Wu8 255.0 DFES_OneToOne 0.00 255.0 FORMAT "%5.1" /end CHARACTERISTIC
/begin CHARACTERISTIC DFES_FaultTyp.DFC_ComAYCATOut_C "assigned fault type / Fault type assignment for check DFC_ComAYCATOut" VALUE 0x8050475C Val_Wu8 255.0 DFES_OneToOne 0.00 255.0 FORMAT "%5.1" /end CHARACTERISTIC
/begin CHARACTERISTIC DFES_FaultTyp.DFC_ComAYCDChkSum_C "assigned fault type / Fault type assignment for check DFC_ComAYCDChkSum" VALUE 0x8050475D Val_Wu8 255.0 DFES_OneToOne 0.00 255.0 FORMAT "%5.1" /end CHARACTERISTIC
/begin CHARACTERISTIC DFES_FaultTyp.DFC_ComAYCDTOut_C "assigned fault type / Fault type assignment for check DFC_ComAYCDTOut" VALUE 0x8050475E Val_Wu8 255.0 DFES_OneToOne 0.00 255.0 FORMAT "%5.1" /end CHARACTERISTIC
/begin CHARACTERISTIC DFES_FaultTyp.DFC_ComAYCFChksum_C "assigned fault type / Fault type assignment for check DFC_ComAYCFChksum" VALUE 0x8050475F Val_Wu8 255.0 DFES_OneToOne 0.00 255.0 FORMAT "%5.1" /end CHARACTERISTIC
/begin CHARACTERISTIC DFES_FaultTyp.DFC_ComAYCFRingCnt_C "assigned fault type / Fault type assignment for check DFC_ComAYCFRingCnt" VALUE 0x80504760 Val_Wu8 255.0 DFES_OneToOne 0.00 255.0 FORMAT "%5.1" /end CHARACTERISTIC
/begin CHARACTERISTIC DFES_FaultTyp.DFC_ComAYCFTOut_C "assigned fault type / Fault type assignment for check DFC_ComAYCFTOut" VALUE 0x80504761 Val_Wu8 255.0 DFES_OneToOne 0.00 255.0 FORMAT "%5.1" /end CHARACTERISTIC
/begin CHARACTERISTIC DFES_FaultTyp.DFC_ComAYCGChksum_C "assigned fault type / Fault type assignment for check DFC_ComAYCGChksum" VALUE 0x80504762 Val_Wu8 255.0 DFES_OneToOne 0.00 255.0 FORMAT "%5.1" /end CHARACTERISTIC
/begin CHARACTERISTIC DFES_FaultTyp.DFC_ComAYCGRingCnt_C "assigned fault type / Fault type assignment for check DFC_ComAYCGRingCnt" VALUE 0x80504763 Val_Wu8 255.0 DFES_OneToOne 0.00 255.0 FORMAT "%5.1" /end CHARACTERISTIC
/begin CHARACTERISTIC DFES_FaultTyp.DFC_ComAYCGTOut_C "assigned fault type / Fault type assignment for check DFC_ComAYCGTOut" VALUE 0x80504764 Val_Wu8 255.0 DFES_OneToOne 0.00 255.0 FORMAT "%5.1" /end CHARACTERISTIC
/begin CHARACTERISTIC DFES_FaultTyp.DFC_ComAYCIChkSum_C "assigned fault type / Fault type assignment for check DFC_ComAYCIChkSum" VALUE 0x80504765 Val_Wu8 255.0 DFES_OneToOne 0.00 255.0 FORMAT "%5.1" /end CHARACTERISTIC
/begin CHARACTERISTIC DFES_FaultTyp.DFC_ComAYCIRingCnt_C "assigned fault type / Fault type assignment for check DFC_ComAYCIRingCnt" VALUE 0x80504766 Val_Wu8 255.0 DFES_OneToOne 0.00 255.0 FORMAT "%5.1" /end CHARACTERISTIC
/begin CHARACTERISTIC DFES_FaultTyp.DFC_ComAYCITOut_C "assigned fault type / Fault type assignment for check DFC_ComAYCITOut" VALUE 0x80504767 Val_Wu8 255.0 DFES_OneToOne 0.00 255.0 FORMAT "%5.1" /end CHARACTERISTIC
/begin CHARACTERISTIC DFES_FaultTyp.DFC_ComBCM1ChkSum_C "assigned fault type / Fault type assignment for check DFC_ComBCM1ChkSum" VALUE 0x80504768 Val_Wu8 255.0 DFES_OneToOne 0.00 255.0 FORMAT "%5.1" /end CHARACTERISTIC
/begin CHARACTERISTIC DFES_FaultTyp.DFC_ComBCM1RingCnt_C "assigned fault type / Fault type assignment for check DFC_ComBCM1RingCnt" VALUE 0x80504769 Val_Wu8 255.0 DFES_OneToOne 0.00 255.0 FORMAT "%5.1" /end CHARACTERISTIC
/begin CHARACTERISTIC DFES_FaultTyp.DFC_ComBCM1TOut_C "assigned fault type / Fault type assignment for check DFC_ComBCM1TOut" VALUE 0x8050476A Val_Wu8 255.0 DFES_OneToOne 0.00 255.0 FORMAT "%5.1" /end CHARACTERISTIC
/begin CHARACTERISTIC DFES_FaultTyp.DFC_ComCANABusOffErr_C "assigned fault type / Fault type assignment for check DFC_ComCANABusOffErr" VALUE 0x8050476B Val_Wu8 255.0 DFES_OneToOne 0.00 255.0 FORMAT "%5.1" /end CHARACTERISTIC
/begin CHARACTERISTIC DFES_FaultTyp.DFC_ComCANBBusOffErr_C "assigned fault type / Fault type assignment for check DFC_ComCANBBusOffErr" VALUE 0x8050476C Val_Wu8 255.0 DFES_OneToOne 0.00 255.0 FORMAT "%5.1" /end CHARACTERISTIC
/begin CHARACTERISTIC DFES_FaultTyp.DFC_ComCANCBusOffErr_C "assigned fault type / Fault type assignment for check DFC_ComCANCBusOffErr" VALUE 0x8050476D Val_Wu8 255.0 DFES_OneToOne 0.00 255.0 FORMAT "%5.1" /end CHARACTERISTIC
/begin CHARACTERISTIC DFES_FaultTyp.DFC_ComCGW1ChkSum_C "assigned fault type / Fault type assignment for check DFC_ComCGW1ChkSum" VALUE 0x8050476E Val_Wu8 255.0 DFES_OneToOne 0.00 255.0 FORMAT "%5.1" /end CHARACTERISTIC
/begin CHARACTERISTIC DFES_FaultTyp.DFC_ComCGW1RingCnt_C "assigned fault type / Fault type assignment for check DFC_ComCGW1RingCnt" VALUE 0x8050476F Val_Wu8 255.0 DFES_OneToOne 0.00 255.0 FORMAT "%5.1" /end CHARACTERISTIC
/begin CHARACTERISTIC DFES_FaultTyp.DFC_ComCGW1TOut_C "assigned fault type / Fault type assignment for check DFC_ComCGW1TOut" VALUE 0x80504770 Val_Wu8 255.0 DFES_OneToOne 0.00 255.0 FORMAT "%5.1" /end CHARACTERISTIC
/begin CHARACTERISTIC DFES_FaultTyp.DFC_ComConvBoostErr_C "assigned fault type / Fault type assignment for check DFC_ComConvBoostErr" VALUE 0x80504771 Val_Wu8 255.0 DFES_OneToOne 0.00 255.0 FORMAT "%5.1" /end CHARACTERISTIC
/begin CHARACTERISTIC DFES_FaultTyp.DFC_ComConvSlipErr_C "assigned fault type / Fault type assignment for check DFC_ComConvSlipErr" VALUE 0x80504772 Val_Wu8 255.0 DFES_OneToOne 0.00 255.0 FORMAT "%5.1" /end CHARACTERISTIC
/begin CHARACTERISTIC DFES_FaultTyp.DFC_ComDCDCPrfmncErr_C "assigned fault type / Fault type assignment for check DFC_ComDCDCPrfmncErr" VALUE 0x80504773 Val_Wu8 255.0 DFES_OneToOne 0.00 255.0 FORMAT "%5.1" /end CHARACTERISTIC
/begin CHARACTERISTIC DFES_FaultTyp.DFC_ComDCDCTempWarn_C "assigned fault type / Fault type assignment for check DFC_ComDCDCTempWarn" VALUE 0x80504774 Val_Wu8 255.0 DFES_OneToOne 0.00 255.0 FORMAT "%5.1" /end CHARACTERISTIC
/begin CHARACTERISTIC DFES_FaultTyp.DFC_ComEAT10Chksum_C "assigned fault type / Fault type assignment for check DFC_ComEAT10Chksum" VALUE 0x80504775 Val_Wu8 255.0 DFES_OneToOne 0.00 255.0 FORMAT "%5.1" /end CHARACTERISTIC
/begin CHARACTERISTIC DFES_FaultTyp.DFC_ComEAT10RingCnt_C "assigned fault type / Fault type assignment for check DFC_ComEAT10RingCnt" VALUE 0x80504776 Val_Wu8 255.0 DFES_OneToOne 0.00 255.0 FORMAT "%5.1" /end CHARACTERISTIC
/begin CHARACTERISTIC DFES_FaultTyp.DFC_ComEAT10TOut_C "assigned fault type / Fault type assignment for check DFC_ComEAT10TOut" VALUE 0x80504777 Val_Wu8 255.0 DFES_OneToOne 0.00 255.0 FORMAT "%5.1" /end CHARACTERISTIC
/begin CHARACTERISTIC DFES_FaultTyp.DFC_ComEAT11ChkSum_C "assigned fault type / Fault type assignment for check DFC_ComEAT11ChkSum" VALUE 0x80504778 Val_Wu8 255.0 DFES_OneToOne 0.00 255.0 FORMAT "%5.1" /end CHARACTERISTIC
/begin CHARACTERISTIC DFES_FaultTyp.DFC_ComEAT11RingCnt_C "assigned fault type / Fault type assignment for check DFC_ComEAT11RingCnt" VALUE 0x80504779 Val_Wu8 255.0 DFES_OneToOne 0.00 255.0 FORMAT "%5.1" /end CHARACTERISTIC
/begin CHARACTERISTIC DFES_FaultTyp.DFC_ComEAT11TOut_C "assigned fault type / Fault type assignment for check DFC_ComEAT11TOut" VALUE 0x8050477A Val_Wu8 255.0 DFES_OneToOne 0.00 255.0 FORMAT "%5.1" /end CHARACTERISTIC
/begin CHARACTERISTIC DFES_FaultTyp.DFC_ComEAT12ChkSum_C "assigned fault type / Fault type assignment for check DFC_ComEAT12ChkSum" VALUE 0x8050477B Val_Wu8 255.0 DFES_OneToOne 0.00 255.0 FORMAT "%5.1" /end CHARACTERISTIC
/begin CHARACTERISTIC DFES_FaultTyp.DFC_ComEAT12RingCnt_C "assigned fault type / Fault type assignment for check DFC_ComEAT12RingCnt" VALUE 0x8050477C Val_Wu8 255.0 DFES_OneToOne 0.00 255.0 FORMAT "%5.1" /end CHARACTERISTIC
/begin CHARACTERISTIC DFES_FaultTyp.DFC_ComEAT12TOut_C "assigned fault type / Fault type assignment for check DFC_ComEAT12TOut" VALUE 0x8050477D Val_Wu8 255.0 DFES_OneToOne 0.00 255.0 FORMAT "%5.1" /end CHARACTERISTIC
/begin CHARACTERISTIC DFES_FaultTyp.DFC_ComEAT13ChkSum_C "assigned fault type / Fault type assignment for check DFC_ComEAT13ChkSum" VALUE 0x8050477E Val_Wu8 255.0 DFES_OneToOne 0.00 255.0 FORMAT "%5.1" /end CHARACTERISTIC
/begin CHARACTERISTIC DFES_FaultTyp.DFC_ComEAT13RingCnt_C "assigned fault type / Fault type assignment for check DFC_ComEAT13RingCnt" VALUE 0x8050477F Val_Wu8 255.0 DFES_OneToOne 0.00 255.0 FORMAT "%5.1" /end CHARACTERISTIC
/begin CHARACTERISTIC DFES_FaultTyp.DFC_ComEAT13TOut_C "assigned fault type / Fault type assignment for check DFC_ComEAT13TOut" VALUE 0x80504780 Val_Wu8 255.0 DFES_OneToOne 0.00 255.0 FORMAT "%5.1" /end CHARACTERISTIC
/begin CHARACTERISTIC DFES_FaultTyp.DFC_ComEAT1Chksum_C "assigned fault type / Fault type assignment for check DFC_ComEAT1Chksum" VALUE 0x80504781 Val_Wu8 255.0 DFES_OneToOne 0.00 255.0 FORMAT "%5.1" /end CHARACTERISTIC
/begin CHARACTERISTIC DFES_FaultTyp.DFC_ComEAT1RingCnt_C "assigned fault type / Fault type assignment for check DFC_ComEAT1RingCnt" VALUE 0x80504782 Val_Wu8 255.0 DFES_OneToOne 0.00 255.0 FORMAT "%5.1" /end CHARACTERISTIC
/begin CHARACTERISTIC DFES_FaultTyp.DFC_ComEAT1TOut_C "assigned fault type / Fault type assignment for check DFC_ComEAT1TOut" VALUE 0x80504783 Val_Wu8 255.0 DFES_OneToOne 0.00 255.0 FORMAT "%5.1" /end CHARACTERISTIC
/begin CHARACTERISTIC DFES_FaultTyp.DFC_ComEAT2ChkSum_C "assigned fault type / Fault type assignment for check DFC_ComEAT2ChkSum" VALUE 0x80504784 Val_Wu8 255.0 DFES_OneToOne 0.00 255.0 FORMAT "%5.1" /end CHARACTERISTIC
/begin CHARACTERISTIC DFES_FaultTyp.DFC_ComEAT2RingCnt_C "assigned fault type / Fault type assignment for check DFC_ComEAT2RingCnt" VALUE 0x80504785 Val_Wu8 255.0 DFES_OneToOne 0.00 255.0 FORMAT "%5.1" /end CHARACTERISTIC
/begin CHARACTERISTIC DFES_FaultTyp.DFC_ComEAT2TOut_C "assigned fault type / Fault type assignment for check DFC_ComEAT2TOut" VALUE 0x80504786 Val_Wu8 255.0 DFES_OneToOne 0.00 255.0 FORMAT "%5.1" /end CHARACTERISTIC
/begin CHARACTERISTIC DFES_FaultTyp.DFC_ComEAT4ChkSum_C "assigned fault type / Fault type assignment for check DFC_ComEAT4ChkSum" VALUE 0x80504787 Val_Wu8 255.0 DFES_OneToOne 0.00 255.0 FORMAT "%5.1" /end CHARACTERISTIC
/begin CHARACTERISTIC DFES_FaultTyp.DFC_ComEAT4RingCnt_C "assigned fault type / Fault type assignment for check DFC_ComEAT4RingCnt" VALUE 0x80504788 Val_Wu8 255.0 DFES_OneToOne 0.00 255.0 FORMAT "%5.1" /end CHARACTERISTIC
/begin CHARACTERISTIC DFES_FaultTyp.DFC_ComEAT4TOut_C "assigned fault type / Fault type assignment for check DFC_ComEAT4TOut" VALUE 0x80504789 Val_Wu8 255.0 DFES_OneToOne 0.00 255.0 FORMAT "%5.1" /end CHARACTERISTIC
/begin CHARACTERISTIC DFES_FaultTyp.DFC_ComEAT6Chksum_C "assigned fault type / Fault type assignment for check DFC_ComEAT6Chksum" VALUE 0x8050478A Val_Wu8 255.0 DFES_OneToOne 0.00 255.0 FORMAT "%5.1" /end CHARACTERISTIC
/begin CHARACTERISTIC DFES_FaultTyp.DFC_ComEAT6RingCnt_C "assigned fault type / Fault type assignment for check DFC_ComEAT6RingCnt" VALUE 0x8050478B Val_Wu8 255.0 DFES_OneToOne 0.00 255.0 FORMAT "%5.1" /end CHARACTERISTIC
/begin CHARACTERISTIC DFES_FaultTyp.DFC_ComEAT6TOut_C "assigned fault type / Fault type assignment for check DFC_ComEAT6TOut" VALUE 0x8050478C Val_Wu8 255.0 DFES_OneToOne 0.00 255.0 FORMAT "%5.1" /end CHARACTERISTIC
/begin CHARACTERISTIC DFES_FaultTyp.DFC_ComEAT7Chksum_C "assigned fault type / Fault type assignment for check DFC_ComEAT7Chksum" VALUE 0x8050478D Val_Wu8 255.0 DFES_OneToOne 0.00 255.0 FORMAT "%5.1" /end CHARACTERISTIC
/begin CHARACTERISTIC DFES_FaultTyp.DFC_ComEAT7RingCnt_C "assigned fault type / Fault type assignment for check DFC_ComEAT7RingCnt" VALUE 0x8050478E Val_Wu8 255.0 DFES_OneToOne 0.00 255.0 FORMAT "%5.1" /end CHARACTERISTIC
/begin CHARACTERISTIC DFES_FaultTyp.DFC_ComEAT7TOut_C "assigned fault type / Fault type assignment for check DFC_ComEAT7TOut" VALUE 0x8050478F Val_Wu8 255.0 DFES_OneToOne 0.00 255.0 FORMAT "%5.1" /end CHARACTERISTIC
/begin CHARACTERISTIC DFES_FaultTyp.DFC_ComEAT8Chksum_C "assigned fault type / Fault type assignment for check DFC_ComEAT8Chksum" VALUE 0x80504790 Val_Wu8 255.0 DFES_OneToOne 0.00 255.0 FORMAT "%5.1" /end CHARACTERISTIC
/begin CHARACTERISTIC DFES_FaultTyp.DFC_ComEAT8RingCnt_C "assigned fault type / Fault type assignment for check DFC_ComEAT8RingCnt" VALUE 0x80504791 Val_Wu8 255.0 DFES_OneToOne 0.00 255.0 FORMAT "%5.1" /end CHARACTERISTIC
/begin CHARACTERISTIC DFES_FaultTyp.DFC_ComEAT8TOut_C "assigned fault type / Fault type assignment for check DFC_ComEAT8TOut" VALUE 0x80504792 Val_Wu8 255.0 DFES_OneToOne 0.00 255.0 FORMAT "%5.1" /end CHARACTERISTIC
/begin CHARACTERISTIC DFES_FaultTyp.DFC_ComEATAChksum_C "assigned fault type / Fault type assignment for check DFC_ComEATAChksum" VALUE 0x80504793 Val_Wu8 255.0 DFES_OneToOne 0.00 255.0 FORMAT "%5.1" /end CHARACTERISTIC
/begin CHARACTERISTIC DFES_FaultTyp.DFC_ComEATARingCnt_C "assigned fault type / Fault type assignment for check DFC_ComEATARingCnt" VALUE 0x80504794 Val_Wu8 255.0 DFES_OneToOne 0.00 255.0 FORMAT "%5.1" /end CHARACTERISTIC
/begin CHARACTERISTIC DFES_FaultTyp.DFC_ComEATATOut_C "assigned fault type / Fault type assignment for check DFC_ComEATATOut" VALUE 0x80504795 Val_Wu8 255.0 DFES_OneToOne 0.00 255.0 FORMAT "%5.1" /end CHARACTERISTIC
/begin CHARACTERISTIC DFES_FaultTyp.DFC_ComEATBChkSum_C "assigned fault type / Fault type assignment for check DFC_ComEATBChkSum" VALUE 0x80504796 Val_Wu8 255.0 DFES_OneToOne 0.00 255.0 FORMAT "%5.1" /end CHARACTERISTIC
/begin CHARACTERISTIC DFES_FaultTyp.DFC_ComEATBRingCnt_C "assigned fault type / Fault type assignment for check DFC_ComEATBRingCnt" VALUE 0x80504797 Val_Wu8 255.0 DFES_OneToOne 0.00 255.0 FORMAT "%5.1" /end CHARACTERISTIC
/begin CHARACTERISTIC DFES_FaultTyp.DFC_ComEATBTOut_C "assigned fault type / Fault type assignment for check DFC_ComEATBTOut" VALUE 0x80504798 Val_Wu8 255.0 DFES_OneToOne 0.00 255.0 FORMAT "%5.1" /end CHARACTERISTIC
/begin CHARACTERISTIC DFES_FaultTyp.DFC_ComEATCChksum_C "assigned fault type / Fault type assignment for check DFC_ComEATCChksum" VALUE 0x80504799 Val_Wu8 255.0 DFES_OneToOne 0.00 255.0 FORMAT "%5.1" /end CHARACTERISTIC
/begin CHARACTERISTIC DFES_FaultTyp.DFC_ComEATCRingCnt_C "assigned fault type / Fault type assignment for check DFC_ComEATCRingCnt" VALUE 0x8050479A Val_Wu8 255.0 DFES_OneToOne 0.00 255.0 FORMAT "%5.1" /end CHARACTERISTIC
/begin CHARACTERISTIC DFES_FaultTyp.DFC_ComEATCTOut_C "assigned fault type / Fault type assignment for check DFC_ComEATCTOut" VALUE 0x8050479B Val_Wu8 255.0 DFES_OneToOne 0.00 255.0 FORMAT "%5.1" /end CHARACTERISTIC
/begin CHARACTERISTIC DFES_FaultTyp.DFC_ComEPBBChkSum_C "assigned fault type / Fault type assignment for check DFC_ComEPBBChkSum" VALUE 0x8050479C Val_Wu8 255.0 DFES_OneToOne 0.00 255.0 FORMAT "%5.1" /end CHARACTERISTIC
/begin CHARACTERISTIC DFES_FaultTyp.DFC_ComEPBBRingCnt_C "assigned fault type / Fault type assignment for check DFC_ComEPBBRingCnt" VALUE 0x8050479D Val_Wu8 255.0 DFES_OneToOne 0.00 255.0 FORMAT "%5.1" /end CHARACTERISTIC
/begin CHARACTERISTIC DFES_FaultTyp.DFC_ComEPBBTOut_C "assigned fault type / Fault type assignment for check DFC_ComEPBBTOut" VALUE 0x8050479E Val_Wu8 255.0 DFES_OneToOne 0.00 255.0 FORMAT "%5.1" /end CHARACTERISTIC
/begin CHARACTERISTIC DFES_FaultTyp.DFC_ComEPBChksum_C "assigned fault type / Fault type assignment for check DFC_ComEPBChksum" VALUE 0x8050479F Val_Wu8 255.0 DFES_OneToOne 0.00 255.0 FORMAT "%5.1" /end CHARACTERISTIC
/begin CHARACTERISTIC DFES_FaultTyp.DFC_ComEPBTOut_C "assigned fault type / Fault type assignment for check DFC_ComEPBTOut" VALUE 0x805047A0 Val_Wu8 255.0 DFES_OneToOne 0.00 255.0 FORMAT "%5.1" /end CHARACTERISTIC
/begin CHARACTERISTIC DFES_FaultTyp.DFC_ComEPBctRing_C "assigned fault type / Fault type assignment for check DFC_ComEPBctRing" VALUE 0x805047A1 Val_Wu8 255.0 DFES_OneToOne 0.00 255.0 FORMAT "%5.1" /end CHARACTERISTIC
/begin CHARACTERISTIC DFES_FaultTyp.DFC_ComEPS1Chksum_C "assigned fault type / Fault type assignment for check DFC_ComEPS1Chksum" VALUE 0x805047A2 Val_Wu8 255.0 DFES_OneToOne 0.00 255.0 FORMAT "%5.1" /end CHARACTERISTIC
/begin CHARACTERISTIC DFES_FaultTyp.DFC_ComEPS1RingCnt_C "assigned fault type / Fault type assignment for check DFC_ComEPS1RingCnt" VALUE 0x805047A3 Val_Wu8 255.0 DFES_OneToOne 0.00 255.0 FORMAT "%5.1" /end CHARACTERISTIC
/begin CHARACTERISTIC DFES_FaultTyp.DFC_ComEPS1TOut_C "assigned fault type / Fault type assignment for check DFC_ComEPS1TOut" VALUE 0x805047A4 Val_Wu8 255.0 DFES_OneToOne 0.00 255.0 FORMAT "%5.1" /end CHARACTERISTIC
/begin CHARACTERISTIC DFES_FaultTyp.DFC_ComEngCanRxErr_C "assigned fault type / Fault type assignment for check DFC_ComEngCanRxErr" VALUE 0x805047A5 Val_Wu8 255.0 DFES_OneToOne 0.00 255.0 FORMAT "%5.1" /end CHARACTERISTIC
/begin CHARACTERISTIC DFES_FaultTyp.DFC_ComGrvySnsrErr_C "assigned fault type / Fault type assignment for check DFC_ComGrvySnsrErr" VALUE 0x805047A6 Val_Wu8 255.0 DFES_OneToOne 0.00 255.0 FORMAT "%5.1" /end CHARACTERISTIC
/begin CHARACTERISTIC DFES_FaultTyp.DFC_ComGwIMG1ChkSum_C "assigned fault type / Fault type assignment for check DFC_ComGwIMG1ChkSum" VALUE 0x805047A7 Val_Wu8 255.0 DFES_OneToOne 0.00 255.0 FORMAT "%5.1" /end CHARACTERISTIC
/begin CHARACTERISTIC DFES_FaultTyp.DFC_ComGwIMG1RingCnt_C "assigned fault type / Fault type assignment for check DFC_ComGwIMG1RingCnt" VALUE 0x805047A8 Val_Wu8 255.0 DFES_OneToOne 0.00 255.0 FORMAT "%5.1" /end CHARACTERISTIC
/begin CHARACTERISTIC DFES_FaultTyp.DFC_ComGwIMG1TOut_C "assigned fault type / Fault type assignment for check DFC_ComGwIMG1TOut" VALUE 0x805047A9 Val_Wu8 255.0 DFES_OneToOne 0.00 255.0 FORMAT "%5.1" /end CHARACTERISTIC
/begin CHARACTERISTIC DFES_FaultTyp.DFC_ComGwIMG3ChkSum_C "assigned fault type / Fault type assignment for check DFC_ComGwIMG3ChkSum" VALUE 0x805047AA Val_Wu8 255.0 DFES_OneToOne 0.00 255.0 FORMAT "%5.1" /end CHARACTERISTIC
/begin CHARACTERISTIC DFES_FaultTyp.DFC_ComGwIMG3RingCnt_C "assigned fault type / Fault type assignment for check DFC_ComGwIMG3RingCnt" VALUE 0x805047AB Val_Wu8 255.0 DFES_OneToOne 0.00 255.0 FORMAT "%5.1" /end CHARACTERISTIC
/begin CHARACTERISTIC DFES_FaultTyp.DFC_ComGwIMG3TOut_C "assigned fault type / Fault type assignment for check DFC_ComGwIMG3TOut" VALUE 0x805047AC Val_Wu8 255.0 DFES_OneToOne 0.00 255.0 FORMAT "%5.1" /end CHARACTERISTIC
/begin CHARACTERISTIC DFES_FaultTyp.DFC_ComGwIMG4ChkSum_C "assigned fault type / Fault type assignment for check DFC_ComGwIMG4ChkSum" VALUE 0x805047AD Val_Wu8 255.0 DFES_OneToOne 0.00 255.0 FORMAT "%5.1" /end CHARACTERISTIC
/begin CHARACTERISTIC DFES_FaultTyp.DFC_ComGwIMG4RingCnt_C "assigned fault type / Fault type assignment for check DFC_ComGwIMG4RingCnt" VALUE 0x805047AE Val_Wu8 255.0 DFES_OneToOne 0.00 255.0 FORMAT "%5.1" /end CHARACTERISTIC
/begin CHARACTERISTIC DFES_FaultTyp.DFC_ComGwIMG4TOut_C "assigned fault type / Fault type assignment for check DFC_ComGwIMG4TOut" VALUE 0x805047AF Val_Wu8 255.0 DFES_OneToOne 0.00 255.0 FORMAT "%5.1" /end CHARACTERISTIC
/begin CHARACTERISTIC DFES_FaultTyp.DFC_ComGwIMG5ChkSum_C "assigned fault type / Fault type assignment for check DFC_ComGwIMG5ChkSum" VALUE 0x805047B0 Val_Wu8 255.0 DFES_OneToOne 0.00 255.0 FORMAT "%5.1" /end CHARACTERISTIC
/begin CHARACTERISTIC DFES_FaultTyp.DFC_ComGwIMG5RingCnt_C "assigned fault type / Fault type assignment for check DFC_ComGwIMG5RingCnt" VALUE 0x805047B1 Val_Wu8 255.0 DFES_OneToOne 0.00 255.0 FORMAT "%5.1" /end CHARACTERISTIC
/begin CHARACTERISTIC DFES_FaultTyp.DFC_ComGwIMG5TOut_C "assigned fault type / Fault type assignment for check DFC_ComGwIMG5TOut" VALUE 0x805047B2 Val_Wu8 255.0 DFES_OneToOne 0.00 255.0 FORMAT "%5.1" /end CHARACTERISTIC
/begin CHARACTERISTIC DFES_FaultTyp.DFC_ComGwIMG6ChkSum_C "assigned fault type / Fault type assignment for check DFC_ComGwIMG6ChkSum" VALUE 0x805047B3 Val_Wu8 255.0 DFES_OneToOne 0.00 255.0 FORMAT "%5.1" /end CHARACTERISTIC
/begin CHARACTERISTIC DFES_FaultTyp.DFC_ComGwIMG6RingCnt_C "assigned fault type / Fault type assignment for check DFC_ComGwIMG6RingCnt" VALUE 0x805047B4 Val_Wu8 255.0 DFES_OneToOne 0.00 255.0 FORMAT "%5.1" /end CHARACTERISTIC
/begin CHARACTERISTIC DFES_FaultTyp.DFC_ComGwIMG6TOut_C "assigned fault type / Fault type assignment for check DFC_ComGwIMG6TOut" VALUE 0x805047B5 Val_Wu8 255.0 DFES_OneToOne 0.00 255.0 FORMAT "%5.1" /end CHARACTERISTIC
/begin CHARACTERISTIC DFES_FaultTyp.DFC_ComIDASBChksum_C "assigned fault type / Fault type assignment for check DFC_ComIDASBChksum" VALUE 0x805047B6 Val_Wu8 255.0 DFES_OneToOne 0.00 255.0 FORMAT "%5.1" /end CHARACTERISTIC
/begin CHARACTERISTIC DFES_FaultTyp.DFC_ComIDASBRingCnt_C "assigned fault type / Fault type assignment for check DFC_ComIDASBRingCnt" VALUE 0x805047B7 Val_Wu8 255.0 DFES_OneToOne 0.00 255.0 FORMAT "%5.1" /end CHARACTERISTIC
/begin CHARACTERISTIC DFES_FaultTyp.DFC_ComIDASBTOut_C "assigned fault type / Fault type assignment for check DFC_ComIDASBTOut" VALUE 0x805047B8 Val_Wu8 255.0 DFES_OneToOne 0.00 255.0 FORMAT "%5.1" /end CHARACTERISTIC
/begin CHARACTERISTIC DFES_FaultTyp.DFC_ComIMGMILReq_C "assigned fault type / Fault type assignment for check DFC_ComIMGMILReq" VALUE 0x805047B9 Val_Wu8 255.0 DFES_OneToOne 0.00 255.0 FORMAT "%5.1" /end CHARACTERISTIC
/begin CHARACTERISTIC DFES_FaultTyp.DFC_ComISSPrms_C "assigned fault type / Fault type assignment for check DFC_ComISSPrms" VALUE 0x805047BA Val_Wu8 255.0 DFES_OneToOne 0.00 255.0 FORMAT "%5.1" /end CHARACTERISTIC
/begin CHARACTERISTIC DFES_FaultTyp.DFC_ComMETAChksum_C "assigned fault type / Fault type assignment for check DFC_ComMETAChksum" VALUE 0x805047BB Val_Wu8 255.0 DFES_OneToOne 0.00 255.0 FORMAT "%5.1" /end CHARACTERISTIC
/begin CHARACTERISTIC DFES_FaultTyp.DFC_ComMETAChksumPstDrv_C "assigned fault type / Fault type assignment for check DFC_ComMETAChksumPstDrv" VALUE 0x805047BC Val_Wu8 255.0 DFES_OneToOne 0.00 255.0 FORMAT "%5.1" /end CHARACTERISTIC
/begin CHARACTERISTIC DFES_FaultTyp.DFC_ComMETARingCnt_C "assigned fault type / Fault type assignment for check DFC_ComMETARingCnt" VALUE 0x805047BD Val_Wu8 255.0 DFES_OneToOne 0.00 255.0 FORMAT "%5.1" /end CHARACTERISTIC
/begin CHARACTERISTIC DFES_FaultTyp.DFC_ComMETARingCntPstDrv_C "assigned fault type / Fault type assignment for check DFC_ComMETARingCntPstDrv" VALUE 0x805047BE Val_Wu8 255.0 DFES_OneToOne 0.00 255.0 FORMAT "%5.1" /end CHARACTERISTIC
/begin CHARACTERISTIC DFES_FaultTyp.DFC_ComMETATOut_C "assigned fault type / Fault type assignment for check DFC_ComMETATOut" VALUE 0x805047BF Val_Wu8 255.0 DFES_OneToOne 0.00 255.0 FORMAT "%5.1" /end CHARACTERISTIC
/begin CHARACTERISTIC DFES_FaultTyp.DFC_ComMETATOutPstDrv_C "assigned fault type / Fault type assignment for check DFC_ComMETATOutPstDrv" VALUE 0x805047C0 Val_Wu8 255.0 DFES_OneToOne 0.00 255.0 FORMAT "%5.1" /end CHARACTERISTIC
/begin CHARACTERISTIC DFES_FaultTyp.DFC_ComMETCChksum_C "assigned fault type / Fault type assignment for check DFC_ComMETCChksum" VALUE 0x805047C1 Val_Wu8 255.0 DFES_OneToOne 0.00 255.0 FORMAT "%5.1" /end CHARACTERISTIC
/begin CHARACTERISTIC DFES_FaultTyp.DFC_ComMETCRingCnt_C "assigned fault type / Fault type assignment for check DFC_ComMETCRingCnt" VALUE 0x805047C2 Val_Wu8 255.0 DFES_OneToOne 0.00 255.0 FORMAT "%5.1" /end CHARACTERISTIC
/begin CHARACTERISTIC DFES_FaultTyp.DFC_ComMETCTOut_C "assigned fault type / Fault type assignment for check DFC_ComMETCTOut" VALUE 0x805047C3 Val_Wu8 255.0 DFES_OneToOne 0.00 255.0 FORMAT "%5.1" /end CHARACTERISTIC
/begin CHARACTERISTIC DFES_FaultTyp.DFC_ComMETDChksum_C "assigned fault type / Fault type assignment for check DFC_ComMETDChksum" VALUE 0x805047C4 Val_Wu8 255.0 DFES_OneToOne 0.00 255.0 FORMAT "%5.1" /end CHARACTERISTIC
/begin CHARACTERISTIC DFES_FaultTyp.DFC_ComMETDRingCnt_C "assigned fault type / Fault type assignment for check DFC_ComMETDRingCnt" VALUE 0x805047C5 Val_Wu8 255.0 DFES_OneToOne 0.00 255.0 FORMAT "%5.1" /end CHARACTERISTIC
/begin CHARACTERISTIC DFES_FaultTyp.DFC_ComMETDTOut_C "assigned fault type / Fault type assignment for check DFC_ComMETDTOut" VALUE 0x805047C6 Val_Wu8 255.0 DFES_OneToOne 0.00 255.0 FORMAT "%5.1" /end CHARACTERISTIC
/begin CHARACTERISTIC DFES_FaultTyp.DFC_ComMETE2Chksum_C "assigned fault type / Fault type assignment for check DFC_ComMETE2Chksum" VALUE 0x805047C7 Val_Wu8 255.0 DFES_OneToOne 0.00 255.0 FORMAT "%5.1" /end CHARACTERISTIC
/begin CHARACTERISTIC DFES_FaultTyp.DFC_ComMETE2RingCnt_C "assigned fault type / Fault type assignment for check DFC_ComMETE2RingCnt" VALUE 0x805047C8 Val_Wu8 255.0 DFES_OneToOne 0.00 255.0 FORMAT "%5.1" /end CHARACTERISTIC
/begin CHARACTERISTIC DFES_FaultTyp.DFC_ComMETE2TOut_C "assigned fault type / Fault type assignment for check DFC_ComMETE2TOut" VALUE 0x805047C9 Val_Wu8 255.0 DFES_OneToOne 0.00 255.0 FORMAT "%5.1" /end CHARACTERISTIC
/begin CHARACTERISTIC DFES_FaultTyp.DFC_ComMETFChksum_C "assigned fault type / Fault type assignment for check DFC_ComMETFChksum" VALUE 0x805047CA Val_Wu8 255.0 DFES_OneToOne 0.00 255.0 FORMAT "%5.1" /end CHARACTERISTIC
/begin CHARACTERISTIC DFES_FaultTyp.DFC_ComMETFRingCnt_C "assigned fault type / Fault type assignment for check DFC_ComMETFRingCnt" VALUE 0x805047CB Val_Wu8 255.0 DFES_OneToOne 0.00 255.0 FORMAT "%5.1" /end CHARACTERISTIC
/begin CHARACTERISTIC DFES_FaultTyp.DFC_ComMETFTOut_C "assigned fault type / Fault type assignment for check DFC_ComMETFTOut" VALUE 0x805047CC Val_Wu8 255.0 DFES_OneToOne 0.00 255.0 FORMAT "%5.1" /end CHARACTERISTIC
/begin CHARACTERISTIC DFES_FaultTyp.DFC_ComMETGChksum_C "assigned fault type / Fault type assignment for check DFC_ComMETGChksum" VALUE 0x805047CD Val_Wu8 255.0 DFES_OneToOne 0.00 255.0 FORMAT "%5.1" /end CHARACTERISTIC
/begin CHARACTERISTIC DFES_FaultTyp.DFC_ComMETGRingCnt_C "assigned fault type / Fault type assignment for check DFC_ComMETGRingCnt" VALUE 0x805047CE Val_Wu8 255.0 DFES_OneToOne 0.00 255.0 FORMAT "%5.1" /end CHARACTERISTIC
/begin CHARACTERISTIC DFES_FaultTyp.DFC_ComMETGTOut_C "assigned fault type / Fault type assignment for check DFC_ComMETGTOut" VALUE 0x805047CF Val_Wu8 255.0 DFES_OneToOne 0.00 255.0 FORMAT "%5.1" /end CHARACTERISTIC
/begin CHARACTERISTIC DFES_FaultTyp.DFC_ComMETH2Chksum_C "assigned fault type / Fault type assignment for check DFC_ComMETH2Chksum" VALUE 0x805047D0 Val_Wu8 255.0 DFES_OneToOne 0.00 255.0 FORMAT "%5.1" /end CHARACTERISTIC
/begin CHARACTERISTIC DFES_FaultTyp.DFC_ComMETH2RingCnt_C "assigned fault type / Fault type assignment for check DFC_ComMETH2RingCnt" VALUE 0x805047D1 Val_Wu8 255.0 DFES_OneToOne 0.00 255.0 FORMAT "%5.1" /end CHARACTERISTIC
/begin CHARACTERISTIC DFES_FaultTyp.DFC_ComMETH2TOut_C "assigned fault type / Fault type assignment for check DFC_ComMETH2TOut" VALUE 0x805047D2 Val_Wu8 255.0 DFES_OneToOne 0.00 255.0 FORMAT "%5.1" /end CHARACTERISTIC
/begin CHARACTERISTIC DFES_FaultTyp.DFC_ComMETHChksum_C "assigned fault type / Fault type assignment for check DFC_ComMETHChksum" VALUE 0x805047D3 Val_Wu8 255.0 DFES_OneToOne 0.00 255.0 FORMAT "%5.1" /end CHARACTERISTIC
/begin CHARACTERISTIC DFES_FaultTyp.DFC_ComMETHRingCnt_C "assigned fault type / Fault type assignment for check DFC_ComMETHRingCnt" VALUE 0x805047D4 Val_Wu8 255.0 DFES_OneToOne 0.00 255.0 FORMAT "%5.1" /end CHARACTERISTIC
/begin CHARACTERISTIC DFES_FaultTyp.DFC_ComMETHTOut_C "assigned fault type / Fault type assignment for check DFC_ComMETHTOut" VALUE 0x805047D5 Val_Wu8 255.0 DFES_OneToOne 0.00 255.0 FORMAT "%5.1" /end CHARACTERISTIC
/begin CHARACTERISTIC DFES_FaultTyp.DFC_ComMETIChksum_C "assigned fault type / Fault type assignment for check DFC_ComMETIChksum" VALUE 0x805047D6 Val_Wu8 255.0 DFES_OneToOne 0.00 255.0 FORMAT "%5.1" /end CHARACTERISTIC
/begin CHARACTERISTIC DFES_FaultTyp.DFC_ComMETIRingCnt_C "assigned fault type / Fault type assignment for check DFC_ComMETIRingCnt" VALUE 0x805047D7 Val_Wu8 255.0 DFES_OneToOne 0.00 255.0 FORMAT "%5.1" /end CHARACTERISTIC
/begin CHARACTERISTIC DFES_FaultTyp.DFC_ComMETITOut_C "assigned fault type / Fault type assignment for check DFC_ComMETITOut" VALUE 0x805047D8 Val_Wu8 255.0 DFES_OneToOne 0.00 255.0 FORMAT "%5.1" /end CHARACTERISTIC
/begin CHARACTERISTIC DFES_FaultTyp.DFC_ComMETKChksum_C "assigned fault type / Fault type assignment for check DFC_ComMETKChksum" VALUE 0x805047D9 Val_Wu8 255.0 DFES_OneToOne 0.00 255.0 FORMAT "%5.1" /end CHARACTERISTIC
/begin CHARACTERISTIC DFES_FaultTyp.DFC_ComMETKRingCnt_C "assigned fault type / Fault type assignment for check DFC_ComMETKRingCnt" VALUE 0x805047DA Val_Wu8 255.0 DFES_OneToOne 0.00 255.0 FORMAT "%5.1" /end CHARACTERISTIC
/begin CHARACTERISTIC DFES_FaultTyp.DFC_ComMETKTOut_C "assigned fault type / Fault type assignment for check DFC_ComMETKTOut" VALUE 0x805047DB Val_Wu8 255.0 DFES_OneToOne 0.00 255.0 FORMAT "%5.1" /end CHARACTERISTIC
/begin CHARACTERISTIC DFES_FaultTyp.DFC_ComMETLChksum_C "assigned fault type / Fault type assignment for check DFC_ComMETLChksum" VALUE 0x805047DC Val_Wu8 255.0 DFES_OneToOne 0.00 255.0 FORMAT "%5.1" /end CHARACTERISTIC
/begin CHARACTERISTIC DFES_FaultTyp.DFC_ComMETLRingCnt_C "assigned fault type / Fault type assignment for check DFC_ComMETLRingCnt" VALUE 0x805047DD Val_Wu8 255.0 DFES_OneToOne 0.00 255.0 FORMAT "%5.1" /end CHARACTERISTIC
/begin CHARACTERISTIC DFES_FaultTyp.DFC_ComMETLTOut_C "assigned fault type / Fault type assignment for check DFC_ComMETLTOut" VALUE 0x805047DE Val_Wu8 255.0 DFES_OneToOne 0.00 255.0 FORMAT "%5.1" /end CHARACTERISTIC
/begin CHARACTERISTIC DFES_FaultTyp.DFC_ComMETMChksum_C "assigned fault type / Fault type assignment for check DFC_ComMETMChksum" VALUE 0x805047DF Val_Wu8 255.0 DFES_OneToOne 0.00 255.0 FORMAT "%5.1" /end CHARACTERISTIC
/begin CHARACTERISTIC DFES_FaultTyp.DFC_ComMETMRingCnt_C "assigned fault type / Fault type assignment for check DFC_ComMETMRingCnt" VALUE 0x805047E0 Val_Wu8 255.0 DFES_OneToOne 0.00 255.0 FORMAT "%5.1" /end CHARACTERISTIC
/begin CHARACTERISTIC DFES_FaultTyp.DFC_ComMETMTOut_C "assigned fault type / Fault type assignment for check DFC_ComMETMTOut" VALUE 0x805047E1 Val_Wu8 255.0 DFES_OneToOne 0.00 255.0 FORMAT "%5.1" /end CHARACTERISTIC
/begin CHARACTERISTIC DFES_FaultTyp.DFC_ComMETNChksum_C "assigned fault type / Fault type assignment for check DFC_ComMETNChksum" VALUE 0x805047E2 Val_Wu8 255.0 DFES_OneToOne 0.00 255.0 FORMAT "%5.1" /end CHARACTERISTIC
/begin CHARACTERISTIC DFES_FaultTyp.DFC_ComMETNRingCnt_C "assigned fault type / Fault type assignment for check DFC_ComMETNRingCnt" VALUE 0x805047E3 Val_Wu8 255.0 DFES_OneToOne 0.00 255.0 FORMAT "%5.1" /end CHARACTERISTIC
/begin CHARACTERISTIC DFES_FaultTyp.DFC_ComMETNTOut_C "assigned fault type / Fault type assignment for check DFC_ComMETNTOut" VALUE 0x805047E4 Val_Wu8 255.0 DFES_OneToOne 0.00 255.0 FORMAT "%5.1" /end CHARACTERISTIC
/begin CHARACTERISTIC DFES_FaultTyp.DFC_ComMtrCom_C "assigned fault type / Fault type assignment for check DFC_ComMtrCom" VALUE 0x805047E5 Val_Wu8 255.0 DFES_OneToOne 0.00 255.0 FORMAT "%5.1" /end CHARACTERISTIC
/begin CHARACTERISTIC DFES_FaultTyp.DFC_ComPCUChkSum_C "assigned fault type / Fault type assignment for check DFC_ComPCUChkSum" VALUE 0x805047E6 Val_Wu8 255.0 DFES_OneToOne 0.00 255.0 FORMAT "%5.1" /end CHARACTERISTIC
/begin CHARACTERISTIC DFES_FaultTyp.DFC_ComPCURingCnt_C "assigned fault type / Fault type assignment for check DFC_ComPCURingCnt" VALUE 0x805047E7 Val_Wu8 255.0 DFES_OneToOne 0.00 255.0 FORMAT "%5.1" /end CHARACTERISTIC
/begin CHARACTERISTIC DFES_FaultTyp.DFC_ComPCUTOut_C "assigned fault type / Fault type assignment for check DFC_ComPCUTOut" VALUE 0x805047E8 Val_Wu8 255.0 DFES_OneToOne 0.00 255.0 FORMAT "%5.1" /end CHARACTERISTIC
/begin CHARACTERISTIC DFES_FaultTyp.DFC_ComSRSAChksum_C "assigned fault type / Fault type assignment for check DFC_ComSRSAChksum" VALUE 0x805047E9 Val_Wu8 255.0 DFES_OneToOne 0.00 255.0 FORMAT "%5.1" /end CHARACTERISTIC
/begin CHARACTERISTIC DFES_FaultTyp.DFC_ComSRSARingCnt_C "assigned fault type / Fault type assignment for check DFC_ComSRSARingCnt" VALUE 0x805047EA Val_Wu8 255.0 DFES_OneToOne 0.00 255.0 FORMAT "%5.1" /end CHARACTERISTIC
/begin CHARACTERISTIC DFES_FaultTyp.DFC_ComSRSATOut_C "assigned fault type / Fault type assignment for check DFC_ComSRSATOut" VALUE 0x805047EB Val_Wu8 255.0 DFES_OneToOne 0.00 255.0 FORMAT "%5.1" /end CHARACTERISTIC
/begin CHARACTERISTIC DFES_FaultTyp.DFC_ComSRSBChksum_C "assigned fault type / Fault type assignment for check DFC_ComSRSBChksum" VALUE 0x805047EC Val_Wu8 255.0 DFES_OneToOne 0.00 255.0 FORMAT "%5.1" /end CHARACTERISTIC
/begin CHARACTERISTIC DFES_FaultTyp.DFC_ComSRSBRingCnt_C "assigned fault type / Fault type assignment for check DFC_ComSRSBRingCnt" VALUE 0x805047ED Val_Wu8 255.0 DFES_OneToOne 0.00 255.0 FORMAT "%5.1" /end CHARACTERISTIC
/begin CHARACTERISTIC DFES_FaultTyp.DFC_ComSRSBTOut_C "assigned fault type / Fault type assignment for check DFC_ComSRSBTOut" VALUE 0x805047EE Val_Wu8 255.0 DFES_OneToOne 0.00 255.0 FORMAT "%5.1" /end CHARACTERISTIC
/begin CHARACTERISTIC DFES_FaultTyp.DFC_ComSRSChksum_C "assigned fault type / Fault type assignment for check DFC_ComSRSChksum" VALUE 0x805047EF Val_Wu8 255.0 DFES_OneToOne 0.00 255.0 FORMAT "%5.1" /end CHARACTERISTIC
/begin CHARACTERISTIC DFES_FaultTyp.DFC_ComSRSErr_C "assigned fault type / Fault type assignment for check DFC_ComSRSErr" VALUE 0x805047F0 Val_Wu8 255.0 DFES_OneToOne 0.00 255.0 FORMAT "%5.1" /end CHARACTERISTIC
/begin CHARACTERISTIC DFES_FaultTyp.DFC_ComSRSRingCnt_C "assigned fault type / Fault type assignment for check DFC_ComSRSRingCnt" VALUE 0x805047F1 Val_Wu8 255.0 DFES_OneToOne 0.00 255.0 FORMAT "%5.1" /end CHARACTERISTIC
/begin CHARACTERISTIC DFES_FaultTyp.DFC_ComSRSTOut_C "assigned fault type / Fault type assignment for check DFC_ComSRSTOut" VALUE 0x805047F2 Val_Wu8 255.0 DFES_OneToOne 0.00 255.0 FORMAT "%5.1" /end CHARACTERISTIC
/begin CHARACTERISTIC DFES_FaultTyp.DFC_ComVehSpdPndFltTCU_C "assigned fault type / Fault type assignment for check DFC_ComVehSpdPndFltTCU" VALUE 0x805047F3 Val_Wu8 255.0 DFES_OneToOne 0.00 255.0 FORMAT "%5.1" /end CHARACTERISTIC
/begin CHARACTERISTIC DFES_FaultTyp.DFC_EbsChartcCurrErr_C "assigned fault type / Fault type assignment for check DFC_EbsChartcCurrErr" VALUE 0x805047F4 Val_Wu8 255.0 DFES_OneToOne 0.00 255.0 FORMAT "%5.1" /end CHARACTERISTIC
/begin CHARACTERISTIC DFES_FaultTyp.DFC_EbsSelfDiagErr_C "assigned fault type / Fault type assignment for check DFC_EbsSelfDiagErr" VALUE 0x805047F5 Val_Wu8 255.0 DFES_OneToOne 0.00 255.0 FORMAT "%5.1" /end CHARACTERISTIC
/begin CHARACTERISTIC DFES_FaultTyp.DFC_GEVlvPhaCsersIntkB1_C "assigned fault type / Fault type assignment for check DFC_GEVlvPhaCsersIntkB1" VALUE 0x805047F6 Val_Wu8 255.0 DFES_OneToOne 0.00 255.0 FORMAT "%5.1" /end CHARACTERISTIC
/begin CHARACTERISTIC DFES_FaultTyp.DFC_GEVlvPhaPsOpenLoadIntkB1_C "assigned fault type / Fault type assignment for check DFC_GEVlvPhaPsOpenLoadIntkB1" VALUE 0x805047F7 Val_Wu8 255.0 DFES_OneToOne 0.00 255.0 FORMAT "%5.1" /end CHARACTERISTIC
/begin CHARACTERISTIC DFES_FaultTyp.DFC_GEVlvPhaPsShoToBattIntkB1_C "assigned fault type / Fault type assignment for check DFC_GEVlvPhaPsShoToBattIntkB1" VALUE 0x805047F8 Val_Wu8 255.0 DFES_OneToOne 0.00 255.0 FORMAT "%5.1" /end CHARACTERISTIC
/begin CHARACTERISTIC DFES_FaultTyp.DFC_GEVlvPhaPsShoToGndIntkB1_C "assigned fault type / Fault type assignment for check DFC_GEVlvPhaPsShoToGndIntkB1" VALUE 0x805047F9 Val_Wu8 255.0 DFES_OneToOne 0.00 255.0 FORMAT "%5.1" /end CHARACTERISTIC
/begin CHARACTERISTIC DFES_FaultTyp.DFC_GbxCANDigPlausErr_C "assigned fault type / Fault type assignment for check DFC_GbxCANDigPlausErr" VALUE 0x805047FA Val_Wu8 255.0 DFES_OneToOne 0.00 255.0 FORMAT "%5.1" /end CHARACTERISTIC
/begin CHARACTERISTIC DFES_FaultTyp.DFC_GbxNPos1SRCMax_C "assigned fault type / Fault type assignment for check DFC_GbxNPos1SRCMax" VALUE 0x805047FB Val_Wu8 255.0 DFES_OneToOne 0.00 255.0 FORMAT "%5.1" /end CHARACTERISTIC
/begin CHARACTERISTIC DFES_FaultTyp.DFC_GbxNPos1SRCMin_C "assigned fault type / Fault type assignment for check DFC_GbxNPos1SRCMin" VALUE 0x805047FC Val_Wu8 255.0 DFES_OneToOne 0.00 255.0 FORMAT "%5.1" /end CHARACTERISTIC
/begin CHARACTERISTIC DFES_FaultTyp.DFC_GbxNPos2SRCMax_C "assigned fault type / Fault type assignment for check DFC_GbxNPos2SRCMax" VALUE 0x805047FD Val_Wu8 255.0 DFES_OneToOne 0.00 255.0 FORMAT "%5.1" /end CHARACTERISTIC
/begin CHARACTERISTIC DFES_FaultTyp.DFC_GbxNPos2SRCMin_C "assigned fault type / Fault type assignment for check DFC_GbxNPos2SRCMin" VALUE 0x805047FE Val_Wu8 255.0 DFES_OneToOne 0.00 255.0 FORMAT "%5.1" /end CHARACTERISTIC
/begin CHARACTERISTIC DFES_FaultTyp.DFC_GbxNPosAlvChk_C "assigned fault type / Fault type assignment for check DFC_GbxNPosAlvChk" VALUE 0x805047FF Val_Wu8 255.0 DFES_OneToOne 0.00 255.0 FORMAT "%5.1" /end CHARACTERISTIC
/begin CHARACTERISTIC DFES_FaultTyp.DFC_GbxNPosSyncErr_C "assigned fault type / Fault type assignment for check DFC_GbxNPosSyncErr" VALUE 0x80504800 Val_Wu8 255.0 DFES_OneToOne 0.00 255.0 FORMAT "%5.1" /end CHARACTERISTIC
/begin CHARACTERISTIC DFES_FaultTyp.DFC_HEGOS2B1HtrPsMax_C "assigned fault type / Fault type assignment for check DFC_HEGOS2B1HtrPsMax" VALUE 0x80504801 Val_Wu8 255.0 DFES_OneToOne 0.00 255.0 FORMAT "%5.1" /end CHARACTERISTIC
/begin CHARACTERISTIC DFES_FaultTyp.DFC_HEGOS2B1HtrPsMin_C "assigned fault type / Fault type assignment for check DFC_HEGOS2B1HtrPsMin" VALUE 0x80504802 Val_Wu8 255.0 DFES_OneToOne 0.00 255.0 FORMAT "%5.1" /end CHARACTERISTIC
/begin CHARACTERISTIC DFES_FaultTyp.DFC_HEGOS2B1HtrPsSig_C "assigned fault type / Fault type assignment for check DFC_HEGOS2B1HtrPsSig" VALUE 0x80504803 Val_Wu8 255.0 DFES_OneToOne 0.00 255.0 FORMAT "%5.1" /end CHARACTERISTIC
/begin CHARACTERISTIC DFES_FaultTyp.DFC_LinCSErrACG_C "assigned fault type / Fault type assignment for check DFC_LinCSErrACG" VALUE 0x80504804 Val_Wu8 255.0 DFES_OneToOne 0.00 255.0 FORMAT "%5.1" /end CHARACTERISTIC
/begin CHARACTERISTIC DFES_FaultTyp.DFC_LinCSErrAEV_C "assigned fault type / Fault type assignment for check DFC_LinCSErrAEV" VALUE 0x80504805 Val_Wu8 255.0 DFES_OneToOne 0.00 255.0 FORMAT "%5.1" /end CHARACTERISTIC
/begin CHARACTERISTIC DFES_FaultTyp.DFC_LinCSErrDCDC_C "assigned fault type / Fault type assignment for check DFC_LinCSErrDCDC" VALUE 0x80504806 Val_Wu8 255.0 DFES_OneToOne 0.00 255.0 FORMAT "%5.1" /end CHARACTERISTIC
/begin CHARACTERISTIC DFES_FaultTyp.DFC_LinCSErrEBS_C "assigned fault type / Fault type assignment for check DFC_LinCSErrEBS" VALUE 0x80504807 Val_Wu8 255.0 DFES_OneToOne 0.00 255.0 FORMAT "%5.1" /end CHARACTERISTIC
/begin CHARACTERISTIC DFES_FaultTyp.DFC_LinHdrTimeoutErrACG_C "assigned fault type / Fault type assignment for check DFC_LinHdrTimeoutErrACG" VALUE 0x80504808 Val_Wu8 255.0 DFES_OneToOne 0.00 255.0 FORMAT "%5.1" /end CHARACTERISTIC
/begin CHARACTERISTIC DFES_FaultTyp.DFC_LinHdrTimeoutErrAEV_C "assigned fault type / Fault type assignment for check DFC_LinHdrTimeoutErrAEV" VALUE 0x80504809 Val_Wu8 255.0 DFES_OneToOne 0.00 255.0 FORMAT "%5.1" /end CHARACTERISTIC
/begin CHARACTERISTIC DFES_FaultTyp.DFC_LinHdrTimeoutErrDCDC_C "assigned fault type / Fault type assignment for check DFC_LinHdrTimeoutErrDCDC" VALUE 0x8050480A Val_Wu8 255.0 DFES_OneToOne 0.00 255.0 FORMAT "%5.1" /end CHARACTERISTIC
/begin CHARACTERISTIC DFES_FaultTyp.DFC_LinHdrTimeoutErrEBS_C "assigned fault type / Fault type assignment for check DFC_LinHdrTimeoutErrEBS" VALUE 0x8050480B Val_Wu8 255.0 DFES_OneToOne 0.00 255.0 FORMAT "%5.1" /end CHARACTERISTIC
/begin CHARACTERISTIC DFES_FaultTyp.DFC_LinMsgTimeoutErrACG_C "assigned fault type / Fault type assignment for check DFC_LinMsgTimeoutErrACG" VALUE 0x8050480C Val_Wu8 255.0 DFES_OneToOne 0.00 255.0 FORMAT "%5.1" /end CHARACTERISTIC
/begin CHARACTERISTIC DFES_FaultTyp.DFC_LinMsgTimeoutErrAEV_C "assigned fault type / Fault type assignment for check DFC_LinMsgTimeoutErrAEV" VALUE 0x8050480D Val_Wu8 255.0 DFES_OneToOne 0.00 255.0 FORMAT "%5.1" /end CHARACTERISTIC
/begin CHARACTERISTIC DFES_FaultTyp.DFC_LinMsgTimeoutErrDCDC_C "assigned fault type / Fault type assignment for check DFC_LinMsgTimeoutErrDCDC" VALUE 0x8050480E Val_Wu8 255.0 DFES_OneToOne 0.00 255.0 FORMAT "%5.1" /end CHARACTERISTIC
/begin CHARACTERISTIC DFES_FaultTyp.DFC_LinMsgTimeoutErrEBS_C "assigned fault type / Fault type assignment for check DFC_LinMsgTimeoutErrEBS" VALUE 0x8050480F Val_Wu8 255.0 DFES_OneToOne 0.00 255.0 FORMAT "%5.1" /end CHARACTERISTIC
/begin CHARACTERISTIC DFES_FaultTyp.DFC_LinNoStrtComErr_C "assigned fault type / Fault type assignment for check DFC_LinNoStrtComErr" VALUE 0x80504810 Val_Wu8 255.0 DFES_OneToOne 0.00 255.0 FORMAT "%5.1" /end CHARACTERISTIC
/begin CHARACTERISTIC DFES_FaultTyp.DFC_LowPresOilP_C "assigned fault type / Fault type assignment for check DFC_LowPresOilP" VALUE 0x80504811 Val_Wu8 255.0 DFES_OneToOne 0.00 255.0 FORMAT "%5.1" /end CHARACTERISTIC
/begin CHARACTERISTIC DFES_FaultTyp.DFC_MisfDetVWhlFrntLeOORHi_C "assigned fault type / Fault type assignment for check DFC_MisfDetVWhlFrntLeOORHi" VALUE 0x80504812 Val_Wu8 255.0 DFES_OneToOne 0.00 255.0 FORMAT "%5.1" /end CHARACTERISTIC
/begin CHARACTERISTIC DFES_FaultTyp.DFC_MisfDetVWhlFrntLeRatyHi_C "assigned fault type / Fault type assignment for check DFC_MisfDetVWhlFrntLeRatyHi" VALUE 0x80504813 Val_Wu8 255.0 DFES_OneToOne 0.00 255.0 FORMAT "%5.1" /end CHARACTERISTIC
/begin CHARACTERISTIC DFES_FaultTyp.DFC_MisfDetVWhlFrntLeRatyLo_C "assigned fault type / Fault type assignment for check DFC_MisfDetVWhlFrntLeRatyLo" VALUE 0x80504814 Val_Wu8 255.0 DFES_OneToOne 0.00 255.0 FORMAT "%5.1" /end CHARACTERISTIC
/begin CHARACTERISTIC DFES_FaultTyp.DFC_MisfDetVWhlFrntLeStuck_C "assigned fault type / Fault type assignment for check DFC_MisfDetVWhlFrntLeStuck" VALUE 0x80504815 Val_Wu8 255.0 DFES_OneToOne 0.00 255.0 FORMAT "%5.1" /end CHARACTERISTIC
/begin CHARACTERISTIC DFES_FaultTyp.DFC_MisfDetVWhlFrntRiOORHi_C "assigned fault type / Fault type assignment for check DFC_MisfDetVWhlFrntRiOORHi" VALUE 0x80504816 Val_Wu8 255.0 DFES_OneToOne 0.00 255.0 FORMAT "%5.1" /end CHARACTERISTIC
/begin CHARACTERISTIC DFES_FaultTyp.DFC_MisfDetVWhlFrntRiRatyHi_C "assigned fault type / Fault type assignment for check DFC_MisfDetVWhlFrntRiRatyHi" VALUE 0x80504817 Val_Wu8 255.0 DFES_OneToOne 0.00 255.0 FORMAT "%5.1" /end CHARACTERISTIC
/begin CHARACTERISTIC DFES_FaultTyp.DFC_MisfDetVWhlFrntRiRatyLo_C "assigned fault type / Fault type assignment for check DFC_MisfDetVWhlFrntRiRatyLo" VALUE 0x80504818 Val_Wu8 255.0 DFES_OneToOne 0.00 255.0 FORMAT "%5.1" /end CHARACTERISTIC
/begin CHARACTERISTIC DFES_FaultTyp.DFC_MisfDetVWhlFrntRiStuck_C "assigned fault type / Fault type assignment for check DFC_MisfDetVWhlFrntRiStuck" VALUE 0x80504819 Val_Wu8 255.0 DFES_OneToOne 0.00 255.0 FORMAT "%5.1" /end CHARACTERISTIC
/begin CHARACTERISTIC DFES_FaultTyp.DFC_MisfDetVWhlReLeOORHi_C "assigned fault type / Fault type assignment for check DFC_MisfDetVWhlReLeOORHi" VALUE 0x8050481A Val_Wu8 255.0 DFES_OneToOne 0.00 255.0 FORMAT "%5.1" /end CHARACTERISTIC
/begin CHARACTERISTIC DFES_FaultTyp.DFC_MisfDetVWhlReLeRatyHi_C "assigned fault type / Fault type assignment for check DFC_MisfDetVWhlReLeRatyHi" VALUE 0x8050481B Val_Wu8 255.0 DFES_OneToOne 0.00 255.0 FORMAT "%5.1" /end CHARACTERISTIC
/begin CHARACTERISTIC DFES_FaultTyp.DFC_MisfDetVWhlReLeRatyLo_C "assigned fault type / Fault type assignment for check DFC_MisfDetVWhlReLeRatyLo" VALUE 0x8050481C Val_Wu8 255.0 DFES_OneToOne 0.00 255.0 FORMAT "%5.1" /end CHARACTERISTIC
/begin CHARACTERISTIC DFES_FaultTyp.DFC_MisfDetVWhlReLeStuck_C "assigned fault type / Fault type assignment for check DFC_MisfDetVWhlReLeStuck" VALUE 0x8050481D Val_Wu8 255.0 DFES_OneToOne 0.00 255.0 FORMAT "%5.1" /end CHARACTERISTIC
/begin CHARACTERISTIC DFES_FaultTyp.DFC_MisfDetVWhlReRiOORHi_C "assigned fault type / Fault type assignment for check DFC_MisfDetVWhlReRiOORHi" VALUE 0x8050481E Val_Wu8 255.0 DFES_OneToOne 0.00 255.0 FORMAT "%5.1" /end CHARACTERISTIC
/begin CHARACTERISTIC DFES_FaultTyp.DFC_MisfDetVWhlReRiRatyHi_C "assigned fault type / Fault type assignment for check DFC_MisfDetVWhlReRiRatyHi" VALUE 0x8050481F Val_Wu8 255.0 DFES_OneToOne 0.00 255.0 FORMAT "%5.1" /end CHARACTERISTIC
/begin CHARACTERISTIC DFES_FaultTyp.DFC_MisfDetVWhlReRiRatyLo_C "assigned fault type / Fault type assignment for check DFC_MisfDetVWhlReRiRatyLo" VALUE 0x80504820 Val_Wu8 255.0 DFES_OneToOne 0.00 255.0 FORMAT "%5.1" /end CHARACTERISTIC
/begin CHARACTERISTIC DFES_FaultTyp.DFC_MisfDetVWhlReRiStuck_C "assigned fault type / Fault type assignment for check DFC_MisfDetVWhlReRiStuck" VALUE 0x80504821 Val_Wu8 255.0 DFES_OneToOne 0.00 255.0 FORMAT "%5.1" /end CHARACTERISTIC
/begin CHARACTERISTIC DFES_FaultTyp.DFC_MisfDetdVWhlFrntLePlaus_C "assigned fault type / Fault type assignment for check DFC_MisfDetdVWhlFrntLePlaus" VALUE 0x80504822 Val_Wu8 255.0 DFES_OneToOne 0.00 255.0 FORMAT "%5.1" /end CHARACTERISTIC
/begin CHARACTERISTIC DFES_FaultTyp.DFC_MisfDetdVWhlFrntRiPlaus_C "assigned fault type / Fault type assignment for check DFC_MisfDetdVWhlFrntRiPlaus" VALUE 0x80504823 Val_Wu8 255.0 DFES_OneToOne 0.00 255.0 FORMAT "%5.1" /end CHARACTERISTIC
/begin CHARACTERISTIC DFES_FaultTyp.DFC_MisfDetdVWhlReLePlaus_C "assigned fault type / Fault type assignment for check DFC_MisfDetdVWhlReLePlaus" VALUE 0x80504824 Val_Wu8 255.0 DFES_OneToOne 0.00 255.0 FORMAT "%5.1" /end CHARACTERISTIC
/begin CHARACTERISTIC DFES_FaultTyp.DFC_MisfDetdVWhlReRiPlaus_C "assigned fault type / Fault type assignment for check DFC_MisfDetdVWhlReRiPlaus" VALUE 0x80504825 Val_Wu8 255.0 DFES_OneToOne 0.00 255.0 FORMAT "%5.1" /end CHARACTERISTIC
/begin CHARACTERISTIC DFES_FaultTyp.DFC_PEnvSigRngMax_C "assigned fault type / Fault type assignment for check DFC_PEnvSigRngMax" VALUE 0x80504826 Val_Wu8 255.0 DFES_OneToOne 0.00 255.0 FORMAT "%5.1" /end CHARACTERISTIC
/begin CHARACTERISTIC DFES_FaultTyp.DFC_PEnvSigRngMin_C "assigned fault type / Fault type assignment for check DFC_PEnvSigRngMin" VALUE 0x80504827 Val_Wu8 255.0 DFES_OneToOne 0.00 255.0 FORMAT "%5.1" /end CHARACTERISTIC
/begin CHARACTERISTIC DFES_FaultTyp.DFC_StmFault_C "assigned fault type / Fault type assignment for check DFC_StmFault" VALUE 0x80504828 Val_Wu8 255.0 DFES_OneToOne 0.00 255.0 FORMAT "%5.1" /end CHARACTERISTIC
/begin CHARACTERISTIC DFES_FaultTyp.DFC_StrtCtOffPth_C "assigned fault type / Fault type assignment for check DFC_StrtCtOffPth" VALUE 0x80504829 Val_Wu8 255.0 DFES_OneToOne 0.00 255.0 FORMAT "%5.1" /end CHARACTERISTIC
/begin CHARACTERISTIC DFES_FaultTyp.DFC_StrtCtlErr_C "assigned fault type / Fault type assignment for check DFC_StrtCtlErr" VALUE 0x8050482A Val_Wu8 255.0 DFES_OneToOne 0.00 255.0 FORMAT "%5.1" /end CHARACTERISTIC
/begin CHARACTERISTIC DFES_FaultTyp.DFC_StrtFault_C "assigned fault type / Fault type assignment for check DFC_StrtFault" VALUE 0x8050482B Val_Wu8 255.0 DFES_OneToOne 0.00 255.0 FORMAT "%5.1" /end CHARACTERISTIC
/begin CHARACTERISTIC DFES_FaultTyp.DFC_StrtLckJudg1_C "assigned fault type / Fault type assignment for check DFC_StrtLckJudg1" VALUE 0x8050482C Val_Wu8 255.0 DFES_OneToOne 0.00 255.0 FORMAT "%5.1" /end CHARACTERISTIC
/begin CHARACTERISTIC DFES_FaultTyp.DFC_StrtLckJudg2_C "assigned fault type / Fault type assignment for check DFC_StrtLckJudg2" VALUE 0x8050482D Val_Wu8 255.0 DFES_OneToOne 0.00 255.0 FORMAT "%5.1" /end CHARACTERISTIC
/begin CHARACTERISTIC DFES_FaultTyp.DFC_StrtOL_C "assigned fault type / Fault type assignment for check DFC_StrtOL" VALUE 0x8050482E Val_Wu8 255.0 DFES_OneToOne 0.00 255.0 FORMAT "%5.1" /end CHARACTERISTIC
/begin CHARACTERISTIC DFES_FaultTyp.DFC_StrtOL2_C "assigned fault type / Fault type assignment for check DFC_StrtOL2" VALUE 0x8050482F Val_Wu8 255.0 DFES_OneToOne 0.00 255.0 FORMAT "%5.1" /end CHARACTERISTIC
/begin CHARACTERISTIC DFES_FaultTyp.DFC_StrtSCB_C "assigned fault type / Fault type assignment for check DFC_StrtSCB" VALUE 0x80504830 Val_Wu8 255.0 DFES_OneToOne 0.00 255.0 FORMAT "%5.1" /end CHARACTERISTIC
/begin CHARACTERISTIC DFES_FaultTyp.DFC_StrtSCB2_C "assigned fault type / Fault type assignment for check DFC_StrtSCB2" VALUE 0x80504831 Val_Wu8 255.0 DFES_OneToOne 0.00 255.0 FORMAT "%5.1" /end CHARACTERISTIC
/begin CHARACTERISTIC DFES_FaultTyp.DFC_StrtSCG_C "assigned fault type / Fault type assignment for check DFC_StrtSCG" VALUE 0x80504832 Val_Wu8 255.0 DFES_OneToOne 0.00 255.0 FORMAT "%5.1" /end CHARACTERISTIC
/begin CHARACTERISTIC DFES_FaultTyp.DFC_StrtSCG2_C "assigned fault type / Fault type assignment for check DFC_StrtSCG2" VALUE 0x80504833 Val_Wu8 255.0 DFES_OneToOne 0.00 255.0 FORMAT "%5.1" /end CHARACTERISTIC
/begin CHARACTERISTIC DFES_FaultTyp.DFC_StrtStkRly1_C "assigned fault type / Fault type assignment for check DFC_StrtStkRly1" VALUE 0x80504834 Val_Wu8 255.0 DFES_OneToOne 0.00 255.0 FORMAT "%5.1" /end CHARACTERISTIC
/begin CHARACTERISTIC DFES_FaultTyp.DFC_StrtStkRly2_C "assigned fault type / Fault type assignment for check DFC_StrtStkRly2" VALUE 0x80504835 Val_Wu8 255.0 DFES_OneToOne 0.00 255.0 FORMAT "%5.1" /end CHARACTERISTIC
/begin CHARACTERISTIC DFES_FaultTyp.DFC_TEVEmax_C "assigned fault type / Fault type assignment for check DFC_TEVEmax" VALUE 0x80504836 Val_Wu8 255.0 DFES_OneToOne 0.00 255.0 FORMAT "%5.1" /end CHARACTERISTIC
/begin CHARACTERISTIC DFES_FaultTyp.DFC_TEVEmin_C "assigned fault type / Fault type assignment for check DFC_TEVEmin" VALUE 0x80504837 Val_Wu8 255.0 DFES_OneToOne 0.00 255.0 FORMAT "%5.1" /end CHARACTERISTIC
/begin CHARACTERISTIC DFES_FaultTyp.DFC_TEVEsig_C "assigned fault type / Fault type assignment for check DFC_TEVEsig" VALUE 0x80504838 Val_Wu8 255.0 DFES_OneToOne 0.00 255.0 FORMAT "%5.1" /end CHARACTERISTIC
/begin CHARACTERISTIC DFES_FaultTyp.DFC_UegoHeatrPrfmncLoS1B1_C "assigned fault type / Fault type assignment for check DFC_UegoHeatrPrfmncLoS1B1" VALUE 0x80504839 Val_Wu8 255.0 DFES_OneToOne 0.00 255.0 FORMAT "%5.1" /end CHARACTERISTIC
/begin CHARACTERISTIC DFES_FaultTyp.DFC_VehVAllPlaus_C "assigned fault type / Fault type assignment for check DFC_VehVAllPlaus" VALUE 0x8050483A Val_Wu8 255.0 DFES_OneToOne 0.00 255.0 FORMAT "%5.1" /end CHARACTERISTIC
/begin CHARACTERISTIC DFES_FaultTyp.DFC_VehVNCSnsrElecFailr_C "assigned fault type / Fault type assignment for check DFC_VehVNCSnsrElecFailr" VALUE 0x8050483B Val_Wu8 255.0 DFES_OneToOne 0.00 255.0 FORMAT "%5.1" /end CHARACTERISTIC
/begin CHARACTERISTIC DFES_FaultTyp.DFC_VehVPlausCan_C "assigned fault type / Fault type assignment for check DFC_VehVPlausCan" VALUE 0x8050483C Val_Wu8 255.0 DFES_OneToOne 0.00 255.0 FORMAT "%5.1" /end CHARACTERISTIC
/begin CHARACTERISTIC DFES_FaultTyp.DFC_VehVPlausFco_C "assigned fault type / Fault type assignment for check DFC_VehVPlausFco" VALUE 0x8050483D Val_Wu8 255.0 DFES_OneToOne 0.00 255.0 FORMAT "%5.1" /end CHARACTERISTIC
/begin CHARACTERISTIC DFES_FaultTyp.DFC_VehVPlausPwr_C "assigned fault type / Fault type assignment for check DFC_VehVPlausPwr" VALUE 0x8050483E Val_Wu8 255.0 DFES_OneToOne 0.00 255.0 FORMAT "%5.1" /end CHARACTERISTIC
/begin CHARACTERISTIC DFES_FaultTyp.DFC_VehVPlausV2N_C "assigned fault type / Fault type assignment for check DFC_VehVPlausV2N" VALUE 0x8050483F Val_Wu8 255.0 DFES_OneToOne 0.00 255.0 FORMAT "%5.1" /end CHARACTERISTIC
/begin CHARACTERISTIC DFES_FaultTyp.DFC_VehVSpdSnsrAElecFailr_C "assigned fault type / Fault type assignment for check DFC_VehVSpdSnsrAElecFailr" VALUE 0x80504840 Val_Wu8 255.0 DFES_OneToOne 0.00 255.0 FORMAT "%5.1" /end CHARACTERISTIC
/begin CHARACTERISTIC DFES_FaultTyp.DFC_VehVSpdSnsrBElecFailr_C "assigned fault type / Fault type assignment for check DFC_VehVSpdSnsrBElecFailr" VALUE 0x80504841 Val_Wu8 255.0 DFES_OneToOne 0.00 255.0 FORMAT "%5.1" /end CHARACTERISTIC
/begin CHARACTERISTIC DFES_FaultTyp.DFC_ClthMax_C "assigned fault type / Fault type assignment for check DFC_ClthMax" VALUE 0x80504842 Val_Wu8 255.0 DFES_OneToOne 0.00 255.0 FORMAT "%5.1" /end CHARACTERISTIC
/begin CHARACTERISTIC DFES_FaultTyp.DFC_IgnClPs_DevComErr_C "assigned fault type / Fault type assignment for check DFC_IgnClPs_DevComErr" VALUE 0x80504843 Val_Wu8 255.0 DFES_OneToOne 0.00 255.0 FORMAT "%5.1" /end CHARACTERISTIC
/begin CHARACTERISTIC DFES_FaultTyp.DFC_IgnClPs_LineOl_0_C "assigned fault type / Fault type assignment for check DFC_IgnClPs_LineOl_0" VALUE 0x80504844 Val_Wu8 255.0 DFES_OneToOne 0.00 255.0 FORMAT "%5.1" /end CHARACTERISTIC
/begin CHARACTERISTIC DFES_FaultTyp.DFC_IgnClPs_LineOl_1_C "assigned fault type / Fault type assignment for check DFC_IgnClPs_LineOl_1" VALUE 0x80504845 Val_Wu8 255.0 DFES_OneToOne 0.00 255.0 FORMAT "%5.1" /end CHARACTERISTIC
/begin CHARACTERISTIC DFES_FaultTyp.DFC_IgnClPs_LineOl_2_C "assigned fault type / Fault type assignment for check DFC_IgnClPs_LineOl_2" VALUE 0x80504846 Val_Wu8 255.0 DFES_OneToOne 0.00 255.0 FORMAT "%5.1" /end CHARACTERISTIC
/begin CHARACTERISTIC DFES_FaultTyp.DFC_IgnClPs_LineOl_3_C "assigned fault type / Fault type assignment for check DFC_IgnClPs_LineOl_3" VALUE 0x80504847 Val_Wu8 255.0 DFES_OneToOne 0.00 255.0 FORMAT "%5.1" /end CHARACTERISTIC
/begin CHARACTERISTIC DFES_FaultTyp.DFC_IgnClPs_LineScb_0_C "assigned fault type / Fault type assignment for check DFC_IgnClPs_LineScb_0" VALUE 0x80504848 Val_Wu8 255.0 DFES_OneToOne 0.00 255.0 FORMAT "%5.1" /end CHARACTERISTIC
/begin CHARACTERISTIC DFES_FaultTyp.DFC_IgnClPs_LineScb_1_C "assigned fault type / Fault type assignment for check DFC_IgnClPs_LineScb_1" VALUE 0x80504849 Val_Wu8 255.0 DFES_OneToOne 0.00 255.0 FORMAT "%5.1" /end CHARACTERISTIC
/begin CHARACTERISTIC DFES_FaultTyp.DFC_IgnClPs_LineScb_2_C "assigned fault type / Fault type assignment for check DFC_IgnClPs_LineScb_2" VALUE 0x8050484A Val_Wu8 255.0 DFES_OneToOne 0.00 255.0 FORMAT "%5.1" /end CHARACTERISTIC
/begin CHARACTERISTIC DFES_FaultTyp.DFC_IgnClPs_LineScb_3_C "assigned fault type / Fault type assignment for check DFC_IgnClPs_LineScb_3" VALUE 0x8050484B Val_Wu8 255.0 DFES_OneToOne 0.00 255.0 FORMAT "%5.1" /end CHARACTERISTIC
/begin CHARACTERISTIC DFES_FaultTyp.DFC_IgnClPs_LineScg_0_C "assigned fault type / Fault type assignment for check DFC_IgnClPs_LineScg_0" VALUE 0x8050484C Val_Wu8 255.0 DFES_OneToOne 0.00 255.0 FORMAT "%5.1" /end CHARACTERISTIC
/begin CHARACTERISTIC DFES_FaultTyp.DFC_IgnClPs_LineScg_1_C "assigned fault type / Fault type assignment for check DFC_IgnClPs_LineScg_1" VALUE 0x8050484D Val_Wu8 255.0 DFES_OneToOne 0.00 255.0 FORMAT "%5.1" /end CHARACTERISTIC
/begin CHARACTERISTIC DFES_FaultTyp.DFC_IgnClPs_LineScg_2_C "assigned fault type / Fault type assignment for check DFC_IgnClPs_LineScg_2" VALUE 0x8050484E Val_Wu8 255.0 DFES_OneToOne 0.00 255.0 FORMAT "%5.1" /end CHARACTERISTIC
/begin CHARACTERISTIC DFES_FaultTyp.DFC_IgnClPs_LineScg_3_C "assigned fault type / Fault type assignment for check DFC_IgnClPs_LineScg_3" VALUE 0x8050484F Val_Wu8 255.0 DFES_OneToOne 0.00 255.0 FORMAT "%5.1" /end CHARACTERISTIC
/begin CHARACTERISTIC DFES_FaultTyp.DFC_KRVEKOEVAB_C "assigned fault type / Fault type assignment for check DFC_KRVEKOEVAB" VALUE 0x80504850 Val_Wu8 255.0 DFES_OneToOne 0.00 255.0 FORMAT "%5.1" /end CHARACTERISTIC
/begin CHARACTERISTIC DFES_FaultTyp.DFC_KRVEKOEVAB0_C "assigned fault type / Fault type assignment for check DFC_KRVEKOEVAB0" VALUE 0x80504851 Val_Wu8 255.0 DFES_OneToOne 0.00 255.0 FORMAT "%5.1" /end CHARACTERISTIC
/begin CHARACTERISTIC DFES_FaultTyp.DFC_KRVEKOEVAB1_C "assigned fault type / Fault type assignment for check DFC_KRVEKOEVAB1" VALUE 0x80504852 Val_Wu8 255.0 DFES_OneToOne 0.00 255.0 FORMAT "%5.1" /end CHARACTERISTIC
/begin CHARACTERISTIC DFES_FaultTyp.DFC_KRVEKOEVAB2_C "assigned fault type / Fault type assignment for check DFC_KRVEKOEVAB2" VALUE 0x80504853 Val_Wu8 255.0 DFES_OneToOne 0.00 255.0 FORMAT "%5.1" /end CHARACTERISTIC
/begin CHARACTERISTIC DFES_FaultTyp.DFC_KRVEKOEVAB3_C "assigned fault type / Fault type assignment for check DFC_KRVEKOEVAB3" VALUE 0x80504854 Val_Wu8 255.0 DFES_OneToOne 0.00 255.0 FORMAT "%5.1" /end CHARACTERISTIC
/begin CHARACTERISTIC DFES_FaultTyp.DFC_UegoSigEcuAsicS1B1_C "assigned fault type / Fault type assignment for check DFC_UegoSigEcuAsicS1B1" VALUE 0x80504855 Val_Wu8 255.0 DFES_OneToOne 0.00 255.0 FORMAT "%5.1" /end CHARACTERISTIC
/begin CHARACTERISTIC DFES_FaultTyp.DFC_UegoSigEcuComS1B1_C "assigned fault type / Fault type assignment for check DFC_UegoSigEcuComS1B1" VALUE 0x80504856 Val_Wu8 255.0 DFES_OneToOne 0.00 255.0 FORMAT "%5.1" /end CHARACTERISTIC
/begin CHARACTERISTIC DFES_FaultTyp.DFC_UegoSigSnsrS1B1_C "assigned fault type / Fault type assignment for check DFC_UegoSigSnsrS1B1" VALUE 0x80504857 Val_Wu8 255.0 DFES_OneToOne 0.00 255.0 FORMAT "%5.1" /end CHARACTERISTIC
/begin CHARACTERISTIC DFES_FaultTyp.DFC_UegoSigWireOlApesS1B1_C "assigned fault type / Fault type assignment for check DFC_UegoSigWireOlApesS1B1" VALUE 0x80504858 Val_Wu8 255.0 DFES_OneToOne 0.00 255.0 FORMAT "%5.1" /end CHARACTERISTIC
/begin CHARACTERISTIC DFES_FaultTyp.DFC_UegoSigWireOlIpeS1B1_C "assigned fault type / Fault type assignment for check DFC_UegoSigWireOlIpeS1B1" VALUE 0x80504859 Val_Wu8 255.0 DFES_OneToOne 0.00 255.0 FORMAT "%5.1" /end CHARACTERISTIC
/begin CHARACTERISTIC DFES_FaultTyp.DFC_UegoSigWireOlReS1B1_C "assigned fault type / Fault type assignment for check DFC_UegoSigWireOlReS1B1" VALUE 0x8050485A Val_Wu8 255.0 DFES_OneToOne 0.00 255.0 FORMAT "%5.1" /end CHARACTERISTIC
/begin CHARACTERISTIC DFES_FaultTyp.DFC_UegoSigWireRCmpS1B1_C "assigned fault type / Fault type assignment for check DFC_UegoSigWireRCmpS1B1" VALUE 0x8050485B Val_Wu8 255.0 DFES_OneToOne 0.00 255.0 FORMAT "%5.1" /end CHARACTERISTIC
/begin CHARACTERISTIC DFES_FaultTyp.DFC_UegoSigWireScbS1B1_C "assigned fault type / Fault type assignment for check DFC_UegoSigWireScbS1B1" VALUE 0x8050485C Val_Wu8 255.0 DFES_OneToOne 0.00 255.0 FORMAT "%5.1" /end CHARACTERISTIC
/begin CHARACTERISTIC DFES_FaultTyp.DFC_UegoSigWireScgS1B1_C "assigned fault type / Fault type assignment for check DFC_UegoSigWireScgS1B1" VALUE 0x8050485D Val_Wu8 255.0 DFES_OneToOne 0.00 255.0 FORMAT "%5.1" /end CHARACTERISTIC
/begin CHARACTERISTIC DFES_FaultTyp.DFC_AfsPhyRngHiB1_C "assigned fault type / Fault type assignment for check DFC_AfsPhyRngHiB1" VALUE 0x8050485E Val_Wu8 255.0 DFES_OneToOne 0.00 255.0 FORMAT "%5.1" /end CHARACTERISTIC
/begin CHARACTERISTIC DFES_FaultTyp.DFC_AfsPhyRngLoB1_C "assigned fault type / Fault type assignment for check DFC_AfsPhyRngLoB1" VALUE 0x8050485F Val_Wu8 255.0 DFES_OneToOne 0.00 255.0 FORMAT "%5.1" /end CHARACTERISTIC
/begin CHARACTERISTIC DFES_FaultTyp.DFC_AirCCmprOL_C "assigned fault type / Fault type assignment for check DFC_AirCCmprOL" VALUE 0x80504860 Val_Wu8 255.0 DFES_OneToOne 0.00 255.0 FORMAT "%5.1" /end CHARACTERISTIC
/begin CHARACTERISTIC DFES_FaultTyp.DFC_AirCCmprOvrTemp_C "assigned fault type / Fault type assignment for check DFC_AirCCmprOvrTemp" VALUE 0x80504861 Val_Wu8 255.0 DFES_OneToOne 0.00 255.0 FORMAT "%5.1" /end CHARACTERISTIC
/begin CHARACTERISTIC DFES_FaultTyp.DFC_AirCCmprSCB_C "assigned fault type / Fault type assignment for check DFC_AirCCmprSCB" VALUE 0x80504862 Val_Wu8 255.0 DFES_OneToOne 0.00 255.0 FORMAT "%5.1" /end CHARACTERISTIC
/begin CHARACTERISTIC DFES_FaultTyp.DFC_AirCCmprSCG_C "assigned fault type / Fault type assignment for check DFC_AirCCmprSCG" VALUE 0x80504863 Val_Wu8 255.0 DFES_OneToOne 0.00 255.0 FORMAT "%5.1" /end CHARACTERISTIC
/begin CHARACTERISTIC DFES_FaultTyp.DFC_AltErr_C "assigned fault type / Fault type assignment for check DFC_AltErr" VALUE 0x80504864 Val_Wu8 255.0 DFES_OneToOne 0.00 255.0 FORMAT "%5.1" /end CHARACTERISTIC
/begin CHARACTERISTIC DFES_FaultTyp.DFC_BattUSRCMax_C "assigned fault type / Fault type assignment for check DFC_BattUSRCMax" VALUE 0x80504865 Val_Wu8 255.0 DFES_OneToOne 0.00 255.0 FORMAT "%5.1" /end CHARACTERISTIC
/begin CHARACTERISTIC DFES_FaultTyp.DFC_BattUSRCMin_C "assigned fault type / Fault type assignment for check DFC_BattUSRCMin" VALUE 0x80504866 Val_Wu8 255.0 DFES_OneToOne 0.00 255.0 FORMAT "%5.1" /end CHARACTERISTIC
/begin CHARACTERISTIC DFES_FaultTyp.DFC_ComChksTCU1_C "assigned fault type / Fault type assignment for check DFC_ComChksTCU1" VALUE 0x80504867 Val_Wu8 255.0 DFES_OneToOne 0.00 255.0 FORMAT "%5.1" /end CHARACTERISTIC
/begin CHARACTERISTIC DFES_FaultTyp.DFC_ComChksTCU11_C "assigned fault type / Fault type assignment for check DFC_ComChksTCU11" VALUE 0x80504868 Val_Wu8 255.0 DFES_OneToOne 0.00 255.0 FORMAT "%5.1" /end CHARACTERISTIC
/begin CHARACTERISTIC DFES_FaultTyp.DFC_ComChksTCU12_C "assigned fault type / Fault type assignment for check DFC_ComChksTCU12" VALUE 0x80504869 Val_Wu8 255.0 DFES_OneToOne 0.00 255.0 FORMAT "%5.1" /end CHARACTERISTIC
/begin CHARACTERISTIC DFES_FaultTyp.DFC_ComChksTCU13_C "assigned fault type / Fault type assignment for check DFC_ComChksTCU13" VALUE 0x8050486A Val_Wu8 255.0 DFES_OneToOne 0.00 255.0 FORMAT "%5.1" /end CHARACTERISTIC
/begin CHARACTERISTIC DFES_FaultTyp.DFC_ComChksTCU2_C "assigned fault type / Fault type assignment for check DFC_ComChksTCU2" VALUE 0x8050486B Val_Wu8 255.0 DFES_OneToOne 0.00 255.0 FORMAT "%5.1" /end CHARACTERISTIC
/begin CHARACTERISTIC DFES_FaultTyp.DFC_ComChksTCU3_C "assigned fault type / Fault type assignment for check DFC_ComChksTCU3" VALUE 0x8050486C Val_Wu8 255.0 DFES_OneToOne 0.00 255.0 FORMAT "%5.1" /end CHARACTERISTIC
/begin CHARACTERISTIC DFES_FaultTyp.DFC_ComChksTCU4_C "assigned fault type / Fault type assignment for check DFC_ComChksTCU4" VALUE 0x8050486D Val_Wu8 255.0 DFES_OneToOne 0.00 255.0 FORMAT "%5.1" /end CHARACTERISTIC
/begin CHARACTERISTIC DFES_FaultTyp.DFC_ComCntTCU1_C "assigned fault type / Fault type assignment for check DFC_ComCntTCU1" VALUE 0x8050486E Val_Wu8 255.0 DFES_OneToOne 0.00 255.0 FORMAT "%5.1" /end CHARACTERISTIC
/begin CHARACTERISTIC DFES_FaultTyp.DFC_ComCntTCU11_C "assigned fault type / Fault type assignment for check DFC_ComCntTCU11" VALUE 0x8050486F Val_Wu8 255.0 DFES_OneToOne 0.00 255.0 FORMAT "%5.1" /end CHARACTERISTIC
/begin CHARACTERISTIC DFES_FaultTyp.DFC_ComCntTCU12_C "assigned fault type / Fault type assignment for check DFC_ComCntTCU12" VALUE 0x80504870 Val_Wu8 255.0 DFES_OneToOne 0.00 255.0 FORMAT "%5.1" /end CHARACTERISTIC
/begin CHARACTERISTIC DFES_FaultTyp.DFC_ComCntTCU13_C "assigned fault type / Fault type assignment for check DFC_ComCntTCU13" VALUE 0x80504871 Val_Wu8 255.0 DFES_OneToOne 0.00 255.0 FORMAT "%5.1" /end CHARACTERISTIC
/begin CHARACTERISTIC DFES_FaultTyp.DFC_ComCntTCU2_C "assigned fault type / Fault type assignment for check DFC_ComCntTCU2" VALUE 0x80504872 Val_Wu8 255.0 DFES_OneToOne 0.00 255.0 FORMAT "%5.1" /end CHARACTERISTIC
/begin CHARACTERISTIC DFES_FaultTyp.DFC_ComCntTCU3_C "assigned fault type / Fault type assignment for check DFC_ComCntTCU3" VALUE 0x80504873 Val_Wu8 255.0 DFES_OneToOne 0.00 255.0 FORMAT "%5.1" /end CHARACTERISTIC
/begin CHARACTERISTIC DFES_FaultTyp.DFC_ComCntTCU4_C "assigned fault type / Fault type assignment for check DFC_ComCntTCU4" VALUE 0x80504874 Val_Wu8 255.0 DFES_OneToOne 0.00 255.0 FORMAT "%5.1" /end CHARACTERISTIC
/begin CHARACTERISTIC DFES_FaultTyp.DFC_ComTOutTCU01_C "assigned fault type / Fault type assignment for check DFC_ComTOutTCU01" VALUE 0x80504875 Val_Wu8 255.0 DFES_OneToOne 0.00 255.0 FORMAT "%5.1" /end CHARACTERISTIC
/begin CHARACTERISTIC DFES_FaultTyp.DFC_ComTOutTCU02_C "assigned fault type / Fault type assignment for check DFC_ComTOutTCU02" VALUE 0x80504876 Val_Wu8 255.0 DFES_OneToOne 0.00 255.0 FORMAT "%5.1" /end CHARACTERISTIC
/begin CHARACTERISTIC DFES_FaultTyp.DFC_ComTOutTCU1_C "assigned fault type / Fault type assignment for check DFC_ComTOutTCU1" VALUE 0x80504877 Val_Wu8 255.0 DFES_OneToOne 0.00 255.0 FORMAT "%5.1" /end CHARACTERISTIC
/begin CHARACTERISTIC DFES_FaultTyp.DFC_ComTOutTCU11_C "assigned fault type / Fault type assignment for check DFC_ComTOutTCU11" VALUE 0x80504878 Val_Wu8 255.0 DFES_OneToOne 0.00 255.0 FORMAT "%5.1" /end CHARACTERISTIC
/begin CHARACTERISTIC DFES_FaultTyp.DFC_ComTOutTCU12_C "assigned fault type / Fault type assignment for check DFC_ComTOutTCU12" VALUE 0x80504879 Val_Wu8 255.0 DFES_OneToOne 0.00 255.0 FORMAT "%5.1" /end CHARACTERISTIC
/begin CHARACTERISTIC DFES_FaultTyp.DFC_ComTOutTCU13_C "assigned fault type / Fault type assignment for check DFC_ComTOutTCU13" VALUE 0x8050487A Val_Wu8 255.0 DFES_OneToOne 0.00 255.0 FORMAT "%5.1" /end CHARACTERISTIC
/begin CHARACTERISTIC DFES_FaultTyp.DFC_ComTOutTCU14_C "assigned fault type / Fault type assignment for check DFC_ComTOutTCU14" VALUE 0x8050487B Val_Wu8 255.0 DFES_OneToOne 0.00 255.0 FORMAT "%5.1" /end CHARACTERISTIC
/begin CHARACTERISTIC DFES_FaultTyp.DFC_ComTOutTCU2_C "assigned fault type / Fault type assignment for check DFC_ComTOutTCU2" VALUE 0x8050487C Val_Wu8 255.0 DFES_OneToOne 0.00 255.0 FORMAT "%5.1" /end CHARACTERISTIC
/begin CHARACTERISTIC DFES_FaultTyp.DFC_ComTOutTCU3_C "assigned fault type / Fault type assignment for check DFC_ComTOutTCU3" VALUE 0x8050487D Val_Wu8 255.0 DFES_OneToOne 0.00 255.0 FORMAT "%5.1" /end CHARACTERISTIC
/begin CHARACTERISTIC DFES_FaultTyp.DFC_ComTOutTCU4_C "assigned fault type / Fault type assignment for check DFC_ComTOutTCU4" VALUE 0x8050487E Val_Wu8 255.0 DFES_OneToOne 0.00 255.0 FORMAT "%5.1" /end CHARACTERISTIC
/begin CHARACTERISTIC DFES_FaultTyp.DFC_DevLibBattUHi_C "assigned fault type / Fault type assignment for check DFC_DevLibBattUHi" VALUE 0x8050487F Val_Wu8 255.0 DFES_OneToOne 0.00 255.0 FORMAT "%5.1" /end CHARACTERISTIC
/begin CHARACTERISTIC DFES_FaultTyp.DFC_DevLibBattULo_C "assigned fault type / Fault type assignment for check DFC_DevLibBattULo" VALUE 0x80504880 Val_Wu8 255.0 DFES_OneToOne 0.00 255.0 FORMAT "%5.1" /end CHARACTERISTIC
/begin CHARACTERISTIC DFES_FaultTyp.DFC_EGRVlvFailSafeActv_C "assigned fault type / Fault type assignment for check DFC_EGRVlvFailSafeActv" VALUE 0x80504881 Val_Wu8 255.0 DFES_OneToOne 0.00 255.0 FORMAT "%5.1" /end CHARACTERISTIC
/begin CHARACTERISTIC DFES_FaultTyp.DFC_EGRVlvGovDvtCld_C "assigned fault type / Fault type assignment for check DFC_EGRVlvGovDvtCld" VALUE 0x80504882 Val_Wu8 255.0 DFES_OneToOne 0.00 255.0 FORMAT "%5.1" /end CHARACTERISTIC
/begin CHARACTERISTIC DFES_FaultTyp.DFC_EGRVlvPhysSRCMax_C "assigned fault type / Fault type assignment for check DFC_EGRVlvPhysSRCMax" VALUE 0x80504883 Val_Wu8 255.0 DFES_OneToOne 0.00 255.0 FORMAT "%5.1" /end CHARACTERISTIC
/begin CHARACTERISTIC DFES_FaultTyp.DFC_EGRVlvPhysSRCMin_C "assigned fault type / Fault type assignment for check DFC_EGRVlvPhysSRCMin" VALUE 0x80504884 Val_Wu8 255.0 DFES_OneToOne 0.00 255.0 FORMAT "%5.1" /end CHARACTERISTIC
/begin CHARACTERISTIC DFES_FaultTyp.DFC_FanDIOOL_0_C "assigned fault type / Fault type assignment for check DFC_FanDIOOL_0" VALUE 0x80504885 Val_Wu8 255.0 DFES_OneToOne 0.00 255.0 FORMAT "%5.1" /end CHARACTERISTIC
/begin CHARACTERISTIC DFES_FaultTyp.DFC_FanDIOOL_1_C "assigned fault type / Fault type assignment for check DFC_FanDIOOL_1" VALUE 0x80504886 Val_Wu8 255.0 DFES_OneToOne 0.00 255.0 FORMAT "%5.1" /end CHARACTERISTIC
/begin CHARACTERISTIC DFES_FaultTyp.DFC_FanDIOOvrTemp_0_C "assigned fault type / Fault type assignment for check DFC_FanDIOOvrTemp_0" VALUE 0x80504887 Val_Wu8 255.0 DFES_OneToOne 0.00 255.0 FORMAT "%5.1" /end CHARACTERISTIC
/begin CHARACTERISTIC DFES_FaultTyp.DFC_FanDIOOvrTemp_1_C "assigned fault type / Fault type assignment for check DFC_FanDIOOvrTemp_1" VALUE 0x80504888 Val_Wu8 255.0 DFES_OneToOne 0.00 255.0 FORMAT "%5.1" /end CHARACTERISTIC
/begin CHARACTERISTIC DFES_FaultTyp.DFC_FanDIOSCB_0_C "assigned fault type / Fault type assignment for check DFC_FanDIOSCB_0" VALUE 0x80504889 Val_Wu8 255.0 DFES_OneToOne 0.00 255.0 FORMAT "%5.1" /end CHARACTERISTIC
/begin CHARACTERISTIC DFES_FaultTyp.DFC_FanDIOSCB_1_C "assigned fault type / Fault type assignment for check DFC_FanDIOSCB_1" VALUE 0x8050488A Val_Wu8 255.0 DFES_OneToOne 0.00 255.0 FORMAT "%5.1" /end CHARACTERISTIC
/begin CHARACTERISTIC DFES_FaultTyp.DFC_FanDIOSCG_0_C "assigned fault type / Fault type assignment for check DFC_FanDIOSCG_0" VALUE 0x8050488B Val_Wu8 255.0 DFES_OneToOne 0.00 255.0 FORMAT "%5.1" /end CHARACTERISTIC
/begin CHARACTERISTIC DFES_FaultTyp.DFC_FanDIOSCG_1_C "assigned fault type / Fault type assignment for check DFC_FanDIOSCG_1" VALUE 0x8050488C Val_Wu8 255.0 DFES_OneToOne 0.00 255.0 FORMAT "%5.1" /end CHARACTERISTIC
/begin CHARACTERISTIC DFES_FaultTyp.DFC_MRlyDcOL_C "assigned fault type / Fault type assignment for check DFC_MRlyDcOL" VALUE 0x8050488D Val_Wu8 255.0 DFES_OneToOne 0.00 255.0 FORMAT "%5.1" /end CHARACTERISTIC
/begin CHARACTERISTIC DFES_FaultTyp.DFC_MRlyDcSCB_C "assigned fault type / Fault type assignment for check DFC_MRlyDcSCB" VALUE 0x8050488E Val_Wu8 255.0 DFES_OneToOne 0.00 255.0 FORMAT "%5.1" /end CHARACTERISTIC
/begin CHARACTERISTIC DFES_FaultTyp.DFC_MRlyDcSCG_C "assigned fault type / Fault type assignment for check DFC_MRlyDcSCG" VALUE 0x8050488F Val_Wu8 255.0 DFES_OneToOne 0.00 255.0 FORMAT "%5.1" /end CHARACTERISTIC
/begin CHARACTERISTIC DFES_FaultTyp.DFC_PSPOL_C "assigned fault type / Fault type assignment for check DFC_PSPOL" VALUE 0x80504890 Val_Wu8 255.0 DFES_OneToOne 0.00 255.0 FORMAT "%5.1" /end CHARACTERISTIC
/begin CHARACTERISTIC DFES_FaultTyp.DFC_PSPOvrTemp_C "assigned fault type / Fault type assignment for check DFC_PSPOvrTemp" VALUE 0x80504891 Val_Wu8 255.0 DFES_OneToOne 0.00 255.0 FORMAT "%5.1" /end CHARACTERISTIC
/begin CHARACTERISTIC DFES_FaultTyp.DFC_PSPSCB_C "assigned fault type / Fault type assignment for check DFC_PSPSCB" VALUE 0x80504892 Val_Wu8 255.0 DFES_OneToOne 0.00 255.0 FORMAT "%5.1" /end CHARACTERISTIC
/begin CHARACTERISTIC DFES_FaultTyp.DFC_PSPSCG_C "assigned fault type / Fault type assignment for check DFC_PSPSCG" VALUE 0x80504893 Val_Wu8 255.0 DFES_OneToOne 0.00 255.0 FORMAT "%5.1" /end CHARACTERISTIC
/begin CHARACTERISTIC DFES_FaultTyp.DFC_T50Err_C "assigned fault type / Fault type assignment for check DFC_T50Err" VALUE 0x80504894 Val_Wu8 255.0 DFES_OneToOne 0.00 255.0 FORMAT "%5.1" /end CHARACTERISTIC
/begin CHARACTERISTIC DFES_FaultTyp.DFC_ThrVlvLoBattB1_C "assigned fault type / Fault type assignment for check DFC_ThrVlvLoBattB1" VALUE 0x80504895 Val_Wu8 255.0 DFES_OneToOne 0.00 255.0 FORMAT "%5.1" /end CHARACTERISTIC
/begin CHARACTERISTIC DFES_FaultTyp.DFC_UegoSigOperPlausS1B1_C "assigned fault type / Fault type assignment for check DFC_UegoSigOperPlausS1B1" VALUE 0x80504896 Val_Wu8 255.0 DFES_OneToOne 0.00 255.0 FORMAT "%5.1" /end CHARACTERISTIC
/begin CHARACTERISTIC DFES_FaultTyp.DFC_VehVPhysRngHi_C "assigned fault type / Fault type assignment for check DFC_VehVPhysRngHi" VALUE 0x80504897 Val_Wu8 255.0 DFES_OneToOne 0.00 255.0 FORMAT "%5.1" /end CHARACTERISTIC
/begin CHARACTERISTIC DFES_FaultTyp.DFC_VehVSclOutOL_C "assigned fault type / Fault type assignment for check DFC_VehVSclOutOL" VALUE 0x80504898 Val_Wu8 255.0 DFES_OneToOne 0.00 255.0 FORMAT "%5.1" /end CHARACTERISTIC
/begin CHARACTERISTIC DFES_FaultTyp.DFC_VehVSclOutOT_C "assigned fault type / Fault type assignment for check DFC_VehVSclOutOT" VALUE 0x80504899 Val_Wu8 255.0 DFES_OneToOne 0.00 255.0 FORMAT "%5.1" /end CHARACTERISTIC
/begin CHARACTERISTIC DFES_FaultTyp.DFC_VehVSclOutSCB_C "assigned fault type / Fault type assignment for check DFC_VehVSclOutSCB" VALUE 0x8050489A Val_Wu8 255.0 DFES_OneToOne 0.00 255.0 FORMAT "%5.1" /end CHARACTERISTIC
/begin CHARACTERISTIC DFES_FaultTyp.DFC_VehVSclOutSCG_C "assigned fault type / Fault type assignment for check DFC_VehVSclOutSCG" VALUE 0x8050489B Val_Wu8 255.0 DFES_OneToOne 0.00 255.0 FORMAT "%5.1" /end CHARACTERISTIC
/begin CHARACTERISTIC DFES_FaultTyp.DFC_VehVSigFL_C "assigned fault type / Fault type assignment for check DFC_VehVSigFL" VALUE 0x8050489C Val_Wu8 255.0 DFES_OneToOne 0.00 255.0 FORMAT "%5.1" /end CHARACTERISTIC
/begin CHARACTERISTIC DFES_FaultTyp.DFC_VehVSigFR_C "assigned fault type / Fault type assignment for check DFC_VehVSigFR" VALUE 0x8050489D Val_Wu8 255.0 DFES_OneToOne 0.00 255.0 FORMAT "%5.1" /end CHARACTERISTIC
/begin CHARACTERISTIC DFES_FaultTyp.DFC_VehVSigRL_C "assigned fault type / Fault type assignment for check DFC_VehVSigRL" VALUE 0x8050489E Val_Wu8 255.0 DFES_OneToOne 0.00 255.0 FORMAT "%5.1" /end CHARACTERISTIC
/begin CHARACTERISTIC DFES_FaultTyp.DFC_VehVSigRR_C "assigned fault type / Fault type assignment for check DFC_VehVSigRR" VALUE 0x8050489F Val_Wu8 255.0 DFES_OneToOne 0.00 255.0 FORMAT "%5.1" /end CHARACTERISTIC
/begin CHARACTERISTIC DFES_FaultTyp.DFC_VehVSnsrARngHi_C "assigned fault type / Fault type assignment for check DFC_VehVSnsrARngHi" VALUE 0x805048A0 Val_Wu8 255.0 DFES_OneToOne 0.00 255.0 FORMAT "%5.1" /end CHARACTERISTIC
/begin CHARACTERISTIC DFES_FaultTyp.DFC_VehVSnsrBRngHi_C "assigned fault type / Fault type assignment for check DFC_VehVSnsrBRngHi" VALUE 0x805048A1 Val_Wu8 255.0 DFES_OneToOne 0.00 255.0 FORMAT "%5.1" /end CHARACTERISTIC
/begin CHARACTERISTIC DFES_FaultTyp.DFC_VehVSpdRtyDiag_C "assigned fault type / Fault type assignment for check DFC_VehVSpdRtyDiag" VALUE 0x805048A2 Val_Wu8 255.0 DFES_OneToOne 0.00 255.0 FORMAT "%5.1" /end CHARACTERISTIC
/begin CHARACTERISTIC DFES_FaultTyp.DFC_DHFHD_C "assigned fault type / Fault type assignment for check DFC_DHFHD" VALUE 0x805048A3 Val_Wu8 255.0 DFES_OneToOne 0.00 255.0 FORMAT "%5.1" /end CHARACTERISTIC
/begin CHARACTERISTIC DFES_FaultTyp.DFC_InjVlv_DI_DcDc_C "assigned fault type / Fault type assignment for check DFC_InjVlv_DI_DcDc" VALUE 0x805048A4 Val_Wu8 255.0 DFES_OneToOne 0.00 255.0 FORMAT "%5.1" /end CHARACTERISTIC
/begin CHARACTERISTIC DFES_FaultTyp.DFC_InjVlv_DI_NoLd_0_C "assigned fault type / Fault type assignment for check DFC_InjVlv_DI_NoLd_0" VALUE 0x805048A5 Val_Wu8 255.0 DFES_OneToOne 0.00 255.0 FORMAT "%5.1" /end CHARACTERISTIC
/begin CHARACTERISTIC DFES_FaultTyp.DFC_InjVlv_DI_NoLd_1_C "assigned fault type / Fault type assignment for check DFC_InjVlv_DI_NoLd_1" VALUE 0x805048A6 Val_Wu8 255.0 DFES_OneToOne 0.00 255.0 FORMAT "%5.1" /end CHARACTERISTIC
/begin CHARACTERISTIC DFES_FaultTyp.DFC_InjVlv_DI_NoLd_2_C "assigned fault type / Fault type assignment for check DFC_InjVlv_DI_NoLd_2" VALUE 0x805048A7 Val_Wu8 255.0 DFES_OneToOne 0.00 255.0 FORMAT "%5.1" /end CHARACTERISTIC
/begin CHARACTERISTIC DFES_FaultTyp.DFC_InjVlv_DI_NoLd_3_C "assigned fault type / Fault type assignment for check DFC_InjVlv_DI_NoLd_3" VALUE 0x805048A8 Val_Wu8 255.0 DFES_OneToOne 0.00 255.0 FORMAT "%5.1" /end CHARACTERISTIC
/begin CHARACTERISTIC DFES_FaultTyp.DFC_InjVlv_DI_ScBnk_0_C "assigned fault type / Fault type assignment for check DFC_InjVlv_DI_ScBnk_0" VALUE 0x805048A9 Val_Wu8 255.0 DFES_OneToOne 0.00 255.0 FORMAT "%5.1" /end CHARACTERISTIC
/begin CHARACTERISTIC DFES_FaultTyp.DFC_InjVlv_DI_ScBnk_1_C "assigned fault type / Fault type assignment for check DFC_InjVlv_DI_ScBnk_1" VALUE 0x805048AA Val_Wu8 255.0 DFES_OneToOne 0.00 255.0 FORMAT "%5.1" /end CHARACTERISTIC
/begin CHARACTERISTIC DFES_FaultTyp.DFC_InjVlv_DI_ScBnk_2_C "assigned fault type / Fault type assignment for check DFC_InjVlv_DI_ScBnk_2" VALUE 0x805048AB Val_Wu8 255.0 DFES_OneToOne 0.00 255.0 FORMAT "%5.1" /end CHARACTERISTIC
/begin CHARACTERISTIC DFES_FaultTyp.DFC_InjVlv_DI_ScBnk_3_C "assigned fault type / Fault type assignment for check DFC_InjVlv_DI_ScBnk_3" VALUE 0x805048AC Val_Wu8 255.0 DFES_OneToOne 0.00 255.0 FORMAT "%5.1" /end CHARACTERISTIC
/begin CHARACTERISTIC DFES_FaultTyp.DFC_InjVlv_DI_ScCyl_0_C "assigned fault type / Fault type assignment for check DFC_InjVlv_DI_ScCyl_0" VALUE 0x805048AD Val_Wu8 255.0 DFES_OneToOne 0.00 255.0 FORMAT "%5.1" /end CHARACTERISTIC
/begin CHARACTERISTIC DFES_FaultTyp.DFC_InjVlv_DI_ScCyl_1_C "assigned fault type / Fault type assignment for check DFC_InjVlv_DI_ScCyl_1" VALUE 0x805048AE Val_Wu8 255.0 DFES_OneToOne 0.00 255.0 FORMAT "%5.1" /end CHARACTERISTIC
/begin CHARACTERISTIC DFES_FaultTyp.DFC_InjVlv_DI_ScCyl_2_C "assigned fault type / Fault type assignment for check DFC_InjVlv_DI_ScCyl_2" VALUE 0x805048AF Val_Wu8 255.0 DFES_OneToOne 0.00 255.0 FORMAT "%5.1" /end CHARACTERISTIC
/begin CHARACTERISTIC DFES_FaultTyp.DFC_InjVlv_DI_ScCyl_3_C "assigned fault type / Fault type assignment for check DFC_InjVlv_DI_ScCyl_3" VALUE 0x805048B0 Val_Wu8 255.0 DFES_OneToOne 0.00 255.0 FORMAT "%5.1" /end CHARACTERISTIC
/begin CHARACTERISTIC DFES_FaultTyp.DFC_InjVlv_DI_ScHsLs_0_C "assigned fault type / Fault type assignment for check DFC_InjVlv_DI_ScHsLs_0" VALUE 0x805048B1 Val_Wu8 255.0 DFES_OneToOne 0.00 255.0 FORMAT "%5.1" /end CHARACTERISTIC
/begin CHARACTERISTIC DFES_FaultTyp.DFC_InjVlv_DI_ScHsLs_1_C "assigned fault type / Fault type assignment for check DFC_InjVlv_DI_ScHsLs_1" VALUE 0x805048B2 Val_Wu8 255.0 DFES_OneToOne 0.00 255.0 FORMAT "%5.1" /end CHARACTERISTIC
/begin CHARACTERISTIC DFES_FaultTyp.DFC_InjVlv_DI_ScHsLs_2_C "assigned fault type / Fault type assignment for check DFC_InjVlv_DI_ScHsLs_2" VALUE 0x805048B3 Val_Wu8 255.0 DFES_OneToOne 0.00 255.0 FORMAT "%5.1" /end CHARACTERISTIC
/begin CHARACTERISTIC DFES_FaultTyp.DFC_InjVlv_DI_ScHsLs_3_C "assigned fault type / Fault type assignment for check DFC_InjVlv_DI_ScHsLs_3" VALUE 0x805048B4 Val_Wu8 255.0 DFES_OneToOne 0.00 255.0 FORMAT "%5.1" /end CHARACTERISTIC
/begin CHARACTERISTIC DFES_FaultTyp.DFC_MfPsDiaOpenLoad1_C "assigned fault type / Fault type assignment for check DFC_MfPsDiaOpenLoad1" VALUE 0x805048B5 Val_Wu8 255.0 DFES_OneToOne 0.00 255.0 FORMAT "%5.1" /end CHARACTERISTIC
/begin CHARACTERISTIC DFES_FaultTyp.DFC_MfPsDiaScHiS1_C "assigned fault type / Fault type assignment for check DFC_MfPsDiaScHiS1" VALUE 0x805048B6 Val_Wu8 255.0 DFES_OneToOne 0.00 255.0 FORMAT "%5.1" /end CHARACTERISTIC
/begin CHARACTERISTIC DFES_FaultTyp.DFC_MfPsDiaScHiSLowS1_C "assigned fault type / Fault type assignment for check DFC_MfPsDiaScHiSLowS1" VALUE 0x805048B7 Val_Wu8 255.0 DFES_OneToOne 0.00 255.0 FORMAT "%5.1" /end CHARACTERISTIC
/begin CHARACTERISTIC DFES_FaultTyp.DFC_MfPsDiaScLowS1_C "assigned fault type / Fault type assignment for check DFC_MfPsDiaScLowS1" VALUE 0x805048B8 Val_Wu8 255.0 DFES_OneToOne 0.00 255.0 FORMAT "%5.1" /end CHARACTERISTIC
/begin CHARACTERISTIC DFES_FaultTyp.DFC_ACEvpTPhysRngHi_C "assigned fault type / Fault type assignment for check DFC_ACEvpTPhysRngHi" VALUE 0x805048B9 Val_Wu8 255.0 DFES_OneToOne 0.00 255.0 FORMAT "%5.1" /end CHARACTERISTIC
/begin CHARACTERISTIC DFES_FaultTyp.DFC_ACEvpTPhysRngLo_C "assigned fault type / Fault type assignment for check DFC_ACEvpTPhysRngLo" VALUE 0x805048BA Val_Wu8 255.0 DFES_OneToOne 0.00 255.0 FORMAT "%5.1" /end CHARACTERISTIC
/begin CHARACTERISTIC DFES_FaultTyp.DFC_ACEvpTSRCMax_C "assigned fault type / Fault type assignment for check DFC_ACEvpTSRCMax" VALUE 0x805048BB Val_Wu8 255.0 DFES_OneToOne 0.00 255.0 FORMAT "%5.1" /end CHARACTERISTIC
/begin CHARACTERISTIC DFES_FaultTyp.DFC_ACEvpTSRCMin_C "assigned fault type / Fault type assignment for check DFC_ACEvpTSRCMin" VALUE 0x805048BC Val_Wu8 255.0 DFES_OneToOne 0.00 255.0 FORMAT "%5.1" /end CHARACTERISTIC
/begin CHARACTERISTIC DFES_FaultTyp.DFC_AfsRawSigRngHiB1_C "assigned fault type / Fault type assignment for check DFC_AfsRawSigRngHiB1" VALUE 0x805048BD Val_Wu8 255.0 DFES_OneToOne 0.00 255.0 FORMAT "%5.1" /end CHARACTERISTIC
/begin CHARACTERISTIC DFES_FaultTyp.DFC_AfsRawSigRngLoB1_C "assigned fault type / Fault type assignment for check DFC_AfsRawSigRngLoB1" VALUE 0x805048BE Val_Wu8 255.0 DFES_OneToOne 0.00 255.0 FORMAT "%5.1" /end CHARACTERISTIC
/begin CHARACTERISTIC DFES_FaultTyp.DFC_AfsSnsrErrB1_C "assigned fault type / Fault type assignment for check DFC_AfsSnsrErrB1" VALUE 0x805048BF Val_Wu8 255.0 DFES_OneToOne 0.00 255.0 FORMAT "%5.1" /end CHARACTERISTIC
/begin CHARACTERISTIC DFES_FaultTyp.DFC_AirCClntPAnaSRCMax_C "assigned fault type / Fault type assignment for check DFC_AirCClntPAnaSRCMax" VALUE 0x805048C0 Val_Wu8 255.0 DFES_OneToOne 0.00 255.0 FORMAT "%5.1" /end CHARACTERISTIC
/begin CHARACTERISTIC DFES_FaultTyp.DFC_AirCClntPAnaSRCMin_C "assigned fault type / Fault type assignment for check DFC_AirCClntPAnaSRCMin" VALUE 0x805048C1 Val_Wu8 255.0 DFES_OneToOne 0.00 255.0 FORMAT "%5.1" /end CHARACTERISTIC
/begin CHARACTERISTIC DFES_FaultTyp.DFC_AirCSwtNpl_C "assigned fault type / Fault type assignment for check DFC_AirCSwtNpl" VALUE 0x805048C2 Val_Wu8 255.0 DFES_OneToOne 0.00 255.0 FORMAT "%5.1" /end CHARACTERISTIC
/begin CHARACTERISTIC DFES_FaultTyp.DFC_AirCSwtSig_C "assigned fault type / Fault type assignment for check DFC_AirCSwtSig" VALUE 0x805048C3 Val_Wu8 255.0 DFES_OneToOne 0.00 255.0 FORMAT "%5.1" /end CHARACTERISTIC
/begin CHARACTERISTIC DFES_FaultTyp.DFC_Brk_C "assigned fault type / Fault type assignment for check DFC_Brk" VALUE 0x805048C4 Val_Wu8 255.0 DFES_OneToOne 0.00 255.0 FORMAT "%5.1" /end CHARACTERISTIC
/begin CHARACTERISTIC DFES_FaultTyp.DFC_BrkBstSensSCB_C "assigned fault type / Fault type assignment for check DFC_BrkBstSensSCB" VALUE 0x805048C5 Val_Wu8 255.0 DFES_OneToOne 0.00 255.0 FORMAT "%5.1" /end CHARACTERISTIC
/begin CHARACTERISTIC DFES_FaultTyp.DFC_BrkBstSensSCG_C "assigned fault type / Fault type assignment for check DFC_BrkBstSensSCG" VALUE 0x805048C6 Val_Wu8 255.0 DFES_OneToOne 0.00 255.0 FORMAT "%5.1" /end CHARACTERISTIC
/begin CHARACTERISTIC DFES_FaultTyp.DFC_BrkSig_C "assigned fault type / Fault type assignment for check DFC_BrkSig" VALUE 0x805048C7 Val_Wu8 255.0 DFES_OneToOne 0.00 255.0 FORMAT "%5.1" /end CHARACTERISTIC
/begin CHARACTERISTIC DFES_FaultTyp.DFC_ClthSig_C "assigned fault type / Fault type assignment for check DFC_ClthSig" VALUE 0x805048C8 Val_Wu8 255.0 DFES_OneToOne 0.00 255.0 FORMAT "%5.1" /end CHARACTERISTIC
/begin CHARACTERISTIC DFES_FaultTyp.DFC_EGRVlvCurrLim_C "assigned fault type / Fault type assignment for check DFC_EGRVlvCurrLim" VALUE 0x805048C9 Val_Wu8 255.0 DFES_OneToOne 0.00 255.0 FORMAT "%5.1" /end CHARACTERISTIC
/begin CHARACTERISTIC DFES_FaultTyp.DFC_EGRVlvOL_C "assigned fault type / Fault type assignment for check DFC_EGRVlvOL" VALUE 0x805048CA Val_Wu8 255.0 DFES_OneToOne 0.00 255.0 FORMAT "%5.1" /end CHARACTERISTIC
/begin CHARACTERISTIC DFES_FaultTyp.DFC_EGRVlvOvrTemp_C "assigned fault type / Fault type assignment for check DFC_EGRVlvOvrTemp" VALUE 0x805048CB Val_Wu8 255.0 DFES_OneToOne 0.00 255.0 FORMAT "%5.1" /end CHARACTERISTIC
/begin CHARACTERISTIC DFES_FaultTyp.DFC_EGRVlvSCB_C "assigned fault type / Fault type assignment for check DFC_EGRVlvSCB" VALUE 0x805048CC Val_Wu8 255.0 DFES_OneToOne 0.00 255.0 FORMAT "%5.1" /end CHARACTERISTIC
/begin CHARACTERISTIC DFES_FaultTyp.DFC_EGRVlvSCG_C "assigned fault type / Fault type assignment for check DFC_EGRVlvSCG" VALUE 0x805048CD Val_Wu8 255.0 DFES_OneToOne 0.00 255.0 FORMAT "%5.1" /end CHARACTERISTIC
/begin CHARACTERISTIC DFES_FaultTyp.DFC_EGRVlvSRCMax_C "assigned fault type / Fault type assignment for check DFC_EGRVlvSRCMax" VALUE 0x805048CE Val_Wu8 255.0 DFES_OneToOne 0.00 255.0 FORMAT "%5.1" /end CHARACTERISTIC
/begin CHARACTERISTIC DFES_FaultTyp.DFC_EGRVlvSRCMin_C "assigned fault type / Fault type assignment for check DFC_EGRVlvSRCMin" VALUE 0x805048CF Val_Wu8 255.0 DFES_OneToOne 0.00 255.0 FORMAT "%5.1" /end CHARACTERISTIC
/begin CHARACTERISTIC DFES_FaultTyp.DFC_HLSDemOvhtEngLim_C "assigned fault type / Fault type assignment for check DFC_HLSDemOvhtEngLim" VALUE 0x805048D0 Val_Wu8 255.0 DFES_OneToOne 0.00 255.0 FORMAT "%5.1" /end CHARACTERISTIC
/begin CHARACTERISTIC DFES_FaultTyp.DFC_OilPSwmpSRCMax_C "assigned fault type / Fault type assignment for check DFC_OilPSwmpSRCMax" VALUE 0x805048D1 Val_Wu8 255.0 DFES_OneToOne 0.00 255.0 FORMAT "%5.1" /end CHARACTERISTIC
/begin CHARACTERISTIC DFES_FaultTyp.DFC_OilPSwmpSRCMin_C "assigned fault type / Fault type assignment for check DFC_OilPSwmpSRCMin" VALUE 0x805048D2 Val_Wu8 255.0 DFES_OneToOne 0.00 255.0 FORMAT "%5.1" /end CHARACTERISTIC
/begin CHARACTERISTIC DFES_FaultTyp.DFC_PIntkVUsLineHiB1_C "assigned fault type / Fault type assignment for check DFC_PIntkVUsLineHiB1" VALUE 0x805048D3 Val_Wu8 255.0 DFES_OneToOne 0.00 255.0 FORMAT "%5.1" /end CHARACTERISTIC
/begin CHARACTERISTIC DFES_FaultTyp.DFC_PIntkVUsLineLoB1_C "assigned fault type / Fault type assignment for check DFC_PIntkVUsLineLoB1" VALUE 0x805048D4 Val_Wu8 255.0 DFES_OneToOne 0.00 255.0 FORMAT "%5.1" /end CHARACTERISTIC
/begin CHARACTERISTIC DFES_FaultTyp.DFC_VehVPhysRngLo_C "assigned fault type / Fault type assignment for check DFC_VehVPhysRngLo" VALUE 0x805048D5 Val_Wu8 255.0 DFES_OneToOne 0.00 255.0 FORMAT "%5.1" /end CHARACTERISTIC
/begin CHARACTERISTIC DFES_FaultTyp.DFC_VehVSigCan_C "assigned fault type / Fault type assignment for check DFC_VehVSigCan" VALUE 0x805048D6 Val_Wu8 255.0 DFES_OneToOne 0.00 255.0 FORMAT "%5.1" /end CHARACTERISTIC
/begin CHARACTERISTIC DFES_FaultTyp.DFC_VehVSigCanSafe_C "assigned fault type / Fault type assignment for check DFC_VehVSigCanSafe" VALUE 0x805048D7 Val_Wu8 255.0 DFES_OneToOne 0.00 255.0 FORMAT "%5.1" /end CHARACTERISTIC
/begin CHARACTERISTIC DFES_FaultTyp.DFC_VlvLftFbOilPSnsrIntk11SRCMax_C "assigned fault type / Fault type assignment for check DFC_VlvLftFbOilPSnsrIntk11SRCMax" VALUE 0x805048D8 Val_Wu8 255.0 DFES_OneToOne 0.00 255.0 FORMAT "%5.1" /end CHARACTERISTIC
/begin CHARACTERISTIC DFES_FaultTyp.DFC_VlvLftFbOilPSnsrIntk11SRCMin_C "assigned fault type / Fault type assignment for check DFC_VlvLftFbOilPSnsrIntk11SRCMin" VALUE 0x805048D9 Val_Wu8 255.0 DFES_OneToOne 0.00 255.0 FORMAT "%5.1" /end CHARACTERISTIC
/begin CHARACTERISTIC DFES_FaultTyp.DFC_ClthNpl_C "assigned fault type / Fault type assignment for check DFC_ClthNpl" VALUE 0x805048DA Val_Wu8 255.0 DFES_OneToOne 0.00 255.0 FORMAT "%5.1" /end CHARACTERISTIC
/begin CHARACTERISTIC DFES_FaultTyp.DFC_GbxPNPosnDrvCdn_C "assigned fault type / Fault type assignment for check DFC_GbxPNPosnDrvCdn" VALUE 0x805048DB Val_Wu8 255.0 DFES_OneToOne 0.00 255.0 FORMAT "%5.1" /end CHARACTERISTIC
/begin CHARACTERISTIC DFES_FaultTyp.DFC_GbxPNPosnPlausy_C "assigned fault type / Fault type assignment for check DFC_GbxPNPosnPlausy" VALUE 0x805048DC Val_Wu8 255.0 DFES_OneToOne 0.00 255.0 FORMAT "%5.1" /end CHARACTERISTIC
/begin CHARACTERISTIC DFES_FaultTyp.DFC_AfsSigErrLineHiB1_C "assigned fault type / Fault type assignment for check DFC_AfsSigErrLineHiB1" VALUE 0x805048DD Val_Wu8 255.0 DFES_OneToOne 0.00 255.0 FORMAT "%5.1" /end CHARACTERISTIC
/begin CHARACTERISTIC DFES_FaultTyp.DFC_AfsSigErrLineLoB1_C "assigned fault type / Fault type assignment for check DFC_AfsSigErrLineLoB1" VALUE 0x805048DE Val_Wu8 255.0 DFES_OneToOne 0.00 255.0 FORMAT "%5.1" /end CHARACTERISTIC
/begin CHARACTERISTIC DFES_FaultTyp.DFC_PEnvCcMax_C "assigned fault type / Fault type assignment for check DFC_PEnvCcMax" VALUE 0x805048DF Val_Wu8 255.0 DFES_OneToOne 0.00 255.0 FORMAT "%5.1" /end CHARACTERISTIC
/begin CHARACTERISTIC DFES_FaultTyp.DFC_PEnvCcMin_C "assigned fault type / Fault type assignment for check DFC_PEnvCcMin" VALUE 0x805048E0 Val_Wu8 255.0 DFES_OneToOne 0.00 255.0 FORMAT "%5.1" /end CHARACTERISTIC
/begin CHARACTERISTIC DFES_FaultTyp.DFC_PEnvRngChkMax_C "assigned fault type / Fault type assignment for check DFC_PEnvRngChkMax" VALUE 0x805048E1 Val_Wu8 255.0 DFES_OneToOne 0.00 255.0 FORMAT "%5.1" /end CHARACTERISTIC
/begin CHARACTERISTIC DFES_FaultTyp.DFC_PEnvRngChkMin_C "assigned fault type / Fault type assignment for check DFC_PEnvRngChkMin" VALUE 0x805048E2 Val_Wu8 255.0 DFES_OneToOne 0.00 255.0 FORMAT "%5.1" /end CHARACTERISTIC
/begin CHARACTERISTIC DFES_FaultTyp.DFC_PEnvSnsrPlaus_C "assigned fault type / Fault type assignment for check DFC_PEnvSnsrPlaus" VALUE 0x805048E3 Val_Wu8 255.0 DFES_OneToOne 0.00 255.0 FORMAT "%5.1" /end CHARACTERISTIC
/begin CHARACTERISTIC DFES_FaultTyp.DFC_UEGOHeatrRlyPsOLS1B1_C "assigned fault type / Fault type assignment for check DFC_UEGOHeatrRlyPsOLS1B1" VALUE 0x805048E4 Val_Wu8 255.0 DFES_OneToOne 0.00 255.0 FORMAT "%5.1" /end CHARACTERISTIC
/begin CHARACTERISTIC DFES_FaultTyp.DFC_UEGOHeatrRlyPsSCBS1B1_C "assigned fault type / Fault type assignment for check DFC_UEGOHeatrRlyPsSCBS1B1" VALUE 0x805048E5 Val_Wu8 255.0 DFES_OneToOne 0.00 255.0 FORMAT "%5.1" /end CHARACTERISTIC
/begin CHARACTERISTIC DFES_FaultTyp.DFC_UEGOHeatrRlyPsSCGS1B1_C "assigned fault type / Fault type assignment for check DFC_UEGOHeatrRlyPsSCGS1B1" VALUE 0x805048E6 Val_Wu8 255.0 DFES_OneToOne 0.00 255.0 FORMAT "%5.1" /end CHARACTERISTIC
/begin CHARACTERISTIC DFES_FaultTyp.DFC_UegoHeatrWireOlS1B1_C "assigned fault type / Fault type assignment for check DFC_UegoHeatrWireOlS1B1" VALUE 0x805048E7 Val_Wu8 255.0 DFES_OneToOne 0.00 255.0 FORMAT "%5.1" /end CHARACTERISTIC
/begin CHARACTERISTIC DFES_FaultTyp.DFC_UegoHeatrWireScbS1B1_C "assigned fault type / Fault type assignment for check DFC_UegoHeatrWireScbS1B1" VALUE 0x805048E8 Val_Wu8 255.0 DFES_OneToOne 0.00 255.0 FORMAT "%5.1" /end CHARACTERISTIC
/begin CHARACTERISTIC DFES_FaultTyp.DFC_UegoHeatrWireScgS1B1_C "assigned fault type / Fault type assignment for check DFC_UegoHeatrWireScgS1B1" VALUE 0x805048E9 Val_Wu8 255.0 DFES_OneToOne 0.00 255.0 FORMAT "%5.1" /end CHARACTERISTIC
/begin CHARACTERISTIC DFES_FaultTyp.DFC_KnDetSens1PortAMax_C "assigned fault type / Fault type assignment for check DFC_KnDetSens1PortAMax" VALUE 0x805048EA Val_Wu8 255.0 DFES_OneToOne 0.00 255.0 FORMAT "%5.1" /end CHARACTERISTIC
/begin CHARACTERISTIC DFES_FaultTyp.DFC_KnDetSens1PortAMin_C "assigned fault type / Fault type assignment for check DFC_KnDetSens1PortAMin" VALUE 0x805048EB Val_Wu8 255.0 DFES_OneToOne 0.00 255.0 FORMAT "%5.1" /end CHARACTERISTIC
/begin CHARACTERISTIC DFES_FaultTyp.DFC_KnDetSens1PortBMax_C "assigned fault type / Fault type assignment for check DFC_KnDetSens1PortBMax" VALUE 0x805048EC Val_Wu8 255.0 DFES_OneToOne 0.00 255.0 FORMAT "%5.1" /end CHARACTERISTIC
/begin CHARACTERISTIC DFES_FaultTyp.DFC_KnDetSens1PortBMin_C "assigned fault type / Fault type assignment for check DFC_KnDetSens1PortBMin" VALUE 0x805048ED Val_Wu8 255.0 DFES_OneToOne 0.00 255.0 FORMAT "%5.1" /end CHARACTERISTIC
/begin CHARACTERISTIC DFES_FaultTyp.DFC_Clth2ONStuck_C "assigned fault type / Fault type assignment for check DFC_Clth2ONStuck" VALUE 0x805048EE Val_Wu8 255.0 DFES_OneToOne 0.00 255.0 FORMAT "%5.1" /end CHARACTERISTIC
/begin CHARACTERISTIC DFES_FaultTyp.DFC_Clth2ONStuckLdc_C "assigned fault type / Fault type assignment for check DFC_Clth2ONStuckLdc" VALUE 0x805048EF Val_Wu8 255.0 DFES_OneToOne 0.00 255.0 FORMAT "%5.1" /end CHARACTERISTIC
/begin CHARACTERISTIC DFES_FaultTyp.DFC_Clth3ONStuckLdc_C "assigned fault type / Fault type assignment for check DFC_Clth3ONStuckLdc" VALUE 0x805048F0 Val_Wu8 255.0 DFES_OneToOne 0.00 255.0 FORMAT "%5.1" /end CHARACTERISTIC
/begin CHARACTERISTIC DFES_FaultTyp.DFC_Clth3ONStuckPostDrv_C "assigned fault type / Fault type assignment for check DFC_Clth3ONStuckPostDrv" VALUE 0x805048F1 Val_Wu8 255.0 DFES_OneToOne 0.00 255.0 FORMAT "%5.1" /end CHARACTERISTIC
/begin CHARACTERISTIC DFES_FaultTyp.DFC_Clth4ONStuck_C "assigned fault type / Fault type assignment for check DFC_Clth4ONStuck" VALUE 0x805048F2 Val_Wu8 255.0 DFES_OneToOne 0.00 255.0 FORMAT "%5.1" /end CHARACTERISTIC
/begin CHARACTERISTIC DFES_FaultTyp.DFC_Clth4ONStuckLdc_C "assigned fault type / Fault type assignment for check DFC_Clth4ONStuckLdc" VALUE 0x805048F3 Val_Wu8 255.0 DFES_OneToOne 0.00 255.0 FORMAT "%5.1" /end CHARACTERISTIC
/begin CHARACTERISTIC DFES_FaultTyp.DFC_ComBCMUnit_C "assigned fault type / Fault type assignment for check DFC_ComBCMUnit" VALUE 0x805048F4 Val_Wu8 255.0 DFES_OneToOne 0.00 255.0 FORMAT "%5.1" /end CHARACTERISTIC
/begin CHARACTERISTIC DFES_FaultTyp.DFC_ComDLCTCU01_C "assigned fault type / Fault type assignment for check DFC_ComDLCTCU01" VALUE 0x805048F5 Val_Wu8 255.0 DFES_OneToOne 0.00 255.0 FORMAT "%5.1" /end CHARACTERISTIC
/begin CHARACTERISTIC DFES_FaultTyp.DFC_ComDLCTCU02_C "assigned fault type / Fault type assignment for check DFC_ComDLCTCU02" VALUE 0x805048F6 Val_Wu8 255.0 DFES_OneToOne 0.00 255.0 FORMAT "%5.1" /end CHARACTERISTIC
/begin CHARACTERISTIC DFES_FaultTyp.DFC_ComDLCTCU1_C "assigned fault type / Fault type assignment for check DFC_ComDLCTCU1" VALUE 0x805048F7 Val_Wu8 255.0 DFES_OneToOne 0.00 255.0 FORMAT "%5.1" /end CHARACTERISTIC
/begin CHARACTERISTIC DFES_FaultTyp.DFC_ComDLCTCU11_C "assigned fault type / Fault type assignment for check DFC_ComDLCTCU11" VALUE 0x805048F8 Val_Wu8 255.0 DFES_OneToOne 0.00 255.0 FORMAT "%5.1" /end CHARACTERISTIC
/begin CHARACTERISTIC DFES_FaultTyp.DFC_ComDLCTCU12_C "assigned fault type / Fault type assignment for check DFC_ComDLCTCU12" VALUE 0x805048F9 Val_Wu8 255.0 DFES_OneToOne 0.00 255.0 FORMAT "%5.1" /end CHARACTERISTIC
/begin CHARACTERISTIC DFES_FaultTyp.DFC_ComDLCTCU13_C "assigned fault type / Fault type assignment for check DFC_ComDLCTCU13" VALUE 0x805048FA Val_Wu8 255.0 DFES_OneToOne 0.00 255.0 FORMAT "%5.1" /end CHARACTERISTIC
/begin CHARACTERISTIC DFES_FaultTyp.DFC_ComDLCTCU14_C "assigned fault type / Fault type assignment for check DFC_ComDLCTCU14" VALUE 0x805048FB Val_Wu8 255.0 DFES_OneToOne 0.00 255.0 FORMAT "%5.1" /end CHARACTERISTIC
/begin CHARACTERISTIC DFES_FaultTyp.DFC_ComDLCTCU2_C "assigned fault type / Fault type assignment for check DFC_ComDLCTCU2" VALUE 0x805048FC Val_Wu8 255.0 DFES_OneToOne 0.00 255.0 FORMAT "%5.1" /end CHARACTERISTIC
/begin CHARACTERISTIC DFES_FaultTyp.DFC_ComDLCTCU3_C "assigned fault type / Fault type assignment for check DFC_ComDLCTCU3" VALUE 0x805048FD Val_Wu8 255.0 DFES_OneToOne 0.00 255.0 FORMAT "%5.1" /end CHARACTERISTIC
/begin CHARACTERISTIC DFES_FaultTyp.DFC_ComDLCTCU4_C "assigned fault type / Fault type assignment for check DFC_ComDLCTCU4" VALUE 0x805048FE Val_Wu8 255.0 DFES_OneToOne 0.00 255.0 FORMAT "%5.1" /end CHARACTERISTIC
/begin CHARACTERISTIC DFES_FaultTyp.DFC_ComEPSUnit_C "assigned fault type / Fault type assignment for check DFC_ComEPSUnit" VALUE 0x805048FF Val_Wu8 255.0 DFES_OneToOne 0.00 255.0 FORMAT "%5.1" /end CHARACTERISTIC
/begin CHARACTERISTIC DFES_FaultTyp.DFC_ComIDASBUnit_C "assigned fault type / Fault type assignment for check DFC_ComIDASBUnit" VALUE 0x80504900 Val_Wu8 255.0 DFES_OneToOne 0.00 255.0 FORMAT "%5.1" /end CHARACTERISTIC
/begin CHARACTERISTIC DFES_FaultTyp.DFC_ComIMGUnit_C "assigned fault type / Fault type assignment for check DFC_ComIMGUnit" VALUE 0x80504901 Val_Wu8 255.0 DFES_OneToOne 0.00 255.0 FORMAT "%5.1" /end CHARACTERISTIC
/begin CHARACTERISTIC DFES_FaultTyp.DFC_ComMETUnit_C "assigned fault type / Fault type assignment for check DFC_ComMETUnit" VALUE 0x80504902 Val_Wu8 255.0 DFES_OneToOne 0.00 255.0 FORMAT "%5.1" /end CHARACTERISTIC
/begin CHARACTERISTIC DFES_FaultTyp.DFC_ComSRSUnit_C "assigned fault type / Fault type assignment for check DFC_ComSRSUnit" VALUE 0x80504903 Val_Wu8 255.0 DFES_OneToOne 0.00 255.0 FORMAT "%5.1" /end CHARACTERISTIC
/begin CHARACTERISTIC DFES_FaultTyp.DFC_ComVSAUnit_C "assigned fault type / Fault type assignment for check DFC_ComVSAUnit" VALUE 0x80504904 Val_Wu8 255.0 DFES_OneToOne 0.00 255.0 FORMAT "%5.1" /end CHARACTERISTIC
/begin CHARACTERISTIC DFES_FaultTyp.DFC_EbsSocFlt_C "assigned fault type / Fault type assignment for check DFC_EbsSocFlt" VALUE 0x80504905 Val_Wu8 255.0 DFES_OneToOne 0.00 255.0 FORMAT "%5.1" /end CHARACTERISTIC
/begin CHARACTERISTIC DFES_FaultTyp.DFC_I14229VINErr_C "assigned fault type / Fault type assignment for check DFC_I14229VINErr" VALUE 0x80504906 Val_Wu8 255.0 DFES_OneToOne 0.00 255.0 FORMAT "%5.1" /end CHARACTERISTIC
/begin CHARACTERISTIC DFES_FaultTyp.DFC_InjCatHeatgErr_C "assigned fault type / Fault type assignment for check DFC_InjCatHeatgErr" VALUE 0x80504907 Val_Wu8 255.0 DFES_OneToOne 0.00 255.0 FORMAT "%5.1" /end CHARACTERISTIC
/begin CHARACTERISTIC DFES_FaultTyp.DFC_InjSysMulInjDiagErr_C "assigned fault type / Fault type assignment for check DFC_InjSysMulInjDiagErr" VALUE 0x80504908 Val_Wu8 255.0 DFES_OneToOne 0.00 255.0 FORMAT "%5.1" /end CHARACTERISTIC
/begin CHARACTERISTIC DFES_FaultTyp.DFC_LLRHmax_C "assigned fault type / Fault type assignment for check DFC_LLRHmax" VALUE 0x80504909 Val_Wu8 255.0 DFES_OneToOne 0.00 255.0 FORMAT "%5.1" /end CHARACTERISTIC
/begin CHARACTERISTIC DFES_FaultTyp.DFC_LLRHmin_C "assigned fault type / Fault type assignment for check DFC_LLRHmin" VALUE 0x8050490A Val_Wu8 255.0 DFES_OneToOne 0.00 255.0 FORMAT "%5.1" /end CHARACTERISTIC
/begin CHARACTERISTIC DFES_FaultTyp.DFC_LLRHnpl_C "assigned fault type / Fault type assignment for check DFC_LLRHnpl" VALUE 0x8050490B Val_Wu8 255.0 DFES_OneToOne 0.00 255.0 FORMAT "%5.1" /end CHARACTERISTIC
/begin CHARACTERISTIC DFES_FaultTyp.DFC_LLRKHmax_C "assigned fault type / Fault type assignment for check DFC_LLRKHmax" VALUE 0x8050490C Val_Wu8 255.0 DFES_OneToOne 0.00 255.0 FORMAT "%5.1" /end CHARACTERISTIC
/begin CHARACTERISTIC DFES_FaultTyp.DFC_LLRKHmin_C "assigned fault type / Fault type assignment for check DFC_LLRKHmin" VALUE 0x8050490D Val_Wu8 255.0 DFES_OneToOne 0.00 255.0 FORMAT "%5.1" /end CHARACTERISTIC
/begin CHARACTERISTIC DFES_FaultTyp.DFC_LLRKHnpl_C "assigned fault type / Fault type assignment for check DFC_LLRKHnpl" VALUE 0x8050490E Val_Wu8 255.0 DFES_OneToOne 0.00 255.0 FORMAT "%5.1" /end CHARACTERISTIC
/begin CHARACTERISTIC DFES_FaultTyp.DFC_LinACGUnit_C "assigned fault type / Fault type assignment for check DFC_LinACGUnit" VALUE 0x8050490F Val_Wu8 255.0 DFES_OneToOne 0.00 255.0 FORMAT "%5.1" /end CHARACTERISTIC
/begin CHARACTERISTIC DFES_FaultTyp.DFC_LinAEVUnit_C "assigned fault type / Fault type assignment for check DFC_LinAEVUnit" VALUE 0x80504910 Val_Wu8 255.0 DFES_OneToOne 0.00 255.0 FORMAT "%5.1" /end CHARACTERISTIC
/begin CHARACTERISTIC DFES_FaultTyp.DFC_LinEBSUnit_C "assigned fault type / Fault type assignment for check DFC_LinEBSUnit" VALUE 0x80504911 Val_Wu8 255.0 DFES_OneToOne 0.00 255.0 FORMAT "%5.1" /end CHARACTERISTIC
/begin CHARACTERISTIC DFES_FaultTyp.DFC_RoughRoad_C "assigned fault type / Fault type assignment for check DFC_RoughRoad" VALUE 0x80504912 Val_Wu8 255.0 DFES_OneToOne 0.00 255.0 FORMAT "%5.1" /end CHARACTERISTIC
/begin CHARACTERISTIC DFES_FaultTyp.DFC_SiaEEPRdErr_C "assigned fault type / Fault type assignment for check DFC_SiaEEPRdErr" VALUE 0x80504913 Val_Wu8 255.0 DFES_OneToOne 0.00 255.0 FORMAT "%5.1" /end CHARACTERISTIC
/begin CHARACTERISTIC DFES_FaultTyp.DFC_SiaEEPWrngCod_C "assigned fault type / Fault type assignment for check DFC_SiaEEPWrngCod" VALUE 0x80504914 Val_Wu8 255.0 DFES_OneToOne 0.00 255.0 FORMAT "%5.1" /end CHARACTERISTIC
/begin CHARACTERISTIC DFES_FaultTyp.DFC_UegoHeatrStrtS1B1_C "assigned fault type / Fault type assignment for check DFC_UegoHeatrStrtS1B1" VALUE 0x80504915 Val_Wu8 255.0 DFES_OneToOne 0.00 255.0 FORMAT "%5.1" /end CHARACTERISTIC
/begin CHARACTERISTIC DFES_FaultTyp.DFC_BusDiagCANAPPLBusOff_C "assigned fault type / Fault type assignment for check DFC_BusDiagCANAPPLBusOff" VALUE 0x80504916 Val_Wu8 255.0 DFES_OneToOne 0.00 255.0 FORMAT "%5.1" /end CHARACTERISTIC
/begin CHARACTERISTIC DFES_FaultTyp.DFC_BusDiagCANCANCBusOff_C "assigned fault type / Fault type assignment for check DFC_BusDiagCANCANCBusOff" VALUE 0x80504917 Val_Wu8 255.0 DFES_OneToOne 0.00 255.0 FORMAT "%5.1" /end CHARACTERISTIC
/begin CHARACTERISTIC DFES_FaultTyp.DFC_BusDiagCANVEHICLEBusOff_C "assigned fault type / Fault type assignment for check DFC_BusDiagCANVEHICLEBusOff" VALUE 0x80504918 Val_Wu8 255.0 DFES_OneToOne 0.00 255.0 FORMAT "%5.1" /end CHARACTERISTIC
/begin CHARACTERISTIC DFES_FaultTyp.DFC_RBA_IODIAGPWR_rba_IoExtCy329_SignalVltSply_0_C "assigned fault type / Fault type assignment for check DFC_RBA_IODIAGPWR_rba_IoExtCy329_SignalVltSply_0" VALUE 0x80504919 Val_Wu8 255.0 DFES_OneToOne 0.00 255.0 FORMAT "%5.1" /end CHARACTERISTIC
/begin CHARACTERISTIC DFES_FaultTyp.DFC_RBA_IODIAGPWR_rba_IoExtCy329_SignalVltSply_0OT_C "assigned fault type / Fault type assignment for check DFC_RBA_IODIAGPWR_rba_IoExtCy329_SignalVltSply_0OT" VALUE 0x8050491A Val_Wu8 255.0 DFES_OneToOne 0.00 255.0 FORMAT "%5.1" /end CHARACTERISTIC
/begin CHARACTERISTIC DFES_FaultTyp.DFC_RBA_IODIAGPWR_rba_IoExtCy329_SignalVltSply_0OV_C "assigned fault type / Fault type assignment for check DFC_RBA_IODIAGPWR_rba_IoExtCy329_SignalVltSply_0OV" VALUE 0x8050491B Val_Wu8 255.0 DFES_OneToOne 0.00 255.0 FORMAT "%5.1" /end CHARACTERISTIC
/begin CHARACTERISTIC DFES_FaultTyp.DFC_RBA_IODIAGPWR_rba_IoExtCy329_SignalVltSply_0SCG_C "assigned fault type / Fault type assignment for check DFC_RBA_IODIAGPWR_rba_IoExtCy329_SignalVltSply_0SCG" VALUE 0x8050491C Val_Wu8 255.0 DFES_OneToOne 0.00 255.0 FORMAT "%5.1" /end CHARACTERISTIC
/begin CHARACTERISTIC DFES_FaultTyp.DFC_RBA_IODIAGPWR_rba_IoExtCy329_SignalVltSply_0UV_C "assigned fault type / Fault type assignment for check DFC_RBA_IODIAGPWR_rba_IoExtCy329_SignalVltSply_0UV" VALUE 0x8050491D Val_Wu8 255.0 DFES_OneToOne 0.00 255.0 FORMAT "%5.1" /end CHARACTERISTIC
/begin CHARACTERISTIC DFES_FaultTyp.DFC_RBA_IODIAGPWR_rba_IoExtCy329_SignalVltSply_1_C "assigned fault type / Fault type assignment for check DFC_RBA_IODIAGPWR_rba_IoExtCy329_SignalVltSply_1" VALUE 0x8050491E Val_Wu8 255.0 DFES_OneToOne 0.00 255.0 FORMAT "%5.1" /end CHARACTERISTIC
/begin CHARACTERISTIC DFES_FaultTyp.DFC_RBA_IODIAGPWR_rba_IoExtCy329_SignalVltSply_1OT_C "assigned fault type / Fault type assignment for check DFC_RBA_IODIAGPWR_rba_IoExtCy329_SignalVltSply_1OT" VALUE 0x8050491F Val_Wu8 255.0 DFES_OneToOne 0.00 255.0 FORMAT "%5.1" /end CHARACTERISTIC
/begin CHARACTERISTIC DFES_FaultTyp.DFC_RBA_IODIAGPWR_rba_IoExtCy329_SignalVltSply_1OV_C "assigned fault type / Fault type assignment for check DFC_RBA_IODIAGPWR_rba_IoExtCy329_SignalVltSply_1OV" VALUE 0x80504920 Val_Wu8 255.0 DFES_OneToOne 0.00 255.0 FORMAT "%5.1" /end CHARACTERISTIC
/begin CHARACTERISTIC DFES_FaultTyp.DFC_RBA_IODIAGPWR_rba_IoExtCy329_SignalVltSply_1SCG_C "assigned fault type / Fault type assignment for check DFC_RBA_IODIAGPWR_rba_IoExtCy329_SignalVltSply_1SCG" VALUE 0x80504921 Val_Wu8 255.0 DFES_OneToOne 0.00 255.0 FORMAT "%5.1" /end CHARACTERISTIC
/begin CHARACTERISTIC DFES_FaultTyp.DFC_RBA_IODIAGPWR_rba_IoExtCy329_SignalVltSply_1UV_C "assigned fault type / Fault type assignment for check DFC_RBA_IODIAGPWR_rba_IoExtCy329_SignalVltSply_1UV" VALUE 0x80504922 Val_Wu8 255.0 DFES_OneToOne 0.00 255.0 FORMAT "%5.1" /end CHARACTERISTIC
/begin CHARACTERISTIC DFES_FaultTyp.DFC_RBA_IODIAGPWR_rba_IoExtCy329_SignalVltSply_2_C "assigned fault type / Fault type assignment for check DFC_RBA_IODIAGPWR_rba_IoExtCy329_SignalVltSply_2" VALUE 0x80504923 Val_Wu8 255.0 DFES_OneToOne 0.00 255.0 FORMAT "%5.1" /end CHARACTERISTIC
/begin CHARACTERISTIC DFES_FaultTyp.DFC_RBA_IODIAGPWR_rba_IoExtCy329_SignalVltSply_2OT_C "assigned fault type / Fault type assignment for check DFC_RBA_IODIAGPWR_rba_IoExtCy329_SignalVltSply_2OT" VALUE 0x80504924 Val_Wu8 255.0 DFES_OneToOne 0.00 255.0 FORMAT "%5.1" /end CHARACTERISTIC
/begin CHARACTERISTIC DFES_FaultTyp.DFC_RBA_IODIAGPWR_rba_IoExtCy329_SignalVltSply_2OV_C "assigned fault type / Fault type assignment for check DFC_RBA_IODIAGPWR_rba_IoExtCy329_SignalVltSply_2OV" VALUE 0x80504925 Val_Wu8 255.0 DFES_OneToOne 0.00 255.0 FORMAT "%5.1" /end CHARACTERISTIC
/begin CHARACTERISTIC DFES_FaultTyp.DFC_RBA_IODIAGPWR_rba_IoExtCy329_SignalVltSply_2SCG_C "assigned fault type / Fault type assignment for check DFC_RBA_IODIAGPWR_rba_IoExtCy329_SignalVltSply_2SCG" VALUE 0x80504926 Val_Wu8 255.0 DFES_OneToOne 0.00 255.0 FORMAT "%5.1" /end CHARACTERISTIC
/begin CHARACTERISTIC DFES_FaultTyp.DFC_RBA_IODIAGPWR_rba_IoExtCy329_SignalVltSply_2UV_C "assigned fault type / Fault type assignment for check DFC_RBA_IODIAGPWR_rba_IoExtCy329_SignalVltSply_2UV" VALUE 0x80504927 Val_Wu8 255.0 DFES_OneToOne 0.00 255.0 FORMAT "%5.1" /end CHARACTERISTIC
/begin CHARACTERISTIC DFES_FaultTyp.DFC_CAN_E_TIMEOUT_C "assigned fault type / Fault type assignment for check DFC_CAN_E_TIMEOUT" VALUE 0x80504928 Val_Wu8 255.0 DFES_OneToOne 0.00 255.0 FORMAT "%5.1" /end CHARACTERISTIC
/begin CHARACTERISTIC DFES_FaultTyp.DFC_LIN_E_TIMEOUT_C "assigned fault type / Fault type assignment for check DFC_LIN_E_TIMEOUT" VALUE 0x80504929 Val_Wu8 255.0 DFES_OneToOne 0.00 255.0 FORMAT "%5.1" /end CHARACTERISTIC
/begin CHARACTERISTIC DFES_FaultTyp.DFC_MRlyOL_C "assigned fault type / Fault type assignment for check DFC_MRlyOL" VALUE 0x8050492A Val_Wu8 255.0 DFES_OneToOne 0.00 255.0 FORMAT "%5.1" /end CHARACTERISTIC
/begin CHARACTERISTIC DFES_FaultTyp.DFC_MRlySCB_C "assigned fault type / Fault type assignment for check DFC_MRlySCB" VALUE 0x8050492B Val_Wu8 255.0 DFES_OneToOne 0.00 255.0 FORMAT "%5.1" /end CHARACTERISTIC
/begin CHARACTERISTIC DFES_FaultTyp.DFC_MRlySCG_C "assigned fault type / Fault type assignment for check DFC_MRlySCG" VALUE 0x8050492C Val_Wu8 255.0 DFES_OneToOne 0.00 255.0 FORMAT "%5.1" /end CHARACTERISTIC
/begin CHARACTERISTIC DFES_FaultTyp.DFC_rba_MultiStackTrace_Threshold_C "assigned fault type / Fault type assignment for check DFC_rba_MultiStackTrace_Threshold" VALUE 0x8050492D Val_Wu8 255.0 DFES_OneToOne 0.00 255.0 FORMAT "%5.1" /end CHARACTERISTIC
/begin CHARACTERISTIC DFES_FaultTyp.DFC_BSWM_E_ACTION_FAILED_C "assigned fault type / Fault type assignment for check DFC_BSWM_E_ACTION_FAILED" VALUE 0x8050492E Val_Wu8 255.0 DFES_OneToOne 0.00 255.0 FORMAT "%5.1" /end CHARACTERISTIC
/begin CHARACTERISTIC DFES_FaultTyp.DFC_BSWM_E_INTRPTQUEUE_FULL_C "assigned fault type / Fault type assignment for check DFC_BSWM_E_INTRPTQUEUE_FULL" VALUE 0x8050492F Val_Wu8 255.0 DFES_OneToOne 0.00 255.0 FORMAT "%5.1" /end CHARACTERISTIC
/begin CHARACTERISTIC DFES_FaultTyp.DFC_RBA_IOEXTLIB_KEEPALIVE_DRV_C "assigned fault type / Fault type assignment for check DFC_RBA_IOEXTLIB_KEEPALIVE_DRV" VALUE 0x80504930 Val_Wu8 255.0 DFES_OneToOne 0.00 255.0 FORMAT "%5.1" /end CHARACTERISTIC
/begin CHARACTERISTIC DFES_FaultTyp.DFC_RBA_IOEXTLIB_KEEPALIVE_INI_C "assigned fault type / Fault type assignment for check DFC_RBA_IOEXTLIB_KEEPALIVE_INI" VALUE 0x80504931 Val_Wu8 255.0 DFES_OneToOne 0.00 255.0 FORMAT "%5.1" /end CHARACTERISTIC
/begin CHARACTERISTIC DFES_FaultTyp.DFC_rba_IoSigRtc_StopCounter_C "assigned fault type / Fault type assignment for check DFC_rba_IoSigRtc_StopCounter" VALUE 0x80504932 Val_Wu8 255.0 DFES_OneToOne 0.00 255.0 FORMAT "%5.1" /end CHARACTERISTIC
/begin CHARACTERISTIC DFES_FaultTyp.DFC_rba_MRly_Diag_Stk_Event_C "assigned fault type / Fault type assignment for check DFC_rba_MRly_Diag_Stk_Event" VALUE 0x80504933 Val_Wu8 255.0 DFES_OneToOne 0.00 255.0 FORMAT "%5.1" /end CHARACTERISTIC
/begin CHARACTERISTIC DFES_FaultTyp.DFC_rba_MemDiag_MemReadErr_C "assigned fault type / Fault type assignment for check DFC_rba_MemDiag_MemReadErr" VALUE 0x80504934 Val_Wu8 255.0 DFES_OneToOne 0.00 255.0 FORMAT "%5.1" /end CHARACTERISTIC
/begin CHARACTERISTIC DFES_FaultTyp.DFC_rba_MemDiag_MemWrErr_C "assigned fault type / Fault type assignment for check DFC_rba_MemDiag_MemWrErr" VALUE 0x80504935 Val_Wu8 255.0 DFES_OneToOne 0.00 255.0 FORMAT "%5.1" /end CHARACTERISTIC
/begin CHARACTERISTIC DFES_FaultTyp.DFC_rba_SyC_IrrSwOffTrigEngRun_Event_C "assigned fault type / Fault type assignment for check DFC_rba_SyC_IrrSwOffTrigEngRun_Event" VALUE 0x80504936 Val_Wu8 255.0 DFES_OneToOne 0.00 255.0 FORMAT "%5.1" /end CHARACTERISTIC
/begin CHARACTERISTIC DFES_FaultTyp.DFC_rba_T15_Diag_ComInVld_Event_C "assigned fault type / Fault type assignment for check DFC_rba_T15_Diag_ComInVld_Event" VALUE 0x80504937 Val_Wu8 255.0 DFES_OneToOne 0.00 255.0 FORMAT "%5.1" /end CHARACTERISTIC
/begin CHARACTERISTIC DFES_FaultTyp.DFC_rba_T15_Diag_ComOff_HwOn_Event_C "assigned fault type / Fault type assignment for check DFC_rba_T15_Diag_ComOff_HwOn_Event" VALUE 0x80504938 Val_Wu8 255.0 DFES_OneToOne 0.00 255.0 FORMAT "%5.1" /end CHARACTERISTIC
/begin CHARACTERISTIC DFES_FaultTyp.DFC_rba_T15_Diag_ComOn_HwOff_Event_C "assigned fault type / Fault type assignment for check DFC_rba_T15_Diag_ComOn_HwOff_Event" VALUE 0x80504939 Val_Wu8 255.0 DFES_OneToOne 0.00 255.0 FORMAT "%5.1" /end CHARACTERISTIC
/begin CHARACTERISTIC DFES_FaultTyp.DFC_AAVmin_C "assigned fault type / Fault type assignment for check DFC_AAVmin" VALUE 0x8050493A Val_Wu8 255.0 DFES_OneToOne 0.00 255.0 FORMAT "%5.1" /end CHARACTERISTIC
/begin CHARACTERISTIC DFES_FaultTyp.DFC_AGRSUS_C "assigned fault type / Fault type assignment for check DFC_AGRSUS" VALUE 0x8050493B Val_Wu8 255.0 DFES_OneToOne 0.00 255.0 FORMAT "%5.1" /end CHARACTERISTIC
/begin CHARACTERISTIC DFES_FaultTyp.DFC_AfsPlausDiagHi_C "assigned fault type / Fault type assignment for check DFC_AfsPlausDiagHi" VALUE 0x8050493C Val_Wu8 255.0 DFES_OneToOne 0.00 255.0 FORMAT "%5.1" /end CHARACTERISTIC
/begin CHARACTERISTIC DFES_FaultTyp.DFC_AfsPlausDiagLo_C "assigned fault type / Fault type assignment for check DFC_AfsPlausDiagLo" VALUE 0x8050493D Val_Wu8 255.0 DFES_OneToOne 0.00 255.0 FORMAT "%5.1" /end CHARACTERISTIC
/begin CHARACTERISTIC DFES_FaultTyp.DFC_AfsVrntDiagErrB1_C "assigned fault type / Fault type assignment for check DFC_AfsVrntDiagErrB1" VALUE 0x8050493E Val_Wu8 255.0 DFES_OneToOne 0.00 255.0 FORMAT "%5.1" /end CHARACTERISTIC
/begin CHARACTERISTIC DFES_FaultTyp.DFC_AppAllSnsrDfct_C "assigned fault type / Fault type assignment for check DFC_AppAllSnsrDfct" VALUE 0x8050493F Val_Wu8 255.0 DFES_OneToOne 0.00 255.0 FORMAT "%5.1" /end CHARACTERISTIC
/begin CHARACTERISTIC DFES_FaultTyp.DFC_BBKRnldg_C "assigned fault type / Fault type assignment for check DFC_BBKRnldg" VALUE 0x80504940 Val_Wu8 255.0 DFES_OneToOne 0.00 255.0 FORMAT "%5.1" /end CHARACTERISTIC
/begin CHARACTERISTIC DFES_FaultTyp.DFC_BBKRsyne_C "assigned fault type / Fault type assignment for check DFC_BBKRsyne" VALUE 0x80504941 Val_Wu8 255.0 DFES_OneToOne 0.00 255.0 FORMAT "%5.1" /end CHARACTERISTIC
/begin CHARACTERISTIC DFES_FaultTyp.DFC_BattUStdbyDiaOL_C "assigned fault type / Fault type assignment for check DFC_BattUStdbyDiaOL" VALUE 0x80504942 Val_Wu8 255.0 DFES_OneToOne 0.00 255.0 FORMAT "%5.1" /end CHARACTERISTIC
/begin CHARACTERISTIC DFES_FaultTyp.DFC_BigLeakIntkMnfldEmiInfl_C "assigned fault type / Fault type assignment for check DFC_BigLeakIntkMnfldEmiInfl" VALUE 0x80504943 Val_Wu8 255.0 DFES_OneToOne 0.00 255.0 FORMAT "%5.1" /end CHARACTERISTIC
/begin CHARACTERISTIC DFES_FaultTyp.DFC_BlkdLineTank_C "assigned fault type / Fault type assignment for check DFC_BlkdLineTank" VALUE 0x80504944 Val_Wu8 255.0 DFES_OneToOne 0.00 255.0 FORMAT "%5.1" /end CHARACTERISTIC
/begin CHARACTERISTIC DFES_FaultTyp.DFC_BrkMnSwtContOnWarnLmp_C "assigned fault type / Fault type assignment for check DFC_BrkMnSwtContOnWarnLmp" VALUE 0x80504945 Val_Wu8 255.0 DFES_OneToOne 0.00 255.0 FORMAT "%5.1" /end CHARACTERISTIC
/begin CHARACTERISTIC DFES_FaultTyp.DFC_BrkMnSwtNotStpWarnLmp_C "assigned fault type / Fault type assignment for check DFC_BrkMnSwtNotStpWarnLmp" VALUE 0x80504946 Val_Wu8 255.0 DFES_OneToOne 0.00 255.0 FORMAT "%5.1" /end CHARACTERISTIC
/begin CHARACTERISTIC DFES_FaultTyp.DFC_BrkRdntSwtContOnWarnLmp_C "assigned fault type / Fault type assignment for check DFC_BrkRdntSwtContOnWarnLmp" VALUE 0x80504947 Val_Wu8 255.0 DFES_OneToOne 0.00 255.0 FORMAT "%5.1" /end CHARACTERISTIC
/begin CHARACTERISTIC DFES_FaultTyp.DFC_BrkRdntSwtNotStpWarnLmp_C "assigned fault type / Fault type assignment for check DFC_BrkRdntSwtNotStpWarnLmp" VALUE 0x80504948 Val_Wu8 255.0 DFES_OneToOne 0.00 255.0 FORMAT "%5.1" /end CHARACTERISTIC
/begin CHARACTERISTIC DFES_FaultTyp.DFC_CEngDsTColdStrtMax_C "assigned fault type / Fault type assignment for check DFC_CEngDsTColdStrtMax" VALUE 0x80504949 Val_Wu8 255.0 DFES_OneToOne 0.00 255.0 FORMAT "%5.1" /end CHARACTERISTIC
/begin CHARACTERISTIC DFES_FaultTyp.DFC_CEngDsTColdStrtMin_C "assigned fault type / Fault type assignment for check DFC_CEngDsTColdStrtMin" VALUE 0x8050494A Val_Wu8 255.0 DFES_OneToOne 0.00 255.0 FORMAT "%5.1" /end CHARACTERISTIC
/begin CHARACTERISTIC DFES_FaultTyp.DFC_CEngDsTImps_C "assigned fault type / Fault type assignment for check DFC_CEngDsTImps" VALUE 0x8050494B Val_Wu8 255.0 DFES_OneToOne 0.00 255.0 FORMAT "%5.1" /end CHARACTERISTIC
/begin CHARACTERISTIC DFES_FaultTyp.DFC_CEngDsTPlausHSC_C "assigned fault type / Fault type assignment for check DFC_CEngDsTPlausHSC" VALUE 0x8050494C Val_Wu8 255.0 DFES_OneToOne 0.00 255.0 FORMAT "%5.1" /end CHARACTERISTIC
/begin CHARACTERISTIC DFES_FaultTyp.DFC_CEngDsTPlausLSC_C "assigned fault type / Fault type assignment for check DFC_CEngDsTPlausLSC" VALUE 0x8050494D Val_Wu8 255.0 DFES_OneToOne 0.00 255.0 FORMAT "%5.1" /end CHARACTERISTIC
/begin CHARACTERISTIC DFES_FaultTyp.DFC_CEngDsTPlausSTC_C "assigned fault type / Fault type assignment for check DFC_CEngDsTPlausSTC" VALUE 0x8050494E Val_Wu8 255.0 DFES_OneToOne 0.00 255.0 FORMAT "%5.1" /end CHARACTERISTIC
/begin CHARACTERISTIC DFES_FaultTyp.DFC_CEngDsTSRCMax_C "assigned fault type / Fault type assignment for check DFC_CEngDsTSRCMax" VALUE 0x8050494F Val_Wu8 255.0 DFES_OneToOne 0.00 255.0 FORMAT "%5.1" /end CHARACTERISTIC
/begin CHARACTERISTIC DFES_FaultTyp.DFC_CEngDsTSRCMin_C "assigned fault type / Fault type assignment for check DFC_CEngDsTSRCMin" VALUE 0x80504950 Val_Wu8 255.0 DFES_OneToOne 0.00 255.0 FORMAT "%5.1" /end CHARACTERISTIC
/begin CHARACTERISTIC DFES_FaultTyp.DFC_CEngDsTSig_C "assigned fault type / Fault type assignment for check DFC_CEngDsTSig" VALUE 0x80504951 Val_Wu8 255.0 DFES_OneToOne 0.00 255.0 FORMAT "%5.1" /end CHARACTERISTIC
/begin CHARACTERISTIC DFES_FaultTyp.DFC_CEngUsTColdStrtMax_C "assigned fault type / Fault type assignment for check DFC_CEngUsTColdStrtMax" VALUE 0x80504952 Val_Wu8 255.0 DFES_OneToOne 0.00 255.0 FORMAT "%5.1" /end CHARACTERISTIC
/begin CHARACTERISTIC DFES_FaultTyp.DFC_CEngUsTColdStrtMin_C "assigned fault type / Fault type assignment for check DFC_CEngUsTColdStrtMin" VALUE 0x80504953 Val_Wu8 255.0 DFES_OneToOne 0.00 255.0 FORMAT "%5.1" /end CHARACTERISTIC
/begin CHARACTERISTIC DFES_FaultTyp.DFC_CEngUsTLooseCnctn_C "assigned fault type / Fault type assignment for check DFC_CEngUsTLooseCnctn" VALUE 0x80504954 Val_Wu8 255.0 DFES_OneToOne 0.00 255.0 FORMAT "%5.1" /end CHARACTERISTIC
/begin CHARACTERISTIC DFES_FaultTyp.DFC_CEngUsTSRCMax_C "assigned fault type / Fault type assignment for check DFC_CEngUsTSRCMax" VALUE 0x80504955 Val_Wu8 255.0 DFES_OneToOne 0.00 255.0 FORMAT "%5.1" /end CHARACTERISTIC
/begin CHARACTERISTIC DFES_FaultTyp.DFC_CEngUsTSRCMin_C "assigned fault type / Fault type assignment for check DFC_CEngUsTSRCMin" VALUE 0x80504956 Val_Wu8 255.0 DFES_OneToOne 0.00 255.0 FORMAT "%5.1" /end CHARACTERISTIC
/begin CHARACTERISTIC DFES_FaultTyp.DFC_ComDCDCACCFailr_C "assigned fault type / Fault type assignment for check DFC_ComDCDCACCFailr" VALUE 0x80504957 Val_Wu8 255.0 DFES_OneToOne 0.00 255.0 FORMAT "%5.1" /end CHARACTERISTIC
/begin CHARACTERISTIC DFES_FaultTyp.DFC_DCDCFltDet_C "assigned fault type / Fault type assignment for check DFC_DCDCFltDet" VALUE 0x80504958 Val_Wu8 255.0 DFES_OneToOne 0.00 255.0 FORMAT "%5.1" /end CHARACTERISTIC
/begin CHARACTERISTIC DFES_FaultTyp.DFC_DKRSA_C "assigned fault type / Fault type assignment for check DFC_DKRSA" VALUE 0x80504959 Val_Wu8 255.0 DFES_OneToOne 0.00 255.0 FORMAT "%5.1" /end CHARACTERISTIC
/begin CHARACTERISTIC DFES_FaultTyp.DFC_DKVSmax_C "assigned fault type / Fault type assignment for check DFC_DKVSmax" VALUE 0x8050495A Val_Wu8 255.0 DFES_OneToOne 0.00 255.0 FORMAT "%5.1" /end CHARACTERISTIC
/begin CHARACTERISTIC DFES_FaultTyp.DFC_DKnpl_C "assigned fault type / Fault type assignment for check DFC_DKnpl" VALUE 0x8050495B Val_Wu8 255.0 DFES_OneToOne 0.00 255.0 FORMAT "%5.1" /end CHARACTERISTIC
/begin CHARACTERISTIC DFES_FaultTyp.DFC_DSKVRmax_C "assigned fault type / Fault type assignment for check DFC_DSKVRmax" VALUE 0x8050495C Val_Wu8 255.0 DFES_OneToOne 0.00 255.0 FORMAT "%5.1" /end CHARACTERISTIC
/begin CHARACTERISTIC DFES_FaultTyp.DFC_DSKVRmin_C "assigned fault type / Fault type assignment for check DFC_DSKVRmin" VALUE 0x8050495D Val_Wu8 255.0 DFES_OneToOne 0.00 255.0 FORMAT "%5.1" /end CHARACTERISTIC
/begin CHARACTERISTIC DFES_FaultTyp.DFC_DSKVRnpl_C "assigned fault type / Fault type assignment for check DFC_DSKVRnpl" VALUE 0x8050495E Val_Wu8 255.0 DFES_OneToOne 0.00 255.0 FORMAT "%5.1" /end CHARACTERISTIC
/begin CHARACTERISTIC DFES_FaultTyp.DFC_DSKVRsig_C "assigned fault type / Fault type assignment for check DFC_DSKVRsig" VALUE 0x8050495F Val_Wu8 255.0 DFES_OneToOne 0.00 255.0 FORMAT "%5.1" /end CHARACTERISTIC
/begin CHARACTERISTIC DFES_FaultTyp.DFC_DSKVSsig_C "assigned fault type / Fault type assignment for check DFC_DSKVSsig" VALUE 0x80504960 Val_Wu8 255.0 DFES_OneToOne 0.00 255.0 FORMAT "%5.1" /end CHARACTERISTIC
/begin CHARACTERISTIC DFES_FaultTyp.DFC_DSSmax_C "assigned fault type / Fault type assignment for check DFC_DSSmax" VALUE 0x80504961 Val_Wu8 255.0 DFES_OneToOne 0.00 255.0 FORMAT "%5.1" /end CHARACTERISTIC
/begin CHARACTERISTIC DFES_FaultTyp.DFC_DSTDmax_C "assigned fault type / Fault type assignment for check DFC_DSTDmax" VALUE 0x80504962 Val_Wu8 255.0 DFES_OneToOne 0.00 255.0 FORMAT "%5.1" /end CHARACTERISTIC
/begin CHARACTERISTIC DFES_FaultTyp.DFC_DSTEmax_C "assigned fault type / Fault type assignment for check DFC_DSTEmax" VALUE 0x80504963 Val_Wu8 255.0 DFES_OneToOne 0.00 255.0 FORMAT "%5.1" /end CHARACTERISTIC
/begin CHARACTERISTIC DFES_FaultTyp.DFC_DSTEmin_C "assigned fault type / Fault type assignment for check DFC_DSTEmin" VALUE 0x80504964 Val_Wu8 255.0 DFES_OneToOne 0.00 255.0 FORMAT "%5.1" /end CHARACTERISTIC
/begin CHARACTERISTIC DFES_FaultTyp.DFC_DSTOFmax_C "assigned fault type / Fault type assignment for check DFC_DSTOFmax" VALUE 0x80504965 Val_Wu8 255.0 DFES_OneToOne 0.00 255.0 FORMAT "%5.1" /end CHARACTERISTIC
/begin CHARACTERISTIC DFES_FaultTyp.DFC_DSTRmax_C "assigned fault type / Fault type assignment for check DFC_DSTRmax" VALUE 0x80504966 Val_Wu8 255.0 DFES_OneToOne 0.00 255.0 FORMAT "%5.1" /end CHARACTERISTIC
/begin CHARACTERISTIC DFES_FaultTyp.DFC_DSTRmin_C "assigned fault type / Fault type assignment for check DFC_DSTRmin" VALUE 0x80504967 Val_Wu8 255.0 DFES_OneToOne 0.00 255.0 FORMAT "%5.1" /end CHARACTERISTIC
/begin CHARACTERISTIC DFES_FaultTyp.DFC_DSTRnpl_C "assigned fault type / Fault type assignment for check DFC_DSTRnpl" VALUE 0x80504968 Val_Wu8 255.0 DFES_OneToOne 0.00 255.0 FORMAT "%5.1" /end CHARACTERISTIC
/begin CHARACTERISTIC DFES_FaultTyp.DFC_DSTRsig_C "assigned fault type / Fault type assignment for check DFC_DSTRsig" VALUE 0x80504969 Val_Wu8 255.0 DFES_OneToOne 0.00 255.0 FORMAT "%5.1" /end CHARACTERISTIC
/begin CHARACTERISTIC DFES_FaultTyp.DFC_DSTTI_C "assigned fault type / Fault type assignment for check DFC_DSTTI" VALUE 0x8050496A Val_Wu8 255.0 DFES_OneToOne 0.00 255.0 FORMAT "%5.1" /end CHARACTERISTIC
/begin CHARACTERISTIC DFES_FaultTyp.DFC_DSUmax_C "assigned fault type / Fault type assignment for check DFC_DSUmax" VALUE 0x8050496B Val_Wu8 255.0 DFES_OneToOne 0.00 255.0 FORMAT "%5.1" /end CHARACTERISTIC
/begin CHARACTERISTIC DFES_FaultTyp.DFC_DiagCpv1DteskLoLoadStuckClsd_C "assigned fault type / Fault type assignment for check DFC_DiagCpv1DteskLoLoadStuckClsd" VALUE 0x8050496C Val_Wu8 255.0 DFES_OneToOne 0.00 255.0 FORMAT "%5.1" /end CHARACTERISTIC
/begin CHARACTERISTIC DFES_FaultTyp.DFC_DiagCpv1DteskLoLoadStuckOpen_C "assigned fault type / Fault type assignment for check DFC_DiagCpv1DteskLoLoadStuckOpen" VALUE 0x8050496D Val_Wu8 255.0 DFES_OneToOne 0.00 255.0 FORMAT "%5.1" /end CHARACTERISTIC
/begin CHARACTERISTIC DFES_FaultTyp.DFC_EGRVlvDrftClsd_C "assigned fault type / Fault type assignment for check DFC_EGRVlvDrftClsd" VALUE 0x8050496E Val_Wu8 255.0 DFES_OneToOne 0.00 255.0 FORMAT "%5.1" /end CHARACTERISTIC
/begin CHARACTERISTIC DFES_FaultTyp.DFC_EGRVlvDrftOpn_C "assigned fault type / Fault type assignment for check DFC_EGRVlvDrftOpn" VALUE 0x8050496F Val_Wu8 255.0 DFES_OneToOne 0.00 255.0 FORMAT "%5.1" /end CHARACTERISTIC
/begin CHARACTERISTIC DFES_FaultTyp.DFC_EGRVlvJamVlvClsd_C "assigned fault type / Fault type assignment for check DFC_EGRVlvJamVlvClsd" VALUE 0x80504970 Val_Wu8 255.0 DFES_OneToOne 0.00 255.0 FORMAT "%5.1" /end CHARACTERISTIC
/begin CHARACTERISTIC DFES_FaultTyp.DFC_EGRVlvJamVlvOpn_C "assigned fault type / Fault type assignment for check DFC_EGRVlvJamVlvOpn" VALUE 0x80504971 Val_Wu8 255.0 DFES_OneToOne 0.00 255.0 FORMAT "%5.1" /end CHARACTERISTIC
/begin CHARACTERISTIC DFES_FaultTyp.DFC_EGRVlvSprgBrk_C "assigned fault type / Fault type assignment for check DFC_EGRVlvSprgBrk" VALUE 0x80504972 Val_Wu8 255.0 DFES_OneToOne 0.00 255.0 FORMAT "%5.1" /end CHARACTERISTIC
/begin CHARACTERISTIC DFES_FaultTyp.DFC_EGRVlvTempMdlEEPErr_C "assigned fault type / Fault type assignment for check DFC_EGRVlvTempMdlEEPErr" VALUE 0x80504973 Val_Wu8 255.0 DFES_OneToOne 0.00 255.0 FORMAT "%5.1" /end CHARACTERISTIC
/begin CHARACTERISTIC DFES_FaultTyp.DFC_EGRVlvTmpErr_C "assigned fault type / Fault type assignment for check DFC_EGRVlvTmpErr" VALUE 0x80504974 Val_Wu8 255.0 DFES_OneToOne 0.00 255.0 FORMAT "%5.1" /end CHARACTERISTIC
/begin CHARACTERISTIC DFES_FaultTyp.DFC_EGSDUS2B1LtrDly_C "assigned fault type / Fault type assignment for check DFC_EGSDUS2B1LtrDly" VALUE 0x80504975 Val_Wu8 255.0 DFES_OneToOne 0.00 255.0 FORMAT "%5.1" /end CHARACTERISTIC
/begin CHARACTERISTIC DFES_FaultTyp.DFC_EGSDUS2B1LtrPT1_C "assigned fault type / Fault type assignment for check DFC_EGSDUS2B1LtrPT1" VALUE 0x80504976 Val_Wu8 255.0 DFES_OneToOne 0.00 255.0 FORMAT "%5.1" /end CHARACTERISTIC
/begin CHARACTERISTIC DFES_FaultTyp.DFC_EGSDUS2B1RtlDly_C "assigned fault type / Fault type assignment for check DFC_EGSDUS2B1RtlDly" VALUE 0x80504977 Val_Wu8 255.0 DFES_OneToOne 0.00 255.0 FORMAT "%5.1" /end CHARACTERISTIC
/begin CHARACTERISTIC DFES_FaultTyp.DFC_EGSDUS2B1RtlPT1_C "assigned fault type / Fault type assignment for check DFC_EGSDUS2B1RtlPT1" VALUE 0x80504978 Val_Wu8 255.0 DFES_OneToOne 0.00 255.0 FORMAT "%5.1" /end CHARACTERISTIC
/begin CHARACTERISTIC DFES_FaultTyp.DFC_EGSDUS2B1TarLean_C "assigned fault type / Fault type assignment for check DFC_EGSDUS2B1TarLean" VALUE 0x80504979 Val_Wu8 255.0 DFES_OneToOne 0.00 255.0 FORMAT "%5.1" /end CHARACTERISTIC
/begin CHARACTERISTIC DFES_FaultTyp.DFC_EGSDUS2B1TarRich_C "assigned fault type / Fault type assignment for check DFC_EGSDUS2B1TarRich" VALUE 0x8050497A Val_Wu8 255.0 DFES_OneToOne 0.00 255.0 FORMAT "%5.1" /end CHARACTERISTIC
/begin CHARACTERISTIC DFES_FaultTyp.DFC_EONVmax_C "assigned fault type / Fault type assignment for check DFC_EONVmax" VALUE 0x8050497B Val_Wu8 255.0 DFES_OneToOne 0.00 255.0 FORMAT "%5.1" /end CHARACTERISTIC
/begin CHARACTERISTIC DFES_FaultTyp.DFC_ETAKHLmax_C "assigned fault type / Fault type assignment for check DFC_ETAKHLmax" VALUE 0x8050497C Val_Wu8 255.0 DFES_OneToOne 0.00 255.0 FORMAT "%5.1" /end CHARACTERISTIC
/begin CHARACTERISTIC DFES_FaultTyp.DFC_ETAKHTmax_C "assigned fault type / Fault type assignment for check DFC_ETAKHTmax" VALUE 0x8050497D Val_Wu8 255.0 DFES_OneToOne 0.00 255.0 FORMAT "%5.1" /end CHARACTERISTIC
/begin CHARACTERISTIC DFES_FaultTyp.DFC_ETHSEmax_C "assigned fault type / Fault type assignment for check DFC_ETHSEmax" VALUE 0x8050497E Val_Wu8 255.0 DFES_OneToOne 0.00 255.0 FORMAT "%5.1" /end CHARACTERISTIC
/begin CHARACTERISTIC DFES_FaultTyp.DFC_ETHSEmin_C "assigned fault type / Fault type assignment for check DFC_ETHSEmin" VALUE 0x8050497F Val_Wu8 255.0 DFES_OneToOne 0.00 255.0 FORMAT "%5.1" /end CHARACTERISTIC
/begin CHARACTERISTIC DFES_FaultTyp.DFC_ETHSFmax_C "assigned fault type / Fault type assignment for check DFC_ETHSFmax" VALUE 0x80504980 Val_Wu8 255.0 DFES_OneToOne 0.00 255.0 FORMAT "%5.1" /end CHARACTERISTIC
/begin CHARACTERISTIC DFES_FaultTyp.DFC_ETHSFmin_C "assigned fault type / Fault type assignment for check DFC_ETHSFmin" VALUE 0x80504981 Val_Wu8 255.0 DFES_OneToOne 0.00 255.0 FORMAT "%5.1" /end CHARACTERISTIC
/begin CHARACTERISTIC DFES_FaultTyp.DFC_ETHSFsig_C "assigned fault type / Fault type assignment for check DFC_ETHSFsig" VALUE 0x80504982 Val_Wu8 255.0 DFES_OneToOne 0.00 255.0 FORMAT "%5.1" /end CHARACTERISTIC
/begin CHARACTERISTIC DFES_FaultTyp.DFC_ETHSNPWmax_C "assigned fault type / Fault type assignment for check DFC_ETHSNPWmax" VALUE 0x80504983 Val_Wu8 255.0 DFES_OneToOne 0.00 255.0 FORMAT "%5.1" /end CHARACTERISTIC
/begin CHARACTERISTIC DFES_FaultTyp.DFC_ETHSNPWmin_C "assigned fault type / Fault type assignment for check DFC_ETHSNPWmin" VALUE 0x80504984 Val_Wu8 255.0 DFES_OneToOne 0.00 255.0 FORMAT "%5.1" /end CHARACTERISTIC
/begin CHARACTERISTIC DFES_FaultTyp.DFC_ETHSNPWsig_C "assigned fault type / Fault type assignment for check DFC_ETHSNPWsig" VALUE 0x80504985 Val_Wu8 255.0 DFES_OneToOne 0.00 255.0 FORMAT "%5.1" /end CHARACTERISTIC
/begin CHARACTERISTIC DFES_FaultTyp.DFC_ETHSPLnpl_C "assigned fault type / Fault type assignment for check DFC_ETHSPLnpl" VALUE 0x80504986 Val_Wu8 255.0 DFES_OneToOne 0.00 255.0 FORMAT "%5.1" /end CHARACTERISTIC
/begin CHARACTERISTIC DFES_FaultTyp.DFC_ETHSTPLnpl_C "assigned fault type / Fault type assignment for check DFC_ETHSTPLnpl" VALUE 0x80504987 Val_Wu8 255.0 DFES_OneToOne 0.00 255.0 FORMAT "%5.1" /end CHARACTERISTIC
/begin CHARACTERISTIC DFES_FaultTyp.DFC_EngICO_C "assigned fault type / Fault type assignment for check DFC_EngICO" VALUE 0x80504988 Val_Wu8 255.0 DFES_OneToOne 0.00 255.0 FORMAT "%5.1" /end CHARACTERISTIC
/begin CHARACTERISTIC DFES_FaultTyp.DFC_EngPrtOvrSpdMon_C "assigned fault type / Fault type assignment for check DFC_EngPrtOvrSpdMon" VALUE 0x80504989 Val_Wu8 255.0 DFES_OneToOne 0.00 255.0 FORMAT "%5.1" /end CHARACTERISTIC
/begin CHARACTERISTIC DFES_FaultTyp.DFC_EpmCaSI1ErrSig_C "assigned fault type / Fault type assignment for check DFC_EpmCaSI1ErrSig" VALUE 0x8050498A Val_Wu8 255.0 DFES_OneToOne 0.00 255.0 FORMAT "%5.1" /end CHARACTERISTIC
/begin CHARACTERISTIC DFES_FaultTyp.DFC_EpmCaSI1MntErr_C "assigned fault type / Fault type assignment for check DFC_EpmCaSI1MntErr" VALUE 0x8050498B Val_Wu8 255.0 DFES_OneToOne 0.00 255.0 FORMAT "%5.1" /end CHARACTERISTIC
/begin CHARACTERISTIC DFES_FaultTyp.DFC_EpmCaSI1NoSigMax_C "assigned fault type / Fault type assignment for check DFC_EpmCaSI1NoSigMax" VALUE 0x8050498C Val_Wu8 255.0 DFES_OneToOne 0.00 255.0 FORMAT "%5.1" /end CHARACTERISTIC
/begin CHARACTERISTIC DFES_FaultTyp.DFC_EpmCaSI1NoSigMin_C "assigned fault type / Fault type assignment for check DFC_EpmCaSI1NoSigMin" VALUE 0x8050498D Val_Wu8 255.0 DFES_OneToOne 0.00 255.0 FORMAT "%5.1" /end CHARACTERISTIC
/begin CHARACTERISTIC DFES_FaultTyp.DFC_EpmCaSI1OfsErr_C "assigned fault type / Fault type assignment for check DFC_EpmCaSI1OfsErr" VALUE 0x8050498E Val_Wu8 255.0 DFES_OneToOne 0.00 255.0 FORMAT "%5.1" /end CHARACTERISTIC
/begin CHARACTERISTIC DFES_FaultTyp.DFC_EpmCrSDGI_C "assigned fault type / Fault type assignment for check DFC_EpmCrSDGI" VALUE 0x8050498F Val_Wu8 255.0 DFES_OneToOne 0.00 255.0 FORMAT "%5.1" /end CHARACTERISTIC
/begin CHARACTERISTIC DFES_FaultTyp.DFC_EpmCrSErrSig_C "assigned fault type / Fault type assignment for check DFC_EpmCrSErrSig" VALUE 0x80504990 Val_Wu8 255.0 DFES_OneToOne 0.00 255.0 FORMAT "%5.1" /end CHARACTERISTIC
/begin CHARACTERISTIC DFES_FaultTyp.DFC_EpmCrSNoSig_C "assigned fault type / Fault type assignment for check DFC_EpmCrSNoSig" VALUE 0x80504991 Val_Wu8 255.0 DFES_OneToOne 0.00 255.0 FORMAT "%5.1" /end CHARACTERISTIC
/begin CHARACTERISTIC DFES_FaultTyp.DFC_EtaEngIdleNonCsers_C "assigned fault type / Fault type assignment for check DFC_EtaEngIdleNonCsers" VALUE 0x80504992 Val_Wu8 255.0 DFES_OneToOne 0.00 255.0 FORMAT "%5.1" /end CHARACTERISTIC
/begin CHARACTERISTIC DFES_FaultTyp.DFC_EtaEngPtlNonCsers_C "assigned fault type / Fault type assignment for check DFC_EtaEngPtlNonCsers" VALUE 0x80504993 Val_Wu8 255.0 DFES_OneToOne 0.00 255.0 FORMAT "%5.1" /end CHARACTERISTIC
/begin CHARACTERISTIC DFES_FaultTyp.DFC_FRAmax_C "assigned fault type / Fault type assignment for check DFC_FRAmax" VALUE 0x80504994 Val_Wu8 255.0 DFES_OneToOne 0.00 255.0 FORMAT "%5.1" /end CHARACTERISTIC
/begin CHARACTERISTIC DFES_FaultTyp.DFC_FRAmin_C "assigned fault type / Fault type assignment for check DFC_FRAmin" VALUE 0x80504995 Val_Wu8 255.0 DFES_OneToOne 0.00 255.0 FORMAT "%5.1" /end CHARACTERISTIC
/begin CHARACTERISTIC DFES_FaultTyp.DFC_FSTEmax_C "assigned fault type / Fault type assignment for check DFC_FSTEmax" VALUE 0x80504996 Val_Wu8 255.0 DFES_OneToOne 0.00 255.0 FORMAT "%5.1" /end CHARACTERISTIC
/begin CHARACTERISTIC DFES_FaultTyp.DFC_FSTEmin_C "assigned fault type / Fault type assignment for check DFC_FSTEmin" VALUE 0x80504997 Val_Wu8 255.0 DFES_OneToOne 0.00 255.0 FORMAT "%5.1" /end CHARACTERISTIC
/begin CHARACTERISTIC DFES_FaultTyp.DFC_FSTRmax_C "assigned fault type / Fault type assignment for check DFC_FSTRmax" VALUE 0x80504998 Val_Wu8 255.0 DFES_OneToOne 0.00 255.0 FORMAT "%5.1" /end CHARACTERISTIC
/begin CHARACTERISTIC DFES_FaultTyp.DFC_FSTRmin_C "assigned fault type / Fault type assignment for check DFC_FSTRmin" VALUE 0x80504999 Val_Wu8 255.0 DFES_OneToOne 0.00 255.0 FORMAT "%5.1" /end CHARACTERISTIC
/begin CHARACTERISTIC DFES_FaultTyp.DFC_FSTRnpl_C "assigned fault type / Fault type assignment for check DFC_FSTRnpl" VALUE 0x8050499A Val_Wu8 255.0 DFES_OneToOne 0.00 255.0 FORMAT "%5.1" /end CHARACTERISTIC
/begin CHARACTERISTIC DFES_FaultTyp.DFC_FSTmax_C "assigned fault type / Fault type assignment for check DFC_FSTmax" VALUE 0x8050499B Val_Wu8 255.0 DFES_OneToOne 0.00 255.0 FORMAT "%5.1" /end CHARACTERISTIC
/begin CHARACTERISTIC DFES_FaultTyp.DFC_FTDLAmax_C "assigned fault type / Fault type assignment for check DFC_FTDLAmax" VALUE 0x8050499C Val_Wu8 255.0 DFES_OneToOne 0.00 255.0 FORMAT "%5.1" /end CHARACTERISTIC
/begin CHARACTERISTIC DFES_FaultTyp.DFC_FTDLAmin_C "assigned fault type / Fault type assignment for check DFC_FTDLAmin" VALUE 0x8050499D Val_Wu8 255.0 DFES_OneToOne 0.00 255.0 FORMAT "%5.1" /end CHARACTERISTIC
/begin CHARACTERISTIC DFES_FaultTyp.DFC_FuPHiSnsrEleclmax_C "assigned fault type / Fault type assignment for check DFC_FuPHiSnsrEleclmax" VALUE 0x8050499E Val_Wu8 255.0 DFES_OneToOne 0.00 255.0 FORMAT "%5.1" /end CHARACTERISTIC
/begin CHARACTERISTIC DFES_FaultTyp.DFC_FuPHiSnsrEleclmin_C "assigned fault type / Fault type assignment for check DFC_FuPHiSnsrEleclmin" VALUE 0x8050499F Val_Wu8 255.0 DFES_OneToOne 0.00 255.0 FORMAT "%5.1" /end CHARACTERISTIC
/begin CHARACTERISTIC DFES_FaultTyp.DFC_FuPHiSnsrEleclnpl_C "assigned fault type / Fault type assignment for check DFC_FuPHiSnsrEleclnpl" VALUE 0x805049A0 Val_Wu8 255.0 DFES_OneToOne 0.00 255.0 FORMAT "%5.1" /end CHARACTERISTIC
/begin CHARACTERISTIC DFES_FaultTyp.DFC_FuPHiSnsrURngMax_C "assigned fault type / Fault type assignment for check DFC_FuPHiSnsrURngMax" VALUE 0x805049A1 Val_Wu8 255.0 DFES_OneToOne 0.00 255.0 FORMAT "%5.1" /end CHARACTERISTIC
/begin CHARACTERISTIC DFES_FaultTyp.DFC_FuPHiSnsrURngMin_C "assigned fault type / Fault type assignment for check DFC_FuPHiSnsrURngMin" VALUE 0x805049A2 Val_Wu8 255.0 DFES_OneToOne 0.00 255.0 FORMAT "%5.1" /end CHARACTERISTIC
/begin CHARACTERISTIC DFES_FaultTyp.DFC_FuSnsrPhyRngMaxErr_C "assigned fault type / Fault type assignment for check DFC_FuSnsrPhyRngMaxErr" VALUE 0x805049A3 Val_Wu8 255.0 DFES_OneToOne 0.00 255.0 FORMAT "%5.1" /end CHARACTERISTIC
/begin CHARACTERISTIC DFES_FaultTyp.DFC_FuSnsrPhyRngMinErr_C "assigned fault type / Fault type assignment for check DFC_FuSnsrPhyRngMinErr" VALUE 0x805049A4 Val_Wu8 255.0 DFES_OneToOne 0.00 255.0 FORMAT "%5.1" /end CHARACTERISTIC
/begin CHARACTERISTIC DFES_FaultTyp.DFC_GEVlvLockPinDiagIntkB1_C "assigned fault type / Fault type assignment for check DFC_GEVlvLockPinDiagIntkB1" VALUE 0x805049A5 Val_Wu8 255.0 DFES_OneToOne 0.00 255.0 FORMAT "%5.1" /end CHARACTERISTIC
/begin CHARACTERISTIC DFES_FaultTyp.DFC_GEVlvPhaSlowIntkB1_C "assigned fault type / Fault type assignment for check DFC_GEVlvPhaSlowIntkB1" VALUE 0x805049A6 Val_Wu8 255.0 DFES_OneToOne 0.00 255.0 FORMAT "%5.1" /end CHARACTERISTIC
/begin CHARACTERISTIC DFES_FaultTyp.DFC_GEVlvPhaTargIntkB1_C "assigned fault type / Fault type assignment for check DFC_GEVlvPhaTargIntkB1" VALUE 0x805049A7 Val_Wu8 255.0 DFES_OneToOne 0.00 255.0 FORMAT "%5.1" /end CHARACTERISTIC
/begin CHARACTERISTIC DFES_FaultTyp.DFC_GbxRvsSwtStk_C "assigned fault type / Fault type assignment for check DFC_GbxRvsSwtStk" VALUE 0x805049A8 Val_Wu8 255.0 DFES_OneToOne 0.00 255.0 FORMAT "%5.1" /end CHARACTERISTIC
/begin CHARACTERISTIC DFES_FaultTyp.DFC_HDRKHmax_C "assigned fault type / Fault type assignment for check DFC_HDRKHmax" VALUE 0x805049A9 Val_Wu8 255.0 DFES_OneToOne 0.00 255.0 FORMAT "%5.1" /end CHARACTERISTIC
/begin CHARACTERISTIC DFES_FaultTyp.DFC_HDRKHmin_C "assigned fault type / Fault type assignment for check DFC_HDRKHmin" VALUE 0x805049AA Val_Wu8 255.0 DFES_OneToOne 0.00 255.0 FORMAT "%5.1" /end CHARACTERISTIC
/begin CHARACTERISTIC DFES_FaultTyp.DFC_HDRPLmax_C "assigned fault type / Fault type assignment for check DFC_HDRPLmax" VALUE 0x805049AB Val_Wu8 255.0 DFES_OneToOne 0.00 255.0 FORMAT "%5.1" /end CHARACTERISTIC
/begin CHARACTERISTIC DFES_FaultTyp.DFC_HDRPLmin_C "assigned fault type / Fault type assignment for check DFC_HDRPLmin" VALUE 0x805049AC Val_Wu8 255.0 DFES_OneToOne 0.00 255.0 FORMAT "%5.1" /end CHARACTERISTIC
/begin CHARACTERISTIC DFES_FaultTyp.DFC_HDRmax_C "assigned fault type / Fault type assignment for check DFC_HDRmax" VALUE 0x805049AD Val_Wu8 255.0 DFES_OneToOne 0.00 255.0 FORMAT "%5.1" /end CHARACTERISTIC
/begin CHARACTERISTIC DFES_FaultTyp.DFC_HDRmin_C "assigned fault type / Fault type assignment for check DFC_HDRmin" VALUE 0x805049AE Val_Wu8 255.0 DFES_OneToOne 0.00 255.0 FORMAT "%5.1" /end CHARACTERISTIC
/begin CHARACTERISTIC DFES_FaultTyp.DFC_HEGOS2B1ElecMax_C "assigned fault type / Fault type assignment for check DFC_HEGOS2B1ElecMax" VALUE 0x805049AF Val_Wu8 255.0 DFES_OneToOne 0.00 255.0 FORMAT "%5.1" /end CHARACTERISTIC
/begin CHARACTERISTIC DFES_FaultTyp.DFC_HEGOS2B1ElecMin_C "assigned fault type / Fault type assignment for check DFC_HEGOS2B1ElecMin" VALUE 0x805049B0 Val_Wu8 255.0 DFES_OneToOne 0.00 255.0 FORMAT "%5.1" /end CHARACTERISTIC
/begin CHARACTERISTIC DFES_FaultTyp.DFC_HEGOS2B1ElecSig_C "assigned fault type / Fault type assignment for check DFC_HEGOS2B1ElecSig" VALUE 0x805049B1 Val_Wu8 255.0 DFES_OneToOne 0.00 255.0 FORMAT "%5.1" /end CHARACTERISTIC
/begin CHARACTERISTIC DFES_FaultTyp.DFC_HEGOS2B1HtgNpl_C "assigned fault type / Fault type assignment for check DFC_HEGOS2B1HtgNpl" VALUE 0x805049B2 Val_Wu8 255.0 DFES_OneToOne 0.00 255.0 FORMAT "%5.1" /end CHARACTERISTIC
/begin CHARACTERISTIC DFES_FaultTyp.DFC_HEV00max_C "assigned fault type / Fault type assignment for check DFC_HEV00max" VALUE 0x805049B3 Val_Wu8 255.0 DFES_OneToOne 0.00 255.0 FORMAT "%5.1" /end CHARACTERISTIC
/begin CHARACTERISTIC DFES_FaultTyp.DFC_HEV01max_C "assigned fault type / Fault type assignment for check DFC_HEV01max" VALUE 0x805049B4 Val_Wu8 255.0 DFES_OneToOne 0.00 255.0 FORMAT "%5.1" /end CHARACTERISTIC
/begin CHARACTERISTIC DFES_FaultTyp.DFC_HEV02max_C "assigned fault type / Fault type assignment for check DFC_HEV02max" VALUE 0x805049B5 Val_Wu8 255.0 DFES_OneToOne 0.00 255.0 FORMAT "%5.1" /end CHARACTERISTIC
/begin CHARACTERISTIC DFES_FaultTyp.DFC_HEV03max_C "assigned fault type / Fault type assignment for check DFC_HEV03max" VALUE 0x805049B6 Val_Wu8 255.0 DFES_OneToOne 0.00 255.0 FORMAT "%5.1" /end CHARACTERISTIC
/begin CHARACTERISTIC DFES_FaultTyp.DFC_HEVE0max_C "assigned fault type / Fault type assignment for check DFC_HEVE0max" VALUE 0x805049B7 Val_Wu8 255.0 DFES_OneToOne 0.00 255.0 FORMAT "%5.1" /end CHARACTERISTIC
/begin CHARACTERISTIC DFES_FaultTyp.DFC_HEVE1max_C "assigned fault type / Fault type assignment for check DFC_HEVE1max" VALUE 0x805049B8 Val_Wu8 255.0 DFES_OneToOne 0.00 255.0 FORMAT "%5.1" /end CHARACTERISTIC
/begin CHARACTERISTIC DFES_FaultTyp.DFC_HFMmax_C "assigned fault type / Fault type assignment for check DFC_HFMmax" VALUE 0x805049B9 Val_Wu8 255.0 DFES_OneToOne 0.00 255.0 FORMAT "%5.1" /end CHARACTERISTIC
/begin CHARACTERISTIC DFES_FaultTyp.DFC_HiPSysHiPMaxLimExcdd_C "assigned fault type / Fault type assignment for check DFC_HiPSysHiPMaxLimExcdd" VALUE 0x805049BA Val_Wu8 255.0 DFES_OneToOne 0.00 255.0 FORMAT "%5.1" /end CHARACTERISTIC
/begin CHARACTERISTIC DFES_FaultTyp.DFC_IVGdiCtlCvoErrMax_0_C "assigned fault type / Fault type assignment for check DFC_IVGdiCtlCvoErrMax_0" VALUE 0x805049BB Val_Wu8 255.0 DFES_OneToOne 0.00 255.0 FORMAT "%5.1" /end CHARACTERISTIC
/begin CHARACTERISTIC DFES_FaultTyp.DFC_IVGdiCtlCvoErrMax_1_C "assigned fault type / Fault type assignment for check DFC_IVGdiCtlCvoErrMax_1" VALUE 0x805049BC Val_Wu8 255.0 DFES_OneToOne 0.00 255.0 FORMAT "%5.1" /end CHARACTERISTIC
/begin CHARACTERISTIC DFES_FaultTyp.DFC_IVGdiCtlCvoErrMax_2_C "assigned fault type / Fault type assignment for check DFC_IVGdiCtlCvoErrMax_2" VALUE 0x805049BD Val_Wu8 255.0 DFES_OneToOne 0.00 255.0 FORMAT "%5.1" /end CHARACTERISTIC
/begin CHARACTERISTIC DFES_FaultTyp.DFC_IVGdiCtlCvoErrMax_3_C "assigned fault type / Fault type assignment for check DFC_IVGdiCtlCvoErrMax_3" VALUE 0x805049BE Val_Wu8 255.0 DFES_OneToOne 0.00 255.0 FORMAT "%5.1" /end CHARACTERISTIC
/begin CHARACTERISTIC DFES_FaultTyp.DFC_IVGdiCtlCvoErrMin_0_C "assigned fault type / Fault type assignment for check DFC_IVGdiCtlCvoErrMin_0" VALUE 0x805049BF Val_Wu8 255.0 DFES_OneToOne 0.00 255.0 FORMAT "%5.1" /end CHARACTERISTIC
/begin CHARACTERISTIC DFES_FaultTyp.DFC_IVGdiCtlCvoErrMin_1_C "assigned fault type / Fault type assignment for check DFC_IVGdiCtlCvoErrMin_1" VALUE 0x805049C0 Val_Wu8 255.0 DFES_OneToOne 0.00 255.0 FORMAT "%5.1" /end CHARACTERISTIC
/begin CHARACTERISTIC DFES_FaultTyp.DFC_IVGdiCtlCvoErrMin_2_C "assigned fault type / Fault type assignment for check DFC_IVGdiCtlCvoErrMin_2" VALUE 0x805049C1 Val_Wu8 255.0 DFES_OneToOne 0.00 255.0 FORMAT "%5.1" /end CHARACTERISTIC
/begin CHARACTERISTIC DFES_FaultTyp.DFC_IVGdiCtlCvoErrMin_3_C "assigned fault type / Fault type assignment for check DFC_IVGdiCtlCvoErrMin_3" VALUE 0x805049C2 Val_Wu8 255.0 DFES_OneToOne 0.00 255.0 FORMAT "%5.1" /end CHARACTERISTIC
/begin CHARACTERISTIC DFES_FaultTyp.DFC_IVGdiCtlCvoErrMinMax_C "assigned fault type / Fault type assignment for check DFC_IVGdiCtlCvoErrMinMax" VALUE 0x805049C3 Val_Wu8 255.0 DFES_OneToOne 0.00 255.0 FORMAT "%5.1" /end CHARACTERISTIC
/begin CHARACTERISTIC DFES_FaultTyp.DFC_IVGdiCtlCvoSigPlausErrSmrCdn_C "assigned fault type / Fault type assignment for check DFC_IVGdiCtlCvoSigPlausErrSmrCdn" VALUE 0x805049C4 Val_Wu8 255.0 DFES_OneToOne 0.00 255.0 FORMAT "%5.1" /end CHARACTERISTIC
/begin CHARACTERISTIC DFES_FaultTyp.DFC_IVGdiCtl_CvoErr_C "assigned fault type / Fault type assignment for check DFC_IVGdiCtl_CvoErr" VALUE 0x805049C5 Val_Wu8 255.0 DFES_OneToOne 0.00 255.0 FORMAT "%5.1" /end CHARACTERISTIC
/begin CHARACTERISTIC DFES_FaultTyp.DFC_IVGdiCtl_CvoSigPlaus_0_C "assigned fault type / Fault type assignment for check DFC_IVGdiCtl_CvoSigPlaus_0" VALUE 0x805049C6 Val_Wu8 255.0 DFES_OneToOne 0.00 255.0 FORMAT "%5.1" /end CHARACTERISTIC
/begin CHARACTERISTIC DFES_FaultTyp.DFC_IVGdiCtl_CvoSigPlaus_1_C "assigned fault type / Fault type assignment for check DFC_IVGdiCtl_CvoSigPlaus_1" VALUE 0x805049C7 Val_Wu8 255.0 DFES_OneToOne 0.00 255.0 FORMAT "%5.1" /end CHARACTERISTIC
/begin CHARACTERISTIC DFES_FaultTyp.DFC_IVGdiCtl_CvoSigPlaus_2_C "assigned fault type / Fault type assignment for check DFC_IVGdiCtl_CvoSigPlaus_2" VALUE 0x805049C8 Val_Wu8 255.0 DFES_OneToOne 0.00 255.0 FORMAT "%5.1" /end CHARACTERISTIC
/begin CHARACTERISTIC DFES_FaultTyp.DFC_IVGdiCtl_CvoSigPlaus_3_C "assigned fault type / Fault type assignment for check DFC_IVGdiCtl_CvoSigPlaus_3" VALUE 0x805049C9 Val_Wu8 255.0 DFES_OneToOne 0.00 255.0 FORMAT "%5.1" /end CHARACTERISTIC
/begin CHARACTERISTIC DFES_FaultTyp.DFC_IntkAirTAirFltDsCrssMax_C "assigned fault type / Fault type assignment for check DFC_IntkAirTAirFltDsCrssMax" VALUE 0x805049CA Val_Wu8 255.0 DFES_OneToOne 0.00 255.0 FORMAT "%5.1" /end CHARACTERISTIC
/begin CHARACTERISTIC DFES_FaultTyp.DFC_IntkAirTAirFltDsCrssMin_C "assigned fault type / Fault type assignment for check DFC_IntkAirTAirFltDsCrssMin" VALUE 0x805049CB Val_Wu8 255.0 DFES_OneToOne 0.00 255.0 FORMAT "%5.1" /end CHARACTERISTIC
/begin CHARACTERISTIC DFES_FaultTyp.DFC_IntkAirTAirFltDsHSCMax_C "assigned fault type / Fault type assignment for check DFC_IntkAirTAirFltDsHSCMax" VALUE 0x805049CC Val_Wu8 255.0 DFES_OneToOne 0.00 255.0 FORMAT "%5.1" /end CHARACTERISTIC
/begin CHARACTERISTIC DFES_FaultTyp.DFC_IntkAirTAirFltDsImps_C "assigned fault type / Fault type assignment for check DFC_IntkAirTAirFltDsImps" VALUE 0x805049CD Val_Wu8 255.0 DFES_OneToOne 0.00 255.0 FORMAT "%5.1" /end CHARACTERISTIC
/begin CHARACTERISTIC DFES_FaultTyp.DFC_IntkAirTAirFltDsPRCMax_C "assigned fault type / Fault type assignment for check DFC_IntkAirTAirFltDsPRCMax" VALUE 0x805049CE Val_Wu8 255.0 DFES_OneToOne 0.00 255.0 FORMAT "%5.1" /end CHARACTERISTIC
/begin CHARACTERISTIC DFES_FaultTyp.DFC_IntkAirTAirFltDsPRCMin_C "assigned fault type / Fault type assignment for check DFC_IntkAirTAirFltDsPRCMin" VALUE 0x805049CF Val_Wu8 255.0 DFES_OneToOne 0.00 255.0 FORMAT "%5.1" /end CHARACTERISTIC
/begin CHARACTERISTIC DFES_FaultTyp.DFC_IntkAirTAirFltDsSRCMax_C "assigned fault type / Fault type assignment for check DFC_IntkAirTAirFltDsSRCMax" VALUE 0x805049D0 Val_Wu8 255.0 DFES_OneToOne 0.00 255.0 FORMAT "%5.1" /end CHARACTERISTIC
/begin CHARACTERISTIC DFES_FaultTyp.DFC_IntkAirTAirFltDsSRCMin_C "assigned fault type / Fault type assignment for check DFC_IntkAirTAirFltDsSRCMin" VALUE 0x805049D1 Val_Wu8 255.0 DFES_OneToOne 0.00 255.0 FORMAT "%5.1" /end CHARACTERISTIC
/begin CHARACTERISTIC DFES_FaultTyp.DFC_IntkAirTAirFltDsSTC_C "assigned fault type / Fault type assignment for check DFC_IntkAirTAirFltDsSTC" VALUE 0x805049D2 Val_Wu8 255.0 DFES_OneToOne 0.00 255.0 FORMAT "%5.1" /end CHARACTERISTIC
/begin CHARACTERISTIC DFES_FaultTyp.DFC_IntkAirTIntkMnfldCrssMax_C "assigned fault type / Fault type assignment for check DFC_IntkAirTIntkMnfldCrssMax" VALUE 0x805049D3 Val_Wu8 255.0 DFES_OneToOne 0.00 255.0 FORMAT "%5.1" /end CHARACTERISTIC
/begin CHARACTERISTIC DFES_FaultTyp.DFC_IntkAirTIntkMnfldCrssMin_C "assigned fault type / Fault type assignment for check DFC_IntkAirTIntkMnfldCrssMin" VALUE 0x805049D4 Val_Wu8 255.0 DFES_OneToOne 0.00 255.0 FORMAT "%5.1" /end CHARACTERISTIC
/begin CHARACTERISTIC DFES_FaultTyp.DFC_IntkAirTIntkMnfldHSCMax_C "assigned fault type / Fault type assignment for check DFC_IntkAirTIntkMnfldHSCMax" VALUE 0x805049D5 Val_Wu8 255.0 DFES_OneToOne 0.00 255.0 FORMAT "%5.1" /end CHARACTERISTIC
/begin CHARACTERISTIC DFES_FaultTyp.DFC_IntkAirTIntkMnfldImps_C "assigned fault type / Fault type assignment for check DFC_IntkAirTIntkMnfldImps" VALUE 0x805049D6 Val_Wu8 255.0 DFES_OneToOne 0.00 255.0 FORMAT "%5.1" /end CHARACTERISTIC
/begin CHARACTERISTIC DFES_FaultTyp.DFC_IntkAirTIntkMnfldPRCMax_C "assigned fault type / Fault type assignment for check DFC_IntkAirTIntkMnfldPRCMax" VALUE 0x805049D7 Val_Wu8 255.0 DFES_OneToOne 0.00 255.0 FORMAT "%5.1" /end CHARACTERISTIC
/begin CHARACTERISTIC DFES_FaultTyp.DFC_IntkAirTIntkMnfldPRCMin_C "assigned fault type / Fault type assignment for check DFC_IntkAirTIntkMnfldPRCMin" VALUE 0x805049D8 Val_Wu8 255.0 DFES_OneToOne 0.00 255.0 FORMAT "%5.1" /end CHARACTERISTIC
/begin CHARACTERISTIC DFES_FaultTyp.DFC_IntkAirTIntkMnfldSRCMax_C "assigned fault type / Fault type assignment for check DFC_IntkAirTIntkMnfldSRCMax" VALUE 0x805049D9 Val_Wu8 255.0 DFES_OneToOne 0.00 255.0 FORMAT "%5.1" /end CHARACTERISTIC
/begin CHARACTERISTIC DFES_FaultTyp.DFC_IntkAirTIntkMnfldSRCMin_C "assigned fault type / Fault type assignment for check DFC_IntkAirTIntkMnfldSRCMin" VALUE 0x805049DA Val_Wu8 255.0 DFES_OneToOne 0.00 255.0 FORMAT "%5.1" /end CHARACTERISTIC
/begin CHARACTERISTIC DFES_FaultTyp.DFC_IntkAirTIntkMnfldSTC_C "assigned fault type / Fault type assignment for check DFC_IntkAirTIntkMnfldSTC" VALUE 0x805049DB Val_Wu8 255.0 DFES_OneToOne 0.00 255.0 FORMAT "%5.1" /end CHARACTERISTIC
/begin CHARACTERISTIC DFES_FaultTyp.DFC_KRREGRLMX_C "assigned fault type / Fault type assignment for check DFC_KRREGRLMX" VALUE 0x805049DC Val_Wu8 255.0 DFES_OneToOne 0.00 255.0 FORMAT "%5.1" /end CHARACTERISTIC
/begin CHARACTERISTIC DFES_FaultTyp.DFC_KRVEKOCVLCI_C "assigned fault type / Fault type assignment for check DFC_KRVEKOCVLCI" VALUE 0x805049DD Val_Wu8 255.0 DFES_OneToOne 0.00 255.0 FORMAT "%5.1" /end CHARACTERISTIC
/begin CHARACTERISTIC DFES_FaultTyp.DFC_KRVEKOENCHMT_C "assigned fault type / Fault type assignment for check DFC_KRVEKOENCHMT" VALUE 0x805049DE Val_Wu8 255.0 DFES_OneToOne 0.00 255.0 FORMAT "%5.1" /end CHARACTERISTIC
/begin CHARACTERISTIC DFES_FaultTyp.DFC_KRVEKOENCHMT0_C "assigned fault type / Fault type assignment for check DFC_KRVEKOENCHMT0" VALUE 0x805049DF Val_Wu8 255.0 DFES_OneToOne 0.00 255.0 FORMAT "%5.1" /end CHARACTERISTIC
/begin CHARACTERISTIC DFES_FaultTyp.DFC_KRVEKOENCHMT1_C "assigned fault type / Fault type assignment for check DFC_KRVEKOENCHMT1" VALUE 0x805049E0 Val_Wu8 255.0 DFES_OneToOne 0.00 255.0 FORMAT "%5.1" /end CHARACTERISTIC
/begin CHARACTERISTIC DFES_FaultTyp.DFC_KRVEKOENCHMT2_C "assigned fault type / Fault type assignment for check DFC_KRVEKOENCHMT2" VALUE 0x805049E1 Val_Wu8 255.0 DFES_OneToOne 0.00 255.0 FORMAT "%5.1" /end CHARACTERISTIC
/begin CHARACTERISTIC DFES_FaultTyp.DFC_KRVEKOENCHMT3_C "assigned fault type / Fault type assignment for check DFC_KRVEKOENCHMT3" VALUE 0x805049E2 Val_Wu8 255.0 DFES_OneToOne 0.00 255.0 FORMAT "%5.1" /end CHARACTERISTIC
/begin CHARACTERISTIC DFES_FaultTyp.DFC_KRVEKOENCHMT4_C "assigned fault type / Fault type assignment for check DFC_KRVEKOENCHMT4" VALUE 0x805049E3 Val_Wu8 255.0 DFES_OneToOne 0.00 255.0 FORMAT "%5.1" /end CHARACTERISTIC
/begin CHARACTERISTIC DFES_FaultTyp.DFC_KRVEKOENCHMT5_C "assigned fault type / Fault type assignment for check DFC_KRVEKOENCHMT5" VALUE 0x805049E4 Val_Wu8 255.0 DFES_OneToOne 0.00 255.0 FORMAT "%5.1" /end CHARACTERISTIC
/begin CHARACTERISTIC DFES_FaultTyp.DFC_KRVEKOENCHMT6_C "assigned fault type / Fault type assignment for check DFC_KRVEKOENCHMT6" VALUE 0x805049E5 Val_Wu8 255.0 DFES_OneToOne 0.00 255.0 FORMAT "%5.1" /end CHARACTERISTIC
/begin CHARACTERISTIC DFES_FaultTyp.DFC_KRVEKOENCHMT7_C "assigned fault type / Fault type assignment for check DFC_KRVEKOENCHMT7" VALUE 0x805049E6 Val_Wu8 255.0 DFES_OneToOne 0.00 255.0 FORMAT "%5.1" /end CHARACTERISTIC
/begin CHARACTERISTIC DFES_FaultTyp.DFC_KRVEKORLMX_C "assigned fault type / Fault type assignment for check DFC_KRVEKORLMX" VALUE 0x805049E7 Val_Wu8 255.0 DFES_OneToOne 0.00 255.0 FORMAT "%5.1" /end CHARACTERISTIC
/begin CHARACTERISTIC DFES_FaultTyp.DFC_KRVEKORLMXL_C "assigned fault type / Fault type assignment for check DFC_KRVEKORLMXL" VALUE 0x805049E8 Val_Wu8 255.0 DFES_OneToOne 0.00 255.0 FORMAT "%5.1" /end CHARACTERISTIC
/begin CHARACTERISTIC DFES_FaultTyp.DFC_KS1max_C "assigned fault type / Fault type assignment for check DFC_KS1max" VALUE 0x805049E9 Val_Wu8 255.0 DFES_OneToOne 0.00 255.0 FORMAT "%5.1" /end CHARACTERISTIC
/begin CHARACTERISTIC DFES_FaultTyp.DFC_KS1min_C "assigned fault type / Fault type assignment for check DFC_KS1min" VALUE 0x805049EA Val_Wu8 255.0 DFES_OneToOne 0.00 255.0 FORMAT "%5.1" /end CHARACTERISTIC
/begin FUNCTION DFES "30000.73.0_2.0.0Diagnostic Fault Event Storage"
 /begin DEF_CHARACTERISTIC DFES_EnvRef.DFC_OilPPlaus_C DFES_EnvRef.DFC_PLLSUmax_C DFES_EnvRef.DFC_PLLSUmin_C DFES_EnvRef.DFC_PSR1max_C DFES_EnvRef.DFC_PSRBmax_C DFES_EnvRef.DFC_PSRBmin_C DFES_EnvRef.DFC_PSRPmax_C DFES_EnvRef.DFC_PSRPmin_C DFES_EnvRef.DFC_PSRPsig_C DFES_EnvRef.DFC_PSRmax_C DFES_EnvRef.DFC_PUmax_C DFES_EnvRef.DFC_P_VSE11_OL_C DFES_EnvRef.DFC_P_VSE11_SCB_C DFES_EnvRef.DFC_P_VSE11_SCG_C DFES_EnvRef.DFC_PhyHighAPP1_C DFES_EnvRef.DFC_PhyHighAPP2_C DFES_EnvRef.DFC_PhyLowAPP1_C DFES_EnvRef.DFC_PhyLowAPP2_C DFES_EnvRef.DFC_SRCHighAPP1_C DFES_EnvRef.DFC_SRCHighAPP2_C DFES_EnvRef.DFC_SRCLowAPP1_C DFES_EnvRef.DFC_SRCLowAPP2_C DFES_EnvRef.DFC_SSpMon2_C DFES_EnvRef.DFC_STHDRmax_C DFES_EnvRef.DFC_SWReset_0_C DFES_EnvRef.DFC_SWReset_1_C DFES_EnvRef.DFC_SWReset_2_C DFES_EnvRef.DFC_SyncAPP_C DFES_EnvRef.DFC_TANKLnpl_C DFES_EnvRef.DFC_TAmax_Dummy_C DFES_EnvRef.DFC_TESFmax_C DFES_EnvRef.DFC_TESGmax_C DFES_EnvRef.DFC_TKAEmax_C DFES_EnvRef.DFC_TKAEmin_C DFES_EnvRef.DFC_TKARmax_C DFES_EnvRef.DFC_TKARnpl_C DFES_EnvRef.DFC_TMmax_Dummy_C DFES_EnvRef.DFC_TUMmax_Dummy_C DFES_EnvRef.DFC_TWCDPriCatB1_C DFES_EnvRef.DFC_ThrVlvClsdPosnFirstOffsLrnImpoB1_C DFES_EnvRef.DFC_ThrVlvClsdPosnOffsLrnImpoB1_C DFES_EnvRef.DFC_ThrVlvClsdPosnOffsLrnMaxB1_C DFES_EnvRef.DFC_ThrVlvClsdPosnOffsLrnMinB1_C DFES_EnvRef.DFC_ThrVlvCtrlDeB1_C DFES_EnvRef.DFC_ThrVlvDycB1_C DFES_EnvRef.DFC_ThrVlvLimpAirPosnMaxAbsltDriftB1_C DFES_EnvRef.DFC_ThrVlvLimpAirPosnMaxB1_C DFES_EnvRef.DFC_ThrVlvLimpAirPosnMaxRelDriftB1_C DFES_EnvRef.DFC_ThrVlvLimpAirPosnMinB1_C DFES_EnvRef.DFC_ThrVlvOpenLoadB1_C DFES_EnvRef.DFC_ThrVlvOpenSprgB1_C DFES_EnvRef.DFC_ThrVlvOpenSprgSprdB1_C DFES_EnvRef.DFC_ThrVlvOpenSprgTwnB1_C DFES_EnvRef.DFC_ThrVlvOverTB1_C DFES_EnvRef.DFC_ThrVlvRetSprgB1_C DFES_EnvRef.DFC_ThrVlvRetSprgSprdB1_C DFES_EnvRef.DFC_ThrVlvRetSprgTwnB1_C DFES_EnvRef.DFC_ThrVlvSens1MaxB1_C DFES_EnvRef.DFC_ThrVlvSens1NplB1_C DFES_EnvRef.DFC_ThrVlvSens2MaxB1_C DFES_EnvRef.DFC_ThrVlvSens2MinB1_C DFES_EnvRef.DFC_ThrVlvSens2NplB1_C DFES_EnvRef.DFC_ThrVlvShoCircB1_C DFES_EnvRef.DFC_ThrVlvSpiErrB1_C DFES_EnvRef.DFC_ThrvlvSens1MinB1_C DFES_EnvRef.DFC_TiOffTBasdChkFast_C DFES_EnvRef.DFC_TiOffTBasdChkSlow_C DFES_EnvRef.DFC_UEGOSnsrMntdS1B1_C DFES_EnvRef.DFC_VehVSig_C DFES_EnvRef.DFC_VlvLftFbSwtIntk11SpclFail_C DFES_EnvRef.DFC_VlvLftFbSwtIntk11StdFail_C DFES_FaultTyp.DFC_Unused_C DFES_FaultTyp.DFC_AAVEmax_C DFES_FaultTyp.DFC_AAVEmin_C DFES_FaultTyp.DFC_AAVEsig_C DFES_FaultTyp.DFC_AltIOACGFailr_C DFES_FaultTyp.DFC_AltIOACGHiVltg_C DFES_FaultTyp.DFC_AltIOACGLoVltg_C DFES_FaultTyp.DFC_AltIOACGTHi_C DFES_FaultTyp.DFC_AltIODConnACG_C DFES_FaultTyp.DFC_BGOELWAF_C DFES_FaultTyp.DFC_BattUHiFailr_C DFES_FaultTyp.DFC_BattULoFailr_C DFES_FaultTyp.DFC_BrkBstPDriftHiErr_C DFES_FaultTyp.DFC_BrkBstPDriftLoErr_C DFES_FaultTyp.DFC_BrkBstPSnsrStuck_C DFES_FaultTyp.DFC_BrkMnSwtContOn_C DFES_FaultTyp.DFC_BrkMnSwtNotStp_C DFES_FaultTyp.DFC_BrkNpl_C DFES_FaultTyp.DFC_BrkRdntSwtContOn_C DFES_FaultTyp.DFC_BrkRdntSwtNotStp_C DFES_FaultTyp.DFC_Clth3ONStuck_C DFES_FaultTyp.DFC_Clth4OFFStuck_C DFES_FaultTyp.DFC_ClthOFFStuck_C DFES_FaultTyp.DFC_ClthONStuck_C DFES_FaultTyp.DFC_ClthStkFailInfo_C DFES_FaultTyp.DFC_ComACFailInfo_C DFES_FaultTyp.DFC_ComATFTValErr_C DFES_FaultTyp.DFC_ComATMILReq_C DFES_FaultTyp.DFC_ComAYCAChksum_C DFES_FaultTyp.DFC_ComAYCARingCnt_C DFES_FaultTyp.DFC_ComAYCATOut_C DFES_FaultTyp.DFC_ComAYCDChkSum_C DFES_FaultTyp.DFC_ComAYCDTOut_C DFES_FaultTyp.DFC_ComAYCFChksum_C DFES_FaultTyp.DFC_ComAYCFRingCnt_C DFES_FaultTyp.DFC_ComAYCFTOut_C DFES_FaultTyp.DFC_ComAYCGChksum_C DFES_FaultTyp.DFC_ComAYCGRingCnt_C DFES_FaultTyp.DFC_ComAYCGTOut_C DFES_FaultTyp.DFC_ComAYCIChkSum_C DFES_FaultTyp.DFC_ComAYCIRingCnt_C DFES_FaultTyp.DFC_ComAYCITOut_C DFES_FaultTyp.DFC_ComBCM1ChkSum_C DFES_FaultTyp.DFC_ComBCM1RingCnt_C DFES_FaultTyp.DFC_ComBCM1TOut_C DFES_FaultTyp.DFC_ComCANABusOffErr_C DFES_FaultTyp.DFC_ComCANBBusOffErr_C DFES_FaultTyp.DFC_ComCANCBusOffErr_C DFES_FaultTyp.DFC_ComCGW1ChkSum_C DFES_FaultTyp.DFC_ComCGW1RingCnt_C DFES_FaultTyp.DFC_ComCGW1TOut_C DFES_FaultTyp.DFC_ComConvBoostErr_C DFES_FaultTyp.DFC_ComConvSlipErr_C DFES_FaultTyp.DFC_ComDCDCPrfmncErr_C DFES_FaultTyp.DFC_ComDCDCTempWarn_C DFES_FaultTyp.DFC_ComEAT10Chksum_C DFES_FaultTyp.DFC_ComEAT10RingCnt_C DFES_FaultTyp.DFC_ComEAT10TOut_C DFES_FaultTyp.DFC_ComEAT11ChkSum_C DFES_FaultTyp.DFC_ComEAT11RingCnt_C DFES_FaultTyp.DFC_ComEAT11TOut_C DFES_FaultTyp.DFC_ComEAT12ChkSum_C DFES_FaultTyp.DFC_ComEAT12RingCnt_C DFES_FaultTyp.DFC_ComEAT12TOut_C DFES_FaultTyp.DFC_ComEAT13ChkSum_C DFES_FaultTyp.DFC_ComEAT13RingCnt_C DFES_FaultTyp.DFC_ComEAT13TOut_C DFES_FaultTyp.DFC_ComEAT1Chksum_C DFES_FaultTyp.DFC_ComEAT1RingCnt_C DFES_FaultTyp.DFC_ComEAT1TOut_C DFES_FaultTyp.DFC_ComEAT2ChkSum_C DFES_FaultTyp.DFC_ComEAT2RingCnt_C DFES_FaultTyp.DFC_ComEAT2TOut_C DFES_FaultTyp.DFC_ComEAT4ChkSum_C DFES_FaultTyp.DFC_ComEAT4RingCnt_C DFES_FaultTyp.DFC_ComEAT4TOut_C DFES_FaultTyp.DFC_ComEAT6Chksum_C DFES_FaultTyp.DFC_ComEAT6RingCnt_C DFES_FaultTyp.DFC_ComEAT6TOut_C DFES_FaultTyp.DFC_ComEAT7Chksum_C DFES_FaultTyp.DFC_ComEAT7RingCnt_C DFES_FaultTyp.DFC_ComEAT7TOut_C DFES_FaultTyp.DFC_ComEAT8Chksum_C DFES_FaultTyp.DFC_ComEAT8RingCnt_C DFES_FaultTyp.DFC_ComEAT8TOut_C DFES_FaultTyp.DFC_ComEATAChksum_C DFES_FaultTyp.DFC_ComEATARingCnt_C DFES_FaultTyp.DFC_ComEATATOut_C DFES_FaultTyp.DFC_ComEATBChkSum_C DFES_FaultTyp.DFC_ComEATBRingCnt_C DFES_FaultTyp.DFC_ComEATBTOut_C DFES_FaultTyp.DFC_ComEATCChksum_C DFES_FaultTyp.DFC_ComEATCRingCnt_C DFES_FaultTyp.DFC_ComEATCTOut_C DFES_FaultTyp.DFC_ComEPBBChkSum_C DFES_FaultTyp.DFC_ComEPBBRingCnt_C DFES_FaultTyp.DFC_ComEPBBTOut_C DFES_FaultTyp.DFC_ComEPBChksum_C DFES_FaultTyp.DFC_ComEPBTOut_C DFES_FaultTyp.DFC_ComEPBctRing_C DFES_FaultTyp.DFC_ComEPS1Chksum_C DFES_FaultTyp.DFC_ComEPS1RingCnt_C DFES_FaultTyp.DFC_ComEPS1TOut_C DFES_FaultTyp.DFC_ComEngCanRxErr_C DFES_FaultTyp.DFC_ComGrvySnsrErr_C DFES_FaultTyp.DFC_ComGwIMG1ChkSum_C DFES_FaultTyp.DFC_ComGwIMG1RingCnt_C DFES_FaultTyp.DFC_ComGwIMG1TOut_C DFES_FaultTyp.DFC_ComGwIMG3ChkSum_C DFES_FaultTyp.DFC_ComGwIMG3RingCnt_C DFES_FaultTyp.DFC_ComGwIMG3TOut_C DFES_FaultTyp.DFC_ComGwIMG4ChkSum_C DFES_FaultTyp.DFC_ComGwIMG4RingCnt_C DFES_FaultTyp.DFC_ComGwIMG4TOut_C DFES_FaultTyp.DFC_ComGwIMG5ChkSum_C DFES_FaultTyp.DFC_ComGwIMG5RingCnt_C DFES_FaultTyp.DFC_ComGwIMG5TOut_C DFES_FaultTyp.DFC_ComGwIMG6ChkSum_C DFES_FaultTyp.DFC_ComGwIMG6RingCnt_C DFES_FaultTyp.DFC_ComGwIMG6TOut_C DFES_FaultTyp.DFC_ComIDASBChksum_C DFES_FaultTyp.DFC_ComIDASBRingCnt_C DFES_FaultTyp.DFC_ComIDASBTOut_C DFES_FaultTyp.DFC_ComIMGMILReq_C DFES_FaultTyp.DFC_ComISSPrms_C DFES_FaultTyp.DFC_ComMETAChksum_C DFES_FaultTyp.DFC_ComMETAChksumPstDrv_C DFES_FaultTyp.DFC_ComMETARingCnt_C DFES_FaultTyp.DFC_ComMETARingCntPstDrv_C DFES_FaultTyp.DFC_ComMETATOut_C DFES_FaultTyp.DFC_ComMETATOutPstDrv_C DFES_FaultTyp.DFC_ComMETCChksum_C DFES_FaultTyp.DFC_ComMETCRingCnt_C DFES_FaultTyp.DFC_ComMETCTOut_C DFES_FaultTyp.DFC_ComMETDChksum_C DFES_FaultTyp.DFC_ComMETDRingCnt_C DFES_FaultTyp.DFC_ComMETDTOut_C DFES_FaultTyp.DFC_ComMETE2Chksum_C DFES_FaultTyp.DFC_ComMETE2RingCnt_C DFES_FaultTyp.DFC_ComMETE2TOut_C DFES_FaultTyp.DFC_ComMETFChksum_C DFES_FaultTyp.DFC_ComMETFRingCnt_C DFES_FaultTyp.DFC_ComMETFTOut_C DFES_FaultTyp.DFC_ComMETGChksum_C DFES_FaultTyp.DFC_ComMETGRingCnt_C DFES_FaultTyp.DFC_ComMETGTOut_C DFES_FaultTyp.DFC_ComMETH2Chksum_C DFES_FaultTyp.DFC_ComMETH2RingCnt_C DFES_FaultTyp.DFC_ComMETH2TOut_C DFES_FaultTyp.DFC_ComMETHChksum_C DFES_FaultTyp.DFC_ComMETHRingCnt_C DFES_FaultTyp.DFC_ComMETHTOut_C DFES_FaultTyp.DFC_ComMETIChksum_C DFES_FaultTyp.DFC_ComMETIRingCnt_C DFES_FaultTyp.DFC_ComMETITOut_C DFES_FaultTyp.DFC_ComMETKChksum_C DFES_FaultTyp.DFC_ComMETKRingCnt_C DFES_FaultTyp.DFC_ComMETKTOut_C DFES_FaultTyp.DFC_ComMETLChksum_C DFES_FaultTyp.DFC_ComMETLRingCnt_C DFES_FaultTyp.DFC_ComMETLTOut_C DFES_FaultTyp.DFC_ComMETMChksum_C DFES_FaultTyp.DFC_ComMETMRingCnt_C DFES_FaultTyp.DFC_ComMETMTOut_C DFES_FaultTyp.DFC_ComMETNChksum_C DFES_FaultTyp.DFC_ComMETNRingCnt_C DFES_FaultTyp.DFC_ComMETNTOut_C DFES_FaultTyp.DFC_ComMtrCom_C DFES_FaultTyp.DFC_ComPCUChkSum_C DFES_FaultTyp.DFC_ComPCURingCnt_C DFES_FaultTyp.DFC_ComPCUTOut_C DFES_FaultTyp.DFC_ComSRSAChksum_C DFES_FaultTyp.DFC_ComSRSARingCnt_C DFES_FaultTyp.DFC_ComSRSATOut_C DFES_FaultTyp.DFC_ComSRSBChksum_C DFES_FaultTyp.DFC_ComSRSBRingCnt_C DFES_FaultTyp.DFC_ComSRSBTOut_C DFES_FaultTyp.DFC_ComSRSChksum_C DFES_FaultTyp.DFC_ComSRSErr_C DFES_FaultTyp.DFC_ComSRSRingCnt_C DFES_FaultTyp.DFC_ComSRSTOut_C DFES_FaultTyp.DFC_ComVehSpdPndFltTCU_C DFES_FaultTyp.DFC_EbsChartcCurrErr_C DFES_FaultTyp.DFC_EbsSelfDiagErr_C DFES_FaultTyp.DFC_GEVlvPhaCsersIntkB1_C DFES_FaultTyp.DFC_GEVlvPhaPsOpenLoadIntkB1_C DFES_FaultTyp.DFC_GEVlvPhaPsShoToBattIntkB1_C DFES_FaultTyp.DFC_GEVlvPhaPsShoToGndIntkB1_C DFES_FaultTyp.DFC_GbxCANDigPlausErr_C DFES_FaultTyp.DFC_GbxNPos1SRCMax_C DFES_FaultTyp.DFC_GbxNPos1SRCMin_C DFES_FaultTyp.DFC_GbxNPos2SRCMax_C DFES_FaultTyp.DFC_GbxNPos2SRCMin_C DFES_FaultTyp.DFC_GbxNPosAlvChk_C DFES_FaultTyp.DFC_GbxNPosSyncErr_C DFES_FaultTyp.DFC_HEGOS2B1HtrPsMax_C DFES_FaultTyp.DFC_HEGOS2B1HtrPsMin_C DFES_FaultTyp.DFC_HEGOS2B1HtrPsSig_C DFES_FaultTyp.DFC_LinCSErrACG_C DFES_FaultTyp.DFC_LinCSErrAEV_C DFES_FaultTyp.DFC_LinCSErrDCDC_C DFES_FaultTyp.DFC_LinCSErrEBS_C DFES_FaultTyp.DFC_LinHdrTimeoutErrACG_C DFES_FaultTyp.DFC_LinHdrTimeoutErrAEV_C DFES_FaultTyp.DFC_LinHdrTimeoutErrDCDC_C DFES_FaultTyp.DFC_LinHdrTimeoutErrEBS_C DFES_FaultTyp.DFC_LinMsgTimeoutErrACG_C DFES_FaultTyp.DFC_LinMsgTimeoutErrAEV_C DFES_FaultTyp.DFC_LinMsgTimeoutErrDCDC_C DFES_FaultTyp.DFC_LinMsgTimeoutErrEBS_C DFES_FaultTyp.DFC_LinNoStrtComErr_C DFES_FaultTyp.DFC_LowPresOilP_C DFES_FaultTyp.DFC_MisfDetVWhlFrntLeOORHi_C DFES_FaultTyp.DFC_MisfDetVWhlFrntLeRatyHi_C DFES_FaultTyp.DFC_MisfDetVWhlFrntLeRatyLo_C DFES_FaultTyp.DFC_MisfDetVWhlFrntLeStuck_C DFES_FaultTyp.DFC_MisfDetVWhlFrntRiOORHi_C DFES_FaultTyp.DFC_MisfDetVWhlFrntRiRatyHi_C DFES_FaultTyp.DFC_MisfDetVWhlFrntRiRatyLo_C DFES_FaultTyp.DFC_MisfDetVWhlFrntRiStuck_C DFES_FaultTyp.DFC_MisfDetVWhlReLeOORHi_C DFES_FaultTyp.DFC_MisfDetVWhlReLeRatyHi_C DFES_FaultTyp.DFC_MisfDetVWhlReLeRatyLo_C DFES_FaultTyp.DFC_MisfDetVWhlReLeStuck_C DFES_FaultTyp.DFC_MisfDetVWhlReRiOORHi_C DFES_FaultTyp.DFC_MisfDetVWhlReRiRatyHi_C DFES_FaultTyp.DFC_MisfDetVWhlReRiRatyLo_C DFES_FaultTyp.DFC_MisfDetVWhlReRiStuck_C DFES_FaultTyp.DFC_MisfDetdVWhlFrntLePlaus_C DFES_FaultTyp.DFC_MisfDetdVWhlFrntRiPlaus_C DFES_FaultTyp.DFC_MisfDetdVWhlReLePlaus_C DFES_FaultTyp.DFC_MisfDetdVWhlReRiPlaus_C DFES_FaultTyp.DFC_PEnvSigRngMax_C DFES_FaultTyp.DFC_PEnvSigRngMin_C DFES_FaultTyp.DFC_StmFault_C DFES_FaultTyp.DFC_StrtCtOffPth_C DFES_FaultTyp.DFC_StrtCtlErr_C DFES_FaultTyp.DFC_StrtFault_C DFES_FaultTyp.DFC_StrtLckJudg1_C DFES_FaultTyp.DFC_StrtLckJudg2_C DFES_FaultTyp.DFC_StrtOL_C DFES_FaultTyp.DFC_StrtOL2_C DFES_FaultTyp.DFC_StrtSCB_C DFES_FaultTyp.DFC_StrtSCB2_C DFES_FaultTyp.DFC_StrtSCG_C DFES_FaultTyp.DFC_StrtSCG2_C DFES_FaultTyp.DFC_StrtStkRly1_C DFES_FaultTyp.DFC_StrtStkRly2_C DFES_FaultTyp.DFC_TEVEmax_C DFES_FaultTyp.DFC_TEVEmin_C DFES_FaultTyp.DFC_TEVEsig_C DFES_FaultTyp.DFC_UegoHeatrPrfmncLoS1B1_C DFES_FaultTyp.DFC_VehVAllPlaus_C DFES_FaultTyp.DFC_VehVNCSnsrElecFailr_C DFES_FaultTyp.DFC_VehVPlausCan_C DFES_FaultTyp.DFC_VehVPlausFco_C DFES_FaultTyp.DFC_VehVPlausPwr_C DFES_FaultTyp.DFC_VehVPlausV2N_C DFES_FaultTyp.DFC_VehVSpdSnsrAElecFailr_C DFES_FaultTyp.DFC_VehVSpdSnsrBElecFailr_C DFES_FaultTyp.DFC_ClthMax_C DFES_FaultTyp.DFC_IgnClPs_DevComErr_C DFES_FaultTyp.DFC_IgnClPs_LineOl_0_C DFES_FaultTyp.DFC_IgnClPs_LineOl_1_C DFES_FaultTyp.DFC_IgnClPs_LineOl_2_C DFES_FaultTyp.DFC_IgnClPs_LineOl_3_C DFES_FaultTyp.DFC_IgnClPs_LineScb_0_C DFES_FaultTyp.DFC_IgnClPs_LineScb_1_C DFES_FaultTyp.DFC_IgnClPs_LineScb_2_C DFES_FaultTyp.DFC_IgnClPs_LineScb_3_C DFES_FaultTyp.DFC_IgnClPs_LineScg_0_C DFES_FaultTyp.DFC_IgnClPs_LineScg_1_C DFES_FaultTyp.DFC_IgnClPs_LineScg_2_C DFES_FaultTyp.DFC_IgnClPs_LineScg_3_C DFES_FaultTyp.DFC_KRVEKOEVAB_C DFES_FaultTyp.DFC_KRVEKOEVAB0_C DFES_FaultTyp.DFC_KRVEKOEVAB1_C DFES_FaultTyp.DFC_KRVEKOEVAB2_C DFES_FaultTyp.DFC_KRVEKOEVAB3_C DFES_FaultTyp.DFC_UegoSigEcuAsicS1B1_C DFES_FaultTyp.DFC_UegoSigEcuComS1B1_C DFES_FaultTyp.DFC_UegoSigSnsrS1B1_C DFES_FaultTyp.DFC_UegoSigWireOlApesS1B1_C DFES_FaultTyp.DFC_UegoSigWireOlIpeS1B1_C DFES_FaultTyp.DFC_UegoSigWireOlReS1B1_C DFES_FaultTyp.DFC_UegoSigWireRCmpS1B1_C DFES_FaultTyp.DFC_UegoSigWireScbS1B1_C DFES_FaultTyp.DFC_UegoSigWireScgS1B1_C DFES_FaultTyp.DFC_AfsPhyRngHiB1_C DFES_FaultTyp.DFC_AfsPhyRngLoB1_C DFES_FaultTyp.DFC_AirCCmprOL_C DFES_FaultTyp.DFC_AirCCmprOvrTemp_C DFES_FaultTyp.DFC_AirCCmprSCB_C DFES_FaultTyp.DFC_AirCCmprSCG_C DFES_FaultTyp.DFC_AltErr_C DFES_FaultTyp.DFC_BattUSRCMax_C DFES_FaultTyp.DFC_BattUSRCMin_C DFES_FaultTyp.DFC_ComChksTCU1_C DFES_FaultTyp.DFC_ComChksTCU11_C DFES_FaultTyp.DFC_ComChksTCU12_C DFES_FaultTyp.DFC_ComChksTCU13_C DFES_FaultTyp.DFC_ComChksTCU2_C DFES_FaultTyp.DFC_ComChksTCU3_C DFES_FaultTyp.DFC_ComChksTCU4_C DFES_FaultTyp.DFC_ComCntTCU1_C DFES_FaultTyp.DFC_ComCntTCU11_C DFES_FaultTyp.DFC_ComCntTCU12_C DFES_FaultTyp.DFC_ComCntTCU13_C DFES_FaultTyp.DFC_ComCntTCU2_C DFES_FaultTyp.DFC_ComCntTCU3_C DFES_FaultTyp.DFC_ComCntTCU4_C DFES_FaultTyp.DFC_ComTOutTCU01_C DFES_FaultTyp.DFC_ComTOutTCU02_C DFES_FaultTyp.DFC_ComTOutTCU1_C DFES_FaultTyp.DFC_ComTOutTCU11_C DFES_FaultTyp.DFC_ComTOutTCU12_C DFES_FaultTyp.DFC_ComTOutTCU13_C DFES_FaultTyp.DFC_ComTOutTCU14_C DFES_FaultTyp.DFC_ComTOutTCU2_C DFES_FaultTyp.DFC_ComTOutTCU3_C DFES_FaultTyp.DFC_ComTOutTCU4_C DFES_FaultTyp.DFC_DevLibBattUHi_C DFES_FaultTyp.DFC_DevLibBattULo_C DFES_FaultTyp.DFC_EGRVlvFailSafeActv_C DFES_FaultTyp.DFC_EGRVlvGovDvtCld_C DFES_FaultTyp.DFC_EGRVlvPhysSRCMax_C DFES_FaultTyp.DFC_EGRVlvPhysSRCMin_C DFES_FaultTyp.DFC_FanDIOOL_0_C DFES_FaultTyp.DFC_FanDIOOL_1_C DFES_FaultTyp.DFC_FanDIOOvrTemp_0_C DFES_FaultTyp.DFC_FanDIOOvrTemp_1_C DFES_FaultTyp.DFC_FanDIOSCB_0_C DFES_FaultTyp.DFC_FanDIOSCB_1_C DFES_FaultTyp.DFC_FanDIOSCG_0_C DFES_FaultTyp.DFC_FanDIOSCG_1_C DFES_FaultTyp.DFC_MRlyDcOL_C DFES_FaultTyp.DFC_MRlyDcSCB_C DFES_FaultTyp.DFC_MRlyDcSCG_C DFES_FaultTyp.DFC_PSPOL_C DFES_FaultTyp.DFC_PSPOvrTemp_C DFES_FaultTyp.DFC_PSPSCB_C DFES_FaultTyp.DFC_PSPSCG_C DFES_FaultTyp.DFC_T50Err_C DFES_FaultTyp.DFC_ThrVlvLoBattB1_C DFES_FaultTyp.DFC_UegoSigOperPlausS1B1_C DFES_FaultTyp.DFC_VehVPhysRngHi_C DFES_FaultTyp.DFC_VehVSclOutOL_C DFES_FaultTyp.DFC_VehVSclOutOT_C DFES_FaultTyp.DFC_VehVSclOutSCB_C DFES_FaultTyp.DFC_VehVSclOutSCG_C DFES_FaultTyp.DFC_VehVSigFL_C DFES_FaultTyp.DFC_VehVSigFR_C DFES_FaultTyp.DFC_VehVSigRL_C DFES_FaultTyp.DFC_VehVSigRR_C DFES_FaultTyp.DFC_VehVSnsrARngHi_C DFES_FaultTyp.DFC_VehVSnsrBRngHi_C DFES_FaultTyp.DFC_VehVSpdRtyDiag_C DFES_FaultTyp.DFC_DHFHD_C DFES_FaultTyp.DFC_InjVlv_DI_DcDc_C DFES_FaultTyp.DFC_InjVlv_DI_NoLd_0_C DFES_FaultTyp.DFC_InjVlv_DI_NoLd_1_C DFES_FaultTyp.DFC_InjVlv_DI_NoLd_2_C DFES_FaultTyp.DFC_InjVlv_DI_NoLd_3_C DFES_FaultTyp.DFC_InjVlv_DI_ScBnk_0_C DFES_FaultTyp.DFC_InjVlv_DI_ScBnk_1_C DFES_FaultTyp.DFC_InjVlv_DI_ScBnk_2_C DFES_FaultTyp.DFC_InjVlv_DI_ScBnk_3_C DFES_FaultTyp.DFC_InjVlv_DI_ScCyl_0_C DFES_FaultTyp.DFC_InjVlv_DI_ScCyl_1_C DFES_FaultTyp.DFC_InjVlv_DI_ScCyl_2_C DFES_FaultTyp.DFC_InjVlv_DI_ScCyl_3_C DFES_FaultTyp.DFC_InjVlv_DI_ScHsLs_0_C DFES_FaultTyp.DFC_InjVlv_DI_ScHsLs_1_C DFES_FaultTyp.DFC_InjVlv_DI_ScHsLs_2_C DFES_FaultTyp.DFC_InjVlv_DI_ScHsLs_3_C DFES_FaultTyp.DFC_MfPsDiaOpenLoad1_C DFES_FaultTyp.DFC_MfPsDiaScHiS1_C DFES_FaultTyp.DFC_MfPsDiaScHiSLowS1_C DFES_FaultTyp.DFC_MfPsDiaScLowS1_C DFES_FaultTyp.DFC_ACEvpTPhysRngHi_C DFES_FaultTyp.DFC_ACEvpTPhysRngLo_C DFES_FaultTyp.DFC_ACEvpTSRCMax_C DFES_FaultTyp.DFC_ACEvpTSRCMin_C DFES_FaultTyp.DFC_AfsRawSigRngHiB1_C DFES_FaultTyp.DFC_AfsRawSigRngLoB1_C DFES_FaultTyp.DFC_AfsSnsrErrB1_C DFES_FaultTyp.DFC_AirCClntPAnaSRCMax_C DFES_FaultTyp.DFC_AirCClntPAnaSRCMin_C DFES_FaultTyp.DFC_AirCSwtNpl_C DFES_FaultTyp.DFC_AirCSwtSig_C DFES_FaultTyp.DFC_Brk_C DFES_FaultTyp.DFC_BrkBstSensSCB_C DFES_FaultTyp.DFC_BrkBstSensSCG_C DFES_FaultTyp.DFC_BrkSig_C DFES_FaultTyp.DFC_ClthSig_C DFES_FaultTyp.DFC_EGRVlvCurrLim_C DFES_FaultTyp.DFC_EGRVlvOL_C DFES_FaultTyp.DFC_EGRVlvOvrTemp_C DFES_FaultTyp.DFC_EGRVlvSCB_C DFES_FaultTyp.DFC_EGRVlvSCG_C DFES_FaultTyp.DFC_EGRVlvSRCMax_C DFES_FaultTyp.DFC_EGRVlvSRCMin_C DFES_FaultTyp.DFC_HLSDemOvhtEngLim_C DFES_FaultTyp.DFC_OilPSwmpSRCMax_C DFES_FaultTyp.DFC_OilPSwmpSRCMin_C DFES_FaultTyp.DFC_PIntkVUsLineHiB1_C DFES_FaultTyp.DFC_PIntkVUsLineLoB1_C DFES_FaultTyp.DFC_VehVPhysRngLo_C DFES_FaultTyp.DFC_VehVSigCan_C DFES_FaultTyp.DFC_VehVSigCanSafe_C DFES_FaultTyp.DFC_VlvLftFbOilPSnsrIntk11SRCMax_C DFES_FaultTyp.DFC_VlvLftFbOilPSnsrIntk11SRCMin_C DFES_FaultTyp.DFC_ClthNpl_C DFES_FaultTyp.DFC_GbxPNPosnDrvCdn_C DFES_FaultTyp.DFC_GbxPNPosnPlausy_C DFES_FaultTyp.DFC_AfsSigErrLineHiB1_C DFES_FaultTyp.DFC_AfsSigErrLineLoB1_C DFES_FaultTyp.DFC_PEnvCcMax_C DFES_FaultTyp.DFC_PEnvCcMin_C DFES_FaultTyp.DFC_PEnvRngChkMax_C DFES_FaultTyp.DFC_PEnvRngChkMin_C DFES_FaultTyp.DFC_PEnvSnsrPlaus_C DFES_FaultTyp.DFC_UEGOHeatrRlyPsOLS1B1_C DFES_FaultTyp.DFC_UEGOHeatrRlyPsSCBS1B1_C DFES_FaultTyp.DFC_UEGOHeatrRlyPsSCGS1B1_C DFES_FaultTyp.DFC_UegoHeatrWireOlS1B1_C DFES_FaultTyp.DFC_UegoHeatrWireScbS1B1_C DFES_FaultTyp.DFC_UegoHeatrWireScgS1B1_C DFES_FaultTyp.DFC_KnDetSens1PortAMax_C DFES_FaultTyp.DFC_KnDetSens1PortAMin_C DFES_FaultTyp.DFC_KnDetSens1PortBMax_C DFES_FaultTyp.DFC_KnDetSens1PortBMin_C DFES_FaultTyp.DFC_Clth2ONStuck_C DFES_FaultTyp.DFC_Clth2ONStuckLdc_C DFES_FaultTyp.DFC_Clth3ONStuckLdc_C DFES_FaultTyp.DFC_Clth3ONStuckPostDrv_C DFES_FaultTyp.DFC_Clth4ONStuck_C DFES_FaultTyp.DFC_Clth4ONStuckLdc_C DFES_FaultTyp.DFC_ComBCMUnit_C DFES_FaultTyp.DFC_ComDLCTCU01_C DFES_FaultTyp.DFC_ComDLCTCU02_C DFES_FaultTyp.DFC_ComDLCTCU1_C DFES_FaultTyp.DFC_ComDLCTCU11_C DFES_FaultTyp.DFC_ComDLCTCU12_C DFES_FaultTyp.DFC_ComDLCTCU13_C DFES_FaultTyp.DFC_ComDLCTCU14_C DFES_FaultTyp.DFC_ComDLCTCU2_C DFES_FaultTyp.DFC_ComDLCTCU3_C DFES_FaultTyp.DFC_ComDLCTCU4_C DFES_FaultTyp.DFC_ComEPSUnit_C DFES_FaultTyp.DFC_ComIDASBUnit_C DFES_FaultTyp.DFC_ComIMGUnit_C DFES_FaultTyp.DFC_ComMETUnit_C DFES_FaultTyp.DFC_ComSRSUnit_C DFES_FaultTyp.DFC_ComVSAUnit_C DFES_FaultTyp.DFC_EbsSocFlt_C DFES_FaultTyp.DFC_I14229VINErr_C DFES_FaultTyp.DFC_InjCatHeatgErr_C DFES_FaultTyp.DFC_InjSysMulInjDiagErr_C DFES_FaultTyp.DFC_LLRHmax_C DFES_FaultTyp.DFC_LLRHmin_C DFES_FaultTyp.DFC_LLRHnpl_C DFES_FaultTyp.DFC_LLRKHmax_C DFES_FaultTyp.DFC_LLRKHmin_C DFES_FaultTyp.DFC_LLRKHnpl_C DFES_FaultTyp.DFC_LinACGUnit_C DFES_FaultTyp.DFC_LinAEVUnit_C DFES_FaultTyp.DFC_LinEBSUnit_C DFES_FaultTyp.DFC_RoughRoad_C DFES_FaultTyp.DFC_SiaEEPRdErr_C DFES_FaultTyp.DFC_SiaEEPWrngCod_C DFES_FaultTyp.DFC_UegoHeatrStrtS1B1_C DFES_FaultTyp.DFC_BusDiagCANAPPLBusOff_C DFES_FaultTyp.DFC_BusDiagCANCANCBusOff_C DFES_FaultTyp.DFC_BusDiagCANVEHICLEBusOff_C DFES_FaultTyp.DFC_RBA_IODIAGPWR_rba_IoExtCy329_SignalVltSply_0_C DFES_FaultTyp.DFC_RBA_IODIAGPWR_rba_IoExtCy329_SignalVltSply_0OT_C DFES_FaultTyp.DFC_RBA_IODIAGPWR_rba_IoExtCy329_SignalVltSply_0OV_C DFES_FaultTyp.DFC_RBA_IODIAGPWR_rba_IoExtCy329_SignalVltSply_0SCG_C DFES_FaultTyp.DFC_RBA_IODIAGPWR_rba_IoExtCy329_SignalVltSply_0UV_C DFES_FaultTyp.DFC_RBA_IODIAGPWR_rba_IoExtCy329_SignalVltSply_1_C DFES_FaultTyp.DFC_RBA_IODIAGPWR_rba_IoExtCy329_SignalVltSply_1OT_C DFES_FaultTyp.DFC_RBA_IODIAGPWR_rba_IoExtCy329_SignalVltSply_1OV_C DFES_FaultTyp.DFC_RBA_IODIAGPWR_rba_IoExtCy329_SignalVltSply_1SCG_C DFES_FaultTyp.DFC_RBA_IODIAGPWR_rba_IoExtCy329_SignalVltSply_1UV_C DFES_FaultTyp.DFC_RBA_IODIAGPWR_rba_IoExtCy329_SignalVltSply_2_C DFES_FaultTyp.DFC_RBA_IODIAGPWR_rba_IoExtCy329_SignalVltSply_2OT_C DFES_FaultTyp.DFC_RBA_IODIAGPWR_rba_IoExtCy329_SignalVltSply_2OV_C DFES_FaultTyp.DFC_RBA_IODIAGPWR_rba_IoExtCy329_SignalVltSply_2SCG_C DFES_FaultTyp.DFC_RBA_IODIAGPWR_rba_IoExtCy329_SignalVltSply_2UV_C DFES_FaultTyp.DFC_CAN_E_TIMEOUT_C DFES_FaultTyp.DFC_LIN_E_TIMEOUT_C DFES_FaultTyp.DFC_MRlyOL_C DFES_FaultTyp.DFC_MRlySCB_C DFES_FaultTyp.DFC_MRlySCG_C DFES_FaultTyp.DFC_rba_MultiStackTrace_Threshold_C DFES_FaultTyp.DFC_BSWM_E_ACTION_FAILED_C DFES_FaultTyp.DFC_BSWM_E_INTRPTQUEUE_FULL_C DFES_FaultTyp.DFC_RBA_IOEXTLIB_KEEPALIVE_DRV_C DFES_FaultTyp.DFC_RBA_IOEXTLIB_KEEPALIVE_INI_C DFES_FaultTyp.DFC_rba_IoSigRtc_StopCounter_C DFES_FaultTyp.DFC_rba_MRly_Diag_Stk_Event_C DFES_FaultTyp.DFC_rba_MemDiag_MemReadErr_C DFES_FaultTyp.DFC_rba_MemDiag_MemWrErr_C DFES_FaultTyp.DFC_rba_SyC_IrrSwOffTrigEngRun_Event_C DFES_FaultTyp.DFC_rba_T15_Diag_ComInVld_Event_C DFES_FaultTyp.DFC_rba_T15_Diag_ComOff_HwOn_Event_C DFES_FaultTyp.DFC_rba_T15_Diag_ComOn_HwOff_Event_C DFES_FaultTyp.DFC_AAVmin_C DFES_FaultTyp.DFC_AGRSUS_C DFES_FaultTyp.DFC_AfsPlausDiagHi_C DFES_FaultTyp.DFC_AfsPlausDiagLo_C DFES_FaultTyp.DFC_AfsVrntDiagErrB1_C DFES_FaultTyp.DFC_AppAllSnsrDfct_C DFES_FaultTyp.DFC_BBKRnldg_C DFES_FaultTyp.DFC_BBKRsyne_C DFES_FaultTyp.DFC_BattUStdbyDiaOL_C DFES_FaultTyp.DFC_BigLeakIntkMnfldEmiInfl_C DFES_FaultTyp.DFC_BlkdLineTank_C DFES_FaultTyp.DFC_BrkMnSwtContOnWarnLmp_C DFES_FaultTyp.DFC_BrkMnSwtNotStpWarnLmp_C DFES_FaultTyp.DFC_BrkRdntSwtContOnWarnLmp_C DFES_FaultTyp.DFC_BrkRdntSwtNotStpWarnLmp_C DFES_FaultTyp.DFC_CEngDsTColdStrtMax_C DFES_FaultTyp.DFC_CEngDsTColdStrtMin_C DFES_FaultTyp.DFC_CEngDsTImps_C DFES_FaultTyp.DFC_CEngDsTPlausHSC_C DFES_FaultTyp.DFC_CEngDsTPlausLSC_C DFES_FaultTyp.DFC_CEngDsTPlausSTC_C DFES_FaultTyp.DFC_CEngDsTSRCMax_C DFES_FaultTyp.DFC_CEngDsTSRCMin_C DFES_FaultTyp.DFC_CEngDsTSig_C DFES_FaultTyp.DFC_CEngUsTColdStrtMax_C DFES_FaultTyp.DFC_CEngUsTColdStrtMin_C DFES_FaultTyp.DFC_CEngUsTLooseCnctn_C DFES_FaultTyp.DFC_CEngUsTSRCMax_C DFES_FaultTyp.DFC_CEngUsTSRCMin_C DFES_FaultTyp.DFC_ComDCDCACCFailr_C DFES_FaultTyp.DFC_DCDCFltDet_C DFES_FaultTyp.DFC_DKRSA_C DFES_FaultTyp.DFC_DKVSmax_C DFES_FaultTyp.DFC_DKnpl_C DFES_FaultTyp.DFC_DSKVRmax_C DFES_FaultTyp.DFC_DSKVRmin_C DFES_FaultTyp.DFC_DSKVRnpl_C DFES_FaultTyp.DFC_DSKVRsig_C DFES_FaultTyp.DFC_DSKVSsig_C DFES_FaultTyp.DFC_DSSmax_C DFES_FaultTyp.DFC_DSTDmax_C DFES_FaultTyp.DFC_DSTEmax_C DFES_FaultTyp.DFC_DSTEmin_C DFES_FaultTyp.DFC_DSTOFmax_C DFES_FaultTyp.DFC_DSTRmax_C DFES_FaultTyp.DFC_DSTRmin_C DFES_FaultTyp.DFC_DSTRnpl_C DFES_FaultTyp.DFC_DSTRsig_C DFES_FaultTyp.DFC_DSTTI_C DFES_FaultTyp.DFC_DSUmax_C DFES_FaultTyp.DFC_DiagCpv1DteskLoLoadStuckClsd_C DFES_FaultTyp.DFC_DiagCpv1DteskLoLoadStuckOpen_C DFES_FaultTyp.DFC_EGRVlvDrftClsd_C DFES_FaultTyp.DFC_EGRVlvDrftOpn_C DFES_FaultTyp.DFC_EGRVlvJamVlvClsd_C DFES_FaultTyp.DFC_EGRVlvJamVlvOpn_C DFES_FaultTyp.DFC_EGRVlvSprgBrk_C DFES_FaultTyp.DFC_EGRVlvTempMdlEEPErr_C DFES_FaultTyp.DFC_EGRVlvTmpErr_C DFES_FaultTyp.DFC_EGSDUS2B1LtrDly_C DFES_FaultTyp.DFC_EGSDUS2B1LtrPT1_C DFES_FaultTyp.DFC_EGSDUS2B1RtlDly_C DFES_FaultTyp.DFC_EGSDUS2B1RtlPT1_C DFES_FaultTyp.DFC_EGSDUS2B1TarLean_C DFES_FaultTyp.DFC_EGSDUS2B1TarRich_C DFES_FaultTyp.DFC_EONVmax_C DFES_FaultTyp.DFC_ETAKHLmax_C DFES_FaultTyp.DFC_ETAKHTmax_C DFES_FaultTyp.DFC_ETHSEmax_C DFES_FaultTyp.DFC_ETHSEmin_C DFES_FaultTyp.DFC_ETHSFmax_C DFES_FaultTyp.DFC_ETHSFmin_C DFES_FaultTyp.DFC_ETHSFsig_C DFES_FaultTyp.DFC_ETHSNPWmax_C DFES_FaultTyp.DFC_ETHSNPWmin_C DFES_FaultTyp.DFC_ETHSNPWsig_C DFES_FaultTyp.DFC_ETHSPLnpl_C DFES_FaultTyp.DFC_ETHSTPLnpl_C DFES_FaultTyp.DFC_EngICO_C DFES_FaultTyp.DFC_EngPrtOvrSpdMon_C DFES_FaultTyp.DFC_EpmCaSI1ErrSig_C DFES_FaultTyp.DFC_EpmCaSI1MntErr_C DFES_FaultTyp.DFC_EpmCaSI1NoSigMax_C DFES_FaultTyp.DFC_EpmCaSI1NoSigMin_C DFES_FaultTyp.DFC_EpmCaSI1OfsErr_C DFES_FaultTyp.DFC_EpmCrSDGI_C DFES_FaultTyp.DFC_EpmCrSErrSig_C DFES_FaultTyp.DFC_EpmCrSNoSig_C DFES_FaultTyp.DFC_EtaEngIdleNonCsers_C DFES_FaultTyp.DFC_EtaEngPtlNonCsers_C DFES_FaultTyp.DFC_FRAmax_C DFES_FaultTyp.DFC_FRAmin_C DFES_FaultTyp.DFC_FSTEmax_C DFES_FaultTyp.DFC_FSTEmin_C DFES_FaultTyp.DFC_FSTRmax_C DFES_FaultTyp.DFC_FSTRmin_C DFES_FaultTyp.DFC_FSTRnpl_C DFES_FaultTyp.DFC_FSTmax_C DFES_FaultTyp.DFC_FTDLAmax_C DFES_FaultTyp.DFC_FTDLAmin_C DFES_FaultTyp.DFC_FuPHiSnsrEleclmax_C DFES_FaultTyp.DFC_FuPHiSnsrEleclmin_C DFES_FaultTyp.DFC_FuPHiSnsrEleclnpl_C DFES_FaultTyp.DFC_FuPHiSnsrURngMax_C DFES_FaultTyp.DFC_FuPHiSnsrURngMin_C DFES_FaultTyp.DFC_FuSnsrPhyRngMaxErr_C DFES_FaultTyp.DFC_FuSnsrPhyRngMinErr_C DFES_FaultTyp.DFC_GEVlvLockPinDiagIntkB1_C DFES_FaultTyp.DFC_GEVlvPhaSlowIntkB1_C DFES_FaultTyp.DFC_GEVlvPhaTargIntkB1_C DFES_FaultTyp.DFC_GbxRvsSwtStk_C DFES_FaultTyp.DFC_HDRKHmax_C DFES_FaultTyp.DFC_HDRKHmin_C DFES_FaultTyp.DFC_HDRPLmax_C DFES_FaultTyp.DFC_HDRPLmin_C DFES_FaultTyp.DFC_HDRmax_C DFES_FaultTyp.DFC_HDRmin_C DFES_FaultTyp.DFC_HEGOS2B1ElecMax_C DFES_FaultTyp.DFC_HEGOS2B1ElecMin_C DFES_FaultTyp.DFC_HEGOS2B1ElecSig_C DFES_FaultTyp.DFC_HEGOS2B1HtgNpl_C DFES_FaultTyp.DFC_HEV00max_C DFES_FaultTyp.DFC_HEV01max_C DFES_FaultTyp.DFC_HEV02max_C DFES_FaultTyp.DFC_HEV03max_C DFES_FaultTyp.DFC_HEVE0max_C DFES_FaultTyp.DFC_HEVE1max_C DFES_FaultTyp.DFC_HFMmax_C DFES_FaultTyp.DFC_HiPSysHiPMaxLimExcdd_C DFES_FaultTyp.DFC_IVGdiCtlCvoErrMax_0_C DFES_FaultTyp.DFC_IVGdiCtlCvoErrMax_1_C DFES_FaultTyp.DFC_IVGdiCtlCvoErrMax_2_C DFES_FaultTyp.DFC_IVGdiCtlCvoErrMax_3_C DFES_FaultTyp.DFC_IVGdiCtlCvoErrMin_0_C DFES_FaultTyp.DFC_IVGdiCtlCvoErrMin_1_C DFES_FaultTyp.DFC_IVGdiCtlCvoErrMin_2_C DFES_FaultTyp.DFC_IVGdiCtlCvoErrMin_3_C DFES_FaultTyp.DFC_IVGdiCtlCvoErrMinMax_C DFES_FaultTyp.DFC_IVGdiCtlCvoSigPlausErrSmrCdn_C DFES_FaultTyp.DFC_IVGdiCtl_CvoErr_C DFES_FaultTyp.DFC_IVGdiCtl_CvoSigPlaus_0_C DFES_FaultTyp.DFC_IVGdiCtl_CvoSigPlaus_1_C DFES_FaultTyp.DFC_IVGdiCtl_CvoSigPlaus_2_C DFES_FaultTyp.DFC_IVGdiCtl_CvoSigPlaus_3_C DFES_FaultTyp.DFC_IntkAirTAirFltDsCrssMax_C DFES_FaultTyp.DFC_IntkAirTAirFltDsCrssMin_C DFES_FaultTyp.DFC_IntkAirTAirFltDsHSCMax_C DFES_FaultTyp.DFC_IntkAirTAirFltDsImps_C DFES_FaultTyp.DFC_IntkAirTAirFltDsPRCMax_C DFES_FaultTyp.DFC_IntkAirTAirFltDsPRCMin_C DFES_FaultTyp.DFC_IntkAirTAirFltDsSRCMax_C DFES_FaultTyp.DFC_IntkAirTAirFltDsSRCMin_C DFES_FaultTyp.DFC_IntkAirTAirFltDsSTC_C DFES_FaultTyp.DFC_IntkAirTIntkMnfldCrssMax_C DFES_FaultTyp.DFC_IntkAirTIntkMnfldCrssMin_C DFES_FaultTyp.DFC_IntkAirTIntkMnfldHSCMax_C DFES_FaultTyp.DFC_IntkAirTIntkMnfldImps_C DFES_FaultTyp.DFC_IntkAirTIntkMnfldPRCMax_C DFES_FaultTyp.DFC_IntkAirTIntkMnfldPRCMin_C DFES_FaultTyp.DFC_IntkAirTIntkMnfldSRCMax_C DFES_FaultTyp.DFC_IntkAirTIntkMnfldSRCMin_C DFES_FaultTyp.DFC_IntkAirTIntkMnfldSTC_C DFES_FaultTyp.DFC_KRREGRLMX_C DFES_FaultTyp.DFC_KRVEKOCVLCI_C DFES_FaultTyp.DFC_KRVEKOENCHMT_C DFES_FaultTyp.DFC_KRVEKOENCHMT0_C DFES_FaultTyp.DFC_KRVEKOENCHMT1_C DFES_FaultTyp.DFC_KRVEKOENCHMT2_C DFES_FaultTyp.DFC_KRVEKOENCHMT3_C DFES_FaultTyp.DFC_KRVEKOENCHMT4_C DFES_FaultTyp.DFC_KRVEKOENCHMT5_C DFES_FaultTyp.DFC_KRVEKOENCHMT6_C DFES_FaultTyp.DFC_KRVEKOENCHMT7_C DFES_FaultTyp.DFC_KRVEKORLMX_C DFES_FaultTyp.DFC_KRVEKORLMXL_C DFES_FaultTyp.DFC_KS1max_C DFES_FaultTyp.DFC_KS1min_C /end DEF_CHARACTERISTIC
 FUNCTION_VERSION "30000.73.0_2.0.0" /end FUNCTION
/begin COMPU_METHOD DFES_EnvTabVerb "" TAB_VERB "%6.3" "-" COMPU_TAB_REF DFES_EnvTabVerb /end COMPU_METHOD
/begin COMPU_VTAB DFES_EnvTabVerb "" TAB_VERB 2 0 "xSet1" 1 "xSet2" DEFAULT_VALUE "---" /end COMPU_VTAB
/begin COMPU_METHOD DFES_OneToOne "" RAT_FUNC "%6.2" "-" COEFFS 0 1 0 0 0 1 /end COMPU_METHOD
/begin RECORD_LAYOUT Val_Wu8 FNC_VALUES 1 UBYTE COLUMN_DIR DIRECT /end RECORD_LAYOUT
/end MODULE
/end PROJECT
