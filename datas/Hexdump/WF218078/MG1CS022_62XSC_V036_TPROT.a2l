ASAP2_VERSION 1 60
/begin PROJECT MG1CS022 "MG1CS022"
/begin HEADER "" VERSION "MG1CS022_62XSC_V036_TPROT" PROJECT_NO MG1CS022 /end HEADER
/begin MODULE DIM ""
/begin MOD_COMMON "" BYTE_ORDER MSB_LAST ALIGNMENT_BYTE 1 ALIGNMENT_WORD 2 ALIGNMENT_LONG 4 ALIGNMENT_INT64 4 ALIGNMENT_FLOAT32_IEEE 4 ALIGNMENT_FLOAT64_IEEE 4 DATA_SIZE 32 /end MOD_COMMON
/begin CHARACTERISTIC DINH_FId.DFC_RoughRoad_CA "inhibitable FIds / FIds to be inhibited by inhibit source DFC_RoughRoad" VAL_BLK 0x804E73BE ValA_Wu16 968.000000000 DINH_FIdVerb 0.00 968.000000000 FORMAT "%13.9" NUMBER 54 /end CHARACTERISTIC
/begin CHARACTERISTIC DINH_FId.DFC_SiaEEPRdErr_CA "inhibitable FIds / FIds to be inhibited by inhibit source DFC_SiaEEPRdErr" VAL_BLK 0x804E742A ValA_Wu16 968.000000000 DINH_FIdVerb 0.00 968.000000000 FORMAT "%13.9" NUMBER 51 /end CHARACTERISTIC
/begin CHARACTERISTIC DINH_FId.DFC_SiaEEPWrngCod_CA "inhibitable FIds / FIds to be inhibited by inhibit source DFC_SiaEEPWrngCod" VAL_BLK 0x804E7490 ValA_Wu16 968.000000000 DINH_FIdVerb 0.00 968.000000000 FORMAT "%13.9" NUMBER 51 /end CHARACTERISTIC
/begin CHARACTERISTIC DINH_FId.DFC_UegoHeatrStrtS1B1_CA "inhibitable FIds / FIds to be inhibited by inhibit source DFC_UegoHeatrStrtS1B1" VAL_BLK 0x804E74F6 ValA_Wu16 968.000000000 DINH_FIdVerb 0.00 968.000000000 FORMAT "%13.9" NUMBER 53 /end CHARACTERISTIC
/begin CHARACTERISTIC DINH_FId.DFC_BusDiagCANAPPLBusOff_CA "inhibitable FIds / FIds to be inhibited by inhibit source DFC_BusDiagCANAPPLBusOff" VAL_BLK 0x804E7560 ValA_Wu16 968.000000000 DINH_FIdVerb 0.00 968.000000000 FORMAT "%13.9" NUMBER 50 /end CHARACTERISTIC
/begin CHARACTERISTIC DINH_FId.DFC_BusDiagCANCANCBusOff_CA "inhibitable FIds / FIds to be inhibited by inhibit source DFC_BusDiagCANCANCBusOff" VAL_BLK 0x804E75C4 ValA_Wu16 968.000000000 DINH_FIdVerb 0.00 968.000000000 FORMAT "%13.9" NUMBER 50 /end CHARACTERISTIC
/begin CHARACTERISTIC DINH_FId.DFC_BusDiagCANVEHICLEBusOff_CA "inhibitable FIds / FIds to be inhibited by inhibit source DFC_BusDiagCANVEHICLEBusOff" VAL_BLK 0x804E7628 ValA_Wu16 968.000000000 DINH_FIdVerb 0.00 968.000000000 FORMAT "%13.9" NUMBER 61 /end CHARACTERISTIC
/begin CHARACTERISTIC DINH_FId.DFC_RBA_IODIAGPWR_rba_IoExtCy329_SignalVltSply_0_CA "inhibitable FIds / FIds to be inhibited by inhibit source DFC_RBA_IODIAGPWR_rba_IoExtCy329_SignalVltSply_0" VAL_BLK 0x804E76A2 ValA_Wu16 968.000000000 DINH_FIdVerb 0.00 968.000000000 FORMAT "%13.9" NUMBER 200 /end CHARACTERISTIC
/begin CHARACTERISTIC DINH_FId.DFC_RBA_IODIAGPWR_rba_IoExtCy329_SignalVltSply_0OT_CA "inhibitable FIds / FIds to be inhibited by inhibit source DFC_RBA_IODIAGPWR_rba_IoExtCy329_SignalVltSply_0OT" VAL_BLK 0x804E7832 ValA_Wu16 968.000000000 DINH_FIdVerb 0.00 968.000000000 FORMAT "%13.9" NUMBER 50 /end CHARACTERISTIC
/begin CHARACTERISTIC DINH_FId.DFC_RBA_IODIAGPWR_rba_IoExtCy329_SignalVltSply_0OV_CA "inhibitable FIds / FIds to be inhibited by inhibit source DFC_RBA_IODIAGPWR_rba_IoExtCy329_SignalVltSply_0OV" VAL_BLK 0x804E7896 ValA_Wu16 968.000000000 DINH_FIdVerb 0.00 968.000000000 FORMAT "%13.9" NUMBER 50 /end CHARACTERISTIC
/begin CHARACTERISTIC DINH_FId.DFC_RBA_IODIAGPWR_rba_IoExtCy329_SignalVltSply_0SCG_CA "inhibitable FIds / FIds to be inhibited by inhibit source DFC_RBA_IODIAGPWR_rba_IoExtCy329_SignalVltSply_0SCG" VAL_BLK 0x804E78FA ValA_Wu16 968.000000000 DINH_FIdVerb 0.00 968.000000000 FORMAT "%13.9" NUMBER 50 /end CHARACTERISTIC
/begin CHARACTERISTIC DINH_FId.DFC_RBA_IODIAGPWR_rba_IoExtCy329_SignalVltSply_0UV_CA "inhibitable FIds / FIds to be inhibited by inhibit source DFC_RBA_IODIAGPWR_rba_IoExtCy329_SignalVltSply_0UV" VAL_BLK 0x804E795E ValA_Wu16 968.000000000 DINH_FIdVerb 0.00 968.000000000 FORMAT "%13.9" NUMBER 50 /end CHARACTERISTIC
/begin CHARACTERISTIC DINH_FId.DFC_RBA_IODIAGPWR_rba_IoExtCy329_SignalVltSply_1_CA "inhibitable FIds / FIds to be inhibited by inhibit source DFC_RBA_IODIAGPWR_rba_IoExtCy329_SignalVltSply_1" VAL_BLK 0x804E79C2 ValA_Wu16 968.000000000 DINH_FIdVerb 0.00 968.000000000 FORMAT "%13.9" NUMBER 200 /end CHARACTERISTIC
/begin CHARACTERISTIC DINH_FId.DFC_RBA_IODIAGPWR_rba_IoExtCy329_SignalVltSply_1OT_CA "inhibitable FIds / FIds to be inhibited by inhibit source DFC_RBA_IODIAGPWR_rba_IoExtCy329_SignalVltSply_1OT" VAL_BLK 0x804E7B52 ValA_Wu16 968.000000000 DINH_FIdVerb 0.00 968.000000000 FORMAT "%13.9" NUMBER 50 /end CHARACTERISTIC
/begin CHARACTERISTIC DINH_FId.DFC_RBA_IODIAGPWR_rba_IoExtCy329_SignalVltSply_1OV_CA "inhibitable FIds / FIds to be inhibited by inhibit source DFC_RBA_IODIAGPWR_rba_IoExtCy329_SignalVltSply_1OV" VAL_BLK 0x804E7BB6 ValA_Wu16 968.000000000 DINH_FIdVerb 0.00 968.000000000 FORMAT "%13.9" NUMBER 50 /end CHARACTERISTIC
/begin CHARACTERISTIC DINH_FId.DFC_RBA_IODIAGPWR_rba_IoExtCy329_SignalVltSply_1SCG_CA "inhibitable FIds / FIds to be inhibited by inhibit source DFC_RBA_IODIAGPWR_rba_IoExtCy329_SignalVltSply_1SCG" VAL_BLK 0x804E7C1A ValA_Wu16 968.000000000 DINH_FIdVerb 0.00 968.000000000 FORMAT "%13.9" NUMBER 50 /end CHARACTERISTIC
/begin CHARACTERISTIC DINH_FId.DFC_RBA_IODIAGPWR_rba_IoExtCy329_SignalVltSply_1UV_CA "inhibitable FIds / FIds to be inhibited by inhibit source DFC_RBA_IODIAGPWR_rba_IoExtCy329_SignalVltSply_1UV" VAL_BLK 0x804E7C7E ValA_Wu16 968.000000000 DINH_FIdVerb 0.00 968.000000000 FORMAT "%13.9" NUMBER 50 /end CHARACTERISTIC
/begin CHARACTERISTIC DINH_FId.DFC_RBA_IODIAGPWR_rba_IoExtCy329_SignalVltSply_2_CA "inhibitable FIds / FIds to be inhibited by inhibit source DFC_RBA_IODIAGPWR_rba_IoExtCy329_SignalVltSply_2" VAL_BLK 0x804E7CE2 ValA_Wu16 968.000000000 DINH_FIdVerb 0.00 968.000000000 FORMAT "%13.9" NUMBER 200 /end CHARACTERISTIC
/begin CHARACTERISTIC DINH_FId.DFC_RBA_IODIAGPWR_rba_IoExtCy329_SignalVltSply_2OT_CA "inhibitable FIds / FIds to be inhibited by inhibit source DFC_RBA_IODIAGPWR_rba_IoExtCy329_SignalVltSply_2OT" VAL_BLK 0x804E7E72 ValA_Wu16 968.000000000 DINH_FIdVerb 0.00 968.000000000 FORMAT "%13.9" NUMBER 50 /end CHARACTERISTIC
/begin CHARACTERISTIC DINH_FId.DFC_RBA_IODIAGPWR_rba_IoExtCy329_SignalVltSply_2OV_CA "inhibitable FIds / FIds to be inhibited by inhibit source DFC_RBA_IODIAGPWR_rba_IoExtCy329_SignalVltSply_2OV" VAL_BLK 0x804E7ED6 ValA_Wu16 968.000000000 DINH_FIdVerb 0.00 968.000000000 FORMAT "%13.9" NUMBER 50 /end CHARACTERISTIC
/begin CHARACTERISTIC DINH_FId.DFC_RBA_IODIAGPWR_rba_IoExtCy329_SignalVltSply_2SCG_CA "inhibitable FIds / FIds to be inhibited by inhibit source DFC_RBA_IODIAGPWR_rba_IoExtCy329_SignalVltSply_2SCG" VAL_BLK 0x804E7F3A ValA_Wu16 968.000000000 DINH_FIdVerb 0.00 968.000000000 FORMAT "%13.9" NUMBER 50 /end CHARACTERISTIC
/begin CHARACTERISTIC DINH_FId.DFC_RBA_IODIAGPWR_rba_IoExtCy329_SignalVltSply_2UV_CA "inhibitable FIds / FIds to be inhibited by inhibit source DFC_RBA_IODIAGPWR_rba_IoExtCy329_SignalVltSply_2UV" VAL_BLK 0x804E7F9E ValA_Wu16 968.000000000 DINH_FIdVerb 0.00 968.000000000 FORMAT "%13.9" NUMBER 50 /end CHARACTERISTIC
/begin CHARACTERISTIC DINH_FId.DFC_CAN_E_TIMEOUT_CA "inhibitable FIds / FIds to be inhibited by inhibit source DFC_CAN_E_TIMEOUT" VAL_BLK 0x804E8002 ValA_Wu16 968.000000000 DINH_FIdVerb 0.00 968.000000000 FORMAT "%13.9" NUMBER 50 /end CHARACTERISTIC
/begin CHARACTERISTIC DINH_FId.DFC_LIN_E_TIMEOUT_CA "inhibitable FIds / FIds to be inhibited by inhibit source DFC_LIN_E_TIMEOUT" VAL_BLK 0x804E8066 ValA_Wu16 968.000000000 DINH_FIdVerb 0.00 968.000000000 FORMAT "%13.9" NUMBER 50 /end CHARACTERISTIC
/begin CHARACTERISTIC DINH_FId.DFC_MRlyOL_CA "inhibitable FIds / FIds to be inhibited by inhibit source DFC_MRlyOL" VAL_BLK 0x804E80CA ValA_Wu16 968.000000000 DINH_FIdVerb 0.00 968.000000000 FORMAT "%13.9" NUMBER 50 /end CHARACTERISTIC
/begin CHARACTERISTIC DINH_FId.DFC_MRlySCB_CA "inhibitable FIds / FIds to be inhibited by inhibit source DFC_MRlySCB" VAL_BLK 0x804E812E ValA_Wu16 968.000000000 DINH_FIdVerb 0.00 968.000000000 FORMAT "%13.9" NUMBER 50 /end CHARACTERISTIC
/begin CHARACTERISTIC DINH_FId.DFC_MRlySCG_CA "inhibitable FIds / FIds to be inhibited by inhibit source DFC_MRlySCG" VAL_BLK 0x804E8192 ValA_Wu16 968.000000000 DINH_FIdVerb 0.00 968.000000000 FORMAT "%13.9" NUMBER 51 /end CHARACTERISTIC
/begin CHARACTERISTIC DINH_FId.DFC_rba_MultiStackTrace_Threshold_CA "inhibitable FIds / FIds to be inhibited by inhibit source DFC_rba_MultiStackTrace_Threshold" VAL_BLK 0x804E81F8 ValA_Wu16 968.000000000 DINH_FIdVerb 0.00 968.000000000 FORMAT "%13.9" NUMBER 50 /end CHARACTERISTIC
/begin CHARACTERISTIC DINH_FId.DFC_BSWM_E_ACTION_FAILED_CA "inhibitable FIds / FIds to be inhibited by inhibit source DFC_BSWM_E_ACTION_FAILED" VAL_BLK 0x804E825C ValA_Wu16 968.000000000 DINH_FIdVerb 0.00 968.000000000 FORMAT "%13.9" NUMBER 50 /end CHARACTERISTIC
/begin CHARACTERISTIC DINH_FId.DFC_BSWM_E_INTRPTQUEUE_FULL_CA "inhibitable FIds / FIds to be inhibited by inhibit source DFC_BSWM_E_INTRPTQUEUE_FULL" VAL_BLK 0x804E82C0 ValA_Wu16 968.000000000 DINH_FIdVerb 0.00 968.000000000 FORMAT "%13.9" NUMBER 50 /end CHARACTERISTIC
/begin CHARACTERISTIC DINH_FId.DFC_RBA_IOEXTLIB_KEEPALIVE_DRV_CA "inhibitable FIds / FIds to be inhibited by inhibit source DFC_RBA_IOEXTLIB_KEEPALIVE_DRV" VAL_BLK 0x804E8324 ValA_Wu16 968.000000000 DINH_FIdVerb 0.00 968.000000000 FORMAT "%13.9" NUMBER 51 /end CHARACTERISTIC
/begin CHARACTERISTIC DINH_FId.DFC_RBA_IOEXTLIB_KEEPALIVE_INI_CA "inhibitable FIds / FIds to be inhibited by inhibit source DFC_RBA_IOEXTLIB_KEEPALIVE_INI" VAL_BLK 0x804E838A ValA_Wu16 968.000000000 DINH_FIdVerb 0.00 968.000000000 FORMAT "%13.9" NUMBER 51 /end CHARACTERISTIC
/begin CHARACTERISTIC DINH_FId.DFC_rba_IoSigRtc_StopCounter_CA "inhibitable FIds / FIds to be inhibited by inhibit source DFC_rba_IoSigRtc_StopCounter" VAL_BLK 0x804E83F0 ValA_Wu16 968.000000000 DINH_FIdVerb 0.00 968.000000000 FORMAT "%13.9" NUMBER 57 /end CHARACTERISTIC
/begin CHARACTERISTIC DINH_FId.DFC_rba_MRly_Diag_Stk_Event_CA "inhibitable FIds / FIds to be inhibited by inhibit source DFC_rba_MRly_Diag_Stk_Event" VAL_BLK 0x804E8462 ValA_Wu16 968.000000000 DINH_FIdVerb 0.00 968.000000000 FORMAT "%13.9" NUMBER 50 /end CHARACTERISTIC
/begin CHARACTERISTIC DINH_FId.DFC_rba_MemDiag_MemReadErr_CA "inhibitable FIds / FIds to be inhibited by inhibit source DFC_rba_MemDiag_MemReadErr" VAL_BLK 0x804E84C6 ValA_Wu16 968.000000000 DINH_FIdVerb 0.00 968.000000000 FORMAT "%13.9" NUMBER 61 /end CHARACTERISTIC
/begin CHARACTERISTIC DINH_FId.DFC_rba_MemDiag_MemWrErr_CA "inhibitable FIds / FIds to be inhibited by inhibit source DFC_rba_MemDiag_MemWrErr" VAL_BLK 0x804E8540 ValA_Wu16 968.000000000 DINH_FIdVerb 0.00 968.000000000 FORMAT "%13.9" NUMBER 60 /end CHARACTERISTIC
/begin CHARACTERISTIC DINH_FId.DFC_rba_SyC_IrrSwOffTrigEngRun_Event_CA "inhibitable FIds / FIds to be inhibited by inhibit source DFC_rba_SyC_IrrSwOffTrigEngRun_Event" VAL_BLK 0x804E85B8 ValA_Wu16 968.000000000 DINH_FIdVerb 0.00 968.000000000 FORMAT "%13.9" NUMBER 50 /end CHARACTERISTIC
/begin CHARACTERISTIC DINH_FId.DFC_rba_T15_Diag_ComInVld_Event_CA "inhibitable FIds / FIds to be inhibited by inhibit source DFC_rba_T15_Diag_ComInVld_Event" VAL_BLK 0x804E861C ValA_Wu16 968.000000000 DINH_FIdVerb 0.00 968.000000000 FORMAT "%13.9" NUMBER 50 /end CHARACTERISTIC
/begin CHARACTERISTIC DINH_FId.DFC_rba_T15_Diag_ComOff_HwOn_Event_CA "inhibitable FIds / FIds to be inhibited by inhibit source DFC_rba_T15_Diag_ComOff_HwOn_Event" VAL_BLK 0x804E8680 ValA_Wu16 968.000000000 DINH_FIdVerb 0.00 968.000000000 FORMAT "%13.9" NUMBER 50 /end CHARACTERISTIC
/begin CHARACTERISTIC DINH_FId.DFC_rba_T15_Diag_ComOn_HwOff_Event_CA "inhibitable FIds / FIds to be inhibited by inhibit source DFC_rba_T15_Diag_ComOn_HwOff_Event" VAL_BLK 0x804E86E4 ValA_Wu16 968.000000000 DINH_FIdVerb 0.00 968.000000000 FORMAT "%13.9" NUMBER 50 /end CHARACTERISTIC
/begin CHARACTERISTIC DINH_FId.DFC_AAVmin_CA "inhibitable FIds / FIds to be inhibited by inhibit source DFC_AAVmin" VAL_BLK 0x804E8748 ValA_Wu16 968.000000000 DINH_FIdVerb 0.00 968.000000000 FORMAT "%13.9" NUMBER 55 /end CHARACTERISTIC
/begin CHARACTERISTIC DINH_FId.DFC_AGRSUS_CA "inhibitable FIds / FIds to be inhibited by inhibit source DFC_AGRSUS" VAL_BLK 0x804E87B6 ValA_Wu16 968.000000000 DINH_FIdVerb 0.00 968.000000000 FORMAT "%13.9" NUMBER 72 /end CHARACTERISTIC
/begin CHARACTERISTIC DINH_FId.DFC_AfsPlausDiagHi_CA "inhibitable FIds / FIds to be inhibited by inhibit source DFC_AfsPlausDiagHi" VAL_BLK 0x804E8846 ValA_Wu16 968.000000000 DINH_FIdVerb 0.00 968.000000000 FORMAT "%13.9" NUMBER 54 /end CHARACTERISTIC
/begin CHARACTERISTIC DINH_FId.DFC_AfsPlausDiagLo_CA "inhibitable FIds / FIds to be inhibited by inhibit source DFC_AfsPlausDiagLo" VAL_BLK 0x804E88B2 ValA_Wu16 968.000000000 DINH_FIdVerb 0.00 968.000000000 FORMAT "%13.9" NUMBER 54 /end CHARACTERISTIC
/begin CHARACTERISTIC DINH_FId.DFC_AfsVrntDiagErrB1_CA "inhibitable FIds / FIds to be inhibited by inhibit source DFC_AfsVrntDiagErrB1" VAL_BLK 0x804E891E ValA_Wu16 968.000000000 DINH_FIdVerb 0.00 968.000000000 FORMAT "%13.9" NUMBER 54 /end CHARACTERISTIC
/begin CHARACTERISTIC DINH_FId.DFC_AppAllSnsrDfct_CA "inhibitable FIds / FIds to be inhibited by inhibit source DFC_AppAllSnsrDfct" VAL_BLK 0x804E898A ValA_Wu16 968.000000000 DINH_FIdVerb 0.00 968.000000000 FORMAT "%13.9" NUMBER 51 /end CHARACTERISTIC
/begin CHARACTERISTIC DINH_FId.DFC_BBKRnldg_CA "inhibitable FIds / FIds to be inhibited by inhibit source DFC_BBKRnldg" VAL_BLK 0x804E89F0 ValA_Wu16 968.000000000 DINH_FIdVerb 0.00 968.000000000 FORMAT "%13.9" NUMBER 52 /end CHARACTERISTIC
/begin CHARACTERISTIC DINH_FId.DFC_BBKRsyne_CA "inhibitable FIds / FIds to be inhibited by inhibit source DFC_BBKRsyne" VAL_BLK 0x804E8A58 ValA_Wu16 968.000000000 DINH_FIdVerb 0.00 968.000000000 FORMAT "%13.9" NUMBER 52 /end CHARACTERISTIC
/begin CHARACTERISTIC DINH_FId.DFC_BattUStdbyDiaOL_CA "inhibitable FIds / FIds to be inhibited by inhibit source DFC_BattUStdbyDiaOL" VAL_BLK 0x804E8AC0 ValA_Wu16 968.000000000 DINH_FIdVerb 0.00 968.000000000 FORMAT "%13.9" NUMBER 50 /end CHARACTERISTIC
/begin CHARACTERISTIC DINH_FId.DFC_BigLeakIntkMnfldEmiInfl_CA "inhibitable FIds / FIds to be inhibited by inhibit source DFC_BigLeakIntkMnfldEmiInfl" VAL_BLK 0x804E8B24 ValA_Wu16 968.000000000 DINH_FIdVerb 0.00 968.000000000 FORMAT "%13.9" NUMBER 54 /end CHARACTERISTIC
/begin CHARACTERISTIC DINH_FId.DFC_BlkdLineTank_CA "inhibitable FIds / FIds to be inhibited by inhibit source DFC_BlkdLineTank" VAL_BLK 0x804E8B90 ValA_Wu16 968.000000000 DINH_FIdVerb 0.00 968.000000000 FORMAT "%13.9" NUMBER 52 /end CHARACTERISTIC
/begin CHARACTERISTIC DINH_FId.DFC_BrkMnSwtContOnWarnLmp_CA "inhibitable FIds / FIds to be inhibited by inhibit source DFC_BrkMnSwtContOnWarnLmp" VAL_BLK 0x804E8BF8 ValA_Wu16 968.000000000 DINH_FIdVerb 0.00 968.000000000 FORMAT "%13.9" NUMBER 50 /end CHARACTERISTIC
/begin CHARACTERISTIC DINH_FId.DFC_BrkMnSwtNotStpWarnLmp_CA "inhibitable FIds / FIds to be inhibited by inhibit source DFC_BrkMnSwtNotStpWarnLmp" VAL_BLK 0x804E8C5C ValA_Wu16 968.000000000 DINH_FIdVerb 0.00 968.000000000 FORMAT "%13.9" NUMBER 50 /end CHARACTERISTIC
/begin CHARACTERISTIC DINH_FId.DFC_BrkRdntSwtContOnWarnLmp_CA "inhibitable FIds / FIds to be inhibited by inhibit source DFC_BrkRdntSwtContOnWarnLmp" VAL_BLK 0x804E8CC0 ValA_Wu16 968.000000000 DINH_FIdVerb 0.00 968.000000000 FORMAT "%13.9" NUMBER 50 /end CHARACTERISTIC
/begin CHARACTERISTIC DINH_FId.DFC_BrkRdntSwtNotStpWarnLmp_CA "inhibitable FIds / FIds to be inhibited by inhibit source DFC_BrkRdntSwtNotStpWarnLmp" VAL_BLK 0x804E8D24 ValA_Wu16 968.000000000 DINH_FIdVerb 0.00 968.000000000 FORMAT "%13.9" NUMBER 50 /end CHARACTERISTIC
/begin CHARACTERISTIC DINH_FId.DFC_CEngDsTColdStrtMax_CA "inhibitable FIds / FIds to be inhibited by inhibit source DFC_CEngDsTColdStrtMax" VAL_BLK 0x804E8D88 ValA_Wu16 968.000000000 DINH_FIdVerb 0.00 968.000000000 FORMAT "%13.9" NUMBER 122 /end CHARACTERISTIC
/begin CHARACTERISTIC DINH_FId.DFC_CEngDsTColdStrtMin_CA "inhibitable FIds / FIds to be inhibited by inhibit source DFC_CEngDsTColdStrtMin" VAL_BLK 0x804E8E7C ValA_Wu16 968.000000000 DINH_FIdVerb 0.00 968.000000000 FORMAT "%13.9" NUMBER 122 /end CHARACTERISTIC
/begin CHARACTERISTIC DINH_FId.DFC_CEngDsTImps_CA "inhibitable FIds / FIds to be inhibited by inhibit source DFC_CEngDsTImps" VAL_BLK 0x804E8F70 ValA_Wu16 968.000000000 DINH_FIdVerb 0.00 968.000000000 FORMAT "%13.9" NUMBER 125 /end CHARACTERISTIC
/begin CHARACTERISTIC DINH_FId.DFC_CEngDsTPlausHSC_CA "inhibitable FIds / FIds to be inhibited by inhibit source DFC_CEngDsTPlausHSC" VAL_BLK 0x804E906A ValA_Wu16 968.000000000 DINH_FIdVerb 0.00 968.000000000 FORMAT "%13.9" NUMBER 121 /end CHARACTERISTIC
/begin CHARACTERISTIC DINH_FId.DFC_CEngDsTPlausLSC_CA "inhibitable FIds / FIds to be inhibited by inhibit source DFC_CEngDsTPlausLSC" VAL_BLK 0x804E915C ValA_Wu16 968.000000000 DINH_FIdVerb 0.00 968.000000000 FORMAT "%13.9" NUMBER 122 /end CHARACTERISTIC
/begin CHARACTERISTIC DINH_FId.DFC_CEngDsTPlausSTC_CA "inhibitable FIds / FIds to be inhibited by inhibit source DFC_CEngDsTPlausSTC" VAL_BLK 0x804E9250 ValA_Wu16 968.000000000 DINH_FIdVerb 0.00 968.000000000 FORMAT "%13.9" NUMBER 121 /end CHARACTERISTIC
/begin CHARACTERISTIC DINH_FId.DFC_CEngDsTSRCMax_CA "inhibitable FIds / FIds to be inhibited by inhibit source DFC_CEngDsTSRCMax" VAL_BLK 0x804E9342 ValA_Wu16 968.000000000 DINH_FIdVerb 0.00 968.000000000 FORMAT "%13.9" NUMBER 135 /end CHARACTERISTIC
/begin CHARACTERISTIC DINH_FId.DFC_CEngDsTSRCMin_CA "inhibitable FIds / FIds to be inhibited by inhibit source DFC_CEngDsTSRCMin" VAL_BLK 0x804E9450 ValA_Wu16 968.000000000 DINH_FIdVerb 0.00 968.000000000 FORMAT "%13.9" NUMBER 135 /end CHARACTERISTIC
/begin CHARACTERISTIC DINH_FId.DFC_CEngDsTSig_CA "inhibitable FIds / FIds to be inhibited by inhibit source DFC_CEngDsTSig" VAL_BLK 0x804E955E ValA_Wu16 968.000000000 DINH_FIdVerb 0.00 968.000000000 FORMAT "%13.9" NUMBER 123 /end CHARACTERISTIC
/begin CHARACTERISTIC DINH_FId.DFC_CEngUsTColdStrtMax_CA "inhibitable FIds / FIds to be inhibited by inhibit source DFC_CEngUsTColdStrtMax" VAL_BLK 0x804E9654 ValA_Wu16 968.000000000 DINH_FIdVerb 0.00 968.000000000 FORMAT "%13.9" NUMBER 53 /end CHARACTERISTIC
/begin CHARACTERISTIC DINH_FId.DFC_CEngUsTColdStrtMin_CA "inhibitable FIds / FIds to be inhibited by inhibit source DFC_CEngUsTColdStrtMin" VAL_BLK 0x804E96BE ValA_Wu16 968.000000000 DINH_FIdVerb 0.00 968.000000000 FORMAT "%13.9" NUMBER 53 /end CHARACTERISTIC
/begin CHARACTERISTIC DINH_FId.DFC_CEngUsTLooseCnctn_CA "inhibitable FIds / FIds to be inhibited by inhibit source DFC_CEngUsTLooseCnctn" VAL_BLK 0x804E9728 ValA_Wu16 968.000000000 DINH_FIdVerb 0.00 968.000000000 FORMAT "%13.9" NUMBER 55 /end CHARACTERISTIC
/begin CHARACTERISTIC DINH_FId.DFC_CEngUsTSRCMax_CA "inhibitable FIds / FIds to be inhibited by inhibit source DFC_CEngUsTSRCMax" VAL_BLK 0x804E9796 ValA_Wu16 968.000000000 DINH_FIdVerb 0.00 968.000000000 FORMAT "%13.9" NUMBER 58 /end CHARACTERISTIC
/begin CHARACTERISTIC DINH_FId.DFC_CEngUsTSRCMin_CA "inhibitable FIds / FIds to be inhibited by inhibit source DFC_CEngUsTSRCMin" VAL_BLK 0x804E980A ValA_Wu16 968.000000000 DINH_FIdVerb 0.00 968.000000000 FORMAT "%13.9" NUMBER 58 /end CHARACTERISTIC
/begin CHARACTERISTIC DINH_FId.DFC_ComDCDCACCFailr_CA "inhibitable FIds / FIds to be inhibited by inhibit source DFC_ComDCDCACCFailr" VAL_BLK 0x804E987E ValA_Wu16 968.000000000 DINH_FIdVerb 0.00 968.000000000 FORMAT "%13.9" NUMBER 57 /end CHARACTERISTIC
/begin CHARACTERISTIC DINH_FId.DFC_DCDCFltDet_CA "inhibitable FIds / FIds to be inhibited by inhibit source DFC_DCDCFltDet" VAL_BLK 0x804E98F0 ValA_Wu16 968.000000000 DINH_FIdVerb 0.00 968.000000000 FORMAT "%13.9" NUMBER 57 /end CHARACTERISTIC
/begin CHARACTERISTIC DINH_FId.DFC_DKRSA_CA "inhibitable FIds / FIds to be inhibited by inhibit source DFC_DKRSA" VAL_BLK 0x804E9962 ValA_Wu16 968.000000000 DINH_FIdVerb 0.00 968.000000000 FORMAT "%13.9" NUMBER 58 /end CHARACTERISTIC
/begin CHARACTERISTIC DINH_FId.DFC_DKVSmax_CA "inhibitable FIds / FIds to be inhibited by inhibit source DFC_DKVSmax" VAL_BLK 0x804E99D6 ValA_Wu16 968.000000000 DINH_FIdVerb 0.00 968.000000000 FORMAT "%13.9" NUMBER 50 /end CHARACTERISTIC
/begin CHARACTERISTIC DINH_FId.DFC_DKnpl_CA "inhibitable FIds / FIds to be inhibited by inhibit source DFC_DKnpl" VAL_BLK 0x804E9A3A ValA_Wu16 968.000000000 DINH_FIdVerb 0.00 968.000000000 FORMAT "%13.9" NUMBER 50 /end CHARACTERISTIC
/begin CHARACTERISTIC DINH_FId.DFC_DSKVRmax_CA "inhibitable FIds / FIds to be inhibited by inhibit source DFC_DSKVRmax" VAL_BLK 0x804E9A9E ValA_Wu16 968.000000000 DINH_FIdVerb 0.00 968.000000000 FORMAT "%13.9" NUMBER 66 /end CHARACTERISTIC
/begin CHARACTERISTIC DINH_FId.DFC_DSKVRmin_CA "inhibitable FIds / FIds to be inhibited by inhibit source DFC_DSKVRmin" VAL_BLK 0x804E9B22 ValA_Wu16 968.000000000 DINH_FIdVerb 0.00 968.000000000 FORMAT "%13.9" NUMBER 66 /end CHARACTERISTIC
/begin CHARACTERISTIC DINH_FId.DFC_DSKVRnpl_CA "inhibitable FIds / FIds to be inhibited by inhibit source DFC_DSKVRnpl" VAL_BLK 0x804E9BA6 ValA_Wu16 968.000000000 DINH_FIdVerb 0.00 968.000000000 FORMAT "%13.9" NUMBER 62 /end CHARACTERISTIC
/begin CHARACTERISTIC DINH_FId.DFC_DSKVRsig_CA "inhibitable FIds / FIds to be inhibited by inhibit source DFC_DSKVRsig" VAL_BLK 0x804E9C22 ValA_Wu16 968.000000000 DINH_FIdVerb 0.00 968.000000000 FORMAT "%13.9" NUMBER 62 /end CHARACTERISTIC
/begin CHARACTERISTIC DINH_FId.DFC_DSKVSsig_CA "inhibitable FIds / FIds to be inhibited by inhibit source DFC_DSKVSsig" VAL_BLK 0x804E9C9E ValA_Wu16 968.000000000 DINH_FIdVerb 0.00 968.000000000 FORMAT "%13.9" NUMBER 64 /end CHARACTERISTIC
/begin CHARACTERISTIC DINH_FId.DFC_DSSmax_CA "inhibitable FIds / FIds to be inhibited by inhibit source DFC_DSSmax" VAL_BLK 0x804E9D1E ValA_Wu16 968.000000000 DINH_FIdVerb 0.00 968.000000000 FORMAT "%13.9" NUMBER 50 /end CHARACTERISTIC
/begin CHARACTERISTIC DINH_FId.DFC_DSTDmax_CA "inhibitable FIds / FIds to be inhibited by inhibit source DFC_DSTDmax" VAL_BLK 0x804E9D82 ValA_Wu16 968.000000000 DINH_FIdVerb 0.00 968.000000000 FORMAT "%13.9" NUMBER 50 /end CHARACTERISTIC
/begin CHARACTERISTIC DINH_FId.DFC_DSTEmax_CA "inhibitable FIds / FIds to be inhibited by inhibit source DFC_DSTEmax" VAL_BLK 0x804E9DE6 ValA_Wu16 968.000000000 DINH_FIdVerb 0.00 968.000000000 FORMAT "%13.9" NUMBER 59 /end CHARACTERISTIC
/begin CHARACTERISTIC DINH_FId.DFC_DSTEmin_CA "inhibitable FIds / FIds to be inhibited by inhibit source DFC_DSTEmin" VAL_BLK 0x804E9E5C ValA_Wu16 968.000000000 DINH_FIdVerb 0.00 968.000000000 FORMAT "%13.9" NUMBER 59 /end CHARACTERISTIC
/begin CHARACTERISTIC DINH_FId.DFC_DSTOFmax_CA "inhibitable FIds / FIds to be inhibited by inhibit source DFC_DSTOFmax" VAL_BLK 0x804E9ED2 ValA_Wu16 968.000000000 DINH_FIdVerb 0.00 968.000000000 FORMAT "%13.9" NUMBER 56 /end CHARACTERISTIC
/begin CHARACTERISTIC DINH_FId.DFC_DSTRmax_CA "inhibitable FIds / FIds to be inhibited by inhibit source DFC_DSTRmax" VAL_BLK 0x804E9F42 ValA_Wu16 968.000000000 DINH_FIdVerb 0.00 968.000000000 FORMAT "%13.9" NUMBER 57 /end CHARACTERISTIC
/begin CHARACTERISTIC DINH_FId.DFC_DSTRmin_CA "inhibitable FIds / FIds to be inhibited by inhibit source DFC_DSTRmin" VAL_BLK 0x804E9FB4 ValA_Wu16 968.000000000 DINH_FIdVerb 0.00 968.000000000 FORMAT "%13.9" NUMBER 57 /end CHARACTERISTIC
/begin CHARACTERISTIC DINH_FId.DFC_DSTRnpl_CA "inhibitable FIds / FIds to be inhibited by inhibit source DFC_DSTRnpl" VAL_BLK 0x804EA026 ValA_Wu16 968.000000000 DINH_FIdVerb 0.00 968.000000000 FORMAT "%13.9" NUMBER 56 /end CHARACTERISTIC
/begin CHARACTERISTIC DINH_FId.DFC_DSTRsig_CA "inhibitable FIds / FIds to be inhibited by inhibit source DFC_DSTRsig" VAL_BLK 0x804EA096 ValA_Wu16 968.000000000 DINH_FIdVerb 0.00 968.000000000 FORMAT "%13.9" NUMBER 56 /end CHARACTERISTIC
/begin CHARACTERISTIC DINH_FId.DFC_DSTTI_CA "inhibitable FIds / FIds to be inhibited by inhibit source DFC_DSTTI" VAL_BLK 0x804EA106 ValA_Wu16 968.000000000 DINH_FIdVerb 0.00 968.000000000 FORMAT "%13.9" NUMBER 51 /end CHARACTERISTIC
/begin CHARACTERISTIC DINH_FId.DFC_DSUmax_CA "inhibitable FIds / FIds to be inhibited by inhibit source DFC_DSUmax" VAL_BLK 0x804EA16C ValA_Wu16 968.000000000 DINH_FIdVerb 0.00 968.000000000 FORMAT "%13.9" NUMBER 50 /end CHARACTERISTIC
/begin CHARACTERISTIC DINH_FId.DFC_DiagCpv1DteskLoLoadStuckClsd_CA "inhibitable FIds / FIds to be inhibited by inhibit source DFC_DiagCpv1DteskLoLoadStuckClsd" VAL_BLK 0x804EA1D0 ValA_Wu16 968.000000000 DINH_FIdVerb 0.00 968.000000000 FORMAT "%13.9" NUMBER 71 /end CHARACTERISTIC
/begin CHARACTERISTIC DINH_FId.DFC_DiagCpv1DteskLoLoadStuckOpen_CA "inhibitable FIds / FIds to be inhibited by inhibit source DFC_DiagCpv1DteskLoLoadStuckOpen" VAL_BLK 0x804EA25E ValA_Wu16 968.000000000 DINH_FIdVerb 0.00 968.000000000 FORMAT "%13.9" NUMBER 80 /end CHARACTERISTIC
/begin CHARACTERISTIC DINH_FId.DFC_EGRVlvDrftClsd_CA "inhibitable FIds / FIds to be inhibited by inhibit source DFC_EGRVlvDrftClsd" VAL_BLK 0x804EA2FE ValA_Wu16 968.000000000 DINH_FIdVerb 0.00 968.000000000 FORMAT "%13.9" NUMBER 51 /end CHARACTERISTIC
/begin CHARACTERISTIC DINH_FId.DFC_EGRVlvDrftOpn_CA "inhibitable FIds / FIds to be inhibited by inhibit source DFC_EGRVlvDrftOpn" VAL_BLK 0x804EA364 ValA_Wu16 968.000000000 DINH_FIdVerb 0.00 968.000000000 FORMAT "%13.9" NUMBER 50 /end CHARACTERISTIC
/begin CHARACTERISTIC DINH_FId.DFC_EGRVlvJamVlvClsd_CA "inhibitable FIds / FIds to be inhibited by inhibit source DFC_EGRVlvJamVlvClsd" VAL_BLK 0x804EA3C8 ValA_Wu16 968.000000000 DINH_FIdVerb 0.00 968.000000000 FORMAT "%13.9" NUMBER 53 /end CHARACTERISTIC
/begin CHARACTERISTIC DINH_FId.DFC_EGRVlvJamVlvOpn_CA "inhibitable FIds / FIds to be inhibited by inhibit source DFC_EGRVlvJamVlvOpn" VAL_BLK 0x804EA432 ValA_Wu16 968.000000000 DINH_FIdVerb 0.00 968.000000000 FORMAT "%13.9" NUMBER 53 /end CHARACTERISTIC
/begin CHARACTERISTIC DINH_FId.DFC_EGRVlvSprgBrk_CA "inhibitable FIds / FIds to be inhibited by inhibit source DFC_EGRVlvSprgBrk" VAL_BLK 0x804EA49C ValA_Wu16 968.000000000 DINH_FIdVerb 0.00 968.000000000 FORMAT "%13.9" NUMBER 50 /end CHARACTERISTIC
/begin CHARACTERISTIC DINH_FId.DFC_EGRVlvTempMdlEEPErr_CA "inhibitable FIds / FIds to be inhibited by inhibit source DFC_EGRVlvTempMdlEEPErr" VAL_BLK 0x804EA500 ValA_Wu16 968.000000000 DINH_FIdVerb 0.00 968.000000000 FORMAT "%13.9" NUMBER 51 /end CHARACTERISTIC
/begin CHARACTERISTIC DINH_FId.DFC_EGRVlvTmpErr_CA "inhibitable FIds / FIds to be inhibited by inhibit source DFC_EGRVlvTmpErr" VAL_BLK 0x804EA566 ValA_Wu16 968.000000000 DINH_FIdVerb 0.00 968.000000000 FORMAT "%13.9" NUMBER 50 /end CHARACTERISTIC
/begin CHARACTERISTIC DINH_FId.DFC_EGSDUS2B1LtrDly_CA "inhibitable FIds / FIds to be inhibited by inhibit source DFC_EGSDUS2B1LtrDly" VAL_BLK 0x804EA5CA ValA_Wu16 968.000000000 DINH_FIdVerb 0.00 968.000000000 FORMAT "%13.9" NUMBER 58 /end CHARACTERISTIC
/begin CHARACTERISTIC DINH_FId.DFC_EGSDUS2B1LtrPT1_CA "inhibitable FIds / FIds to be inhibited by inhibit source DFC_EGSDUS2B1LtrPT1" VAL_BLK 0x804EA63E ValA_Wu16 968.000000000 DINH_FIdVerb 0.00 968.000000000 FORMAT "%13.9" NUMBER 58 /end CHARACTERISTIC
/begin CHARACTERISTIC DINH_FId.DFC_EGSDUS2B1RtlDly_CA "inhibitable FIds / FIds to be inhibited by inhibit source DFC_EGSDUS2B1RtlDly" VAL_BLK 0x804EA6B2 ValA_Wu16 968.000000000 DINH_FIdVerb 0.00 968.000000000 FORMAT "%13.9" NUMBER 58 /end CHARACTERISTIC
/begin CHARACTERISTIC DINH_FId.DFC_EGSDUS2B1RtlPT1_CA "inhibitable FIds / FIds to be inhibited by inhibit source DFC_EGSDUS2B1RtlPT1" VAL_BLK 0x804EA726 ValA_Wu16 968.000000000 DINH_FIdVerb 0.00 968.000000000 FORMAT "%13.9" NUMBER 58 /end CHARACTERISTIC
/begin CHARACTERISTIC DINH_FId.DFC_EGSDUS2B1TarLean_CA "inhibitable FIds / FIds to be inhibited by inhibit source DFC_EGSDUS2B1TarLean" VAL_BLK 0x804EA79A ValA_Wu16 968.000000000 DINH_FIdVerb 0.00 968.000000000 FORMAT "%13.9" NUMBER 69 /end CHARACTERISTIC
/begin CHARACTERISTIC DINH_FId.DFC_EGSDUS2B1TarRich_CA "inhibitable FIds / FIds to be inhibited by inhibit source DFC_EGSDUS2B1TarRich" VAL_BLK 0x804EA824 ValA_Wu16 968.000000000 DINH_FIdVerb 0.00 968.000000000 FORMAT "%13.9" NUMBER 69 /end CHARACTERISTIC
/begin CHARACTERISTIC DINH_FId.DFC_EONVmax_CA "inhibitable FIds / FIds to be inhibited by inhibit source DFC_EONVmax" VAL_BLK 0x804EA8AE ValA_Wu16 968.000000000 DINH_FIdVerb 0.00 968.000000000 FORMAT "%13.9" NUMBER 50 /end CHARACTERISTIC
/begin CHARACTERISTIC DINH_FId.DFC_ETAKHLmax_CA "inhibitable FIds / FIds to be inhibited by inhibit source DFC_ETAKHLmax" VAL_BLK 0x804EA912 ValA_Wu16 968.000000000 DINH_FIdVerb 0.00 968.000000000 FORMAT "%13.9" NUMBER 50 /end CHARACTERISTIC
/begin CHARACTERISTIC DINH_FId.DFC_ETAKHTmax_CA "inhibitable FIds / FIds to be inhibited by inhibit source DFC_ETAKHTmax" VAL_BLK 0x804EA976 ValA_Wu16 968.000000000 DINH_FIdVerb 0.00 968.000000000 FORMAT "%13.9" NUMBER 50 /end CHARACTERISTIC
/begin CHARACTERISTIC DINH_FId.DFC_ETHSEmax_CA "inhibitable FIds / FIds to be inhibited by inhibit source DFC_ETHSEmax" VAL_BLK 0x804EA9DA ValA_Wu16 968.000000000 DINH_FIdVerb 0.00 968.000000000 FORMAT "%13.9" NUMBER 70 /end CHARACTERISTIC
/begin CHARACTERISTIC DINH_FId.DFC_ETHSEmin_CA "inhibitable FIds / FIds to be inhibited by inhibit source DFC_ETHSEmin" VAL_BLK 0x804EAA66 ValA_Wu16 968.000000000 DINH_FIdVerb 0.00 968.000000000 FORMAT "%13.9" NUMBER 70 /end CHARACTERISTIC
/begin CHARACTERISTIC DINH_FId.DFC_ETHSFmax_CA "inhibitable FIds / FIds to be inhibited by inhibit source DFC_ETHSFmax" VAL_BLK 0x804EAAF2 ValA_Wu16 968.000000000 DINH_FIdVerb 0.00 968.000000000 FORMAT "%13.9" NUMBER 70 /end CHARACTERISTIC
/begin CHARACTERISTIC DINH_FId.DFC_ETHSFmin_CA "inhibitable FIds / FIds to be inhibited by inhibit source DFC_ETHSFmin" VAL_BLK 0x804EAB7E ValA_Wu16 968.000000000 DINH_FIdVerb 0.00 968.000000000 FORMAT "%13.9" NUMBER 70 /end CHARACTERISTIC
/begin CHARACTERISTIC DINH_FId.DFC_ETHSFsig_CA "inhibitable FIds / FIds to be inhibited by inhibit source DFC_ETHSFsig" VAL_BLK 0x804EAC0A ValA_Wu16 968.000000000 DINH_FIdVerb 0.00 968.000000000 FORMAT "%13.9" NUMBER 70 /end CHARACTERISTIC
/begin CHARACTERISTIC DINH_FId.DFC_ETHSNPWmax_CA "inhibitable FIds / FIds to be inhibited by inhibit source DFC_ETHSNPWmax" VAL_BLK 0x804EAC96 ValA_Wu16 968.000000000 DINH_FIdVerb 0.00 968.000000000 FORMAT "%13.9" NUMBER 68 /end CHARACTERISTIC
/begin CHARACTERISTIC DINH_FId.DFC_ETHSNPWmin_CA "inhibitable FIds / FIds to be inhibited by inhibit source DFC_ETHSNPWmin" VAL_BLK 0x804EAD1E ValA_Wu16 968.000000000 DINH_FIdVerb 0.00 968.000000000 FORMAT "%13.9" NUMBER 68 /end CHARACTERISTIC
/begin CHARACTERISTIC DINH_FId.DFC_ETHSNPWsig_CA "inhibitable FIds / FIds to be inhibited by inhibit source DFC_ETHSNPWsig" VAL_BLK 0x804EADA6 ValA_Wu16 968.000000000 DINH_FIdVerb 0.00 968.000000000 FORMAT "%13.9" NUMBER 68 /end CHARACTERISTIC
/begin CHARACTERISTIC DINH_FId.DFC_ETHSPLnpl_CA "inhibitable FIds / FIds to be inhibited by inhibit source DFC_ETHSPLnpl" VAL_BLK 0x804EAE2E ValA_Wu16 968.000000000 DINH_FIdVerb 0.00 968.000000000 FORMAT "%13.9" NUMBER 66 /end CHARACTERISTIC
/begin CHARACTERISTIC DINH_FId.DFC_ETHSTPLnpl_CA "inhibitable FIds / FIds to be inhibited by inhibit source DFC_ETHSTPLnpl" VAL_BLK 0x804EAEB2 ValA_Wu16 968.000000000 DINH_FIdVerb 0.00 968.000000000 FORMAT "%13.9" NUMBER 68 /end CHARACTERISTIC
/begin CHARACTERISTIC DINH_FId.DFC_EngICO_CA "inhibitable FIds / FIds to be inhibited by inhibit source DFC_EngICO" VAL_BLK 0x804EAF3A ValA_Wu16 968.000000000 DINH_FIdVerb 0.00 968.000000000 FORMAT "%13.9" NUMBER 50 /end CHARACTERISTIC
/begin CHARACTERISTIC DINH_FId.DFC_EngPrtOvrSpdMon_CA "inhibitable FIds / FIds to be inhibited by inhibit source DFC_EngPrtOvrSpdMon" VAL_BLK 0x804EAF9E ValA_Wu16 968.000000000 DINH_FIdVerb 0.00 968.000000000 FORMAT "%13.9" NUMBER 50 /end CHARACTERISTIC
/begin CHARACTERISTIC DINH_FId.DFC_EpmCaSI1ErrSig_CA "inhibitable FIds / FIds to be inhibited by inhibit source DFC_EpmCaSI1ErrSig" VAL_BLK 0x804EB002 ValA_Wu16 968.000000000 DINH_FIdVerb 0.00 968.000000000 FORMAT "%13.9" NUMBER 72 /end CHARACTERISTIC
/begin CHARACTERISTIC DINH_FId.DFC_EpmCaSI1MntErr_CA "inhibitable FIds / FIds to be inhibited by inhibit source DFC_EpmCaSI1MntErr" VAL_BLK 0x804EB092 ValA_Wu16 968.000000000 DINH_FIdVerb 0.00 968.000000000 FORMAT "%13.9" NUMBER 74 /end CHARACTERISTIC
/begin CHARACTERISTIC DINH_FId.DFC_EpmCaSI1NoSigMax_CA "inhibitable FIds / FIds to be inhibited by inhibit source DFC_EpmCaSI1NoSigMax" VAL_BLK 0x804EB126 ValA_Wu16 968.000000000 DINH_FIdVerb 0.00 968.000000000 FORMAT "%13.9" NUMBER 72 /end CHARACTERISTIC
/begin CHARACTERISTIC DINH_FId.DFC_EpmCaSI1NoSigMin_CA "inhibitable FIds / FIds to be inhibited by inhibit source DFC_EpmCaSI1NoSigMin" VAL_BLK 0x804EB1B6 ValA_Wu16 968.000000000 DINH_FIdVerb 0.00 968.000000000 FORMAT "%13.9" NUMBER 72 /end CHARACTERISTIC
/begin CHARACTERISTIC DINH_FId.DFC_EpmCaSI1OfsErr_CA "inhibitable FIds / FIds to be inhibited by inhibit source DFC_EpmCaSI1OfsErr" VAL_BLK 0x804EB246 ValA_Wu16 968.000000000 DINH_FIdVerb 0.00 968.000000000 FORMAT "%13.9" NUMBER 80 /end CHARACTERISTIC
/begin CHARACTERISTIC DINH_FId.DFC_EpmCrSDGI_CA "inhibitable FIds / FIds to be inhibited by inhibit source DFC_EpmCrSDGI" VAL_BLK 0x804EB2E6 ValA_Wu16 968.000000000 DINH_FIdVerb 0.00 968.000000000 FORMAT "%13.9" NUMBER 61 /end CHARACTERISTIC
/begin CHARACTERISTIC DINH_FId.DFC_EpmCrSErrSig_CA "inhibitable FIds / FIds to be inhibited by inhibit source DFC_EpmCrSErrSig" VAL_BLK 0x804EB360 ValA_Wu16 968.000000000 DINH_FIdVerb 0.00 968.000000000 FORMAT "%13.9" NUMBER 101 /end CHARACTERISTIC
/begin CHARACTERISTIC DINH_FId.DFC_EpmCrSNoSig_CA "inhibitable FIds / FIds to be inhibited by inhibit source DFC_EpmCrSNoSig" VAL_BLK 0x804EB42A ValA_Wu16 968.000000000 DINH_FIdVerb 0.00 968.000000000 FORMAT "%13.9" NUMBER 114 /end CHARACTERISTIC
/begin CHARACTERISTIC DINH_FId.DFC_EtaEngIdleNonCsers_CA "inhibitable FIds / FIds to be inhibited by inhibit source DFC_EtaEngIdleNonCsers" VAL_BLK 0x804EB50E ValA_Wu16 968.000000000 DINH_FIdVerb 0.00 968.000000000 FORMAT "%13.9" NUMBER 50 /end CHARACTERISTIC
/begin CHARACTERISTIC DINH_FId.DFC_EtaEngPtlNonCsers_CA "inhibitable FIds / FIds to be inhibited by inhibit source DFC_EtaEngPtlNonCsers" VAL_BLK 0x804EB572 ValA_Wu16 968.000000000 DINH_FIdVerb 0.00 968.000000000 FORMAT "%13.9" NUMBER 50 /end CHARACTERISTIC
/begin CHARACTERISTIC DINH_FId.DFC_FRAmax_CA "inhibitable FIds / FIds to be inhibited by inhibit source DFC_FRAmax" VAL_BLK 0x804EB5D6 ValA_Wu16 968.000000000 DINH_FIdVerb 0.00 968.000000000 FORMAT "%13.9" NUMBER 73 /end CHARACTERISTIC
/begin CHARACTERISTIC DINH_FId.DFC_FRAmin_CA "inhibitable FIds / FIds to be inhibited by inhibit source DFC_FRAmin" VAL_BLK 0x804EB668 ValA_Wu16 968.000000000 DINH_FIdVerb 0.00 968.000000000 FORMAT "%13.9" NUMBER 73 /end CHARACTERISTIC
/begin CHARACTERISTIC DINH_FId.DFC_FSTEmax_CA "inhibitable FIds / FIds to be inhibited by inhibit source DFC_FSTEmax" VAL_BLK 0x804EB6FA ValA_Wu16 968.000000000 DINH_FIdVerb 0.00 968.000000000 FORMAT "%13.9" NUMBER 54 /end CHARACTERISTIC
/begin CHARACTERISTIC DINH_FId.DFC_FSTEmin_CA "inhibitable FIds / FIds to be inhibited by inhibit source DFC_FSTEmin" VAL_BLK 0x804EB766 ValA_Wu16 968.000000000 DINH_FIdVerb 0.00 968.000000000 FORMAT "%13.9" NUMBER 54 /end CHARACTERISTIC
/begin CHARACTERISTIC DINH_FId.DFC_FSTRmax_CA "inhibitable FIds / FIds to be inhibited by inhibit source DFC_FSTRmax" VAL_BLK 0x804EB7D2 ValA_Wu16 968.000000000 DINH_FIdVerb 0.00 968.000000000 FORMAT "%13.9" NUMBER 53 /end CHARACTERISTIC
/begin CHARACTERISTIC DINH_FId.DFC_FSTRmin_CA "inhibitable FIds / FIds to be inhibited by inhibit source DFC_FSTRmin" VAL_BLK 0x804EB83C ValA_Wu16 968.000000000 DINH_FIdVerb 0.00 968.000000000 FORMAT "%13.9" NUMBER 53 /end CHARACTERISTIC
/begin CHARACTERISTIC DINH_FId.DFC_FSTRnpl_CA "inhibitable FIds / FIds to be inhibited by inhibit source DFC_FSTRnpl" VAL_BLK 0x804EB8A6 ValA_Wu16 968.000000000 DINH_FIdVerb 0.00 968.000000000 FORMAT "%13.9" NUMBER 53 /end CHARACTERISTIC
/begin CHARACTERISTIC DINH_FId.DFC_FSTmax_CA "inhibitable FIds / FIds to be inhibited by inhibit source DFC_FSTmax" VAL_BLK 0x804EB910 ValA_Wu16 968.000000000 DINH_FIdVerb 0.00 968.000000000 FORMAT "%13.9" NUMBER 50 /end CHARACTERISTIC
/begin CHARACTERISTIC DINH_FId.DFC_FTDLAmax_CA "inhibitable FIds / FIds to be inhibited by inhibit source DFC_FTDLAmax" VAL_BLK 0x804EB974 ValA_Wu16 968.000000000 DINH_FIdVerb 0.00 968.000000000 FORMAT "%13.9" NUMBER 67 /end CHARACTERISTIC
/begin CHARACTERISTIC DINH_FId.DFC_FTDLAmin_CA "inhibitable FIds / FIds to be inhibited by inhibit source DFC_FTDLAmin" VAL_BLK 0x804EB9FA ValA_Wu16 968.000000000 DINH_FIdVerb 0.00 968.000000000 FORMAT "%13.9" NUMBER 67 /end CHARACTERISTIC
/begin CHARACTERISTIC DINH_FId.DFC_FuPHiSnsrEleclmax_CA "inhibitable FIds / FIds to be inhibited by inhibit source DFC_FuPHiSnsrEleclmax" VAL_BLK 0x804EBA80 ValA_Wu16 968.000000000 DINH_FIdVerb 0.00 968.000000000 FORMAT "%13.9" NUMBER 51 /end CHARACTERISTIC
/begin CHARACTERISTIC DINH_FId.DFC_FuPHiSnsrEleclmin_CA "inhibitable FIds / FIds to be inhibited by inhibit source DFC_FuPHiSnsrEleclmin" VAL_BLK 0x804EBAE6 ValA_Wu16 968.000000000 DINH_FIdVerb 0.00 968.000000000 FORMAT "%13.9" NUMBER 51 /end CHARACTERISTIC
/begin CHARACTERISTIC DINH_FId.DFC_FuPHiSnsrEleclnpl_CA "inhibitable FIds / FIds to be inhibited by inhibit source DFC_FuPHiSnsrEleclnpl" VAL_BLK 0x804EBB4C ValA_Wu16 968.000000000 DINH_FIdVerb 0.00 968.000000000 FORMAT "%13.9" NUMBER 51 /end CHARACTERISTIC
/begin CHARACTERISTIC DINH_FId.DFC_FuPHiSnsrURngMax_CA "inhibitable FIds / FIds to be inhibited by inhibit source DFC_FuPHiSnsrURngMax" VAL_BLK 0x804EBBB2 ValA_Wu16 968.000000000 DINH_FIdVerb 0.00 968.000000000 FORMAT "%13.9" NUMBER 55 /end CHARACTERISTIC
/begin CHARACTERISTIC DINH_FId.DFC_FuPHiSnsrURngMin_CA "inhibitable FIds / FIds to be inhibited by inhibit source DFC_FuPHiSnsrURngMin" VAL_BLK 0x804EBC20 ValA_Wu16 968.000000000 DINH_FIdVerb 0.00 968.000000000 FORMAT "%13.9" NUMBER 55 /end CHARACTERISTIC
/begin CHARACTERISTIC DINH_FId.DFC_FuSnsrPhyRngMaxErr_CA "inhibitable FIds / FIds to be inhibited by inhibit source DFC_FuSnsrPhyRngMaxErr" VAL_BLK 0x804EBC8E ValA_Wu16 968.000000000 DINH_FIdVerb 0.00 968.000000000 FORMAT "%13.9" NUMBER 53 /end CHARACTERISTIC
/begin CHARACTERISTIC DINH_FId.DFC_FuSnsrPhyRngMinErr_CA "inhibitable FIds / FIds to be inhibited by inhibit source DFC_FuSnsrPhyRngMinErr" VAL_BLK 0x804EBCF8 ValA_Wu16 968.000000000 DINH_FIdVerb 0.00 968.000000000 FORMAT "%13.9" NUMBER 53 /end CHARACTERISTIC
/begin CHARACTERISTIC DINH_FId.DFC_GEVlvLockPinDiagIntkB1_CA "inhibitable FIds / FIds to be inhibited by inhibit source DFC_GEVlvLockPinDiagIntkB1" VAL_BLK 0x804EBD62 ValA_Wu16 968.000000000 DINH_FIdVerb 0.00 968.000000000 FORMAT "%13.9" NUMBER 51 /end CHARACTERISTIC
/begin CHARACTERISTIC DINH_FId.DFC_GEVlvPhaSlowIntkB1_CA "inhibitable FIds / FIds to be inhibited by inhibit source DFC_GEVlvPhaSlowIntkB1" VAL_BLK 0x804EBDC8 ValA_Wu16 968.000000000 DINH_FIdVerb 0.00 968.000000000 FORMAT "%13.9" NUMBER 91 /end CHARACTERISTIC
/begin CHARACTERISTIC DINH_FId.DFC_GEVlvPhaTargIntkB1_CA "inhibitable FIds / FIds to be inhibited by inhibit source DFC_GEVlvPhaTargIntkB1" VAL_BLK 0x804EBE7E ValA_Wu16 968.000000000 DINH_FIdVerb 0.00 968.000000000 FORMAT "%13.9" NUMBER 91 /end CHARACTERISTIC
/begin CHARACTERISTIC DINH_FId.DFC_GbxRvsSwtStk_CA "inhibitable FIds / FIds to be inhibited by inhibit source DFC_GbxRvsSwtStk" VAL_BLK 0x804EBF34 ValA_Wu16 968.000000000 DINH_FIdVerb 0.00 968.000000000 FORMAT "%13.9" NUMBER 55 /end CHARACTERISTIC
/begin CHARACTERISTIC DINH_FId.DFC_HDRKHmax_CA "inhibitable FIds / FIds to be inhibited by inhibit source DFC_HDRKHmax" VAL_BLK 0x804EBFA2 ValA_Wu16 968.000000000 DINH_FIdVerb 0.00 968.000000000 FORMAT "%13.9" NUMBER 52 /end CHARACTERISTIC
/begin CHARACTERISTIC DINH_FId.DFC_HDRKHmin_CA "inhibitable FIds / FIds to be inhibited by inhibit source DFC_HDRKHmin" VAL_BLK 0x804EC00A ValA_Wu16 968.000000000 DINH_FIdVerb 0.00 968.000000000 FORMAT "%13.9" NUMBER 52 /end CHARACTERISTIC
/begin CHARACTERISTIC DINH_FId.DFC_HDRPLmax_CA "inhibitable FIds / FIds to be inhibited by inhibit source DFC_HDRPLmax" VAL_BLK 0x804EC072 ValA_Wu16 968.000000000 DINH_FIdVerb 0.00 968.000000000 FORMAT "%13.9" NUMBER 55 /end CHARACTERISTIC
/begin CHARACTERISTIC DINH_FId.DFC_HDRPLmin_CA "inhibitable FIds / FIds to be inhibited by inhibit source DFC_HDRPLmin" VAL_BLK 0x804EC0E0 ValA_Wu16 968.000000000 DINH_FIdVerb 0.00 968.000000000 FORMAT "%13.9" NUMBER 55 /end CHARACTERISTIC
/begin CHARACTERISTIC DINH_FId.DFC_HDRmax_CA "inhibitable FIds / FIds to be inhibited by inhibit source DFC_HDRmax" VAL_BLK 0x804EC14E ValA_Wu16 968.000000000 DINH_FIdVerb 0.00 968.000000000 FORMAT "%13.9" NUMBER 65 /end CHARACTERISTIC
/begin CHARACTERISTIC DINH_FId.DFC_HDRmin_CA "inhibitable FIds / FIds to be inhibited by inhibit source DFC_HDRmin" VAL_BLK 0x804EC1D0 ValA_Wu16 968.000000000 DINH_FIdVerb 0.00 968.000000000 FORMAT "%13.9" NUMBER 68 /end CHARACTERISTIC
/begin CHARACTERISTIC DINH_FId.DFC_HEGOS2B1ElecMax_CA "inhibitable FIds / FIds to be inhibited by inhibit source DFC_HEGOS2B1ElecMax" VAL_BLK 0x804EC258 ValA_Wu16 968.000000000 DINH_FIdVerb 0.00 968.000000000 FORMAT "%13.9" NUMBER 71 /end CHARACTERISTIC
/begin CHARACTERISTIC DINH_FId.DFC_HEGOS2B1ElecMin_CA "inhibitable FIds / FIds to be inhibited by inhibit source DFC_HEGOS2B1ElecMin" VAL_BLK 0x804EC2E6 ValA_Wu16 968.000000000 DINH_FIdVerb 0.00 968.000000000 FORMAT "%13.9" NUMBER 71 /end CHARACTERISTIC
/begin CHARACTERISTIC DINH_FId.DFC_HEGOS2B1ElecSig_CA "inhibitable FIds / FIds to be inhibited by inhibit source DFC_HEGOS2B1ElecSig" VAL_BLK 0x804EC374 ValA_Wu16 968.000000000 DINH_FIdVerb 0.00 968.000000000 FORMAT "%13.9" NUMBER 71 /end CHARACTERISTIC
/begin CHARACTERISTIC DINH_FId.DFC_HEGOS2B1HtgNpl_CA "inhibitable FIds / FIds to be inhibited by inhibit source DFC_HEGOS2B1HtgNpl" VAL_BLK 0x804EC402 ValA_Wu16 968.000000000 DINH_FIdVerb 0.00 968.000000000 FORMAT "%13.9" NUMBER 65 /end CHARACTERISTIC
/begin CHARACTERISTIC DINH_FId.DFC_HEV00max_CA "inhibitable FIds / FIds to be inhibited by inhibit source DFC_HEV00max" VAL_BLK 0x804EC484 ValA_Wu16 968.000000000 DINH_FIdVerb 0.00 968.000000000 FORMAT "%13.9" NUMBER 51 /end CHARACTERISTIC
/begin CHARACTERISTIC DINH_FId.DFC_HEV01max_CA "inhibitable FIds / FIds to be inhibited by inhibit source DFC_HEV01max" VAL_BLK 0x804EC4EA ValA_Wu16 968.000000000 DINH_FIdVerb 0.00 968.000000000 FORMAT "%13.9" NUMBER 51 /end CHARACTERISTIC
/begin CHARACTERISTIC DINH_FId.DFC_HEV02max_CA "inhibitable FIds / FIds to be inhibited by inhibit source DFC_HEV02max" VAL_BLK 0x804EC550 ValA_Wu16 968.000000000 DINH_FIdVerb 0.00 968.000000000 FORMAT "%13.9" NUMBER 51 /end CHARACTERISTIC
/begin CHARACTERISTIC DINH_FId.DFC_HEV03max_CA "inhibitable FIds / FIds to be inhibited by inhibit source DFC_HEV03max" VAL_BLK 0x804EC5B6 ValA_Wu16 968.000000000 DINH_FIdVerb 0.00 968.000000000 FORMAT "%13.9" NUMBER 51 /end CHARACTERISTIC
/begin CHARACTERISTIC DINH_FId.DFC_HEVE0max_CA "inhibitable FIds / FIds to be inhibited by inhibit source DFC_HEVE0max" VAL_BLK 0x804EC61C ValA_Wu16 968.000000000 DINH_FIdVerb 0.00 968.000000000 FORMAT "%13.9" NUMBER 53 /end CHARACTERISTIC
/begin CHARACTERISTIC DINH_FId.DFC_HEVE1max_CA "inhibitable FIds / FIds to be inhibited by inhibit source DFC_HEVE1max" VAL_BLK 0x804EC686 ValA_Wu16 968.000000000 DINH_FIdVerb 0.00 968.000000000 FORMAT "%13.9" NUMBER 53 /end CHARACTERISTIC
/begin CHARACTERISTIC DINH_FId.DFC_HFMmax_CA "inhibitable FIds / FIds to be inhibited by inhibit source DFC_HFMmax" VAL_BLK 0x804EC6F0 ValA_Wu16 968.000000000 DINH_FIdVerb 0.00 968.000000000 FORMAT "%13.9" NUMBER 64 /end CHARACTERISTIC
/begin CHARACTERISTIC DINH_FId.DFC_HiPSysHiPMaxLimExcdd_CA "inhibitable FIds / FIds to be inhibited by inhibit source DFC_HiPSysHiPMaxLimExcdd" VAL_BLK 0x804EC770 ValA_Wu16 968.000000000 DINH_FIdVerb 0.00 968.000000000 FORMAT "%13.9" NUMBER 51 /end CHARACTERISTIC
/begin CHARACTERISTIC DINH_FId.DFC_IVGdiCtlCvoErrMax_0_CA "inhibitable FIds / FIds to be inhibited by inhibit source DFC_IVGdiCtlCvoErrMax_0" VAL_BLK 0x804EC7D6 ValA_Wu16 968.000000000 DINH_FIdVerb 0.00 968.000000000 FORMAT "%13.9" NUMBER 51 /end CHARACTERISTIC
/begin CHARACTERISTIC DINH_FId.DFC_IVGdiCtlCvoErrMax_1_CA "inhibitable FIds / FIds to be inhibited by inhibit source DFC_IVGdiCtlCvoErrMax_1" VAL_BLK 0x804EC83C ValA_Wu16 968.000000000 DINH_FIdVerb 0.00 968.000000000 FORMAT "%13.9" NUMBER 51 /end CHARACTERISTIC
/begin CHARACTERISTIC DINH_FId.DFC_IVGdiCtlCvoErrMax_2_CA "inhibitable FIds / FIds to be inhibited by inhibit source DFC_IVGdiCtlCvoErrMax_2" VAL_BLK 0x804EC8A2 ValA_Wu16 968.000000000 DINH_FIdVerb 0.00 968.000000000 FORMAT "%13.9" NUMBER 51 /end CHARACTERISTIC
/begin CHARACTERISTIC DINH_FId.DFC_IVGdiCtlCvoErrMax_3_CA "inhibitable FIds / FIds to be inhibited by inhibit source DFC_IVGdiCtlCvoErrMax_3" VAL_BLK 0x804EC908 ValA_Wu16 968.000000000 DINH_FIdVerb 0.00 968.000000000 FORMAT "%13.9" NUMBER 51 /end CHARACTERISTIC
/begin CHARACTERISTIC DINH_FId.DFC_IVGdiCtlCvoErrMin_0_CA "inhibitable FIds / FIds to be inhibited by inhibit source DFC_IVGdiCtlCvoErrMin_0" VAL_BLK 0x804EC96E ValA_Wu16 968.000000000 DINH_FIdVerb 0.00 968.000000000 FORMAT "%13.9" NUMBER 51 /end CHARACTERISTIC
/begin CHARACTERISTIC DINH_FId.DFC_IVGdiCtlCvoErrMin_1_CA "inhibitable FIds / FIds to be inhibited by inhibit source DFC_IVGdiCtlCvoErrMin_1" VAL_BLK 0x804EC9D4 ValA_Wu16 968.000000000 DINH_FIdVerb 0.00 968.000000000 FORMAT "%13.9" NUMBER 51 /end CHARACTERISTIC
/begin CHARACTERISTIC DINH_FId.DFC_IVGdiCtlCvoErrMin_2_CA "inhibitable FIds / FIds to be inhibited by inhibit source DFC_IVGdiCtlCvoErrMin_2" VAL_BLK 0x804ECA3A ValA_Wu16 968.000000000 DINH_FIdVerb 0.00 968.000000000 FORMAT "%13.9" NUMBER 51 /end CHARACTERISTIC
/begin CHARACTERISTIC DINH_FId.DFC_IVGdiCtlCvoErrMin_3_CA "inhibitable FIds / FIds to be inhibited by inhibit source DFC_IVGdiCtlCvoErrMin_3" VAL_BLK 0x804ECAA0 ValA_Wu16 968.000000000 DINH_FIdVerb 0.00 968.000000000 FORMAT "%13.9" NUMBER 51 /end CHARACTERISTIC
/begin CHARACTERISTIC DINH_FId.DFC_IVGdiCtlCvoErrMinMax_CA "inhibitable FIds / FIds to be inhibited by inhibit source DFC_IVGdiCtlCvoErrMinMax" VAL_BLK 0x804ECB06 ValA_Wu16 968.000000000 DINH_FIdVerb 0.00 968.000000000 FORMAT "%13.9" NUMBER 50 /end CHARACTERISTIC
/begin CHARACTERISTIC DINH_FId.DFC_IVGdiCtlCvoSigPlausErrSmrCdn_CA "inhibitable FIds / FIds to be inhibited by inhibit source DFC_IVGdiCtlCvoSigPlausErrSmrCdn" VAL_BLK 0x804ECB6A ValA_Wu16 968.000000000 DINH_FIdVerb 0.00 968.000000000 FORMAT "%13.9" NUMBER 50 /end CHARACTERISTIC
/begin CHARACTERISTIC DINH_FId.DFC_IVGdiCtl_CvoErr_CA "inhibitable FIds / FIds to be inhibited by inhibit source DFC_IVGdiCtl_CvoErr" VAL_BLK 0x804ECBCE ValA_Wu16 968.000000000 DINH_FIdVerb 0.00 968.000000000 FORMAT "%13.9" NUMBER 50 /end CHARACTERISTIC
/begin CHARACTERISTIC DINH_FId.DFC_IVGdiCtl_CvoSigPlaus_0_CA "inhibitable FIds / FIds to be inhibited by inhibit source DFC_IVGdiCtl_CvoSigPlaus_0" VAL_BLK 0x804ECC32 ValA_Wu16 968.000000000 DINH_FIdVerb 0.00 968.000000000 FORMAT "%13.9" NUMBER 51 /end CHARACTERISTIC
/begin CHARACTERISTIC DINH_FId.DFC_IVGdiCtl_CvoSigPlaus_1_CA "inhibitable FIds / FIds to be inhibited by inhibit source DFC_IVGdiCtl_CvoSigPlaus_1" VAL_BLK 0x804ECC98 ValA_Wu16 968.000000000 DINH_FIdVerb 0.00 968.000000000 FORMAT "%13.9" NUMBER 51 /end CHARACTERISTIC
/begin CHARACTERISTIC DINH_FId.DFC_IVGdiCtl_CvoSigPlaus_2_CA "inhibitable FIds / FIds to be inhibited by inhibit source DFC_IVGdiCtl_CvoSigPlaus_2" VAL_BLK 0x804ECCFE ValA_Wu16 968.000000000 DINH_FIdVerb 0.00 968.000000000 FORMAT "%13.9" NUMBER 51 /end CHARACTERISTIC
/begin CHARACTERISTIC DINH_FId.DFC_IVGdiCtl_CvoSigPlaus_3_CA "inhibitable FIds / FIds to be inhibited by inhibit source DFC_IVGdiCtl_CvoSigPlaus_3" VAL_BLK 0x804ECD64 ValA_Wu16 968.000000000 DINH_FIdVerb 0.00 968.000000000 FORMAT "%13.9" NUMBER 51 /end CHARACTERISTIC
/begin CHARACTERISTIC DINH_FId.DFC_IntkAirTAirFltDsCrssMax_CA "inhibitable FIds / FIds to be inhibited by inhibit source DFC_IntkAirTAirFltDsCrssMax" VAL_BLK 0x804ECDCA ValA_Wu16 968.000000000 DINH_FIdVerb 0.00 968.000000000 FORMAT "%13.9" NUMBER 52 /end CHARACTERISTIC
/begin CHARACTERISTIC DINH_FId.DFC_IntkAirTAirFltDsCrssMin_CA "inhibitable FIds / FIds to be inhibited by inhibit source DFC_IntkAirTAirFltDsCrssMin" VAL_BLK 0x804ECE32 ValA_Wu16 968.000000000 DINH_FIdVerb 0.00 968.000000000 FORMAT "%13.9" NUMBER 52 /end CHARACTERISTIC
/begin CHARACTERISTIC DINH_FId.DFC_IntkAirTAirFltDsHSCMax_CA "inhibitable FIds / FIds to be inhibited by inhibit source DFC_IntkAirTAirFltDsHSCMax" VAL_BLK 0x804ECE9A ValA_Wu16 968.000000000 DINH_FIdVerb 0.00 968.000000000 FORMAT "%13.9" NUMBER 52 /end CHARACTERISTIC
/begin CHARACTERISTIC DINH_FId.DFC_IntkAirTAirFltDsImps_CA "inhibitable FIds / FIds to be inhibited by inhibit source DFC_IntkAirTAirFltDsImps" VAL_BLK 0x804ECF02 ValA_Wu16 968.000000000 DINH_FIdVerb 0.00 968.000000000 FORMAT "%13.9" NUMBER 57 /end CHARACTERISTIC
/begin CHARACTERISTIC DINH_FId.DFC_IntkAirTAirFltDsPRCMax_CA "inhibitable FIds / FIds to be inhibited by inhibit source DFC_IntkAirTAirFltDsPRCMax" VAL_BLK 0x804ECF74 ValA_Wu16 968.000000000 DINH_FIdVerb 0.00 968.000000000 FORMAT "%13.9" NUMBER 52 /end CHARACTERISTIC
/begin CHARACTERISTIC DINH_FId.DFC_IntkAirTAirFltDsPRCMin_CA "inhibitable FIds / FIds to be inhibited by inhibit source DFC_IntkAirTAirFltDsPRCMin" VAL_BLK 0x804ECFDC ValA_Wu16 968.000000000 DINH_FIdVerb 0.00 968.000000000 FORMAT "%13.9" NUMBER 52 /end CHARACTERISTIC
/begin CHARACTERISTIC DINH_FId.DFC_IntkAirTAirFltDsSRCMax_CA "inhibitable FIds / FIds to be inhibited by inhibit source DFC_IntkAirTAirFltDsSRCMax" VAL_BLK 0x804ED044 ValA_Wu16 968.000000000 DINH_FIdVerb 0.00 968.000000000 FORMAT "%13.9" NUMBER 57 /end CHARACTERISTIC
/begin CHARACTERISTIC DINH_FId.DFC_IntkAirTAirFltDsSRCMin_CA "inhibitable FIds / FIds to be inhibited by inhibit source DFC_IntkAirTAirFltDsSRCMin" VAL_BLK 0x804ED0B6 ValA_Wu16 968.000000000 DINH_FIdVerb 0.00 968.000000000 FORMAT "%13.9" NUMBER 57 /end CHARACTERISTIC
/begin CHARACTERISTIC DINH_FId.DFC_IntkAirTAirFltDsSTC_CA "inhibitable FIds / FIds to be inhibited by inhibit source DFC_IntkAirTAirFltDsSTC" VAL_BLK 0x804ED128 ValA_Wu16 968.000000000 DINH_FIdVerb 0.00 968.000000000 FORMAT "%13.9" NUMBER 52 /end CHARACTERISTIC
/begin CHARACTERISTIC DINH_FId.DFC_IntkAirTIntkMnfldCrssMax_CA "inhibitable FIds / FIds to be inhibited by inhibit source DFC_IntkAirTIntkMnfldCrssMax" VAL_BLK 0x804ED190 ValA_Wu16 968.000000000 DINH_FIdVerb 0.00 968.000000000 FORMAT "%13.9" NUMBER 90 /end CHARACTERISTIC
/begin CHARACTERISTIC DINH_FId.DFC_IntkAirTIntkMnfldCrssMin_CA "inhibitable FIds / FIds to be inhibited by inhibit source DFC_IntkAirTIntkMnfldCrssMin" VAL_BLK 0x804ED244 ValA_Wu16 968.000000000 DINH_FIdVerb 0.00 968.000000000 FORMAT "%13.9" NUMBER 90 /end CHARACTERISTIC
/begin CHARACTERISTIC DINH_FId.DFC_IntkAirTIntkMnfldHSCMax_CA "inhibitable FIds / FIds to be inhibited by inhibit source DFC_IntkAirTIntkMnfldHSCMax" VAL_BLK 0x804ED2F8 ValA_Wu16 968.000000000 DINH_FIdVerb 0.00 968.000000000 FORMAT "%13.9" NUMBER 84 /end CHARACTERISTIC
/begin CHARACTERISTIC DINH_FId.DFC_IntkAirTIntkMnfldImps_CA "inhibitable FIds / FIds to be inhibited by inhibit source DFC_IntkAirTIntkMnfldImps" VAL_BLK 0x804ED3A0 ValA_Wu16 968.000000000 DINH_FIdVerb 0.00 968.000000000 FORMAT "%13.9" NUMBER 95 /end CHARACTERISTIC
/begin CHARACTERISTIC DINH_FId.DFC_IntkAirTIntkMnfldPRCMax_CA "inhibitable FIds / FIds to be inhibited by inhibit source DFC_IntkAirTIntkMnfldPRCMax" VAL_BLK 0x804ED45E ValA_Wu16 968.000000000 DINH_FIdVerb 0.00 968.000000000 FORMAT "%13.9" NUMBER 84 /end CHARACTERISTIC
/begin CHARACTERISTIC DINH_FId.DFC_IntkAirTIntkMnfldPRCMin_CA "inhibitable FIds / FIds to be inhibited by inhibit source DFC_IntkAirTIntkMnfldPRCMin" VAL_BLK 0x804ED506 ValA_Wu16 968.000000000 DINH_FIdVerb 0.00 968.000000000 FORMAT "%13.9" NUMBER 84 /end CHARACTERISTIC
/begin CHARACTERISTIC DINH_FId.DFC_IntkAirTIntkMnfldSRCMax_CA "inhibitable FIds / FIds to be inhibited by inhibit source DFC_IntkAirTIntkMnfldSRCMax" VAL_BLK 0x804ED5AE ValA_Wu16 968.000000000 DINH_FIdVerb 0.00 968.000000000 FORMAT "%13.9" NUMBER 96 /end CHARACTERISTIC
/begin CHARACTERISTIC DINH_FId.DFC_IntkAirTIntkMnfldSRCMin_CA "inhibitable FIds / FIds to be inhibited by inhibit source DFC_IntkAirTIntkMnfldSRCMin" VAL_BLK 0x804ED66E ValA_Wu16 968.000000000 DINH_FIdVerb 0.00 968.000000000 FORMAT "%13.9" NUMBER 96 /end CHARACTERISTIC
/begin CHARACTERISTIC DINH_FId.DFC_IntkAirTIntkMnfldSTC_CA "inhibitable FIds / FIds to be inhibited by inhibit source DFC_IntkAirTIntkMnfldSTC" VAL_BLK 0x804ED72E ValA_Wu16 968.000000000 DINH_FIdVerb 0.00 968.000000000 FORMAT "%13.9" NUMBER 84 /end CHARACTERISTIC
/begin CHARACTERISTIC DINH_FId.DFC_KRREGRLMX_CA "inhibitable FIds / FIds to be inhibited by inhibit source DFC_KRREGRLMX" VAL_BLK 0x804ED7D6 ValA_Wu16 968.000000000 DINH_FIdVerb 0.00 968.000000000 FORMAT "%13.9" NUMBER 50 /end CHARACTERISTIC
/begin CHARACTERISTIC DINH_FId.DFC_KRVEKOCVLCI_CA "inhibitable FIds / FIds to be inhibited by inhibit source DFC_KRVEKOCVLCI" VAL_BLK 0x804ED83A ValA_Wu16 968.000000000 DINH_FIdVerb 0.00 968.000000000 FORMAT "%13.9" NUMBER 50 /end CHARACTERISTIC
/begin CHARACTERISTIC DINH_FId.DFC_KRVEKOENCHMT_CA "inhibitable FIds / FIds to be inhibited by inhibit source DFC_KRVEKOENCHMT" VAL_BLK 0x804ED89E ValA_Wu16 968.000000000 DINH_FIdVerb 0.00 968.000000000 FORMAT "%13.9" NUMBER 50 /end CHARACTERISTIC
/begin CHARACTERISTIC DINH_FId.DFC_KRVEKOENCHMT0_CA "inhibitable FIds / FIds to be inhibited by inhibit source DFC_KRVEKOENCHMT0" VAL_BLK 0x804ED902 ValA_Wu16 968.000000000 DINH_FIdVerb 0.00 968.000000000 FORMAT "%13.9" NUMBER 50 /end CHARACTERISTIC
/begin CHARACTERISTIC DINH_FId.DFC_KRVEKOENCHMT1_CA "inhibitable FIds / FIds to be inhibited by inhibit source DFC_KRVEKOENCHMT1" VAL_BLK 0x804ED966 ValA_Wu16 968.000000000 DINH_FIdVerb 0.00 968.000000000 FORMAT "%13.9" NUMBER 50 /end CHARACTERISTIC
/begin CHARACTERISTIC DINH_FId.DFC_KRVEKOENCHMT2_CA "inhibitable FIds / FIds to be inhibited by inhibit source DFC_KRVEKOENCHMT2" VAL_BLK 0x804ED9CA ValA_Wu16 968.000000000 DINH_FIdVerb 0.00 968.000000000 FORMAT "%13.9" NUMBER 50 /end CHARACTERISTIC
/begin CHARACTERISTIC DINH_FId.DFC_KRVEKOENCHMT3_CA "inhibitable FIds / FIds to be inhibited by inhibit source DFC_KRVEKOENCHMT3" VAL_BLK 0x804EDA2E ValA_Wu16 968.000000000 DINH_FIdVerb 0.00 968.000000000 FORMAT "%13.9" NUMBER 50 /end CHARACTERISTIC
/begin CHARACTERISTIC DINH_FId.DFC_KRVEKOENCHMT4_CA "inhibitable FIds / FIds to be inhibited by inhibit source DFC_KRVEKOENCHMT4" VAL_BLK 0x804EDA92 ValA_Wu16 968.000000000 DINH_FIdVerb 0.00 968.000000000 FORMAT "%13.9" NUMBER 50 /end CHARACTERISTIC
/begin CHARACTERISTIC DINH_FId.DFC_KRVEKOENCHMT5_CA "inhibitable FIds / FIds to be inhibited by inhibit source DFC_KRVEKOENCHMT5" VAL_BLK 0x804EDAF6 ValA_Wu16 968.000000000 DINH_FIdVerb 0.00 968.000000000 FORMAT "%13.9" NUMBER 50 /end CHARACTERISTIC
/begin CHARACTERISTIC DINH_FId.DFC_KRVEKOENCHMT6_CA "inhibitable FIds / FIds to be inhibited by inhibit source DFC_KRVEKOENCHMT6" VAL_BLK 0x804EDB5A ValA_Wu16 968.000000000 DINH_FIdVerb 0.00 968.000000000 FORMAT "%13.9" NUMBER 50 /end CHARACTERISTIC
/begin CHARACTERISTIC DINH_FId.DFC_KRVEKOENCHMT7_CA "inhibitable FIds / FIds to be inhibited by inhibit source DFC_KRVEKOENCHMT7" VAL_BLK 0x804EDBBE ValA_Wu16 968.000000000 DINH_FIdVerb 0.00 968.000000000 FORMAT "%13.9" NUMBER 50 /end CHARACTERISTIC
/begin CHARACTERISTIC DINH_FId.DFC_KRVEKORLMX_CA "inhibitable FIds / FIds to be inhibited by inhibit source DFC_KRVEKORLMX" VAL_BLK 0x804EDC22 ValA_Wu16 968.000000000 DINH_FIdVerb 0.00 968.000000000 FORMAT "%13.9" NUMBER 50 /end CHARACTERISTIC
/begin CHARACTERISTIC DINH_FId.DFC_KRVEKORLMXL_CA "inhibitable FIds / FIds to be inhibited by inhibit source DFC_KRVEKORLMXL" VAL_BLK 0x804EDC86 ValA_Wu16 968.000000000 DINH_FIdVerb 0.00 968.000000000 FORMAT "%13.9" NUMBER 50 /end CHARACTERISTIC
/begin CHARACTERISTIC DINH_FId.DFC_KS1max_CA "inhibitable FIds / FIds to be inhibited by inhibit source DFC_KS1max" VAL_BLK 0x804EDCEA ValA_Wu16 968.000000000 DINH_FIdVerb 0.00 968.000000000 FORMAT "%13.9" NUMBER 58 /end CHARACTERISTIC
/begin CHARACTERISTIC DINH_FId.DFC_KS1min_CA "inhibitable FIds / FIds to be inhibited by inhibit source DFC_KS1min" VAL_BLK 0x804EDD5E ValA_Wu16 968.000000000 DINH_FIdVerb 0.00 968.000000000 FORMAT "%13.9" NUMBER 58 /end CHARACTERISTIC
/begin CHARACTERISTIC DINH_FId.DFC_LMmax_CA "inhibitable FIds / FIds to be inhibited by inhibit source DFC_LMmax" VAL_BLK 0x804EDDD2 ValA_Wu16 968.000000000 DINH_FIdVerb 0.00 968.000000000 FORMAT "%13.9" NUMBER 67 /end CHARACTERISTIC
/begin CHARACTERISTIC DINH_FId.DFC_LZSRnpl_CA "inhibitable FIds / FIds to be inhibited by inhibit source DFC_LZSRnpl" VAL_BLK 0x804EDE58 ValA_Wu16 968.000000000 DINH_FIdVerb 0.00 968.000000000 FORMAT "%13.9" NUMBER 57 /end CHARACTERISTIC
/begin CHARACTERISTIC DINH_FId.DFC_LamDynDiagS1B1_CA "inhibitable FIds / FIds to be inhibited by inhibit source DFC_LamDynDiagS1B1" VAL_BLK 0x804EDECA ValA_Wu16 968.000000000 DINH_FIdVerb 0.00 968.000000000 FORMAT "%13.9" NUMBER 78 /end CHARACTERISTIC
/begin CHARACTERISTIC DINH_FId.DFC_LeakIntkMnfldEmiInfl_CA "inhibitable FIds / FIds to be inhibited by inhibit source DFC_LeakIntkMnfldEmiInfl" VAL_BLK 0x804EDF66 ValA_Wu16 968.000000000 DINH_FIdVerb 0.00 968.000000000 FORMAT "%13.9" NUMBER 52 /end CHARACTERISTIC
/begin CHARACTERISTIC DINH_FId.DFC_LinFrameErrDCDC_CA "inhibitable FIds / FIds to be inhibited by inhibit source DFC_LinFrameErrDCDC" VAL_BLK 0x804EDFCE ValA_Wu16 968.000000000 DINH_FIdVerb 0.00 968.000000000 FORMAT "%13.9" NUMBER 52 /end CHARACTERISTIC
/begin CHARACTERISTIC DINH_FId.DFC_LinOverrunErrDCDC_CA "inhibitable FIds / FIds to be inhibited by inhibit source DFC_LinOverrunErrDCDC" VAL_BLK 0x804EE036 ValA_Wu16 968.000000000 DINH_FIdVerb 0.00 968.000000000 FORMAT "%13.9" NUMBER 52 /end CHARACTERISTIC
/begin CHARACTERISTIC DINH_FId.DFC_MD00max_CA "inhibitable FIds / FIds to be inhibited by inhibit source DFC_MD00max" VAL_BLK 0x804EE09E ValA_Wu16 968.000000000 DINH_FIdVerb 0.00 968.000000000 FORMAT "%13.9" NUMBER 50 /end CHARACTERISTIC
/begin CHARACTERISTIC DINH_FId.DFC_MDBmax_CA "inhibitable FIds / FIds to be inhibited by inhibit source DFC_MDBmax" VAL_BLK 0x804EE102 ValA_Wu16 968.000000000 DINH_FIdVerb 0.00 968.000000000 FORMAT "%13.9" NUMBER 58 /end CHARACTERISTIC
/begin CHARACTERISTIC DINH_FId.DFC_MDCat_CA "inhibitable FIds / FIds to be inhibited by inhibit source DFC_MDCat" VAL_BLK 0x804EE176 ValA_Wu16 968.000000000 DINH_FIdVerb 0.00 968.000000000 FORMAT "%13.9" NUMBER 56 /end CHARACTERISTIC
/begin CHARACTERISTIC DINH_FId.DFC_MDCatCrit_CA "inhibitable FIds / FIds to be inhibited by inhibit source DFC_MDCatCrit" VAL_BLK 0x804EE1E6 ValA_Wu16 968.000000000 DINH_FIdVerb 0.00 968.000000000 FORMAT "%13.9" NUMBER 50 /end CHARACTERISTIC
/begin CHARACTERISTIC DINH_FId.DFC_MDCatCurr_CA "inhibitable FIds / FIds to be inhibited by inhibit source DFC_MDCatCurr" VAL_BLK 0x804EE24A ValA_Wu16 968.000000000 DINH_FIdVerb 0.00 968.000000000 FORMAT "%13.9" NUMBER 53 /end CHARACTERISTIC
/begin CHARACTERISTIC DINH_FId.DFC_MDCyl_0_CA "inhibitable FIds / FIds to be inhibited by inhibit source DFC_MDCyl_0" VAL_BLK 0x804EE2B4 ValA_Wu16 968.000000000 DINH_FIdVerb 0.00 968.000000000 FORMAT "%13.9" NUMBER 78 /end CHARACTERISTIC
/begin CHARACTERISTIC DINH_FId.DFC_MDCyl_1_CA "inhibitable FIds / FIds to be inhibited by inhibit source DFC_MDCyl_1" VAL_BLK 0x804EE350 ValA_Wu16 968.000000000 DINH_FIdVerb 0.00 968.000000000 FORMAT "%13.9" NUMBER 78 /end CHARACTERISTIC
/begin CHARACTERISTIC DINH_FId.DFC_MDCyl_2_CA "inhibitable FIds / FIds to be inhibited by inhibit source DFC_MDCyl_2" VAL_BLK 0x804EE3EC ValA_Wu16 968.000000000 DINH_FIdVerb 0.00 968.000000000 FORMAT "%13.9" NUMBER 78 /end CHARACTERISTIC
/begin CHARACTERISTIC DINH_FId.DFC_MDCyl_3_CA "inhibitable FIds / FIds to be inhibited by inhibit source DFC_MDCyl_3" VAL_BLK 0x804EE488 ValA_Wu16 968.000000000 DINH_FIdVerb 0.00 968.000000000 FORMAT "%13.9" NUMBER 78 /end CHARACTERISTIC
/begin CHARACTERISTIC DINH_FId.DFC_MDEmi_CA "inhibitable FIds / FIds to be inhibited by inhibit source DFC_MDEmi" VAL_BLK 0x804EE524 ValA_Wu16 968.000000000 DINH_FIdVerb 0.00 968.000000000 FORMAT "%13.9" NUMBER 56 /end CHARACTERISTIC
/begin CHARACTERISTIC DINH_FId.DFC_MDEmiStrt_CA "inhibitable FIds / FIds to be inhibited by inhibit source DFC_MDEmiStrt" VAL_BLK 0x804EE594 ValA_Wu16 968.000000000 DINH_FIdVerb 0.00 968.000000000 FORMAT "%13.9" NUMBER 56 /end CHARACTERISTIC
/begin CHARACTERISTIC DINH_FId.DFC_MDFco_CA "inhibitable FIds / FIds to be inhibited by inhibit source DFC_MDFco" VAL_BLK 0x804EE604 ValA_Wu16 968.000000000 DINH_FIdVerb 0.00 968.000000000 FORMAT "%13.9" NUMBER 54 /end CHARACTERISTIC
/begin CHARACTERISTIC DINH_FId.DFC_MDMpl_CA "inhibitable FIds / FIds to be inhibited by inhibit source DFC_MDMpl" VAL_BLK 0x804EE670 ValA_Wu16 968.000000000 DINH_FIdVerb 0.00 968.000000000 FORMAT "%13.9" NUMBER 78 /end CHARACTERISTIC
/begin CHARACTERISTIC DINH_FId.DFC_MDSegTiAdpn_CA "inhibitable FIds / FIds to be inhibited by inhibit source DFC_MDSegTiAdpn" VAL_BLK 0x804EE70C ValA_Wu16 968.000000000 DINH_FIdVerb 0.00 968.000000000 FORMAT "%13.9" NUMBER 50 /end CHARACTERISTIC
/begin CHARACTERISTIC DINH_FId.DFC_MDmax_CA "inhibitable FIds / FIds to be inhibited by inhibit source DFC_MDmax" VAL_BLK 0x804EE770 ValA_Wu16 968.000000000 DINH_FIdVerb 0.00 968.000000000 FORMAT "%13.9" NUMBER 50 /end CHARACTERISTIC
/begin CHARACTERISTIC DINH_FId.DFC_MFuOilMax_CA "inhibitable FIds / FIds to be inhibited by inhibit source DFC_MFuOilMax" VAL_BLK 0x804EE7D4 ValA_Wu16 968.000000000 DINH_FIdVerb 0.00 968.000000000 FORMAT "%13.9" NUMBER 50 /end CHARACTERISTIC
/begin CHARACTERISTIC DINH_FId.DFC_MOXEMM_SMU_ALM0_0_CA "inhibitable FIds / FIds to be inhibited by inhibit source DFC_MOXEMM_SMU_ALM0_0" VAL_BLK 0x804EE838 ValA_Wu16 968.000000000 DINH_FIdVerb 0.00 968.000000000 FORMAT "%13.9" NUMBER 50 /end CHARACTERISTIC
/begin CHARACTERISTIC DINH_FId.DFC_MOXEMM_SMU_ALM0_1_CA "inhibitable FIds / FIds to be inhibited by inhibit source DFC_MOXEMM_SMU_ALM0_1" VAL_BLK 0x804EE89C ValA_Wu16 968.000000000 DINH_FIdVerb 0.00 968.000000000 FORMAT "%13.9" NUMBER 50 /end CHARACTERISTIC
/begin CHARACTERISTIC DINH_FId.DFC_MOXEMM_SMU_ALM0_10_CA "inhibitable FIds / FIds to be inhibited by inhibit source DFC_MOXEMM_SMU_ALM0_10" VAL_BLK 0x804EE900 ValA_Wu16 968.000000000 DINH_FIdVerb 0.00 968.000000000 FORMAT "%13.9" NUMBER 50 /end CHARACTERISTIC
/begin CHARACTERISTIC DINH_FId.DFC_MOXEMM_SMU_ALM0_11_CA "inhibitable FIds / FIds to be inhibited by inhibit source DFC_MOXEMM_SMU_ALM0_11" VAL_BLK 0x804EE964 ValA_Wu16 968.000000000 DINH_FIdVerb 0.00 968.000000000 FORMAT "%13.9" NUMBER 50 /end CHARACTERISTIC
/begin CHARACTERISTIC DINH_FId.DFC_MOXEMM_SMU_ALM0_13_CA "inhibitable FIds / FIds to be inhibited by inhibit source DFC_MOXEMM_SMU_ALM0_13" VAL_BLK 0x804EE9C8 ValA_Wu16 968.000000000 DINH_FIdVerb 0.00 968.000000000 FORMAT "%13.9" NUMBER 50 /end CHARACTERISTIC
/begin CHARACTERISTIC DINH_FId.DFC_MOXEMM_SMU_ALM0_14_CA "inhibitable FIds / FIds to be inhibited by inhibit source DFC_MOXEMM_SMU_ALM0_14" VAL_BLK 0x804EEA2C ValA_Wu16 968.000000000 DINH_FIdVerb 0.00 968.000000000 FORMAT "%13.9" NUMBER 50 /end CHARACTERISTIC
/begin CHARACTERISTIC DINH_FId.DFC_MOXEMM_SMU_ALM0_2_CA "inhibitable FIds / FIds to be inhibited by inhibit source DFC_MOXEMM_SMU_ALM0_2" VAL_BLK 0x804EEA90 ValA_Wu16 968.000000000 DINH_FIdVerb 0.00 968.000000000 FORMAT "%13.9" NUMBER 50 /end CHARACTERISTIC
/begin CHARACTERISTIC DINH_FId.DFC_MOXEMM_SMU_ALM0_22_CA "inhibitable FIds / FIds to be inhibited by inhibit source DFC_MOXEMM_SMU_ALM0_22" VAL_BLK 0x804EEAF4 ValA_Wu16 968.000000000 DINH_FIdVerb 0.00 968.000000000 FORMAT "%13.9" NUMBER 50 /end CHARACTERISTIC
/begin CHARACTERISTIC DINH_FId.DFC_MOXEMM_SMU_ALM0_23_CA "inhibitable FIds / FIds to be inhibited by inhibit source DFC_MOXEMM_SMU_ALM0_23" VAL_BLK 0x804EEB58 ValA_Wu16 968.000000000 DINH_FIdVerb 0.00 968.000000000 FORMAT "%13.9" NUMBER 50 /end CHARACTERISTIC
/begin CHARACTERISTIC DINH_FId.DFC_MOXEMM_SMU_ALM0_4_CA "inhibitable FIds / FIds to be inhibited by inhibit source DFC_MOXEMM_SMU_ALM0_4" VAL_BLK 0x804EEBBC ValA_Wu16 968.000000000 DINH_FIdVerb 0.00 968.000000000 FORMAT "%13.9" NUMBER 50 /end CHARACTERISTIC
/begin CHARACTERISTIC DINH_FId.DFC_MOXEMM_SMU_ALM0_5_CA "inhibitable FIds / FIds to be inhibited by inhibit source DFC_MOXEMM_SMU_ALM0_5" VAL_BLK 0x804EEC20 ValA_Wu16 968.000000000 DINH_FIdVerb 0.00 968.000000000 FORMAT "%13.9" NUMBER 50 /end CHARACTERISTIC
/begin CHARACTERISTIC DINH_FId.DFC_MOXEMM_SMU_ALM0_7_CA "inhibitable FIds / FIds to be inhibited by inhibit source DFC_MOXEMM_SMU_ALM0_7" VAL_BLK 0x804EEC84 ValA_Wu16 968.000000000 DINH_FIdVerb 0.00 968.000000000 FORMAT "%13.9" NUMBER 50 /end CHARACTERISTIC
/begin CHARACTERISTIC DINH_FId.DFC_MOXEMM_SMU_ALM0_8_CA "inhibitable FIds / FIds to be inhibited by inhibit source DFC_MOXEMM_SMU_ALM0_8" VAL_BLK 0x804EECE8 ValA_Wu16 968.000000000 DINH_FIdVerb 0.00 968.000000000 FORMAT "%13.9" NUMBER 50 /end CHARACTERISTIC
/begin CHARACTERISTIC DINH_FId.DFC_MOXEMM_SMU_ALM10_16_CA "inhibitable FIds / FIds to be inhibited by inhibit source DFC_MOXEMM_SMU_ALM10_16" VAL_BLK 0x804EED4C ValA_Wu16 968.000000000 DINH_FIdVerb 0.00 968.000000000 FORMAT "%13.9" NUMBER 50 /end CHARACTERISTIC
/begin CHARACTERISTIC DINH_FId.DFC_MOXEMM_SMU_ALM10_17_CA "inhibitable FIds / FIds to be inhibited by inhibit source DFC_MOXEMM_SMU_ALM10_17" VAL_BLK 0x804EEDB0 ValA_Wu16 968.000000000 DINH_FIdVerb 0.00 968.000000000 FORMAT "%13.9" NUMBER 50 /end CHARACTERISTIC
/begin CHARACTERISTIC DINH_FId.DFC_MOXEMM_SMU_ALM10_21_CA "inhibitable FIds / FIds to be inhibited by inhibit source DFC_MOXEMM_SMU_ALM10_21" VAL_BLK 0x804EEE14 ValA_Wu16 968.000000000 DINH_FIdVerb 0.00 968.000000000 FORMAT "%13.9" NUMBER 50 /end CHARACTERISTIC
/begin CHARACTERISTIC DINH_FId.DFC_MOXEMM_SMU_ALM11_0_CA "inhibitable FIds / FIds to be inhibited by inhibit source DFC_MOXEMM_SMU_ALM11_0" VAL_BLK 0x804EEE78 ValA_Wu16 968.000000000 DINH_FIdVerb 0.00 968.000000000 FORMAT "%13.9" NUMBER 50 /end CHARACTERISTIC
/begin CHARACTERISTIC DINH_FId.DFC_MOXEMM_SMU_ALM11_1_CA "inhibitable FIds / FIds to be inhibited by inhibit source DFC_MOXEMM_SMU_ALM11_1" VAL_BLK 0x804EEEDC ValA_Wu16 968.000000000 DINH_FIdVerb 0.00 968.000000000 FORMAT "%13.9" NUMBER 50 /end CHARACTERISTIC
/begin CHARACTERISTIC DINH_FId.DFC_MOXEMM_SMU_ALM11_2_CA "inhibitable FIds / FIds to be inhibited by inhibit source DFC_MOXEMM_SMU_ALM11_2" VAL_BLK 0x804EEF40 ValA_Wu16 968.000000000 DINH_FIdVerb 0.00 968.000000000 FORMAT "%13.9" NUMBER 50 /end CHARACTERISTIC
/begin CHARACTERISTIC DINH_FId.DFC_MOXEMM_SMU_ALM11_3_CA "inhibitable FIds / FIds to be inhibited by inhibit source DFC_MOXEMM_SMU_ALM11_3" VAL_BLK 0x804EEFA4 ValA_Wu16 968.000000000 DINH_FIdVerb 0.00 968.000000000 FORMAT "%13.9" NUMBER 50 /end CHARACTERISTIC
/begin CHARACTERISTIC DINH_FId.DFC_MOXEMM_SMU_ALM11_4_CA "inhibitable FIds / FIds to be inhibited by inhibit source DFC_MOXEMM_SMU_ALM11_4" VAL_BLK 0x804EF008 ValA_Wu16 968.000000000 DINH_FIdVerb 0.00 968.000000000 FORMAT "%13.9" NUMBER 50 /end CHARACTERISTIC
/begin CHARACTERISTIC DINH_FId.DFC_MOXEMM_SMU_ALM11_5_CA "inhibitable FIds / FIds to be inhibited by inhibit source DFC_MOXEMM_SMU_ALM11_5" VAL_BLK 0x804EF06C ValA_Wu16 968.000000000 DINH_FIdVerb 0.00 968.000000000 FORMAT "%13.9" NUMBER 50 /end CHARACTERISTIC
/begin CHARACTERISTIC DINH_FId.DFC_MOXEMM_SMU_ALM11_8_CA "inhibitable FIds / FIds to be inhibited by inhibit source DFC_MOXEMM_SMU_ALM11_8" VAL_BLK 0x804EF0D0 ValA_Wu16 968.000000000 DINH_FIdVerb 0.00 968.000000000 FORMAT "%13.9" NUMBER 50 /end CHARACTERISTIC
/begin CHARACTERISTIC DINH_FId.DFC_MOXEMM_SMU_ALM11_9_CA "inhibitable FIds / FIds to be inhibited by inhibit source DFC_MOXEMM_SMU_ALM11_9" VAL_BLK 0x804EF134 ValA_Wu16 968.000000000 DINH_FIdVerb 0.00 968.000000000 FORMAT "%13.9" NUMBER 50 /end CHARACTERISTIC
/begin CHARACTERISTIC DINH_FId.DFC_MOXEMM_SMU_ALM1_0_CA "inhibitable FIds / FIds to be inhibited by inhibit source DFC_MOXEMM_SMU_ALM1_0" VAL_BLK 0x804EF198 ValA_Wu16 968.000000000 DINH_FIdVerb 0.00 968.000000000 FORMAT "%13.9" NUMBER 50 /end CHARACTERISTIC
/begin CHARACTERISTIC DINH_FId.DFC_MOXEMM_SMU_ALM1_1_CA "inhibitable FIds / FIds to be inhibited by inhibit source DFC_MOXEMM_SMU_ALM1_1" VAL_BLK 0x804EF1FC ValA_Wu16 968.000000000 DINH_FIdVerb 0.00 968.000000000 FORMAT "%13.9" NUMBER 50 /end CHARACTERISTIC
/begin CHARACTERISTIC DINH_FId.DFC_MOXEMM_SMU_ALM1_10_CA "inhibitable FIds / FIds to be inhibited by inhibit source DFC_MOXEMM_SMU_ALM1_10" VAL_BLK 0x804EF260 ValA_Wu16 968.000000000 DINH_FIdVerb 0.00 968.000000000 FORMAT "%13.9" NUMBER 50 /end CHARACTERISTIC
/begin CHARACTERISTIC DINH_FId.DFC_MOXEMM_SMU_ALM1_11_CA "inhibitable FIds / FIds to be inhibited by inhibit source DFC_MOXEMM_SMU_ALM1_11" VAL_BLK 0x804EF2C4 ValA_Wu16 968.000000000 DINH_FIdVerb 0.00 968.000000000 FORMAT "%13.9" NUMBER 50 /end CHARACTERISTIC
/begin CHARACTERISTIC DINH_FId.DFC_MOXEMM_SMU_ALM1_13_CA "inhibitable FIds / FIds to be inhibited by inhibit source DFC_MOXEMM_SMU_ALM1_13" VAL_BLK 0x804EF328 ValA_Wu16 968.000000000 DINH_FIdVerb 0.00 968.000000000 FORMAT "%13.9" NUMBER 50 /end CHARACTERISTIC
/begin CHARACTERISTIC DINH_FId.DFC_MOXEMM_SMU_ALM1_14_CA "inhibitable FIds / FIds to be inhibited by inhibit source DFC_MOXEMM_SMU_ALM1_14" VAL_BLK 0x804EF38C ValA_Wu16 968.000000000 DINH_FIdVerb 0.00 968.000000000 FORMAT "%13.9" NUMBER 50 /end CHARACTERISTIC
/begin CHARACTERISTIC DINH_FId.DFC_MOXEMM_SMU_ALM1_2_CA "inhibitable FIds / FIds to be inhibited by inhibit source DFC_MOXEMM_SMU_ALM1_2" VAL_BLK 0x804EF3F0 ValA_Wu16 968.000000000 DINH_FIdVerb 0.00 968.000000000 FORMAT "%13.9" NUMBER 50 /end CHARACTERISTIC
/begin CHARACTERISTIC DINH_FId.DFC_MOXEMM_SMU_ALM1_22_CA "inhibitable FIds / FIds to be inhibited by inhibit source DFC_MOXEMM_SMU_ALM1_22" VAL_BLK 0x804EF454 ValA_Wu16 968.000000000 DINH_FIdVerb 0.00 968.000000000 FORMAT "%13.9" NUMBER 50 /end CHARACTERISTIC
/begin CHARACTERISTIC DINH_FId.DFC_MOXEMM_SMU_ALM1_23_CA "inhibitable FIds / FIds to be inhibited by inhibit source DFC_MOXEMM_SMU_ALM1_23" VAL_BLK 0x804EF4B8 ValA_Wu16 968.000000000 DINH_FIdVerb 0.00 968.000000000 FORMAT "%13.9" NUMBER 50 /end CHARACTERISTIC
/begin CHARACTERISTIC DINH_FId.DFC_MOXEMM_SMU_ALM1_4_CA "inhibitable FIds / FIds to be inhibited by inhibit source DFC_MOXEMM_SMU_ALM1_4" VAL_BLK 0x804EF51C ValA_Wu16 968.000000000 DINH_FIdVerb 0.00 968.000000000 FORMAT "%13.9" NUMBER 50 /end CHARACTERISTIC
/begin CHARACTERISTIC DINH_FId.DFC_MOXEMM_SMU_ALM1_5_CA "inhibitable FIds / FIds to be inhibited by inhibit source DFC_MOXEMM_SMU_ALM1_5" VAL_BLK 0x804EF580 ValA_Wu16 968.000000000 DINH_FIdVerb 0.00 968.000000000 FORMAT "%13.9" NUMBER 50 /end CHARACTERISTIC
/begin CHARACTERISTIC DINH_FId.DFC_MOXEMM_SMU_ALM1_7_CA "inhibitable FIds / FIds to be inhibited by inhibit source DFC_MOXEMM_SMU_ALM1_7" VAL_BLK 0x804EF5E4 ValA_Wu16 968.000000000 DINH_FIdVerb 0.00 968.000000000 FORMAT "%13.9" NUMBER 50 /end CHARACTERISTIC
/begin CHARACTERISTIC DINH_FId.DFC_MOXEMM_SMU_ALM1_8_CA "inhibitable FIds / FIds to be inhibited by inhibit source DFC_MOXEMM_SMU_ALM1_8" VAL_BLK 0x804EF648 ValA_Wu16 968.000000000 DINH_FIdVerb 0.00 968.000000000 FORMAT "%13.9" NUMBER 50 /end CHARACTERISTIC
/begin CHARACTERISTIC DINH_FId.DFC_MOXEMM_SMU_ALM21_0_CA "inhibitable FIds / FIds to be inhibited by inhibit source DFC_MOXEMM_SMU_ALM21_0" VAL_BLK 0x804EF6AC ValA_Wu16 968.000000000 DINH_FIdVerb 0.00 968.000000000 FORMAT "%13.9" NUMBER 50 /end CHARACTERISTIC
/begin CHARACTERISTIC DINH_FId.DFC_MOXEMM_SMU_ALM21_16_CA "inhibitable FIds / FIds to be inhibited by inhibit source DFC_MOXEMM_SMU_ALM21_16" VAL_BLK 0x804EF710 ValA_Wu16 968.000000000 DINH_FIdVerb 0.00 968.000000000 FORMAT "%13.9" NUMBER 50 /end CHARACTERISTIC
/begin CHARACTERISTIC DINH_FId.DFC_MOXEMM_SMU_ALM21_3_CA "inhibitable FIds / FIds to be inhibited by inhibit source DFC_MOXEMM_SMU_ALM21_3" VAL_BLK 0x804EF774 ValA_Wu16 968.000000000 DINH_FIdVerb 0.00 968.000000000 FORMAT "%13.9" NUMBER 50 /end CHARACTERISTIC
/begin CHARACTERISTIC DINH_FId.DFC_MOXEMM_SMU_ALM2_1_CA "inhibitable FIds / FIds to be inhibited by inhibit source DFC_MOXEMM_SMU_ALM2_1" VAL_BLK 0x804EF7D8 ValA_Wu16 968.000000000 DINH_FIdVerb 0.00 968.000000000 FORMAT "%13.9" NUMBER 50 /end CHARACTERISTIC
/begin CHARACTERISTIC DINH_FId.DFC_MOXEMM_SMU_ALM2_10_CA "inhibitable FIds / FIds to be inhibited by inhibit source DFC_MOXEMM_SMU_ALM2_10" VAL_BLK 0x804EF83C ValA_Wu16 968.000000000 DINH_FIdVerb 0.00 968.000000000 FORMAT "%13.9" NUMBER 50 /end CHARACTERISTIC
/begin CHARACTERISTIC DINH_FId.DFC_MOXEMM_SMU_ALM2_11_CA "inhibitable FIds / FIds to be inhibited by inhibit source DFC_MOXEMM_SMU_ALM2_11" VAL_BLK 0x804EF8A0 ValA_Wu16 968.000000000 DINH_FIdVerb 0.00 968.000000000 FORMAT "%13.9" NUMBER 50 /end CHARACTERISTIC
/begin CHARACTERISTIC DINH_FId.DFC_MOXEMM_SMU_ALM2_13_CA "inhibitable FIds / FIds to be inhibited by inhibit source DFC_MOXEMM_SMU_ALM2_13" VAL_BLK 0x804EF904 ValA_Wu16 968.000000000 DINH_FIdVerb 0.00 968.000000000 FORMAT "%13.9" NUMBER 50 /end CHARACTERISTIC
/begin CHARACTERISTIC DINH_FId.DFC_MOXEMM_SMU_ALM2_14_CA "inhibitable FIds / FIds to be inhibited by inhibit source DFC_MOXEMM_SMU_ALM2_14" VAL_BLK 0x804EF968 ValA_Wu16 968.000000000 DINH_FIdVerb 0.00 968.000000000 FORMAT "%13.9" NUMBER 50 /end CHARACTERISTIC
/begin CHARACTERISTIC DINH_FId.DFC_MOXEMM_SMU_ALM2_22_CA "inhibitable FIds / FIds to be inhibited by inhibit source DFC_MOXEMM_SMU_ALM2_22" VAL_BLK 0x804EF9CC ValA_Wu16 968.000000000 DINH_FIdVerb 0.00 968.000000000 FORMAT "%13.9" NUMBER 50 /end CHARACTERISTIC
/begin CHARACTERISTIC DINH_FId.DFC_MOXEMM_SMU_ALM2_23_CA "inhibitable FIds / FIds to be inhibited by inhibit source DFC_MOXEMM_SMU_ALM2_23" VAL_BLK 0x804EFA30 ValA_Wu16 968.000000000 DINH_FIdVerb 0.00 968.000000000 FORMAT "%13.9" NUMBER 50 /end CHARACTERISTIC
/begin CHARACTERISTIC DINH_FId.DFC_MOXEMM_SMU_ALM2_4_CA "inhibitable FIds / FIds to be inhibited by inhibit source DFC_MOXEMM_SMU_ALM2_4" VAL_BLK 0x804EFA94 ValA_Wu16 968.000000000 DINH_FIdVerb 0.00 968.000000000 FORMAT "%13.9" NUMBER 50 /end CHARACTERISTIC
/begin CHARACTERISTIC DINH_FId.DFC_MOXEMM_SMU_ALM2_5_CA "inhibitable FIds / FIds to be inhibited by inhibit source DFC_MOXEMM_SMU_ALM2_5" VAL_BLK 0x804EFAF8 ValA_Wu16 968.000000000 DINH_FIdVerb 0.00 968.000000000 FORMAT "%13.9" NUMBER 50 /end CHARACTERISTIC
/begin CHARACTERISTIC DINH_FId.DFC_MOXEMM_SMU_ALM2_7_CA "inhibitable FIds / FIds to be inhibited by inhibit source DFC_MOXEMM_SMU_ALM2_7" VAL_BLK 0x804EFB5C ValA_Wu16 968.000000000 DINH_FIdVerb 0.00 968.000000000 FORMAT "%13.9" NUMBER 50 /end CHARACTERISTIC
/begin CHARACTERISTIC DINH_FId.DFC_MOXEMM_SMU_ALM2_8_CA "inhibitable FIds / FIds to be inhibited by inhibit source DFC_MOXEMM_SMU_ALM2_8" VAL_BLK 0x804EFBC0 ValA_Wu16 968.000000000 DINH_FIdVerb 0.00 968.000000000 FORMAT "%13.9" NUMBER 50 /end CHARACTERISTIC
/begin CHARACTERISTIC DINH_FId.DFC_MOXEMM_SMU_ALM6_0_CA "inhibitable FIds / FIds to be inhibited by inhibit source DFC_MOXEMM_SMU_ALM6_0" VAL_BLK 0x804EFC24 ValA_Wu16 968.000000000 DINH_FIdVerb 0.00 968.000000000 FORMAT "%13.9" NUMBER 50 /end CHARACTERISTIC
/begin CHARACTERISTIC DINH_FId.DFC_MOXEMM_SMU_ALM6_11_CA "inhibitable FIds / FIds to be inhibited by inhibit source DFC_MOXEMM_SMU_ALM6_11" VAL_BLK 0x804EFC88 ValA_Wu16 968.000000000 DINH_FIdVerb 0.00 968.000000000 FORMAT "%13.9" NUMBER 50 /end CHARACTERISTIC
/begin CHARACTERISTIC DINH_FId.DFC_MOXEMM_SMU_ALM6_12_CA "inhibitable FIds / FIds to be inhibited by inhibit source DFC_MOXEMM_SMU_ALM6_12" VAL_BLK 0x804EFCEC ValA_Wu16 968.000000000 DINH_FIdVerb 0.00 968.000000000 FORMAT "%13.9" NUMBER 50 /end CHARACTERISTIC
/begin CHARACTERISTIC DINH_FId.DFC_MOXEMM_SMU_ALM6_14_CA "inhibitable FIds / FIds to be inhibited by inhibit source DFC_MOXEMM_SMU_ALM6_14" VAL_BLK 0x804EFD50 ValA_Wu16 968.000000000 DINH_FIdVerb 0.00 968.000000000 FORMAT "%13.9" NUMBER 50 /end CHARACTERISTIC
/begin CHARACTERISTIC DINH_FId.DFC_MOXEMM_SMU_ALM6_15_CA "inhibitable FIds / FIds to be inhibited by inhibit source DFC_MOXEMM_SMU_ALM6_15" VAL_BLK 0x804EFDB4 ValA_Wu16 968.000000000 DINH_FIdVerb 0.00 968.000000000 FORMAT "%13.9" NUMBER 50 /end CHARACTERISTIC
/begin CHARACTERISTIC DINH_FId.DFC_MOXEMM_SMU_ALM6_17_CA "inhibitable FIds / FIds to be inhibited by inhibit source DFC_MOXEMM_SMU_ALM6_17" VAL_BLK 0x804EFE18 ValA_Wu16 968.000000000 DINH_FIdVerb 0.00 968.000000000 FORMAT "%13.9" NUMBER 50 /end CHARACTERISTIC
/begin CHARACTERISTIC DINH_FId.DFC_MOXEMM_SMU_ALM6_18_CA "inhibitable FIds / FIds to be inhibited by inhibit source DFC_MOXEMM_SMU_ALM6_18" VAL_BLK 0x804EFE7C ValA_Wu16 968.000000000 DINH_FIdVerb 0.00 968.000000000 FORMAT "%13.9" NUMBER 50 /end CHARACTERISTIC
/begin CHARACTERISTIC DINH_FId.DFC_MOXEMM_SMU_ALM6_20_CA "inhibitable FIds / FIds to be inhibited by inhibit source DFC_MOXEMM_SMU_ALM6_20" VAL_BLK 0x804EFEE0 ValA_Wu16 968.000000000 DINH_FIdVerb 0.00 968.000000000 FORMAT "%13.9" NUMBER 50 /end CHARACTERISTIC
/begin CHARACTERISTIC DINH_FId.DFC_MOXEMM_SMU_ALM6_21_CA "inhibitable FIds / FIds to be inhibited by inhibit source DFC_MOXEMM_SMU_ALM6_21" VAL_BLK 0x804EFF44 ValA_Wu16 968.000000000 DINH_FIdVerb 0.00 968.000000000 FORMAT "%13.9" NUMBER 50 /end CHARACTERISTIC
/begin CHARACTERISTIC DINH_FId.DFC_MOXEMM_SMU_ALM6_25_CA "inhibitable FIds / FIds to be inhibited by inhibit source DFC_MOXEMM_SMU_ALM6_25" VAL_BLK 0x804EFFA8 ValA_Wu16 968.000000000 DINH_FIdVerb 0.00 968.000000000 FORMAT "%13.9" NUMBER 50 /end CHARACTERISTIC
/begin CHARACTERISTIC DINH_FId.DFC_MOXEMM_SMU_ALM6_4_CA "inhibitable FIds / FIds to be inhibited by inhibit source DFC_MOXEMM_SMU_ALM6_4" VAL_BLK 0x804F000C ValA_Wu16 968.000000000 DINH_FIdVerb 0.00 968.000000000 FORMAT "%13.9" NUMBER 50 /end CHARACTERISTIC
/begin CHARACTERISTIC DINH_FId.DFC_MOXEMM_SMU_ALM6_5_CA "inhibitable FIds / FIds to be inhibited by inhibit source DFC_MOXEMM_SMU_ALM6_5" VAL_BLK 0x804F0070 ValA_Wu16 968.000000000 DINH_FIdVerb 0.00 968.000000000 FORMAT "%13.9" NUMBER 50 /end CHARACTERISTIC
/begin CHARACTERISTIC DINH_FId.DFC_MOXEMM_SMU_ALM6_7_CA "inhibitable FIds / FIds to be inhibited by inhibit source DFC_MOXEMM_SMU_ALM6_7" VAL_BLK 0x804F00D4 ValA_Wu16 968.000000000 DINH_FIdVerb 0.00 968.000000000 FORMAT "%13.9" NUMBER 50 /end CHARACTERISTIC
/begin CHARACTERISTIC DINH_FId.DFC_MOXEMM_SMU_ALM6_8_CA "inhibitable FIds / FIds to be inhibited by inhibit source DFC_MOXEMM_SMU_ALM6_8" VAL_BLK 0x804F0138 ValA_Wu16 968.000000000 DINH_FIdVerb 0.00 968.000000000 FORMAT "%13.9" NUMBER 50 /end CHARACTERISTIC
/begin CHARACTERISTIC DINH_FId.DFC_MOXEMM_SMU_ALM7_1_CA "inhibitable FIds / FIds to be inhibited by inhibit source DFC_MOXEMM_SMU_ALM7_1" VAL_BLK 0x804F019C ValA_Wu16 968.000000000 DINH_FIdVerb 0.00 968.000000000 FORMAT "%13.9" NUMBER 50 /end CHARACTERISTIC
/begin CHARACTERISTIC DINH_FId.DFC_MOXEMM_SMU_ALM7_12_CA "inhibitable FIds / FIds to be inhibited by inhibit source DFC_MOXEMM_SMU_ALM7_12" VAL_BLK 0x804F0200 ValA_Wu16 968.000000000 DINH_FIdVerb 0.00 968.000000000 FORMAT "%13.9" NUMBER 50 /end CHARACTERISTIC
/begin CHARACTERISTIC DINH_FId.DFC_MOXEMM_SMU_ALM7_13_CA "inhibitable FIds / FIds to be inhibited by inhibit source DFC_MOXEMM_SMU_ALM7_13" VAL_BLK 0x804F0264 ValA_Wu16 968.000000000 DINH_FIdVerb 0.00 968.000000000 FORMAT "%13.9" NUMBER 50 /end CHARACTERISTIC
/begin CHARACTERISTIC DINH_FId.DFC_MOXEMM_SMU_ALM7_14_CA "inhibitable FIds / FIds to be inhibited by inhibit source DFC_MOXEMM_SMU_ALM7_14" VAL_BLK 0x804F02C8 ValA_Wu16 968.000000000 DINH_FIdVerb 0.00 968.000000000 FORMAT "%13.9" NUMBER 50 /end CHARACTERISTIC
/begin CHARACTERISTIC DINH_FId.DFC_MOXEMM_SMU_ALM7_15_CA "inhibitable FIds / FIds to be inhibited by inhibit source DFC_MOXEMM_SMU_ALM7_15" VAL_BLK 0x804F032C ValA_Wu16 968.000000000 DINH_FIdVerb 0.00 968.000000000 FORMAT "%13.9" NUMBER 50 /end CHARACTERISTIC
/begin CHARACTERISTIC DINH_FId.DFC_MOXEMM_SMU_ALM7_16_CA "inhibitable FIds / FIds to be inhibited by inhibit source DFC_MOXEMM_SMU_ALM7_16" VAL_BLK 0x804F0390 ValA_Wu16 968.000000000 DINH_FIdVerb 0.00 968.000000000 FORMAT "%13.9" NUMBER 50 /end CHARACTERISTIC
/begin CHARACTERISTIC DINH_FId.DFC_MOXEMM_SMU_ALM7_17_CA "inhibitable FIds / FIds to be inhibited by inhibit source DFC_MOXEMM_SMU_ALM7_17" VAL_BLK 0x804F03F4 ValA_Wu16 968.000000000 DINH_FIdVerb 0.00 968.000000000 FORMAT "%13.9" NUMBER 50 /end CHARACTERISTIC
/begin CHARACTERISTIC DINH_FId.DFC_MOXEMM_SMU_ALM7_2_CA "inhibitable FIds / FIds to be inhibited by inhibit source DFC_MOXEMM_SMU_ALM7_2" VAL_BLK 0x804F0458 ValA_Wu16 968.000000000 DINH_FIdVerb 0.00 968.000000000 FORMAT "%13.9" NUMBER 50 /end CHARACTERISTIC
/begin CHARACTERISTIC DINH_FId.DFC_MOXEMM_SMU_ALM7_20_CA "inhibitable FIds / FIds to be inhibited by inhibit source DFC_MOXEMM_SMU_ALM7_20" VAL_BLK 0x804F04BC ValA_Wu16 968.000000000 DINH_FIdVerb 0.00 968.000000000 FORMAT "%13.9" NUMBER 50 /end CHARACTERISTIC
/begin CHARACTERISTIC DINH_FId.DFC_MOXEMM_SMU_ALM7_25_CA "inhibitable FIds / FIds to be inhibited by inhibit source DFC_MOXEMM_SMU_ALM7_25" VAL_BLK 0x804F0520 ValA_Wu16 968.000000000 DINH_FIdVerb 0.00 968.000000000 FORMAT "%13.9" NUMBER 50 /end CHARACTERISTIC
/begin CHARACTERISTIC DINH_FId.DFC_MOXEMM_SMU_ALM7_26_CA "inhibitable FIds / FIds to be inhibited by inhibit source DFC_MOXEMM_SMU_ALM7_26" VAL_BLK 0x804F0584 ValA_Wu16 968.000000000 DINH_FIdVerb 0.00 968.000000000 FORMAT "%13.9" NUMBER 50 /end CHARACTERISTIC
/begin CHARACTERISTIC DINH_FId.DFC_MOXEMM_SMU_ALM7_28_CA "inhibitable FIds / FIds to be inhibited by inhibit source DFC_MOXEMM_SMU_ALM7_28" VAL_BLK 0x804F05E8 ValA_Wu16 968.000000000 DINH_FIdVerb 0.00 968.000000000 FORMAT "%13.9" NUMBER 50 /end CHARACTERISTIC
/begin CHARACTERISTIC DINH_FId.DFC_MOXEMM_SMU_ALM7_29_CA "inhibitable FIds / FIds to be inhibited by inhibit source DFC_MOXEMM_SMU_ALM7_29" VAL_BLK 0x804F064C ValA_Wu16 968.000000000 DINH_FIdVerb 0.00 968.000000000 FORMAT "%13.9" NUMBER 50 /end CHARACTERISTIC
/begin CHARACTERISTIC DINH_FId.DFC_MOXEMM_SMU_ALM7_30_CA "inhibitable FIds / FIds to be inhibited by inhibit source DFC_MOXEMM_SMU_ALM7_30" VAL_BLK 0x804F06B0 ValA_Wu16 968.000000000 DINH_FIdVerb 0.00 968.000000000 FORMAT "%13.9" NUMBER 50 /end CHARACTERISTIC
/begin CHARACTERISTIC DINH_FId.DFC_MOXEMM_SMU_ALM7_31_CA "inhibitable FIds / FIds to be inhibited by inhibit source DFC_MOXEMM_SMU_ALM7_31" VAL_BLK 0x804F0714 ValA_Wu16 968.000000000 DINH_FIdVerb 0.00 968.000000000 FORMAT "%13.9" NUMBER 50 /end CHARACTERISTIC
/begin CHARACTERISTIC DINH_FId.DFC_MOXEMM_SMU_ALM8_0_CA "inhibitable FIds / FIds to be inhibited by inhibit source DFC_MOXEMM_SMU_ALM8_0" VAL_BLK 0x804F0778 ValA_Wu16 968.000000000 DINH_FIdVerb 0.00 968.000000000 FORMAT "%13.9" NUMBER 50 /end CHARACTERISTIC
/begin CHARACTERISTIC DINH_FId.DFC_MOXEMM_SMU_ALM8_1_CA "inhibitable FIds / FIds to be inhibited by inhibit source DFC_MOXEMM_SMU_ALM8_1" VAL_BLK 0x804F07DC ValA_Wu16 968.000000000 DINH_FIdVerb 0.00 968.000000000 FORMAT "%13.9" NUMBER 50 /end CHARACTERISTIC
/begin CHARACTERISTIC DINH_FId.DFC_MOXEMM_SMU_ALM8_10_CA "inhibitable FIds / FIds to be inhibited by inhibit source DFC_MOXEMM_SMU_ALM8_10" VAL_BLK 0x804F0840 ValA_Wu16 968.000000000 DINH_FIdVerb 0.00 968.000000000 FORMAT "%13.9" NUMBER 50 /end CHARACTERISTIC
/begin CHARACTERISTIC DINH_FId.DFC_MOXEMM_SMU_ALM8_11_CA "inhibitable FIds / FIds to be inhibited by inhibit source DFC_MOXEMM_SMU_ALM8_11" VAL_BLK 0x804F08A4 ValA_Wu16 968.000000000 DINH_FIdVerb 0.00 968.000000000 FORMAT "%13.9" NUMBER 50 /end CHARACTERISTIC
/begin CHARACTERISTIC DINH_FId.DFC_MOXEMM_SMU_ALM8_12_CA "inhibitable FIds / FIds to be inhibited by inhibit source DFC_MOXEMM_SMU_ALM8_12" VAL_BLK 0x804F0908 ValA_Wu16 968.000000000 DINH_FIdVerb 0.00 968.000000000 FORMAT "%13.9" NUMBER 50 /end CHARACTERISTIC
/begin CHARACTERISTIC DINH_FId.DFC_MOXEMM_SMU_ALM8_16_CA "inhibitable FIds / FIds to be inhibited by inhibit source DFC_MOXEMM_SMU_ALM8_16" VAL_BLK 0x804F096C ValA_Wu16 968.000000000 DINH_FIdVerb 0.00 968.000000000 FORMAT "%13.9" NUMBER 50 /end CHARACTERISTIC
/begin CHARACTERISTIC DINH_FId.DFC_MOXEMM_SMU_ALM8_18_CA "inhibitable FIds / FIds to be inhibited by inhibit source DFC_MOXEMM_SMU_ALM8_18" VAL_BLK 0x804F09D0 ValA_Wu16 968.000000000 DINH_FIdVerb 0.00 968.000000000 FORMAT "%13.9" NUMBER 50 /end CHARACTERISTIC
/begin CHARACTERISTIC DINH_FId.DFC_MOXEMM_SMU_ALM8_2_CA "inhibitable FIds / FIds to be inhibited by inhibit source DFC_MOXEMM_SMU_ALM8_2" VAL_BLK 0x804F0A34 ValA_Wu16 968.000000000 DINH_FIdVerb 0.00 968.000000000 FORMAT "%13.9" NUMBER 50 /end CHARACTERISTIC
/begin CHARACTERISTIC DINH_FId.DFC_MOXEMM_SMU_ALM8_3_CA "inhibitable FIds / FIds to be inhibited by inhibit source DFC_MOXEMM_SMU_ALM8_3" VAL_BLK 0x804F0A98 ValA_Wu16 968.000000000 DINH_FIdVerb 0.00 968.000000000 FORMAT "%13.9" NUMBER 50 /end CHARACTERISTIC
/begin CHARACTERISTIC DINH_FId.DFC_MOXEMM_SMU_ALM8_31_CA "inhibitable FIds / FIds to be inhibited by inhibit source DFC_MOXEMM_SMU_ALM8_31" VAL_BLK 0x804F0AFC ValA_Wu16 968.000000000 DINH_FIdVerb 0.00 968.000000000 FORMAT "%13.9" NUMBER 50 /end CHARACTERISTIC
/begin CHARACTERISTIC DINH_FId.DFC_MOXEMM_SMU_ALM8_4_CA "inhibitable FIds / FIds to be inhibited by inhibit source DFC_MOXEMM_SMU_ALM8_4" VAL_BLK 0x804F0B60 ValA_Wu16 968.000000000 DINH_FIdVerb 0.00 968.000000000 FORMAT "%13.9" NUMBER 50 /end CHARACTERISTIC
/begin CHARACTERISTIC DINH_FId.DFC_MOXEMM_SMU_ALM9_0_CA "inhibitable FIds / FIds to be inhibited by inhibit source DFC_MOXEMM_SMU_ALM9_0" VAL_BLK 0x804F0BC4 ValA_Wu16 968.000000000 DINH_FIdVerb 0.00 968.000000000 FORMAT "%13.9" NUMBER 50 /end CHARACTERISTIC
/begin CHARACTERISTIC DINH_FId.DFC_MOXEMM_SMU_ALM9_15_CA "inhibitable FIds / FIds to be inhibited by inhibit source DFC_MOXEMM_SMU_ALM9_15" VAL_BLK 0x804F0C28 ValA_Wu16 968.000000000 DINH_FIdVerb 0.00 968.000000000 FORMAT "%13.9" NUMBER 50 /end CHARACTERISTIC
/begin CHARACTERISTIC DINH_FId.DFC_MOXEMM_SMU_ALM9_3_CA "inhibitable FIds / FIds to be inhibited by inhibit source DFC_MOXEMM_SMU_ALM9_3" VAL_BLK 0x804F0C8C ValA_Wu16 968.000000000 DINH_FIdVerb 0.00 968.000000000 FORMAT "%13.9" NUMBER 50 /end CHARACTERISTIC
/begin CHARACTERISTIC DINH_FId.DFC_MoCADCNTP_CA "inhibitable FIds / FIds to be inhibited by inhibit source DFC_MoCADCNTP" VAL_BLK 0x804F0CF0 ValA_Wu16 968.000000000 DINH_FIdVerb 0.00 968.000000000 FORMAT "%13.9" NUMBER 66 /end CHARACTERISTIC
/begin CHARACTERISTIC DINH_FId.DFC_MoCADCTst_CA "inhibitable FIds / FIds to be inhibited by inhibit source DFC_MoCADCTst" VAL_BLK 0x804F0D74 ValA_Wu16 968.000000000 DINH_FIdVerb 0.00 968.000000000 FORMAT "%13.9" NUMBER 66 /end CHARACTERISTIC
/begin CHARACTERISTIC DINH_FId.DFC_MoCSOPICO_CA "inhibitable FIds / FIds to be inhibited by inhibit source DFC_MoCSOPICO" VAL_BLK 0x804F0DF8 ValA_Wu16 968.000000000 DINH_FIdVerb 0.00 968.000000000 FORMAT "%13.9" NUMBER 51 /end CHARACTERISTIC
/begin CHARACTERISTIC DINH_FId.DFC_MoFAPP_CA "inhibitable FIds / FIds to be inhibited by inhibit source DFC_MoFAPP" VAL_BLK 0x804F0E5E ValA_Wu16 968.000000000 DINH_FIdVerb 0.00 968.000000000 FORMAT "%13.9" NUMBER 66 /end CHARACTERISTIC
/begin CHARACTERISTIC DINH_FId.DFC_MoFAirFilgPrdc_CA "inhibitable FIds / FIds to be inhibited by inhibit source DFC_MoFAirFilgPrdc" VAL_BLK 0x804F0EE2 ValA_Wu16 968.000000000 DINH_FIdVerb 0.00 968.000000000 FORMAT "%13.9" NUMBER 65 /end CHARACTERISTIC
/begin CHARACTERISTIC DINH_FId.DFC_MoFAirFlCtOffGdi_CA "inhibitable FIds / FIds to be inhibited by inhibit source DFC_MoFAirFlCtOffGdi" VAL_BLK 0x804F0F64 ValA_Wu16 968.000000000 DINH_FIdVerb 0.00 968.000000000 FORMAT "%13.9" NUMBER 51 /end CHARACTERISTIC
/begin CHARACTERISTIC DINH_FId.DFC_MoFAirFlCylGdi_CA "inhibitable FIds / FIds to be inhibited by inhibit source DFC_MoFAirFlCylGdi" VAL_BLK 0x804F0FCA ValA_Wu16 968.000000000 DINH_FIdVerb 0.00 968.000000000 FORMAT "%13.9" NUMBER 51 /end CHARACTERISTIC
/begin CHARACTERISTIC DINH_FId.DFC_MoFAirFlFF_CA "inhibitable FIds / FIds to be inhibited by inhibit source DFC_MoFAirFlFF" VAL_BLK 0x804F1030 ValA_Wu16 968.000000000 DINH_FIdVerb 0.00 968.000000000 FORMAT "%13.9" NUMBER 51 /end CHARACTERISTIC
/begin CHARACTERISTIC DINH_FId.DFC_MoFAirFlIn_CA "inhibitable FIds / FIds to be inhibited by inhibit source DFC_MoFAirFlIn" VAL_BLK 0x804F1096 ValA_Wu16 968.000000000 DINH_FIdVerb 0.00 968.000000000 FORMAT "%13.9" NUMBER 51 /end CHARACTERISTIC
/begin CHARACTERISTIC DINH_FId.DFC_MoFAirFlMixCtlGdiChkAirFl_CA "inhibitable FIds / FIds to be inhibited by inhibit source DFC_MoFAirFlMixCtlGdiChkAirFl" VAL_BLK 0x804F10FC ValA_Wu16 968.000000000 DINH_FIdVerb 0.00 968.000000000 FORMAT "%13.9" NUMBER 51 /end CHARACTERISTIC
/begin CHARACTERISTIC DINH_FId.DFC_MoFAirFlMixCtlGdiChkCtrl_CA "inhibitable FIds / FIds to be inhibited by inhibit source DFC_MoFAirFlMixCtlGdiChkCtrl" VAL_BLK 0x804F1162 ValA_Wu16 968.000000000 DINH_FIdVerb 0.00 968.000000000 FORMAT "%13.9" NUMBER 51 /end CHARACTERISTIC
/begin CHARACTERISTIC DINH_FId.DFC_MoFAirFlMode_CA "inhibitable FIds / FIds to be inhibited by inhibit source DFC_MoFAirFlMode" VAL_BLK 0x804F11C8 ValA_Wu16 968.000000000 DINH_FIdVerb 0.00 968.000000000 FORMAT "%13.9" NUMBER 52 /end CHARACTERISTIC
/begin CHARACTERISTIC DINH_FId.DFC_MoFESpd_CA "inhibitable FIds / FIds to be inhibited by inhibit source DFC_MoFESpd" VAL_BLK 0x804F1230 ValA_Wu16 968.000000000 DINH_FIdVerb 0.00 968.000000000 FORMAT "%13.9" NUMBER 66 /end CHARACTERISTIC
/begin CHARACTERISTIC DINH_FId.DFC_MoFIACo_CA "inhibitable FIds / FIds to be inhibited by inhibit source DFC_MoFIACo" VAL_BLK 0x804F12B4 ValA_Wu16 968.000000000 DINH_FIdVerb 0.00 968.000000000 FORMAT "%13.9" NUMBER 52 /end CHARACTERISTIC
/begin CHARACTERISTIC DINH_FId.DFC_MoFICOL1_CA "inhibitable FIds / FIds to be inhibited by inhibit source DFC_MoFICOL1" VAL_BLK 0x804F131C ValA_Wu16 968.000000000 DINH_FIdVerb 0.00 968.000000000 FORMAT "%13.9" NUMBER 64 /end CHARACTERISTIC
/begin CHARACTERISTIC DINH_FId.DFC_MoFICOL2_CA "inhibitable FIds / FIds to be inhibited by inhibit source DFC_MoFICOL2" VAL_BLK 0x804F139C ValA_Wu16 968.000000000 DINH_FIdVerb 0.00 968.000000000 FORMAT "%13.9" NUMBER 60 /end CHARACTERISTIC
/begin CHARACTERISTIC DINH_FId.DFC_MoFStrt_CA "inhibitable FIds / FIds to be inhibited by inhibit source DFC_MoFStrt" VAL_BLK 0x804F1414 ValA_Wu16 968.000000000 DINH_FIdVerb 0.00 968.000000000 FORMAT "%13.9" NUMBER 61 /end CHARACTERISTIC
/begin CHARACTERISTIC DINH_FId.DFC_MoFTrqCmp_CA "inhibitable FIds / FIds to be inhibited by inhibit source DFC_MoFTrqCmp" VAL_BLK 0x804F148E ValA_Wu16 968.000000000 DINH_FIdVerb 0.00 968.000000000 FORMAT "%13.9" NUMBER 65 /end CHARACTERISTIC
/begin CHARACTERISTIC DINH_FId.DFC_MoFTrqCmpMax_CA "inhibitable FIds / FIds to be inhibited by inhibit source DFC_MoFTrqCmpMax" VAL_BLK 0x804F1510 ValA_Wu16 968.000000000 DINH_FIdVerb 0.00 968.000000000 FORMAT "%13.9" NUMBER 50 /end CHARACTERISTIC
/begin CHARACTERISTIC DINH_FId.DFC_MoFTrqCmpMin_CA "inhibitable FIds / FIds to be inhibited by inhibit source DFC_MoFTrqCmpMin" VAL_BLK 0x804F1574 ValA_Wu16 968.000000000 DINH_FIdVerb 0.00 968.000000000 FORMAT "%13.9" NUMBER 50 /end CHARACTERISTIC
/begin CHARACTERISTIC DINH_FId.DFC_MoFVarPostBldSel_CA "inhibitable FIds / FIds to be inhibited by inhibit source DFC_MoFVarPostBldSel" VAL_BLK 0x804F15D8 ValA_Wu16 968.000000000 DINH_FIdVerb 0.00 968.000000000 FORMAT "%13.9" NUMBER 50 /end CHARACTERISTIC
/begin CHARACTERISTIC DINH_FId.DFC_MoXEMMHwLTMCUFW_CA "inhibitable FIds / FIds to be inhibited by inhibit source DFC_MoXEMMHwLTMCUFW" VAL_BLK 0x804F163C ValA_Wu16 968.000000000 DINH_FIdVerb 0.00 968.000000000 FORMAT "%13.9" NUMBER 50 /end CHARACTERISTIC
/begin CHARACTERISTIC DINH_FId.DFC_MoXEMMHwLTMonBIST_CA "inhibitable FIds / FIds to be inhibited by inhibit source DFC_MoXEMMHwLTMonBIST" VAL_BLK 0x804F16A0 ValA_Wu16 968.000000000 DINH_FIdVerb 0.00 968.000000000 FORMAT "%13.9" NUMBER 50 /end CHARACTERISTIC
/begin CHARACTERISTIC DINH_FId.DFC_MoXEMMHwLTRegMonTest_CA "inhibitable FIds / FIds to be inhibited by inhibit source DFC_MoXEMMHwLTRegMonTest" VAL_BLK 0x804F1704 ValA_Wu16 968.000000000 DINH_FIdVerb 0.00 968.000000000 FORMAT "%13.9" NUMBER 50 /end CHARACTERISTIC
/begin CHARACTERISTIC DINH_FId.DFC_MoXEMMHwLTStbySMUAlvTest_CA "inhibitable FIds / FIds to be inhibited by inhibit source DFC_MoXEMMHwLTStbySMUAlvTest" VAL_BLK 0x804F1768 ValA_Wu16 968.000000000 DINH_FIdVerb 0.00 968.000000000 FORMAT "%13.9" NUMBER 50 /end CHARACTERISTIC
/begin CHARACTERISTIC DINH_FId.DFC_MoXEMMHwLTTempSens_CA "inhibitable FIds / FIds to be inhibited by inhibit source DFC_MoXEMMHwLTTempSens" VAL_BLK 0x804F17CC ValA_Wu16 968.000000000 DINH_FIdVerb 0.00 968.000000000 FORMAT "%13.9" NUMBER 50 /end CHARACTERISTIC
/begin CHARACTERISTIC DINH_FId.DFC_MoXEMMHwLTUCBCfg_CA "inhibitable FIds / FIds to be inhibited by inhibit source DFC_MoXEMMHwLTUCBCfg" VAL_BLK 0x804F1830 ValA_Wu16 968.000000000 DINH_FIdVerb 0.00 968.000000000 FORMAT "%13.9" NUMBER 50 /end CHARACTERISTIC
/begin CHARACTERISTIC DINH_FId.DFC_NWSEmax_CA "inhibitable FIds / FIds to be inhibited by inhibit source DFC_NWSEmax" VAL_BLK 0x804F1894 ValA_Wu16 968.000000000 DINH_FIdVerb 0.00 968.000000000 FORMAT "%13.9" NUMBER 50 /end CHARACTERISTIC
/begin CHARACTERISTIC DINH_FId.DFC_NWSmax_CA "inhibitable FIds / FIds to be inhibited by inhibit source DFC_NWSmax" VAL_BLK 0x804F18F8 ValA_Wu16 968.000000000 DINH_FIdVerb 0.00 968.000000000 FORMAT "%13.9" NUMBER 50 /end CHARACTERISTIC
/begin CHARACTERISTIC DINH_FId.DFC_OCWDAABEActv_CA "inhibitable FIds / FIds to be inhibited by inhibit source DFC_OCWDAABEActv" VAL_BLK 0x804F195C ValA_Wu16 968.000000000 DINH_FIdVerb 0.00 968.000000000 FORMAT "%13.9" NUMBER 51 /end CHARACTERISTIC
/begin CHARACTERISTIC DINH_FId.DFC_OCWDACom_CA "inhibitable FIds / FIds to be inhibited by inhibit source DFC_OCWDACom" VAL_BLK 0x804F19C2 ValA_Wu16 968.000000000 DINH_FIdVerb 0.00 968.000000000 FORMAT "%13.9" NUMBER 53 /end CHARACTERISTIC
/begin CHARACTERISTIC DINH_FId.DFC_OCWDAErrPin_CA "inhibitable FIds / FIds to be inhibited by inhibit source DFC_OCWDAErrPin" VAL_BLK 0x804F1A2C ValA_Wu16 968.000000000 DINH_FIdVerb 0.00 968.000000000 FORMAT "%13.9" NUMBER 51 /end CHARACTERISTIC
/begin CHARACTERISTIC DINH_FId.DFC_OCWDAOvrVltg_CA "inhibitable FIds / FIds to be inhibited by inhibit source DFC_OCWDAOvrVltg" VAL_BLK 0x804F1A92 ValA_Wu16 968.000000000 DINH_FIdVerb 0.00 968.000000000 FORMAT "%13.9" NUMBER 51 /end CHARACTERISTIC
/begin CHARACTERISTIC DINH_FId.DFC_ORAmax_CA "inhibitable FIds / FIds to be inhibited by inhibit source DFC_ORAmax" VAL_BLK 0x804F1AF8 ValA_Wu16 968.000000000 DINH_FIdVerb 0.00 968.000000000 FORMAT "%13.9" NUMBER 73 /end CHARACTERISTIC
/begin CHARACTERISTIC DINH_FId.DFC_ORAmin_CA "inhibitable FIds / FIds to be inhibited by inhibit source DFC_ORAmin" VAL_BLK 0x804F1B8A ValA_Wu16 968.000000000 DINH_FIdVerb 0.00 968.000000000 FORMAT "%13.9" NUMBER 73 /end CHARACTERISTIC
/begin CHARACTERISTIC DINH_FId.DFC_OilPPlaus_CA "inhibitable FIds / FIds to be inhibited by inhibit source DFC_OilPPlaus" VAL_BLK 0x804F1C1C ValA_Wu16 968.000000000 DINH_FIdVerb 0.00 968.000000000 FORMAT "%13.9" NUMBER 52 /end CHARACTERISTIC
/begin CHARACTERISTIC DINH_FId.DFC_PLLSUmax_CA "inhibitable FIds / FIds to be inhibited by inhibit source DFC_PLLSUmax" VAL_BLK 0x804F1C84 ValA_Wu16 968.000000000 DINH_FIdVerb 0.00 968.000000000 FORMAT "%13.9" NUMBER 76 /end CHARACTERISTIC
/begin CHARACTERISTIC DINH_FId.DFC_PLLSUmin_CA "inhibitable FIds / FIds to be inhibited by inhibit source DFC_PLLSUmin" VAL_BLK 0x804F1D1C ValA_Wu16 968.000000000 DINH_FIdVerb 0.00 968.000000000 FORMAT "%13.9" NUMBER 76 /end CHARACTERISTIC
/begin CHARACTERISTIC DINH_FId.DFC_PSR1max_CA "inhibitable FIds / FIds to be inhibited by inhibit source DFC_PSR1max" VAL_BLK 0x804F1DB4 ValA_Wu16 968.000000000 DINH_FIdVerb 0.00 968.000000000 FORMAT "%13.9" NUMBER 50 /end CHARACTERISTIC
/begin CHARACTERISTIC DINH_FId.DFC_PSRBmax_CA "inhibitable FIds / FIds to be inhibited by inhibit source DFC_PSRBmax" VAL_BLK 0x804F1E18 ValA_Wu16 968.000000000 DINH_FIdVerb 0.00 968.000000000 FORMAT "%13.9" NUMBER 96 /end CHARACTERISTIC
/begin CHARACTERISTIC DINH_FId.DFC_PSRBmin_CA "inhibitable FIds / FIds to be inhibited by inhibit source DFC_PSRBmin" VAL_BLK 0x804F1ED8 ValA_Wu16 968.000000000 DINH_FIdVerb 0.00 968.000000000 FORMAT "%13.9" NUMBER 96 /end CHARACTERISTIC
/begin CHARACTERISTIC DINH_FId.DFC_PSRPmax_CA "inhibitable FIds / FIds to be inhibited by inhibit source DFC_PSRPmax" VAL_BLK 0x804F1F98 ValA_Wu16 968.000000000 DINH_FIdVerb 0.00 968.000000000 FORMAT "%13.9" NUMBER 95 /end CHARACTERISTIC
/begin CHARACTERISTIC DINH_FId.DFC_PSRPmin_CA "inhibitable FIds / FIds to be inhibited by inhibit source DFC_PSRPmin" VAL_BLK 0x804F2056 ValA_Wu16 968.000000000 DINH_FIdVerb 0.00 968.000000000 FORMAT "%13.9" NUMBER 95 /end CHARACTERISTIC
/begin CHARACTERISTIC DINH_FId.DFC_PSRPsig_CA "inhibitable FIds / FIds to be inhibited by inhibit source DFC_PSRPsig" VAL_BLK 0x804F2114 ValA_Wu16 968.000000000 DINH_FIdVerb 0.00 968.000000000 FORMAT "%13.9" NUMBER 89 /end CHARACTERISTIC
/begin CHARACTERISTIC DINH_FId.DFC_PSRmax_CA "inhibitable FIds / FIds to be inhibited by inhibit source DFC_PSRmax" VAL_BLK 0x804F21C6 ValA_Wu16 968.000000000 DINH_FIdVerb 0.00 968.000000000 FORMAT "%13.9" NUMBER 50 /end CHARACTERISTIC
/begin CHARACTERISTIC DINH_FId.DFC_PUmax_CA "inhibitable FIds / FIds to be inhibited by inhibit source DFC_PUmax" VAL_BLK 0x804F222A ValA_Wu16 968.000000000 DINH_FIdVerb 0.00 968.000000000 FORMAT "%13.9" NUMBER 50 /end CHARACTERISTIC
/begin CHARACTERISTIC DINH_FId.DFC_P_VSE11_OL_CA "inhibitable FIds / FIds to be inhibited by inhibit source DFC_P_VSE11_OL" VAL_BLK 0x804F228E ValA_Wu16 968.000000000 DINH_FIdVerb 0.00 968.000000000 FORMAT "%13.9" NUMBER 82 /end CHARACTERISTIC
/begin CHARACTERISTIC DINH_FId.DFC_P_VSE11_SCB_CA "inhibitable FIds / FIds to be inhibited by inhibit source DFC_P_VSE11_SCB" VAL_BLK 0x804F2332 ValA_Wu16 968.000000000 DINH_FIdVerb 0.00 968.000000000 FORMAT "%13.9" NUMBER 82 /end CHARACTERISTIC
/begin CHARACTERISTIC DINH_FId.DFC_P_VSE11_SCG_CA "inhibitable FIds / FIds to be inhibited by inhibit source DFC_P_VSE11_SCG" VAL_BLK 0x804F23D6 ValA_Wu16 968.000000000 DINH_FIdVerb 0.00 968.000000000 FORMAT "%13.9" NUMBER 82 /end CHARACTERISTIC
/begin CHARACTERISTIC DINH_FId.DFC_PhyHighAPP1_CA "inhibitable FIds / FIds to be inhibited by inhibit source DFC_PhyHighAPP1" VAL_BLK 0x804F247A ValA_Wu16 968.000000000 DINH_FIdVerb 0.00 968.000000000 FORMAT "%13.9" NUMBER 58 /end CHARACTERISTIC
/begin CHARACTERISTIC DINH_FId.DFC_PhyHighAPP2_CA "inhibitable FIds / FIds to be inhibited by inhibit source DFC_PhyHighAPP2" VAL_BLK 0x804F24EE ValA_Wu16 968.000000000 DINH_FIdVerb 0.00 968.000000000 FORMAT "%13.9" NUMBER 57 /end CHARACTERISTIC
/begin CHARACTERISTIC DINH_FId.DFC_PhyLowAPP1_CA "inhibitable FIds / FIds to be inhibited by inhibit source DFC_PhyLowAPP1" VAL_BLK 0x804F2560 ValA_Wu16 968.000000000 DINH_FIdVerb 0.00 968.000000000 FORMAT "%13.9" NUMBER 58 /end CHARACTERISTIC
/begin CHARACTERISTIC DINH_FId.DFC_PhyLowAPP2_CA "inhibitable FIds / FIds to be inhibited by inhibit source DFC_PhyLowAPP2" VAL_BLK 0x804F25D4 ValA_Wu16 968.000000000 DINH_FIdVerb 0.00 968.000000000 FORMAT "%13.9" NUMBER 57 /end CHARACTERISTIC
/begin CHARACTERISTIC DINH_FId.DFC_SRCHighAPP1_CA "inhibitable FIds / FIds to be inhibited by inhibit source DFC_SRCHighAPP1" VAL_BLK 0x804F2646 ValA_Wu16 968.000000000 DINH_FIdVerb 0.00 968.000000000 FORMAT "%13.9" NUMBER 70 /end CHARACTERISTIC
/begin CHARACTERISTIC DINH_FId.DFC_SRCHighAPP2_CA "inhibitable FIds / FIds to be inhibited by inhibit source DFC_SRCHighAPP2" VAL_BLK 0x804F26D2 ValA_Wu16 968.000000000 DINH_FIdVerb 0.00 968.000000000 FORMAT "%13.9" NUMBER 69 /end CHARACTERISTIC
/begin CHARACTERISTIC DINH_FId.DFC_SRCLowAPP1_CA "inhibitable FIds / FIds to be inhibited by inhibit source DFC_SRCLowAPP1" VAL_BLK 0x804F275C ValA_Wu16 968.000000000 DINH_FIdVerb 0.00 968.000000000 FORMAT "%13.9" NUMBER 71 /end CHARACTERISTIC
/begin CHARACTERISTIC DINH_FId.DFC_SRCLowAPP2_CA "inhibitable FIds / FIds to be inhibited by inhibit source DFC_SRCLowAPP2" VAL_BLK 0x804F27EA ValA_Wu16 968.000000000 DINH_FIdVerb 0.00 968.000000000 FORMAT "%13.9" NUMBER 70 /end CHARACTERISTIC
/begin CHARACTERISTIC DINH_FId.DFC_SSpMon2_CA "inhibitable FIds / FIds to be inhibited by inhibit source DFC_SSpMon2" VAL_BLK 0x804F2876 ValA_Wu16 968.000000000 DINH_FIdVerb 0.00 968.000000000 FORMAT "%13.9" NUMBER 79 /end CHARACTERISTIC
/begin CHARACTERISTIC DINH_FId.DFC_STHDRmax_CA "inhibitable FIds / FIds to be inhibited by inhibit source DFC_STHDRmax" VAL_BLK 0x804F2914 ValA_Wu16 968.000000000 DINH_FIdVerb 0.00 968.000000000 FORMAT "%13.9" NUMBER 50 /end CHARACTERISTIC
/begin CHARACTERISTIC DINH_FId.DFC_SWReset_0_CA "inhibitable FIds / FIds to be inhibited by inhibit source DFC_SWReset_0" VAL_BLK 0x804F2978 ValA_Wu16 968.000000000 DINH_FIdVerb 0.00 968.000000000 FORMAT "%13.9" NUMBER 50 /end CHARACTERISTIC
/begin CHARACTERISTIC DINH_FId.DFC_SWReset_1_CA "inhibitable FIds / FIds to be inhibited by inhibit source DFC_SWReset_1" VAL_BLK 0x804F29DC ValA_Wu16 968.000000000 DINH_FIdVerb 0.00 968.000000000 FORMAT "%13.9" NUMBER 50 /end CHARACTERISTIC
/begin CHARACTERISTIC DINH_FId.DFC_SWReset_2_CA "inhibitable FIds / FIds to be inhibited by inhibit source DFC_SWReset_2" VAL_BLK 0x804F2A40 ValA_Wu16 968.000000000 DINH_FIdVerb 0.00 968.000000000 FORMAT "%13.9" NUMBER 50 /end CHARACTERISTIC
/begin CHARACTERISTIC DINH_FId.DFC_SyncAPP_CA "inhibitable FIds / FIds to be inhibited by inhibit source DFC_SyncAPP" VAL_BLK 0x804F2AA4 ValA_Wu16 968.000000000 DINH_FIdVerb 0.00 968.000000000 FORMAT "%13.9" NUMBER 74 /end CHARACTERISTIC
/begin CHARACTERISTIC DINH_FId.DFC_TANKLnpl_CA "inhibitable FIds / FIds to be inhibited by inhibit source DFC_TANKLnpl" VAL_BLK 0x804F2B38 ValA_Wu16 968.000000000 DINH_FIdVerb 0.00 968.000000000 FORMAT "%13.9" NUMBER 50 /end CHARACTERISTIC
/begin CHARACTERISTIC DINH_FId.DFC_TAmax_Dummy_CA "inhibitable FIds / FIds to be inhibited by inhibit source DFC_TAmax_Dummy" VAL_BLK 0x804F2B9C ValA_Wu16 968.000000000 DINH_FIdVerb 0.00 968.000000000 FORMAT "%13.9" NUMBER 50 /end CHARACTERISTIC
/begin CHARACTERISTIC DINH_FId.DFC_TESFmax_CA "inhibitable FIds / FIds to be inhibited by inhibit source DFC_TESFmax" VAL_BLK 0x804F2C00 ValA_Wu16 968.000000000 DINH_FIdVerb 0.00 968.000000000 FORMAT "%13.9" NUMBER 51 /end CHARACTERISTIC
/begin CHARACTERISTIC DINH_FId.DFC_TESGmax_CA "inhibitable FIds / FIds to be inhibited by inhibit source DFC_TESGmax" VAL_BLK 0x804F2C66 ValA_Wu16 968.000000000 DINH_FIdVerb 0.00 968.000000000 FORMAT "%13.9" NUMBER 53 /end CHARACTERISTIC
/begin CHARACTERISTIC DINH_FId.DFC_TKAEmax_CA "inhibitable FIds / FIds to be inhibited by inhibit source DFC_TKAEmax" VAL_BLK 0x804F2CD0 ValA_Wu16 968.000000000 DINH_FIdVerb 0.00 968.000000000 FORMAT "%13.9" NUMBER 51 /end CHARACTERISTIC
/begin CHARACTERISTIC DINH_FId.DFC_TKAEmin_CA "inhibitable FIds / FIds to be inhibited by inhibit source DFC_TKAEmin" VAL_BLK 0x804F2D36 ValA_Wu16 968.000000000 DINH_FIdVerb 0.00 968.000000000 FORMAT "%13.9" NUMBER 51 /end CHARACTERISTIC
/begin CHARACTERISTIC DINH_FId.DFC_TKARmax_CA "inhibitable FIds / FIds to be inhibited by inhibit source DFC_TKARmax" VAL_BLK 0x804F2D9C ValA_Wu16 968.000000000 DINH_FIdVerb 0.00 968.000000000 FORMAT "%13.9" NUMBER 51 /end CHARACTERISTIC
/begin CHARACTERISTIC DINH_FId.DFC_TKARnpl_CA "inhibitable FIds / FIds to be inhibited by inhibit source DFC_TKARnpl" VAL_BLK 0x804F2E02 ValA_Wu16 968.000000000 DINH_FIdVerb 0.00 968.000000000 FORMAT "%13.9" NUMBER 51 /end CHARACTERISTIC
/begin CHARACTERISTIC DINH_FId.DFC_TMmax_Dummy_CA "inhibitable FIds / FIds to be inhibited by inhibit source DFC_TMmax_Dummy" VAL_BLK 0x804F2E68 ValA_Wu16 968.000000000 DINH_FIdVerb 0.00 968.000000000 FORMAT "%13.9" NUMBER 50 /end CHARACTERISTIC
/begin CHARACTERISTIC DINH_FId.DFC_TUMmax_Dummy_CA "inhibitable FIds / FIds to be inhibited by inhibit source DFC_TUMmax_Dummy" VAL_BLK 0x804F2ECC ValA_Wu16 968.000000000 DINH_FIdVerb 0.00 968.000000000 FORMAT "%13.9" NUMBER 50 /end CHARACTERISTIC
/begin CHARACTERISTIC DINH_FId.DFC_TWCDPriCatB1_CA "inhibitable FIds / FIds to be inhibited by inhibit source DFC_TWCDPriCatB1" VAL_BLK 0x804F2F30 ValA_Wu16 968.000000000 DINH_FIdVerb 0.00 968.000000000 FORMAT "%13.9" NUMBER 54 /end CHARACTERISTIC
/begin CHARACTERISTIC DINH_FId.DFC_ThrVlvClsdPosnFirstOffsLrnImpoB1_CA "inhibitable FIds / FIds to be inhibited by inhibit source DFC_ThrVlvClsdPosnFirstOffsLrnImpoB1" VAL_BLK 0x804F2F9C ValA_Wu16 968.000000000 DINH_FIdVerb 0.00 968.000000000 FORMAT "%13.9" NUMBER 75 /end CHARACTERISTIC
/begin CHARACTERISTIC DINH_FId.DFC_ThrVlvClsdPosnOffsLrnImpoB1_CA "inhibitable FIds / FIds to be inhibited by inhibit source DFC_ThrVlvClsdPosnOffsLrnImpoB1" VAL_BLK 0x804F3032 ValA_Wu16 968.000000000 DINH_FIdVerb 0.00 968.000000000 FORMAT "%13.9" NUMBER 59 /end CHARACTERISTIC
/begin CHARACTERISTIC DINH_FId.DFC_ThrVlvClsdPosnOffsLrnMaxB1_CA "inhibitable FIds / FIds to be inhibited by inhibit source DFC_ThrVlvClsdPosnOffsLrnMaxB1" VAL_BLK 0x804F30A8 ValA_Wu16 968.000000000 DINH_FIdVerb 0.00 968.000000000 FORMAT "%13.9" NUMBER 59 /end CHARACTERISTIC
/begin CHARACTERISTIC DINH_FId.DFC_ThrVlvClsdPosnOffsLrnMinB1_CA "inhibitable FIds / FIds to be inhibited by inhibit source DFC_ThrVlvClsdPosnOffsLrnMinB1" VAL_BLK 0x804F311E ValA_Wu16 968.000000000 DINH_FIdVerb 0.00 968.000000000 FORMAT "%13.9" NUMBER 59 /end CHARACTERISTIC
/begin CHARACTERISTIC DINH_FId.DFC_ThrVlvCtrlDeB1_CA "inhibitable FIds / FIds to be inhibited by inhibit source DFC_ThrVlvCtrlDeB1" VAL_BLK 0x804F3194 ValA_Wu16 968.000000000 DINH_FIdVerb 0.00 968.000000000 FORMAT "%13.9" NUMBER 70 /end CHARACTERISTIC
/begin CHARACTERISTIC DINH_FId.DFC_ThrVlvDycB1_CA "inhibitable FIds / FIds to be inhibited by inhibit source DFC_ThrVlvDycB1" VAL_BLK 0x804F3220 ValA_Wu16 968.000000000 DINH_FIdVerb 0.00 968.000000000 FORMAT "%13.9" NUMBER 70 /end CHARACTERISTIC
/begin CHARACTERISTIC DINH_FId.DFC_ThrVlvLimpAirPosnMaxAbsltDriftB1_CA "inhibitable FIds / FIds to be inhibited by inhibit source DFC_ThrVlvLimpAirPosnMaxAbsltDriftB1" VAL_BLK 0x804F32AC ValA_Wu16 968.000000000 DINH_FIdVerb 0.00 968.000000000 FORMAT "%13.9" NUMBER 54 /end CHARACTERISTIC
/begin CHARACTERISTIC DINH_FId.DFC_ThrVlvLimpAirPosnMaxB1_CA "inhibitable FIds / FIds to be inhibited by inhibit source DFC_ThrVlvLimpAirPosnMaxB1" VAL_BLK 0x804F3318 ValA_Wu16 968.000000000 DINH_FIdVerb 0.00 968.000000000 FORMAT "%13.9" NUMBER 54 /end CHARACTERISTIC
/begin CHARACTERISTIC DINH_FId.DFC_ThrVlvLimpAirPosnMaxRelDriftB1_CA "inhibitable FIds / FIds to be inhibited by inhibit source DFC_ThrVlvLimpAirPosnMaxRelDriftB1" VAL_BLK 0x804F3384 ValA_Wu16 968.000000000 DINH_FIdVerb 0.00 968.000000000 FORMAT "%13.9" NUMBER 54 /end CHARACTERISTIC
/begin CHARACTERISTIC DINH_FId.DFC_ThrVlvLimpAirPosnMinB1_CA "inhibitable FIds / FIds to be inhibited by inhibit source DFC_ThrVlvLimpAirPosnMinB1" VAL_BLK 0x804F33F0 ValA_Wu16 968.000000000 DINH_FIdVerb 0.00 968.000000000 FORMAT "%13.9" NUMBER 54 /end CHARACTERISTIC
/begin CHARACTERISTIC DINH_FId.DFC_ThrVlvOpenLoadB1_CA "inhibitable FIds / FIds to be inhibited by inhibit source DFC_ThrVlvOpenLoadB1" VAL_BLK 0x804F345C ValA_Wu16 968.000000000 DINH_FIdVerb 0.00 968.000000000 FORMAT "%13.9" NUMBER 67 /end CHARACTERISTIC
/begin CHARACTERISTIC DINH_FId.DFC_ThrVlvOpenSprgB1_CA "inhibitable FIds / FIds to be inhibited by inhibit source DFC_ThrVlvOpenSprgB1" VAL_BLK 0x804F34E2 ValA_Wu16 968.000000000 DINH_FIdVerb 0.00 968.000000000 FORMAT "%13.9" NUMBER 65 /end CHARACTERISTIC
/begin CHARACTERISTIC DINH_FId.DFC_ThrVlvOpenSprgSprdB1_CA "inhibitable FIds / FIds to be inhibited by inhibit source DFC_ThrVlvOpenSprgSprdB1" VAL_BLK 0x804F3564 ValA_Wu16 968.000000000 DINH_FIdVerb 0.00 968.000000000 FORMAT "%13.9" NUMBER 53 /end CHARACTERISTIC
/begin CHARACTERISTIC DINH_FId.DFC_ThrVlvOpenSprgTwnB1_CA "inhibitable FIds / FIds to be inhibited by inhibit source DFC_ThrVlvOpenSprgTwnB1" VAL_BLK 0x804F35CE ValA_Wu16 968.000000000 DINH_FIdVerb 0.00 968.000000000 FORMAT "%13.9" NUMBER 52 /end CHARACTERISTIC
/begin CHARACTERISTIC DINH_FId.DFC_ThrVlvOverTB1_CA "inhibitable FIds / FIds to be inhibited by inhibit source DFC_ThrVlvOverTB1" VAL_BLK 0x804F3636 ValA_Wu16 968.000000000 DINH_FIdVerb 0.00 968.000000000 FORMAT "%13.9" NUMBER 67 /end CHARACTERISTIC
/begin CHARACTERISTIC DINH_FId.DFC_ThrVlvRetSprgB1_CA "inhibitable FIds / FIds to be inhibited by inhibit source DFC_ThrVlvRetSprgB1" VAL_BLK 0x804F36BC ValA_Wu16 968.000000000 DINH_FIdVerb 0.00 968.000000000 FORMAT "%13.9" NUMBER 67 /end CHARACTERISTIC
/begin CHARACTERISTIC DINH_FId.DFC_ThrVlvRetSprgSprdB1_CA "inhibitable FIds / FIds to be inhibited by inhibit source DFC_ThrVlvRetSprgSprdB1" VAL_BLK 0x804F3742 ValA_Wu16 968.000000000 DINH_FIdVerb 0.00 968.000000000 FORMAT "%13.9" NUMBER 53 /end CHARACTERISTIC
/begin CHARACTERISTIC DINH_FId.DFC_ThrVlvRetSprgTwnB1_CA "inhibitable FIds / FIds to be inhibited by inhibit source DFC_ThrVlvRetSprgTwnB1" VAL_BLK 0x804F37AC ValA_Wu16 968.000000000 DINH_FIdVerb 0.00 968.000000000 FORMAT "%13.9" NUMBER 52 /end CHARACTERISTIC
/begin CHARACTERISTIC DINH_FId.DFC_ThrVlvSens1MaxB1_CA "inhibitable FIds / FIds to be inhibited by inhibit source DFC_ThrVlvSens1MaxB1" VAL_BLK 0x804F3814 ValA_Wu16 968.000000000 DINH_FIdVerb 0.00 968.000000000 FORMAT "%13.9" NUMBER 96 /end CHARACTERISTIC
/begin CHARACTERISTIC DINH_FId.DFC_ThrVlvSens1NplB1_CA "inhibitable FIds / FIds to be inhibited by inhibit source DFC_ThrVlvSens1NplB1" VAL_BLK 0x804F38D4 ValA_Wu16 968.000000000 DINH_FIdVerb 0.00 968.000000000 FORMAT "%13.9" NUMBER 96 /end CHARACTERISTIC
/begin CHARACTERISTIC DINH_FId.DFC_ThrVlvSens2MaxB1_CA "inhibitable FIds / FIds to be inhibited by inhibit source DFC_ThrVlvSens2MaxB1" VAL_BLK 0x804F3994 ValA_Wu16 968.000000000 DINH_FIdVerb 0.00 968.000000000 FORMAT "%13.9" NUMBER 96 /end CHARACTERISTIC
/begin CHARACTERISTIC DINH_FId.DFC_ThrVlvSens2MinB1_CA "inhibitable FIds / FIds to be inhibited by inhibit source DFC_ThrVlvSens2MinB1" VAL_BLK 0x804F3A54 ValA_Wu16 968.000000000 DINH_FIdVerb 0.00 968.000000000 FORMAT "%13.9" NUMBER 96 /end CHARACTERISTIC
/begin CHARACTERISTIC DINH_FId.DFC_ThrVlvSens2NplB1_CA "inhibitable FIds / FIds to be inhibited by inhibit source DFC_ThrVlvSens2NplB1" VAL_BLK 0x804F3B14 ValA_Wu16 968.000000000 DINH_FIdVerb 0.00 968.000000000 FORMAT "%13.9" NUMBER 96 /end CHARACTERISTIC
/begin CHARACTERISTIC DINH_FId.DFC_ThrVlvShoCircB1_CA "inhibitable FIds / FIds to be inhibited by inhibit source DFC_ThrVlvShoCircB1" VAL_BLK 0x804F3BD4 ValA_Wu16 968.000000000 DINH_FIdVerb 0.00 968.000000000 FORMAT "%13.9" NUMBER 67 /end CHARACTERISTIC
/begin CHARACTERISTIC DINH_FId.DFC_ThrVlvSpiErrB1_CA "inhibitable FIds / FIds to be inhibited by inhibit source DFC_ThrVlvSpiErrB1" VAL_BLK 0x804F3C5A ValA_Wu16 968.000000000 DINH_FIdVerb 0.00 968.000000000 FORMAT "%13.9" NUMBER 67 /end CHARACTERISTIC
/begin CHARACTERISTIC DINH_FId.DFC_ThrvlvSens1MinB1_CA "inhibitable FIds / FIds to be inhibited by inhibit source DFC_ThrvlvSens1MinB1" VAL_BLK 0x804F3CE0 ValA_Wu16 968.000000000 DINH_FIdVerb 0.00 968.000000000 FORMAT "%13.9" NUMBER 96 /end CHARACTERISTIC
/begin CHARACTERISTIC DINH_FId.DFC_TiOffTBasdChkFast_CA "inhibitable FIds / FIds to be inhibited by inhibit source DFC_TiOffTBasdChkFast" VAL_BLK 0x804F3DA0 ValA_Wu16 968.000000000 DINH_FIdVerb 0.00 968.000000000 FORMAT "%13.9" NUMBER 55 /end CHARACTERISTIC
/begin CHARACTERISTIC DINH_FId.DFC_TiOffTBasdChkSlow_CA "inhibitable FIds / FIds to be inhibited by inhibit source DFC_TiOffTBasdChkSlow" VAL_BLK 0x804F3E0E ValA_Wu16 968.000000000 DINH_FIdVerb 0.00 968.000000000 FORMAT "%13.9" NUMBER 55 /end CHARACTERISTIC
/begin CHARACTERISTIC DINH_FId.DFC_UEGOSnsrMntdS1B1_CA "inhibitable FIds / FIds to be inhibited by inhibit source DFC_UEGOSnsrMntdS1B1" VAL_BLK 0x804F3E7C ValA_Wu16 968.000000000 DINH_FIdVerb 0.00 968.000000000 FORMAT "%13.9" NUMBER 75 /end CHARACTERISTIC
/begin CHARACTERISTIC DINH_FId.DFC_VehVSig_CA "inhibitable FIds / FIds to be inhibited by inhibit source DFC_VehVSig" VAL_BLK 0x804F3F12 ValA_Wu16 968.000000000 DINH_FIdVerb 0.00 968.000000000 FORMAT "%13.9" NUMBER 92 /end CHARACTERISTIC
/begin CHARACTERISTIC DINH_FId.DFC_VlvLftFbSwtIntk11SpclFail_CA "inhibitable FIds / FIds to be inhibited by inhibit source DFC_VlvLftFbSwtIntk11SpclFail" VAL_BLK 0x804F3FCA ValA_Wu16 968.000000000 DINH_FIdVerb 0.00 968.000000000 FORMAT "%13.9" NUMBER 84 /end CHARACTERISTIC
/begin CHARACTERISTIC DINH_FId.DFC_VlvLftFbSwtIntk11StdFail_CA "inhibitable FIds / FIds to be inhibited by inhibit source DFC_VlvLftFbSwtIntk11StdFail" VAL_BLK 0x804F4072 ValA_Wu16 968.000000000 DINH_FIdVerb 0.00 968.000000000 FORMAT "%13.9" NUMBER 84 /end CHARACTERISTIC
/begin CHARACTERISTIC DINH_FId.DSQ_ACClntP_CA "inhibitable FIds / FIds to be inhibited by inhibit source DSQ_ACClntP" VAL_BLK 0x804F411A ValA_Wu16 968.000000000 DINH_FIdVerb 0.00 968.000000000 FORMAT "%13.9" NUMBER 50 /end CHARACTERISTIC
/begin CHARACTERISTIC DINH_FId.DSQ_ACEvpT_CA "inhibitable FIds / FIds to be inhibited by inhibit source DSQ_ACEvpT" VAL_BLK 0x804F417E ValA_Wu16 968.000000000 DINH_FIdVerb 0.00 968.000000000 FORMAT "%13.9" NUMBER 50 /end CHARACTERISTIC
/begin CHARACTERISTIC DINH_FId.DSQ_AirCCmprActr_CA "inhibitable FIds / FIds to be inhibited by inhibit source DSQ_AirCCmprActr" VAL_BLK 0x804F41E2 ValA_Wu16 968.000000000 DINH_FIdVerb 0.00 968.000000000 FORMAT "%13.9" NUMBER 50 /end CHARACTERISTIC
/begin CHARACTERISTIC DINH_FId.DSQ_BattU_CA "inhibitable FIds / FIds to be inhibited by inhibit source DSQ_BattU" VAL_BLK 0x804F4246 ValA_Wu16 968.000000000 DINH_FIdVerb 0.00 968.000000000 FORMAT "%13.9" NUMBER 53 /end CHARACTERISTIC
/begin CHARACTERISTIC DINH_FId.DSQ_BattULo_CA "inhibitable FIds / FIds to be inhibited by inhibit source DSQ_BattULo" VAL_BLK 0x804F42B0 ValA_Wu16 968.000000000 DINH_FIdVerb 0.00 968.000000000 FORMAT "%13.9" NUMBER 51 /end CHARACTERISTIC
/begin CHARACTERISTIC DINH_FId.DSQ_BrkBstPMdl_CA "inhibitable FIds / FIds to be inhibited by inhibit source DSQ_BrkBstPMdl" VAL_BLK 0x804F4316 ValA_Wu16 968.000000000 DINH_FIdVerb 0.00 968.000000000 FORMAT "%13.9" NUMBER 50 /end CHARACTERISTIC
/begin CHARACTERISTIC DINH_FId.DSQ_BrkP_CA "inhibitable FIds / FIds to be inhibited by inhibit source DSQ_BrkP" VAL_BLK 0x804F437A ValA_Wu16 968.000000000 DINH_FIdVerb 0.00 968.000000000 FORMAT "%13.9" NUMBER 51 /end CHARACTERISTIC
/begin CHARACTERISTIC DINH_FId.DSQ_BrkPSnsr_CA "inhibitable FIds / FIds to be inhibited by inhibit source DSQ_BrkPSnsr" VAL_BLK 0x804F43E0 ValA_Wu16 968.000000000 DINH_FIdVerb 0.00 968.000000000 FORMAT "%13.9" NUMBER 52 /end CHARACTERISTIC
/begin CHARACTERISTIC DINH_FId.DSQ_CoVMDIDASFail_CA "inhibitable FIds / FIds to be inhibited by inhibit source DSQ_CoVMDIDASFail" VAL_BLK 0x804F4448 ValA_Wu16 968.000000000 DINH_FIdVerb 0.00 968.000000000 FORMAT "%13.9" NUMBER 50 /end CHARACTERISTIC
/begin CHARACTERISTIC DINH_FId.DSQ_DSMInhibitAlways_CA "inhibitable FIds / FIds to be inhibited by inhibit source DSQ_DSMInhibitAlways" VAL_BLK 0x804F44AC ValA_Wu16 968.000000000 DINH_FIdVerb 0.00 968.000000000 FORMAT "%13.9" NUMBER 51 /end CHARACTERISTIC
/begin CHARACTERISTIC DINH_FId.DSQ_EGRVlv_GovDesVal_CA "inhibitable FIds / FIds to be inhibited by inhibit source DSQ_EGRVlv_GovDesVal" VAL_BLK 0x804F4512 ValA_Wu16 968.000000000 DINH_FIdVerb 0.00 968.000000000 FORMAT "%13.9" NUMBER 51 /end CHARACTERISTIC
/begin CHARACTERISTIC DINH_FId.DSQ_ElecLd_CA "inhibitable FIds / FIds to be inhibited by inhibit source DSQ_ElecLd" VAL_BLK 0x804F4578 ValA_Wu16 968.000000000 DINH_FIdVerb 0.00 968.000000000 FORMAT "%13.9" NUMBER 51 /end CHARACTERISTIC
/begin CHARACTERISTIC DINH_FId.DSQ_EngICO_CA "inhibitable FIds / FIds to be inhibited by inhibit source DSQ_EngICO" VAL_BLK 0x804F45DE ValA_Wu16 968.000000000 DINH_FIdVerb 0.00 968.000000000 FORMAT "%13.9" NUMBER 50 /end CHARACTERISTIC
/begin CHARACTERISTIC DINH_FId.DSQ_EpmCaSSigQuality_CA "inhibitable FIds / FIds to be inhibited by inhibit source DSQ_EpmCaSSigQuality" VAL_BLK 0x804F4642 ValA_Wu16 968.000000000 DINH_FIdVerb 0.00 968.000000000 FORMAT "%13.9" NUMBER 55 /end CHARACTERISTIC
/begin CHARACTERISTIC DINH_FId.DSQ_EpmReverseRun_CA "inhibitable FIds / FIds to be inhibited by inhibit source DSQ_EpmReverseRun" VAL_BLK 0x804F46B0 ValA_Wu16 968.000000000 DINH_FIdVerb 0.00 968.000000000 FORMAT "%13.9" NUMBER 52 /end CHARACTERISTIC
/begin CHARACTERISTIC DINH_FId.DSQ_FanDIO_0_CA "inhibitable FIds / FIds to be inhibited by inhibit source DSQ_FanDIO_0" VAL_BLK 0x804F4718 ValA_Wu16 968.000000000 DINH_FIdVerb 0.00 968.000000000 FORMAT "%13.9" NUMBER 50 /end CHARACTERISTIC
/begin CHARACTERISTIC DINH_FId.DSQ_FanDIO_1_CA "inhibitable FIds / FIds to be inhibited by inhibit source DSQ_FanDIO_1" VAL_BLK 0x804F477C ValA_Wu16 968.000000000 DINH_FIdVerb 0.00 968.000000000 FORMAT "%13.9" NUMBER 50 /end CHARACTERISTIC
/begin CHARACTERISTIC DINH_FId.DSQ_FuelP_CA "inhibitable FIds / FIds to be inhibited by inhibit source DSQ_FuelP" VAL_BLK 0x804F47E0 ValA_Wu16 968.000000000 DINH_FIdVerb 0.00 968.000000000 FORMAT "%13.9" NUMBER 50 /end CHARACTERISTIC
/begin CHARACTERISTIC DINH_FId.DSQ_FuelT_CA "inhibitable FIds / FIds to be inhibited by inhibit source DSQ_FuelT" VAL_BLK 0x804F4844 ValA_Wu16 968.000000000 DINH_FIdVerb 0.00 968.000000000 FORMAT "%13.9" NUMBER 50 /end CHARACTERISTIC
/begin CHARACTERISTIC DINH_FId.DSQ_GEVCtlTOilCylHd_CA "inhibitable FIds / FIds to be inhibited by inhibit source DSQ_GEVCtlTOilCylHd" VAL_BLK 0x804F48A8 ValA_Wu16 968.000000000 DINH_FIdVerb 0.00 968.000000000 FORMAT "%13.9" NUMBER 54 /end CHARACTERISTIC
/begin CHARACTERISTIC DINH_FId.DSQ_GEVlvAgIntkB1_CA "inhibitable FIds / FIds to be inhibited by inhibit source DSQ_GEVlvAgIntkB1" VAL_BLK 0x804F4914 ValA_Wu16 968.000000000 DINH_FIdVerb 0.00 968.000000000 FORMAT "%13.9" NUMBER 51 /end CHARACTERISTIC
/begin CHARACTERISTIC DINH_FId.DSQ_GbxPNPos_CA "inhibitable FIds / FIds to be inhibited by inhibit source DSQ_GbxPNPos" VAL_BLK 0x804F497A ValA_Wu16 968.000000000 DINH_FIdVerb 0.00 968.000000000 FORMAT "%13.9" NUMBER 51 /end CHARACTERISTIC
/begin CHARACTERISTIC DINH_FId.DSQ_GbxPosNotPN_CA "inhibitable FIds / FIds to be inhibited by inhibit source DSQ_GbxPosNotPN" VAL_BLK 0x804F49E0 ValA_Wu16 968.000000000 DINH_FIdVerb 0.00 968.000000000 FORMAT "%13.9" NUMBER 51 /end CHARACTERISTIC
/begin CHARACTERISTIC DINH_FId.DSQ_InjVlv_DI_CylOk_CA "inhibitable FIds / FIds to be inhibited by inhibit source DSQ_InjVlv_DI_CylOk" VAL_BLK 0x804F4A46 ValA_Wu16 968.000000000 DINH_FIdVerb 0.00 968.000000000 FORMAT "%13.9" NUMBER 50 /end CHARACTERISTIC
/begin CHARACTERISTIC DINH_FId.DSQ_MRly_CA "inhibitable FIds / FIds to be inhibited by inhibit source DSQ_MRly" VAL_BLK 0x804F4AAA ValA_Wu16 968.000000000 DINH_FIdVerb 0.00 968.000000000 FORMAT "%13.9" NUMBER 50 /end CHARACTERISTIC
/begin CHARACTERISTIC DINH_FId.DSQ_OilP_CA "inhibitable FIds / FIds to be inhibited by inhibit source DSQ_OilP" VAL_BLK 0x804F4B0E ValA_Wu16 968.000000000 DINH_FIdVerb 0.00 968.000000000 FORMAT "%13.9" NUMBER 50 /end CHARACTERISTIC
/begin CHARACTERISTIC DINH_FId.DSQ_PEnvMeasVld_CA "inhibitable FIds / FIds to be inhibited by inhibit source DSQ_PEnvMeasVld" VAL_BLK 0x804F4B72 ValA_Wu16 968.000000000 DINH_FIdVerb 0.00 968.000000000 FORMAT "%13.9" NUMBER 52 /end CHARACTERISTIC
/begin CHARACTERISTIC DINH_FId.DSQ_PEnvVld_CA "inhibitable FIds / FIds to be inhibited by inhibit source DSQ_PEnvVld" VAL_BLK 0x804F4BDA ValA_Wu16 968.000000000 DINH_FIdVerb 0.00 968.000000000 FORMAT "%13.9" NUMBER 54 /end CHARACTERISTIC
/begin CHARACTERISTIC DINH_FId.DSQ_PEnv_pRaw_CA "inhibitable FIds / FIds to be inhibited by inhibit source DSQ_PEnv_pRaw" VAL_BLK 0x804F4C46 ValA_Wu16 968.000000000 DINH_FIdVerb 0.00 968.000000000 FORMAT "%13.9" NUMBER 51 /end CHARACTERISTIC
/begin CHARACTERISTIC DINH_FId.DSQ_PRail_CA "inhibitable FIds / FIds to be inhibited by inhibit source DSQ_PRail" VAL_BLK 0x804F4CAC ValA_Wu16 968.000000000 DINH_FIdVerb 0.00 968.000000000 FORMAT "%13.9" NUMBER 50 /end CHARACTERISTIC
/begin CHARACTERISTIC DINH_FId.DSQ_PThrVlvUs_CA "inhibitable FIds / FIds to be inhibited by inhibit source DSQ_PThrVlvUs" VAL_BLK 0x804F4D10 ValA_Wu16 968.000000000 DINH_FIdVerb 0.00 968.000000000 FORMAT "%13.9" NUMBER 50 /end CHARACTERISTIC
/begin CHARACTERISTIC DINH_FId.DSQ_PThrVlvUsB1_CA "inhibitable FIds / FIds to be inhibited by inhibit source DSQ_PThrVlvUsB1" VAL_BLK 0x804F4D74 ValA_Wu16 968.000000000 DINH_FIdVerb 0.00 968.000000000 FORMAT "%13.9" NUMBER 50 /end CHARACTERISTIC
/begin CHARACTERISTIC DINH_FId.DSQ_StrtImobChk_CA "inhibitable FIds / FIds to be inhibited by inhibit source DSQ_StrtImobChk" VAL_BLK 0x804F4DD8 ValA_Wu16 968.000000000 DINH_FIdVerb 0.00 968.000000000 FORMAT "%13.9" NUMBER 50 /end CHARACTERISTIC
/begin CHARACTERISTIC DINH_FId.DSQ_TDevCenColdStrt_CA "inhibitable FIds / FIds to be inhibited by inhibit source DSQ_TDevCenColdStrt" VAL_BLK 0x804F4E3C ValA_Wu16 968.000000000 DINH_FIdVerb 0.00 968.000000000 FORMAT "%13.9" NUMBER 55 /end CHARACTERISTIC
/begin CHARACTERISTIC DINH_FId.DSQ_VehV_CA "inhibitable FIds / FIds to be inhibited by inhibit source DSQ_VehV" VAL_BLK 0x804F4EAA ValA_Wu16 968.000000000 DINH_FIdVerb 0.00 968.000000000 FORMAT "%13.9" NUMBER 58 /end CHARACTERISTIC
/begin CHARACTERISTIC DINH_FId.DSQ_VehVSens_CA "inhibitable FIds / FIds to be inhibited by inhibit source DSQ_VehVSens" VAL_BLK 0x804F4F1E ValA_Wu16 968.000000000 DINH_FIdVerb 0.00 968.000000000 FORMAT "%13.9" NUMBER 53 /end CHARACTERISTIC
/begin CHARACTERISTIC DINH_FId.DSQ_VehVSnsr_CA "inhibitable FIds / FIds to be inhibited by inhibit source DSQ_VehVSnsr" VAL_BLK 0x804F4F88 ValA_Wu16 968.000000000 DINH_FIdVerb 0.00 968.000000000 FORMAT "%13.9" NUMBER 62 /end CHARACTERISTIC
/begin CHARACTERISTIC DINH_FId.DSQ_stAPP_CA "inhibitable FIds / FIds to be inhibited by inhibit source DSQ_stAPP" VAL_BLK 0x804F5004 ValA_Wu16 968.000000000 DINH_FIdVerb 0.00 968.000000000 FORMAT "%13.9" NUMBER 58 /end CHARACTERISTIC
/begin CHARACTERISTIC DINH_FId.DSQ_stComEAT4_CA "inhibitable FIds / FIds to be inhibited by inhibit source DSQ_stComEAT4" VAL_BLK 0x804F5078 ValA_Wu16 968.000000000 DINH_FIdVerb 0.00 968.000000000 FORMAT "%13.9" NUMBER 50 /end CHARACTERISTIC
/begin CHARACTERISTIC DINH_Lim.DFC_AAVEmax_CA "inhibit conditions / inhibit limit conditions for inhibit source DFC_AAVEmax" VAL_BLK 0x804F5F1C ValA_Wu8 17.0000000000 DINH_LimDFCVerb 0.00 17.0000000000 FORMAT "%13.10" NUMBER 59 /end CHARACTERISTIC
/begin CHARACTERISTIC DINH_Lim.DFC_AAVEmin_CA "inhibit conditions / inhibit limit conditions for inhibit source DFC_AAVEmin" VAL_BLK 0x804F5F57 ValA_Wu8 17.0000000000 DINH_LimDFCVerb 0.00 17.0000000000 FORMAT "%13.10" NUMBER 60 /end CHARACTERISTIC
/begin CHARACTERISTIC DINH_Lim.DFC_AAVEsig_CA "inhibit conditions / inhibit limit conditions for inhibit source DFC_AAVEsig" VAL_BLK 0x804F5F93 ValA_Wu8 17.0000000000 DINH_LimDFCVerb 0.00 17.0000000000 FORMAT "%13.10" NUMBER 59 /end CHARACTERISTIC
/begin CHARACTERISTIC DINH_Lim.DFC_AltIOACGFailr_CA "inhibit conditions / inhibit limit conditions for inhibit source DFC_AltIOACGFailr" VAL_BLK 0x804F5FCE ValA_Wu8 17.0000000000 DINH_LimDFCVerb 0.00 17.0000000000 FORMAT "%13.10" NUMBER 65 /end CHARACTERISTIC
/begin CHARACTERISTIC DINH_Lim.DFC_AltIOACGHiVltg_CA "inhibit conditions / inhibit limit conditions for inhibit source DFC_AltIOACGHiVltg" VAL_BLK 0x804F600F ValA_Wu8 17.0000000000 DINH_LimDFCVerb 0.00 17.0000000000 FORMAT "%13.10" NUMBER 65 /end CHARACTERISTIC
/begin CHARACTERISTIC DINH_Lim.DFC_AltIOACGLoVltg_CA "inhibit conditions / inhibit limit conditions for inhibit source DFC_AltIOACGLoVltg" VAL_BLK 0x804F6050 ValA_Wu8 17.0000000000 DINH_LimDFCVerb 0.00 17.0000000000 FORMAT "%13.10" NUMBER 65 /end CHARACTERISTIC
/begin CHARACTERISTIC DINH_Lim.DFC_AltIOACGTHi_CA "inhibit conditions / inhibit limit conditions for inhibit source DFC_AltIOACGTHi" VAL_BLK 0x804F6091 ValA_Wu8 17.0000000000 DINH_LimDFCVerb 0.00 17.0000000000 FORMAT "%13.10" NUMBER 59 /end CHARACTERISTIC
/begin CHARACTERISTIC DINH_Lim.DFC_AltIODConnACG_CA "inhibit conditions / inhibit limit conditions for inhibit source DFC_AltIODConnACG" VAL_BLK 0x804F60CC ValA_Wu8 17.0000000000 DINH_LimDFCVerb 0.00 17.0000000000 FORMAT "%13.10" NUMBER 65 /end CHARACTERISTIC
/begin CHARACTERISTIC DINH_Lim.DFC_BGOELWAF_CA "inhibit conditions / inhibit limit conditions for inhibit source DFC_BGOELWAF" VAL_BLK 0x804F610D ValA_Wu8 17.0000000000 DINH_LimDFCVerb 0.00 17.0000000000 FORMAT "%13.10" NUMBER 50 /end CHARACTERISTIC
/begin CHARACTERISTIC DINH_Lim.DFC_BattUHiFailr_CA "inhibit conditions / inhibit limit conditions for inhibit source DFC_BattUHiFailr" VAL_BLK 0x804F613F ValA_Wu8 17.0000000000 DINH_LimDFCVerb 0.00 17.0000000000 FORMAT "%13.10" NUMBER 51 /end CHARACTERISTIC
/begin CHARACTERISTIC DINH_Lim.DFC_BattULoFailr_CA "inhibit conditions / inhibit limit conditions for inhibit source DFC_BattULoFailr" VAL_BLK 0x804F6172 ValA_Wu8 17.0000000000 DINH_LimDFCVerb 0.00 17.0000000000 FORMAT "%13.10" NUMBER 51 /end CHARACTERISTIC
/begin CHARACTERISTIC DINH_Lim.DFC_BrkBstPDriftHiErr_CA "inhibit conditions / inhibit limit conditions for inhibit source DFC_BrkBstPDriftHiErr" VAL_BLK 0x804F61A5 ValA_Wu8 17.0000000000 DINH_LimDFCVerb 0.00 17.0000000000 FORMAT "%13.10" NUMBER 55 /end CHARACTERISTIC
/begin CHARACTERISTIC DINH_Lim.DFC_BrkBstPDriftLoErr_CA "inhibit conditions / inhibit limit conditions for inhibit source DFC_BrkBstPDriftLoErr" VAL_BLK 0x804F61DC ValA_Wu8 17.0000000000 DINH_LimDFCVerb 0.00 17.0000000000 FORMAT "%13.10" NUMBER 55 /end CHARACTERISTIC
/begin CHARACTERISTIC DINH_Lim.DFC_BrkBstPSnsrStuck_CA "inhibit conditions / inhibit limit conditions for inhibit source DFC_BrkBstPSnsrStuck" VAL_BLK 0x804F6213 ValA_Wu8 17.0000000000 DINH_LimDFCVerb 0.00 17.0000000000 FORMAT "%13.10" NUMBER 56 /end CHARACTERISTIC
/begin CHARACTERISTIC DINH_Lim.DFC_BrkMnSwtContOn_CA "inhibit conditions / inhibit limit conditions for inhibit source DFC_BrkMnSwtContOn" VAL_BLK 0x804F624B ValA_Wu8 17.0000000000 DINH_LimDFCVerb 0.00 17.0000000000 FORMAT "%13.10" NUMBER 55 /end CHARACTERISTIC
/begin CHARACTERISTIC DINH_Lim.DFC_BrkMnSwtNotStp_CA "inhibit conditions / inhibit limit conditions for inhibit source DFC_BrkMnSwtNotStp" VAL_BLK 0x804F6282 ValA_Wu8 17.0000000000 DINH_LimDFCVerb 0.00 17.0000000000 FORMAT "%13.10" NUMBER 55 /end CHARACTERISTIC
/begin CHARACTERISTIC DINH_Lim.DFC_BrkNpl_CA "inhibit conditions / inhibit limit conditions for inhibit source DFC_BrkNpl" VAL_BLK 0x804F62B9 ValA_Wu8 17.0000000000 DINH_LimDFCVerb 0.00 17.0000000000 FORMAT "%13.10" NUMBER 54 /end CHARACTERISTIC
/begin CHARACTERISTIC DINH_Lim.DFC_BrkRdntSwtContOn_CA "inhibit conditions / inhibit limit conditions for inhibit source DFC_BrkRdntSwtContOn" VAL_BLK 0x804F62EF ValA_Wu8 17.0000000000 DINH_LimDFCVerb 0.00 17.0000000000 FORMAT "%13.10" NUMBER 55 /end CHARACTERISTIC
/begin CHARACTERISTIC DINH_Lim.DFC_BrkRdntSwtNotStp_CA "inhibit conditions / inhibit limit conditions for inhibit source DFC_BrkRdntSwtNotStp" VAL_BLK 0x804F6326 ValA_Wu8 17.0000000000 DINH_LimDFCVerb 0.00 17.0000000000 FORMAT "%13.10" NUMBER 55 /end CHARACTERISTIC
/begin CHARACTERISTIC DINH_Lim.DFC_Clth3ONStuck_CA "inhibit conditions / inhibit limit conditions for inhibit source DFC_Clth3ONStuck" VAL_BLK 0x804F635D ValA_Wu8 17.0000000000 DINH_LimDFCVerb 0.00 17.0000000000 FORMAT "%13.10" NUMBER 63 /end CHARACTERISTIC
/begin CHARACTERISTIC DINH_Lim.DFC_Clth4OFFStuck_CA "inhibit conditions / inhibit limit conditions for inhibit source DFC_Clth4OFFStuck" VAL_BLK 0x804F639C ValA_Wu8 17.0000000000 DINH_LimDFCVerb 0.00 17.0000000000 FORMAT "%13.10" NUMBER 59 /end CHARACTERISTIC
/begin CHARACTERISTIC DINH_Lim.DFC_ClthOFFStuck_CA "inhibit conditions / inhibit limit conditions for inhibit source DFC_ClthOFFStuck" VAL_BLK 0x804F63D7 ValA_Wu8 17.0000000000 DINH_LimDFCVerb 0.00 17.0000000000 FORMAT "%13.10" NUMBER 60 /end CHARACTERISTIC
/begin CHARACTERISTIC DINH_Lim.DFC_ClthONStuck_CA "inhibit conditions / inhibit limit conditions for inhibit source DFC_ClthONStuck" VAL_BLK 0x804F6413 ValA_Wu8 17.0000000000 DINH_LimDFCVerb 0.00 17.0000000000 FORMAT "%13.10" NUMBER 60 /end CHARACTERISTIC
/begin CHARACTERISTIC DINH_Lim.DFC_ClthStkFailInfo_CA "inhibit conditions / inhibit limit conditions for inhibit source DFC_ClthStkFailInfo" VAL_BLK 0x804F644F ValA_Wu8 17.0000000000 DINH_LimDFCVerb 0.00 17.0000000000 FORMAT "%13.10" NUMBER 68 /end CHARACTERISTIC
/begin CHARACTERISTIC DINH_Lim.DFC_ComACFailInfo_CA "inhibit conditions / inhibit limit conditions for inhibit source DFC_ComACFailInfo" VAL_BLK 0x804F6493 ValA_Wu8 17.0000000000 DINH_LimDFCVerb 0.00 17.0000000000 FORMAT "%13.10" NUMBER 53 /end CHARACTERISTIC
/begin CHARACTERISTIC DINH_Lim.DFC_ComATFTValErr_CA "inhibit conditions / inhibit limit conditions for inhibit source DFC_ComATFTValErr" VAL_BLK 0x804F64C8 ValA_Wu8 17.0000000000 DINH_LimDFCVerb 0.00 17.0000000000 FORMAT "%13.10" NUMBER 50 /end CHARACTERISTIC
/begin CHARACTERISTIC DINH_Lim.DFC_ComATMILReq_CA "inhibit conditions / inhibit limit conditions for inhibit source DFC_ComATMILReq" VAL_BLK 0x804F64FA ValA_Wu8 17.0000000000 DINH_LimDFCVerb 0.00 17.0000000000 FORMAT "%13.10" NUMBER 50 /end CHARACTERISTIC
/begin CHARACTERISTIC DINH_Lim.DFC_ComAYCAChksum_CA "inhibit conditions / inhibit limit conditions for inhibit source DFC_ComAYCAChksum" VAL_BLK 0x804F652C ValA_Wu8 17.0000000000 DINH_LimDFCVerb 0.00 17.0000000000 FORMAT "%13.10" NUMBER 67 /end CHARACTERISTIC
/begin CHARACTERISTIC DINH_Lim.DFC_ComAYCARingCnt_CA "inhibit conditions / inhibit limit conditions for inhibit source DFC_ComAYCARingCnt" VAL_BLK 0x804F656F ValA_Wu8 17.0000000000 DINH_LimDFCVerb 0.00 17.0000000000 FORMAT "%13.10" NUMBER 67 /end CHARACTERISTIC
/begin CHARACTERISTIC DINH_Lim.DFC_ComAYCATOut_CA "inhibit conditions / inhibit limit conditions for inhibit source DFC_ComAYCATOut" VAL_BLK 0x804F65B2 ValA_Wu8 17.0000000000 DINH_LimDFCVerb 0.00 17.0000000000 FORMAT "%13.10" NUMBER 67 /end CHARACTERISTIC
/begin CHARACTERISTIC DINH_Lim.DFC_ComAYCDChkSum_CA "inhibit conditions / inhibit limit conditions for inhibit source DFC_ComAYCDChkSum" VAL_BLK 0x804F65F5 ValA_Wu8 17.0000000000 DINH_LimDFCVerb 0.00 17.0000000000 FORMAT "%13.10" NUMBER 66 /end CHARACTERISTIC
/begin CHARACTERISTIC DINH_Lim.DFC_ComAYCDTOut_CA "inhibit conditions / inhibit limit conditions for inhibit source DFC_ComAYCDTOut" VAL_BLK 0x804F6637 ValA_Wu8 17.0000000000 DINH_LimDFCVerb 0.00 17.0000000000 FORMAT "%13.10" NUMBER 66 /end CHARACTERISTIC
/begin CHARACTERISTIC DINH_Lim.DFC_ComAYCFChksum_CA "inhibit conditions / inhibit limit conditions for inhibit source DFC_ComAYCFChksum" VAL_BLK 0x804F6679 ValA_Wu8 17.0000000000 DINH_LimDFCVerb 0.00 17.0000000000 FORMAT "%13.10" NUMBER 69 /end CHARACTERISTIC
/begin CHARACTERISTIC DINH_Lim.DFC_ComAYCFRingCnt_CA "inhibit conditions / inhibit limit conditions for inhibit source DFC_ComAYCFRingCnt" VAL_BLK 0x804F66BE ValA_Wu8 17.0000000000 DINH_LimDFCVerb 0.00 17.0000000000 FORMAT "%13.10" NUMBER 69 /end CHARACTERISTIC
/begin CHARACTERISTIC DINH_Lim.DFC_ComAYCFTOut_CA "inhibit conditions / inhibit limit conditions for inhibit source DFC_ComAYCFTOut" VAL_BLK 0x804F6703 ValA_Wu8 17.0000000000 DINH_LimDFCVerb 0.00 17.0000000000 FORMAT "%13.10" NUMBER 69 /end CHARACTERISTIC
/begin CHARACTERISTIC DINH_Lim.DFC_ComAYCGChksum_CA "inhibit conditions / inhibit limit conditions for inhibit source DFC_ComAYCGChksum" VAL_BLK 0x804F6748 ValA_Wu8 17.0000000000 DINH_LimDFCVerb 0.00 17.0000000000 FORMAT "%13.10" NUMBER 64 /end CHARACTERISTIC
/begin CHARACTERISTIC DINH_Lim.DFC_ComAYCGRingCnt_CA "inhibit conditions / inhibit limit conditions for inhibit source DFC_ComAYCGRingCnt" VAL_BLK 0x804F6788 ValA_Wu8 17.0000000000 DINH_LimDFCVerb 0.00 17.0000000000 FORMAT "%13.10" NUMBER 64 /end CHARACTERISTIC
/begin CHARACTERISTIC DINH_Lim.DFC_ComAYCGTOut_CA "inhibit conditions / inhibit limit conditions for inhibit source DFC_ComAYCGTOut" VAL_BLK 0x804F67C8 ValA_Wu8 17.0000000000 DINH_LimDFCVerb 0.00 17.0000000000 FORMAT "%13.10" NUMBER 64 /end CHARACTERISTIC
/begin CHARACTERISTIC DINH_Lim.DFC_ComAYCIChkSum_CA "inhibit conditions / inhibit limit conditions for inhibit source DFC_ComAYCIChkSum" VAL_BLK 0x804F6808 ValA_Wu8 17.0000000000 DINH_LimDFCVerb 0.00 17.0000000000 FORMAT "%13.10" NUMBER 58 /end CHARACTERISTIC
/begin CHARACTERISTIC DINH_Lim.DFC_ComAYCIRingCnt_CA "inhibit conditions / inhibit limit conditions for inhibit source DFC_ComAYCIRingCnt" VAL_BLK 0x804F6842 ValA_Wu8 17.0000000000 DINH_LimDFCVerb 0.00 17.0000000000 FORMAT "%13.10" NUMBER 58 /end CHARACTERISTIC
/begin CHARACTERISTIC DINH_Lim.DFC_ComAYCITOut_CA "inhibit conditions / inhibit limit conditions for inhibit source DFC_ComAYCITOut" VAL_BLK 0x804F687C ValA_Wu8 17.0000000000 DINH_LimDFCVerb 0.00 17.0000000000 FORMAT "%13.10" NUMBER 58 /end CHARACTERISTIC
/begin CHARACTERISTIC DINH_Lim.DFC_ComBCM1ChkSum_CA "inhibit conditions / inhibit limit conditions for inhibit source DFC_ComBCM1ChkSum" VAL_BLK 0x804F68B6 ValA_Wu8 17.0000000000 DINH_LimDFCVerb 0.00 17.0000000000 FORMAT "%13.10" NUMBER 55 /end CHARACTERISTIC
/begin CHARACTERISTIC DINH_Lim.DFC_ComBCM1RingCnt_CA "inhibit conditions / inhibit limit conditions for inhibit source DFC_ComBCM1RingCnt" VAL_BLK 0x804F68ED ValA_Wu8 17.0000000000 DINH_LimDFCVerb 0.00 17.0000000000 FORMAT "%13.10" NUMBER 55 /end CHARACTERISTIC
/begin CHARACTERISTIC DINH_Lim.DFC_ComBCM1TOut_CA "inhibit conditions / inhibit limit conditions for inhibit source DFC_ComBCM1TOut" VAL_BLK 0x804F6924 ValA_Wu8 17.0000000000 DINH_LimDFCVerb 0.00 17.0000000000 FORMAT "%13.10" NUMBER 55 /end CHARACTERISTIC
/begin CHARACTERISTIC DINH_Lim.DFC_ComCANABusOffErr_CA "inhibit conditions / inhibit limit conditions for inhibit source DFC_ComCANABusOffErr" VAL_BLK 0x804F695B ValA_Wu8 17.0000000000 DINH_LimDFCVerb 0.00 17.0000000000 FORMAT "%13.10" NUMBER 201 /end CHARACTERISTIC
/begin CHARACTERISTIC DINH_Lim.DFC_ComCANBBusOffErr_CA "inhibit conditions / inhibit limit conditions for inhibit source DFC_ComCANBBusOffErr" VAL_BLK 0x804F6A24 ValA_Wu8 17.0000000000 DINH_LimDFCVerb 0.00 17.0000000000 FORMAT "%13.10" NUMBER 200 /end CHARACTERISTIC
/begin CHARACTERISTIC DINH_Lim.DFC_ComCANCBusOffErr_CA "inhibit conditions / inhibit limit conditions for inhibit source DFC_ComCANCBusOffErr" VAL_BLK 0x804F6AEC ValA_Wu8 17.0000000000 DINH_LimDFCVerb 0.00 17.0000000000 FORMAT "%13.10" NUMBER 200 /end CHARACTERISTIC
/begin CHARACTERISTIC DINH_Lim.DFC_ComCGW1ChkSum_CA "inhibit conditions / inhibit limit conditions for inhibit source DFC_ComCGW1ChkSum" VAL_BLK 0x804F6BB4 ValA_Wu8 17.0000000000 DINH_LimDFCVerb 0.00 17.0000000000 FORMAT "%13.10" NUMBER 53 /end CHARACTERISTIC
/begin CHARACTERISTIC DINH_Lim.DFC_ComCGW1RingCnt_CA "inhibit conditions / inhibit limit conditions for inhibit source DFC_ComCGW1RingCnt" VAL_BLK 0x804F6BE9 ValA_Wu8 17.0000000000 DINH_LimDFCVerb 0.00 17.0000000000 FORMAT "%13.10" NUMBER 53 /end CHARACTERISTIC
/begin CHARACTERISTIC DINH_Lim.DFC_ComCGW1TOut_CA "inhibit conditions / inhibit limit conditions for inhibit source DFC_ComCGW1TOut" VAL_BLK 0x804F6C1E ValA_Wu8 17.0000000000 DINH_LimDFCVerb 0.00 17.0000000000 FORMAT "%13.10" NUMBER 53 /end CHARACTERISTIC
/begin CHARACTERISTIC DINH_Lim.DFC_ComConvBoostErr_CA "inhibit conditions / inhibit limit conditions for inhibit source DFC_ComConvBoostErr" VAL_BLK 0x804F6C53 ValA_Wu8 17.0000000000 DINH_LimDFCVerb 0.00 17.0000000000 FORMAT "%13.10" NUMBER 51 /end CHARACTERISTIC
/begin CHARACTERISTIC DINH_Lim.DFC_ComConvSlipErr_CA "inhibit conditions / inhibit limit conditions for inhibit source DFC_ComConvSlipErr" VAL_BLK 0x804F6C86 ValA_Wu8 17.0000000000 DINH_LimDFCVerb 0.00 17.0000000000 FORMAT "%13.10" NUMBER 51 /end CHARACTERISTIC
/begin CHARACTERISTIC DINH_Lim.DFC_ComDCDCPrfmncErr_CA "inhibit conditions / inhibit limit conditions for inhibit source DFC_ComDCDCPrfmncErr" VAL_BLK 0x804F6CB9 ValA_Wu8 17.0000000000 DINH_LimDFCVerb 0.00 17.0000000000 FORMAT "%13.10" NUMBER 57 /end CHARACTERISTIC
/begin CHARACTERISTIC DINH_Lim.DFC_ComDCDCTempWarn_CA "inhibit conditions / inhibit limit conditions for inhibit source DFC_ComDCDCTempWarn" VAL_BLK 0x804F6CF2 ValA_Wu8 17.0000000000 DINH_LimDFCVerb 0.00 17.0000000000 FORMAT "%13.10" NUMBER 54 /end CHARACTERISTIC
/begin CHARACTERISTIC DINH_Lim.DFC_ComEAT10Chksum_CA "inhibit conditions / inhibit limit conditions for inhibit source DFC_ComEAT10Chksum" VAL_BLK 0x804F6D28 ValA_Wu8 17.0000000000 DINH_LimDFCVerb 0.00 17.0000000000 FORMAT "%13.10" NUMBER 60 /end CHARACTERISTIC
/begin CHARACTERISTIC DINH_Lim.DFC_ComEAT10RingCnt_CA "inhibit conditions / inhibit limit conditions for inhibit source DFC_ComEAT10RingCnt" VAL_BLK 0x804F6D64 ValA_Wu8 17.0000000000 DINH_LimDFCVerb 0.00 17.0000000000 FORMAT "%13.10" NUMBER 60 /end CHARACTERISTIC
/begin CHARACTERISTIC DINH_Lim.DFC_ComEAT10TOut_CA "inhibit conditions / inhibit limit conditions for inhibit source DFC_ComEAT10TOut" VAL_BLK 0x804F6DA0 ValA_Wu8 17.0000000000 DINH_LimDFCVerb 0.00 17.0000000000 FORMAT "%13.10" NUMBER 60 /end CHARACTERISTIC
/begin CHARACTERISTIC DINH_Lim.DFC_ComEAT11ChkSum_CA "inhibit conditions / inhibit limit conditions for inhibit source DFC_ComEAT11ChkSum" VAL_BLK 0x804F6DDC ValA_Wu8 17.0000000000 DINH_LimDFCVerb 0.00 17.0000000000 FORMAT "%13.10" NUMBER 53 /end CHARACTERISTIC
/begin CHARACTERISTIC DINH_Lim.DFC_ComEAT11RingCnt_CA "inhibit conditions / inhibit limit conditions for inhibit source DFC_ComEAT11RingCnt" VAL_BLK 0x804F6E11 ValA_Wu8 17.0000000000 DINH_LimDFCVerb 0.00 17.0000000000 FORMAT "%13.10" NUMBER 53 /end CHARACTERISTIC
/begin CHARACTERISTIC DINH_Lim.DFC_ComEAT11TOut_CA "inhibit conditions / inhibit limit conditions for inhibit source DFC_ComEAT11TOut" VAL_BLK 0x804F6E46 ValA_Wu8 17.0000000000 DINH_LimDFCVerb 0.00 17.0000000000 FORMAT "%13.10" NUMBER 53 /end CHARACTERISTIC
/begin CHARACTERISTIC DINH_Lim.DFC_ComEAT12ChkSum_CA "inhibit conditions / inhibit limit conditions for inhibit source DFC_ComEAT12ChkSum" VAL_BLK 0x804F6E7B ValA_Wu8 17.0000000000 DINH_LimDFCVerb 0.00 17.0000000000 FORMAT "%13.10" NUMBER 53 /end CHARACTERISTIC
/begin CHARACTERISTIC DINH_Lim.DFC_ComEAT12RingCnt_CA "inhibit conditions / inhibit limit conditions for inhibit source DFC_ComEAT12RingCnt" VAL_BLK 0x804F6EB0 ValA_Wu8 17.0000000000 DINH_LimDFCVerb 0.00 17.0000000000 FORMAT "%13.10" NUMBER 53 /end CHARACTERISTIC
/begin CHARACTERISTIC DINH_Lim.DFC_ComEAT12TOut_CA "inhibit conditions / inhibit limit conditions for inhibit source DFC_ComEAT12TOut" VAL_BLK 0x804F6EE5 ValA_Wu8 17.0000000000 DINH_LimDFCVerb 0.00 17.0000000000 FORMAT "%13.10" NUMBER 53 /end CHARACTERISTIC
/begin CHARACTERISTIC DINH_Lim.DFC_ComEAT13ChkSum_CA "inhibit conditions / inhibit limit conditions for inhibit source DFC_ComEAT13ChkSum" VAL_BLK 0x804F6F1A ValA_Wu8 17.0000000000 DINH_LimDFCVerb 0.00 17.0000000000 FORMAT "%13.10" NUMBER 57 /end CHARACTERISTIC
/begin CHARACTERISTIC DINH_Lim.DFC_ComEAT13RingCnt_CA "inhibit conditions / inhibit limit conditions for inhibit source DFC_ComEAT13RingCnt" VAL_BLK 0x804F6F53 ValA_Wu8 17.0000000000 DINH_LimDFCVerb 0.00 17.0000000000 FORMAT "%13.10" NUMBER 57 /end CHARACTERISTIC
/begin CHARACTERISTIC DINH_Lim.DFC_ComEAT13TOut_CA "inhibit conditions / inhibit limit conditions for inhibit source DFC_ComEAT13TOut" VAL_BLK 0x804F6F8C ValA_Wu8 17.0000000000 DINH_LimDFCVerb 0.00 17.0000000000 FORMAT "%13.10" NUMBER 57 /end CHARACTERISTIC
/begin CHARACTERISTIC DINH_Lim.DFC_ComEAT1Chksum_CA "inhibit conditions / inhibit limit conditions for inhibit source DFC_ComEAT1Chksum" VAL_BLK 0x804F6FC5 ValA_Wu8 17.0000000000 DINH_LimDFCVerb 0.00 17.0000000000 FORMAT "%13.10" NUMBER 57 /end CHARACTERISTIC
/begin CHARACTERISTIC DINH_Lim.DFC_ComEAT1RingCnt_CA "inhibit conditions / inhibit limit conditions for inhibit source DFC_ComEAT1RingCnt" VAL_BLK 0x804F6FFE ValA_Wu8 17.0000000000 DINH_LimDFCVerb 0.00 17.0000000000 FORMAT "%13.10" NUMBER 57 /end CHARACTERISTIC
/begin CHARACTERISTIC DINH_Lim.DFC_ComEAT1TOut_CA "inhibit conditions / inhibit limit conditions for inhibit source DFC_ComEAT1TOut" VAL_BLK 0x804F7037 ValA_Wu8 17.0000000000 DINH_LimDFCVerb 0.00 17.0000000000 FORMAT "%13.10" NUMBER 57 /end CHARACTERISTIC
/begin CHARACTERISTIC DINH_Lim.DFC_ComEAT2ChkSum_CA "inhibit conditions / inhibit limit conditions for inhibit source DFC_ComEAT2ChkSum" VAL_BLK 0x804F7070 ValA_Wu8 17.0000000000 DINH_LimDFCVerb 0.00 17.0000000000 FORMAT "%13.10" NUMBER 58 /end CHARACTERISTIC
/begin CHARACTERISTIC DINH_Lim.DFC_ComEAT2RingCnt_CA "inhibit conditions / inhibit limit conditions for inhibit source DFC_ComEAT2RingCnt" VAL_BLK 0x804F70AA ValA_Wu8 17.0000000000 DINH_LimDFCVerb 0.00 17.0000000000 FORMAT "%13.10" NUMBER 58 /end CHARACTERISTIC
/begin CHARACTERISTIC DINH_Lim.DFC_ComEAT2TOut_CA "inhibit conditions / inhibit limit conditions for inhibit source DFC_ComEAT2TOut" VAL_BLK 0x804F70E4 ValA_Wu8 17.0000000000 DINH_LimDFCVerb 0.00 17.0000000000 FORMAT "%13.10" NUMBER 58 /end CHARACTERISTIC
/begin CHARACTERISTIC DINH_Lim.DFC_ComEAT4ChkSum_CA "inhibit conditions / inhibit limit conditions for inhibit source DFC_ComEAT4ChkSum" VAL_BLK 0x804F711E ValA_Wu8 17.0000000000 DINH_LimDFCVerb 0.00 17.0000000000 FORMAT "%13.10" NUMBER 58 /end CHARACTERISTIC
/begin CHARACTERISTIC DINH_Lim.DFC_ComEAT4RingCnt_CA "inhibit conditions / inhibit limit conditions for inhibit source DFC_ComEAT4RingCnt" VAL_BLK 0x804F7158 ValA_Wu8 17.0000000000 DINH_LimDFCVerb 0.00 17.0000000000 FORMAT "%13.10" NUMBER 58 /end CHARACTERISTIC
/begin CHARACTERISTIC DINH_Lim.DFC_ComEAT4TOut_CA "inhibit conditions / inhibit limit conditions for inhibit source DFC_ComEAT4TOut" VAL_BLK 0x804F7192 ValA_Wu8 17.0000000000 DINH_LimDFCVerb 0.00 17.0000000000 FORMAT "%13.10" NUMBER 58 /end CHARACTERISTIC
/begin CHARACTERISTIC DINH_Lim.DFC_ComEAT6Chksum_CA "inhibit conditions / inhibit limit conditions for inhibit source DFC_ComEAT6Chksum" VAL_BLK 0x804F71CC ValA_Wu8 17.0000000000 DINH_LimDFCVerb 0.00 17.0000000000 FORMAT "%13.10" NUMBER 59 /end CHARACTERISTIC
/begin CHARACTERISTIC DINH_Lim.DFC_ComEAT6RingCnt_CA "inhibit conditions / inhibit limit conditions for inhibit source DFC_ComEAT6RingCnt" VAL_BLK 0x804F7207 ValA_Wu8 17.0000000000 DINH_LimDFCVerb 0.00 17.0000000000 FORMAT "%13.10" NUMBER 59 /end CHARACTERISTIC
/begin CHARACTERISTIC DINH_Lim.DFC_ComEAT6TOut_CA "inhibit conditions / inhibit limit conditions for inhibit source DFC_ComEAT6TOut" VAL_BLK 0x804F7242 ValA_Wu8 17.0000000000 DINH_LimDFCVerb 0.00 17.0000000000 FORMAT "%13.10" NUMBER 59 /end CHARACTERISTIC
/begin CHARACTERISTIC DINH_Lim.DFC_ComEAT7Chksum_CA "inhibit conditions / inhibit limit conditions for inhibit source DFC_ComEAT7Chksum" VAL_BLK 0x804F727D ValA_Wu8 17.0000000000 DINH_LimDFCVerb 0.00 17.0000000000 FORMAT "%13.10" NUMBER 58 /end CHARACTERISTIC
/begin CHARACTERISTIC DINH_Lim.DFC_ComEAT7RingCnt_CA "inhibit conditions / inhibit limit conditions for inhibit source DFC_ComEAT7RingCnt" VAL_BLK 0x804F72B7 ValA_Wu8 17.0000000000 DINH_LimDFCVerb 0.00 17.0000000000 FORMAT "%13.10" NUMBER 58 /end CHARACTERISTIC
/begin CHARACTERISTIC DINH_Lim.DFC_ComEAT7TOut_CA "inhibit conditions / inhibit limit conditions for inhibit source DFC_ComEAT7TOut" VAL_BLK 0x804F72F1 ValA_Wu8 17.0000000000 DINH_LimDFCVerb 0.00 17.0000000000 FORMAT "%13.10" NUMBER 58 /end CHARACTERISTIC
/begin CHARACTERISTIC DINH_Lim.DFC_ComEAT8Chksum_CA "inhibit conditions / inhibit limit conditions for inhibit source DFC_ComEAT8Chksum" VAL_BLK 0x804F732B ValA_Wu8 17.0000000000 DINH_LimDFCVerb 0.00 17.0000000000 FORMAT "%13.10" NUMBER 59 /end CHARACTERISTIC
/begin CHARACTERISTIC DINH_Lim.DFC_ComEAT8RingCnt_CA "inhibit conditions / inhibit limit conditions for inhibit source DFC_ComEAT8RingCnt" VAL_BLK 0x804F7366 ValA_Wu8 17.0000000000 DINH_LimDFCVerb 0.00 17.0000000000 FORMAT "%13.10" NUMBER 59 /end CHARACTERISTIC
/begin CHARACTERISTIC DINH_Lim.DFC_ComEAT8TOut_CA "inhibit conditions / inhibit limit conditions for inhibit source DFC_ComEAT8TOut" VAL_BLK 0x804F73A1 ValA_Wu8 17.0000000000 DINH_LimDFCVerb 0.00 17.0000000000 FORMAT "%13.10" NUMBER 59 /end CHARACTERISTIC
/begin CHARACTERISTIC DINH_Lim.DFC_ComEATAChksum_CA "inhibit conditions / inhibit limit conditions for inhibit source DFC_ComEATAChksum" VAL_BLK 0x804F73DC ValA_Wu8 17.0000000000 DINH_LimDFCVerb 0.00 17.0000000000 FORMAT "%13.10" NUMBER 59 /end CHARACTERISTIC
/begin CHARACTERISTIC DINH_Lim.DFC_ComEATARingCnt_CA "inhibit conditions / inhibit limit conditions for inhibit source DFC_ComEATARingCnt" VAL_BLK 0x804F7417 ValA_Wu8 17.0000000000 DINH_LimDFCVerb 0.00 17.0000000000 FORMAT "%13.10" NUMBER 59 /end CHARACTERISTIC
/begin CHARACTERISTIC DINH_Lim.DFC_ComEATATOut_CA "inhibit conditions / inhibit limit conditions for inhibit source DFC_ComEATATOut" VAL_BLK 0x804F7452 ValA_Wu8 17.0000000000 DINH_LimDFCVerb 0.00 17.0000000000 FORMAT "%13.10" NUMBER 59 /end CHARACTERISTIC
/begin CHARACTERISTIC DINH_Lim.DFC_ComEATBChkSum_CA "inhibit conditions / inhibit limit conditions for inhibit source DFC_ComEATBChkSum" VAL_BLK 0x804F748D ValA_Wu8 17.0000000000 DINH_LimDFCVerb 0.00 17.0000000000 FORMAT "%13.10" NUMBER 65 /end CHARACTERISTIC
/begin CHARACTERISTIC DINH_Lim.DFC_ComEATBRingCnt_CA "inhibit conditions / inhibit limit conditions for inhibit source DFC_ComEATBRingCnt" VAL_BLK 0x804F74CE ValA_Wu8 17.0000000000 DINH_LimDFCVerb 0.00 17.0000000000 FORMAT "%13.10" NUMBER 65 /end CHARACTERISTIC
/begin CHARACTERISTIC DINH_Lim.DFC_ComEATBTOut_CA "inhibit conditions / inhibit limit conditions for inhibit source DFC_ComEATBTOut" VAL_BLK 0x804F750F ValA_Wu8 17.0000000000 DINH_LimDFCVerb 0.00 17.0000000000 FORMAT "%13.10" NUMBER 65 /end CHARACTERISTIC
/begin CHARACTERISTIC DINH_Lim.DFC_ComEATCChksum_CA "inhibit conditions / inhibit limit conditions for inhibit source DFC_ComEATCChksum" VAL_BLK 0x804F7550 ValA_Wu8 17.0000000000 DINH_LimDFCVerb 0.00 17.0000000000 FORMAT "%13.10" NUMBER 52 /end CHARACTERISTIC
/begin CHARACTERISTIC DINH_Lim.DFC_ComEATCRingCnt_CA "inhibit conditions / inhibit limit conditions for inhibit source DFC_ComEATCRingCnt" VAL_BLK 0x804F7584 ValA_Wu8 17.0000000000 DINH_LimDFCVerb 0.00 17.0000000000 FORMAT "%13.10" NUMBER 52 /end CHARACTERISTIC
/begin CHARACTERISTIC DINH_Lim.DFC_ComEATCTOut_CA "inhibit conditions / inhibit limit conditions for inhibit source DFC_ComEATCTOut" VAL_BLK 0x804F75B8 ValA_Wu8 17.0000000000 DINH_LimDFCVerb 0.00 17.0000000000 FORMAT "%13.10" NUMBER 52 /end CHARACTERISTIC
/begin CHARACTERISTIC DINH_Lim.DFC_ComEPBBChkSum_CA "inhibit conditions / inhibit limit conditions for inhibit source DFC_ComEPBBChkSum" VAL_BLK 0x804F75EC ValA_Wu8 17.0000000000 DINH_LimDFCVerb 0.00 17.0000000000 FORMAT "%13.10" NUMBER 53 /end CHARACTERISTIC
/begin CHARACTERISTIC DINH_Lim.DFC_ComEPBBRingCnt_CA "inhibit conditions / inhibit limit conditions for inhibit source DFC_ComEPBBRingCnt" VAL_BLK 0x804F7621 ValA_Wu8 17.0000000000 DINH_LimDFCVerb 0.00 17.0000000000 FORMAT "%13.10" NUMBER 53 /end CHARACTERISTIC
/begin CHARACTERISTIC DINH_Lim.DFC_ComEPBBTOut_CA "inhibit conditions / inhibit limit conditions for inhibit source DFC_ComEPBBTOut" VAL_BLK 0x804F7656 ValA_Wu8 17.0000000000 DINH_LimDFCVerb 0.00 17.0000000000 FORMAT "%13.10" NUMBER 53 /end CHARACTERISTIC
/begin CHARACTERISTIC DINH_Lim.DFC_ComEPBChksum_CA "inhibit conditions / inhibit limit conditions for inhibit source DFC_ComEPBChksum" VAL_BLK 0x804F768B ValA_Wu8 17.0000000000 DINH_LimDFCVerb 0.00 17.0000000000 FORMAT "%13.10" NUMBER 65 /end CHARACTERISTIC
/begin CHARACTERISTIC DINH_Lim.DFC_ComEPBTOut_CA "inhibit conditions / inhibit limit conditions for inhibit source DFC_ComEPBTOut" VAL_BLK 0x804F76CC ValA_Wu8 17.0000000000 DINH_LimDFCVerb 0.00 17.0000000000 FORMAT "%13.10" NUMBER 65 /end CHARACTERISTIC
/begin CHARACTERISTIC DINH_Lim.DFC_ComEPBctRing_CA "inhibit conditions / inhibit limit conditions for inhibit source DFC_ComEPBctRing" VAL_BLK 0x804F770D ValA_Wu8 17.0000000000 DINH_LimDFCVerb 0.00 17.0000000000 FORMAT "%13.10" NUMBER 65 /end CHARACTERISTIC
/begin CHARACTERISTIC DINH_Lim.DFC_ComEPS1Chksum_CA "inhibit conditions / inhibit limit conditions for inhibit source DFC_ComEPS1Chksum" VAL_BLK 0x804F774E ValA_Wu8 17.0000000000 DINH_LimDFCVerb 0.00 17.0000000000 FORMAT "%13.10" NUMBER 59 /end CHARACTERISTIC
/begin CHARACTERISTIC DINH_Lim.DFC_ComEPS1RingCnt_CA "inhibit conditions / inhibit limit conditions for inhibit source DFC_ComEPS1RingCnt" VAL_BLK 0x804F7789 ValA_Wu8 17.0000000000 DINH_LimDFCVerb 0.00 17.0000000000 FORMAT "%13.10" NUMBER 59 /end CHARACTERISTIC
/begin CHARACTERISTIC DINH_Lim.DFC_ComEPS1TOut_CA "inhibit conditions / inhibit limit conditions for inhibit source DFC_ComEPS1TOut" VAL_BLK 0x804F77C4 ValA_Wu8 17.0000000000 DINH_LimDFCVerb 0.00 17.0000000000 FORMAT "%13.10" NUMBER 59 /end CHARACTERISTIC
/begin CHARACTERISTIC DINH_Lim.DFC_ComEngCanRxErr_CA "inhibit conditions / inhibit limit conditions for inhibit source DFC_ComEngCanRxErr" VAL_BLK 0x804F77FF ValA_Wu8 17.0000000000 DINH_LimDFCVerb 0.00 17.0000000000 FORMAT "%13.10" NUMBER 53 /end CHARACTERISTIC
/begin CHARACTERISTIC DINH_Lim.DFC_ComGrvySnsrErr_CA "inhibit conditions / inhibit limit conditions for inhibit source DFC_ComGrvySnsrErr" VAL_BLK 0x804F7834 ValA_Wu8 17.0000000000 DINH_LimDFCVerb 0.00 17.0000000000 FORMAT "%13.10" NUMBER 50 /end CHARACTERISTIC
/begin CHARACTERISTIC DINH_Lim.DFC_ComGwIMG1ChkSum_CA "inhibit conditions / inhibit limit conditions for inhibit source DFC_ComGwIMG1ChkSum" VAL_BLK 0x804F7866 ValA_Wu8 17.0000000000 DINH_LimDFCVerb 0.00 17.0000000000 FORMAT "%13.10" NUMBER 58 /end CHARACTERISTIC
/begin CHARACTERISTIC DINH_Lim.DFC_ComGwIMG1RingCnt_CA "inhibit conditions / inhibit limit conditions for inhibit source DFC_ComGwIMG1RingCnt" VAL_BLK 0x804F78A0 ValA_Wu8 17.0000000000 DINH_LimDFCVerb 0.00 17.0000000000 FORMAT "%13.10" NUMBER 58 /end CHARACTERISTIC
/begin CHARACTERISTIC DINH_Lim.DFC_ComGwIMG1TOut_CA "inhibit conditions / inhibit limit conditions for inhibit source DFC_ComGwIMG1TOut" VAL_BLK 0x804F78DA ValA_Wu8 17.0000000000 DINH_LimDFCVerb 0.00 17.0000000000 FORMAT "%13.10" NUMBER 58 /end CHARACTERISTIC
/begin CHARACTERISTIC DINH_Lim.DFC_ComGwIMG3ChkSum_CA "inhibit conditions / inhibit limit conditions for inhibit source DFC_ComGwIMG3ChkSum" VAL_BLK 0x804F7914 ValA_Wu8 17.0000000000 DINH_LimDFCVerb 0.00 17.0000000000 FORMAT "%13.10" NUMBER 60 /end CHARACTERISTIC
/begin CHARACTERISTIC DINH_Lim.DFC_ComGwIMG3RingCnt_CA "inhibit conditions / inhibit limit conditions for inhibit source DFC_ComGwIMG3RingCnt" VAL_BLK 0x804F7950 ValA_Wu8 17.0000000000 DINH_LimDFCVerb 0.00 17.0000000000 FORMAT "%13.10" NUMBER 60 /end CHARACTERISTIC
/begin CHARACTERISTIC DINH_Lim.DFC_ComGwIMG3TOut_CA "inhibit conditions / inhibit limit conditions for inhibit source DFC_ComGwIMG3TOut" VAL_BLK 0x804F798C ValA_Wu8 17.0000000000 DINH_LimDFCVerb 0.00 17.0000000000 FORMAT "%13.10" NUMBER 60 /end CHARACTERISTIC
/begin CHARACTERISTIC DINH_Lim.DFC_ComGwIMG4ChkSum_CA "inhibit conditions / inhibit limit conditions for inhibit source DFC_ComGwIMG4ChkSum" VAL_BLK 0x804F79C8 ValA_Wu8 17.0000000000 DINH_LimDFCVerb 0.00 17.0000000000 FORMAT "%13.10" NUMBER 58 /end CHARACTERISTIC
/begin CHARACTERISTIC DINH_Lim.DFC_ComGwIMG4RingCnt_CA "inhibit conditions / inhibit limit conditions for inhibit source DFC_ComGwIMG4RingCnt" VAL_BLK 0x804F7A02 ValA_Wu8 17.0000000000 DINH_LimDFCVerb 0.00 17.0000000000 FORMAT "%13.10" NUMBER 58 /end CHARACTERISTIC
/begin CHARACTERISTIC DINH_Lim.DFC_ComGwIMG4TOut_CA "inhibit conditions / inhibit limit conditions for inhibit source DFC_ComGwIMG4TOut" VAL_BLK 0x804F7A3C ValA_Wu8 17.0000000000 DINH_LimDFCVerb 0.00 17.0000000000 FORMAT "%13.10" NUMBER 58 /end CHARACTERISTIC
/begin CHARACTERISTIC DINH_Lim.DFC_ComGwIMG5ChkSum_CA "inhibit conditions / inhibit limit conditions for inhibit source DFC_ComGwIMG5ChkSum" VAL_BLK 0x804F7A76 ValA_Wu8 17.0000000000 DINH_LimDFCVerb 0.00 17.0000000000 FORMAT "%13.10" NUMBER 57 /end CHARACTERISTIC
/begin CHARACTERISTIC DINH_Lim.DFC_ComGwIMG5RingCnt_CA "inhibit conditions / inhibit limit conditions for inhibit source DFC_ComGwIMG5RingCnt" VAL_BLK 0x804F7AAF ValA_Wu8 17.0000000000 DINH_LimDFCVerb 0.00 17.0000000000 FORMAT "%13.10" NUMBER 57 /end CHARACTERISTIC
/begin CHARACTERISTIC DINH_Lim.DFC_ComGwIMG5TOut_CA "inhibit conditions / inhibit limit conditions for inhibit source DFC_ComGwIMG5TOut" VAL_BLK 0x804F7AE8 ValA_Wu8 17.0000000000 DINH_LimDFCVerb 0.00 17.0000000000 FORMAT "%13.10" NUMBER 57 /end CHARACTERISTIC
/begin CHARACTERISTIC DINH_Lim.DFC_ComGwIMG6ChkSum_CA "inhibit conditions / inhibit limit conditions for inhibit source DFC_ComGwIMG6ChkSum" VAL_BLK 0x804F7B21 ValA_Wu8 17.0000000000 DINH_LimDFCVerb 0.00 17.0000000000 FORMAT "%13.10" NUMBER 52 /end CHARACTERISTIC
/begin CHARACTERISTIC DINH_Lim.DFC_ComGwIMG6RingCnt_CA "inhibit conditions / inhibit limit conditions for inhibit source DFC_ComGwIMG6RingCnt" VAL_BLK 0x804F7B55 ValA_Wu8 17.0000000000 DINH_LimDFCVerb 0.00 17.0000000000 FORMAT "%13.10" NUMBER 52 /end CHARACTERISTIC
/begin CHARACTERISTIC DINH_Lim.DFC_ComGwIMG6TOut_CA "inhibit conditions / inhibit limit conditions for inhibit source DFC_ComGwIMG6TOut" VAL_BLK 0x804F7B89 ValA_Wu8 17.0000000000 DINH_LimDFCVerb 0.00 17.0000000000 FORMAT "%13.10" NUMBER 52 /end CHARACTERISTIC
/begin CHARACTERISTIC DINH_Lim.DFC_ComIDASBChksum_CA "inhibit conditions / inhibit limit conditions for inhibit source DFC_ComIDASBChksum" VAL_BLK 0x804F7BBD ValA_Wu8 17.0000000000 DINH_LimDFCVerb 0.00 17.0000000000 FORMAT "%13.10" NUMBER 54 /end CHARACTERISTIC
/begin CHARACTERISTIC DINH_Lim.DFC_ComIDASBRingCnt_CA "inhibit conditions / inhibit limit conditions for inhibit source DFC_ComIDASBRingCnt" VAL_BLK 0x804F7BF3 ValA_Wu8 17.0000000000 DINH_LimDFCVerb 0.00 17.0000000000 FORMAT "%13.10" NUMBER 54 /end CHARACTERISTIC
/begin CHARACTERISTIC DINH_Lim.DFC_ComIDASBTOut_CA "inhibit conditions / inhibit limit conditions for inhibit source DFC_ComIDASBTOut" VAL_BLK 0x804F7C29 ValA_Wu8 17.0000000000 DINH_LimDFCVerb 0.00 17.0000000000 FORMAT "%13.10" NUMBER 54 /end CHARACTERISTIC
/begin CHARACTERISTIC DINH_Lim.DFC_ComIMGMILReq_CA "inhibit conditions / inhibit limit conditions for inhibit source DFC_ComIMGMILReq" VAL_BLK 0x804F7C5F ValA_Wu8 17.0000000000 DINH_LimDFCVerb 0.00 17.0000000000 FORMAT "%13.10" NUMBER 50 /end CHARACTERISTIC
/begin CHARACTERISTIC DINH_Lim.DFC_ComISSPrms_CA "inhibit conditions / inhibit limit conditions for inhibit source DFC_ComISSPrms" VAL_BLK 0x804F7C91 ValA_Wu8 17.0000000000 DINH_LimDFCVerb 0.00 17.0000000000 FORMAT "%13.10" NUMBER 51 /end CHARACTERISTIC
/begin CHARACTERISTIC DINH_Lim.DFC_ComMETAChksum_CA "inhibit conditions / inhibit limit conditions for inhibit source DFC_ComMETAChksum" VAL_BLK 0x804F7CC4 ValA_Wu8 17.0000000000 DINH_LimDFCVerb 0.00 17.0000000000 FORMAT "%13.10" NUMBER 65 /end CHARACTERISTIC
/begin CHARACTERISTIC DINH_Lim.DFC_ComMETAChksumPstDrv_CA "inhibit conditions / inhibit limit conditions for inhibit source DFC_ComMETAChksumPstDrv" VAL_BLK 0x804F7D05 ValA_Wu8 17.0000000000 DINH_LimDFCVerb 0.00 17.0000000000 FORMAT "%13.10" NUMBER 50 /end CHARACTERISTIC
/begin CHARACTERISTIC DINH_Lim.DFC_ComMETARingCnt_CA "inhibit conditions / inhibit limit conditions for inhibit source DFC_ComMETARingCnt" VAL_BLK 0x804F7D37 ValA_Wu8 17.0000000000 DINH_LimDFCVerb 0.00 17.0000000000 FORMAT "%13.10" NUMBER 65 /end CHARACTERISTIC
/begin CHARACTERISTIC DINH_Lim.DFC_ComMETARingCntPstDrv_CA "inhibit conditions / inhibit limit conditions for inhibit source DFC_ComMETARingCntPstDrv" VAL_BLK 0x804F7D78 ValA_Wu8 17.0000000000 DINH_LimDFCVerb 0.00 17.0000000000 FORMAT "%13.10" NUMBER 50 /end CHARACTERISTIC
/begin CHARACTERISTIC DINH_Lim.DFC_ComMETATOut_CA "inhibit conditions / inhibit limit conditions for inhibit source DFC_ComMETATOut" VAL_BLK 0x804F7DAA ValA_Wu8 17.0000000000 DINH_LimDFCVerb 0.00 17.0000000000 FORMAT "%13.10" NUMBER 65 /end CHARACTERISTIC
/begin FUNCTION DINH "30000.27.0_1.0.0Diagnostic Inhibit Handler"
 /begin DEF_CHARACTERISTIC DINH_FId.DFC_RoughRoad_CA DINH_FId.DFC_SiaEEPRdErr_CA DINH_FId.DFC_SiaEEPWrngCod_CA DINH_FId.DFC_UegoHeatrStrtS1B1_CA DINH_FId.DFC_BusDiagCANAPPLBusOff_CA DINH_FId.DFC_BusDiagCANCANCBusOff_CA DINH_FId.DFC_BusDiagCANVEHICLEBusOff_CA DINH_FId.DFC_RBA_IODIAGPWR_rba_IoExtCy329_SignalVltSply_0_CA DINH_FId.DFC_RBA_IODIAGPWR_rba_IoExtCy329_SignalVltSply_0OT_CA DINH_FId.DFC_RBA_IODIAGPWR_rba_IoExtCy329_SignalVltSply_0OV_CA DINH_FId.DFC_RBA_IODIAGPWR_rba_IoExtCy329_SignalVltSply_0SCG_CA DINH_FId.DFC_RBA_IODIAGPWR_rba_IoExtCy329_SignalVltSply_0UV_CA DINH_FId.DFC_RBA_IODIAGPWR_rba_IoExtCy329_SignalVltSply_1_CA DINH_FId.DFC_RBA_IODIAGPWR_rba_IoExtCy329_SignalVltSply_1OT_CA DINH_FId.DFC_RBA_IODIAGPWR_rba_IoExtCy329_SignalVltSply_1OV_CA DINH_FId.DFC_RBA_IODIAGPWR_rba_IoExtCy329_SignalVltSply_1SCG_CA DINH_FId.DFC_RBA_IODIAGPWR_rba_IoExtCy329_SignalVltSply_1UV_CA DINH_FId.DFC_RBA_IODIAGPWR_rba_IoExtCy329_SignalVltSply_2_CA DINH_FId.DFC_RBA_IODIAGPWR_rba_IoExtCy329_SignalVltSply_2OT_CA DINH_FId.DFC_RBA_IODIAGPWR_rba_IoExtCy329_SignalVltSply_2OV_CA DINH_FId.DFC_RBA_IODIAGPWR_rba_IoExtCy329_SignalVltSply_2SCG_CA DINH_FId.DFC_RBA_IODIAGPWR_rba_IoExtCy329_SignalVltSply_2UV_CA DINH_FId.DFC_CAN_E_TIMEOUT_CA DINH_FId.DFC_LIN_E_TIMEOUT_CA DINH_FId.DFC_MRlyOL_CA DINH_FId.DFC_MRlySCB_CA DINH_FId.DFC_MRlySCG_CA DINH_FId.DFC_rba_MultiStackTrace_Threshold_CA DINH_FId.DFC_BSWM_E_ACTION_FAILED_CA DINH_FId.DFC_BSWM_E_INTRPTQUEUE_FULL_CA DINH_FId.DFC_RBA_IOEXTLIB_KEEPALIVE_DRV_CA DINH_FId.DFC_RBA_IOEXTLIB_KEEPALIVE_INI_CA DINH_FId.DFC_rba_IoSigRtc_StopCounter_CA DINH_FId.DFC_rba_MRly_Diag_Stk_Event_CA DINH_FId.DFC_rba_MemDiag_MemReadErr_CA DINH_FId.DFC_rba_MemDiag_MemWrErr_CA DINH_FId.DFC_rba_SyC_IrrSwOffTrigEngRun_Event_CA DINH_FId.DFC_rba_T15_Diag_ComInVld_Event_CA DINH_FId.DFC_rba_T15_Diag_ComOff_HwOn_Event_CA DINH_FId.DFC_rba_T15_Diag_ComOn_HwOff_Event_CA DINH_FId.DFC_AAVmin_CA DINH_FId.DFC_AGRSUS_CA DINH_FId.DFC_AfsPlausDiagHi_CA DINH_FId.DFC_AfsPlausDiagLo_CA DINH_FId.DFC_AfsVrntDiagErrB1_CA DINH_FId.DFC_AppAllSnsrDfct_CA DINH_FId.DFC_BBKRnldg_CA DINH_FId.DFC_BBKRsyne_CA DINH_FId.DFC_BattUStdbyDiaOL_CA DINH_FId.DFC_BigLeakIntkMnfldEmiInfl_CA DINH_FId.DFC_BlkdLineTank_CA DINH_FId.DFC_BrkMnSwtContOnWarnLmp_CA DINH_FId.DFC_BrkMnSwtNotStpWarnLmp_CA DINH_FId.DFC_BrkRdntSwtContOnWarnLmp_CA DINH_FId.DFC_BrkRdntSwtNotStpWarnLmp_CA DINH_FId.DFC_CEngDsTColdStrtMax_CA DINH_FId.DFC_CEngDsTColdStrtMin_CA DINH_FId.DFC_CEngDsTImps_CA DINH_FId.DFC_CEngDsTPlausHSC_CA DINH_FId.DFC_CEngDsTPlausLSC_CA DINH_FId.DFC_CEngDsTPlausSTC_CA DINH_FId.DFC_CEngDsTSRCMax_CA DINH_FId.DFC_CEngDsTSRCMin_CA DINH_FId.DFC_CEngDsTSig_CA DINH_FId.DFC_CEngUsTColdStrtMax_CA DINH_FId.DFC_CEngUsTColdStrtMin_CA DINH_FId.DFC_CEngUsTLooseCnctn_CA DINH_FId.DFC_CEngUsTSRCMax_CA DINH_FId.DFC_CEngUsTSRCMin_CA DINH_FId.DFC_ComDCDCACCFailr_CA DINH_FId.DFC_DCDCFltDet_CA DINH_FId.DFC_DKRSA_CA DINH_FId.DFC_DKVSmax_CA DINH_FId.DFC_DKnpl_CA DINH_FId.DFC_DSKVRmax_CA DINH_FId.DFC_DSKVRmin_CA DINH_FId.DFC_DSKVRnpl_CA DINH_FId.DFC_DSKVRsig_CA DINH_FId.DFC_DSKVSsig_CA DINH_FId.DFC_DSSmax_CA DINH_FId.DFC_DSTDmax_CA DINH_FId.DFC_DSTEmax_CA DINH_FId.DFC_DSTEmin_CA DINH_FId.DFC_DSTOFmax_CA DINH_FId.DFC_DSTRmax_CA DINH_FId.DFC_DSTRmin_CA DINH_FId.DFC_DSTRnpl_CA DINH_FId.DFC_DSTRsig_CA DINH_FId.DFC_DSTTI_CA DINH_FId.DFC_DSUmax_CA DINH_FId.DFC_DiagCpv1DteskLoLoadStuckClsd_CA DINH_FId.DFC_DiagCpv1DteskLoLoadStuckOpen_CA DINH_FId.DFC_EGRVlvDrftClsd_CA DINH_FId.DFC_EGRVlvDrftOpn_CA DINH_FId.DFC_EGRVlvJamVlvClsd_CA DINH_FId.DFC_EGRVlvJamVlvOpn_CA DINH_FId.DFC_EGRVlvSprgBrk_CA DINH_FId.DFC_EGRVlvTempMdlEEPErr_CA DINH_FId.DFC_EGRVlvTmpErr_CA DINH_FId.DFC_EGSDUS2B1LtrDly_CA DINH_FId.DFC_EGSDUS2B1LtrPT1_CA DINH_FId.DFC_EGSDUS2B1RtlDly_CA DINH_FId.DFC_EGSDUS2B1RtlPT1_CA DINH_FId.DFC_EGSDUS2B1TarLean_CA DINH_FId.DFC_EGSDUS2B1TarRich_CA DINH_FId.DFC_EONVmax_CA DINH_FId.DFC_ETAKHLmax_CA DINH_FId.DFC_ETAKHTmax_CA DINH_FId.DFC_ETHSEmax_CA DINH_FId.DFC_ETHSEmin_CA DINH_FId.DFC_ETHSFmax_CA DINH_FId.DFC_ETHSFmin_CA DINH_FId.DFC_ETHSFsig_CA DINH_FId.DFC_ETHSNPWmax_CA DINH_FId.DFC_ETHSNPWmin_CA DINH_FId.DFC_ETHSNPWsig_CA DINH_FId.DFC_ETHSPLnpl_CA DINH_FId.DFC_ETHSTPLnpl_CA DINH_FId.DFC_EngICO_CA DINH_FId.DFC_EngPrtOvrSpdMon_CA DINH_FId.DFC_EpmCaSI1ErrSig_CA DINH_FId.DFC_EpmCaSI1MntErr_CA DINH_FId.DFC_EpmCaSI1NoSigMax_CA DINH_FId.DFC_EpmCaSI1NoSigMin_CA DINH_FId.DFC_EpmCaSI1OfsErr_CA DINH_FId.DFC_EpmCrSDGI_CA DINH_FId.DFC_EpmCrSErrSig_CA DINH_FId.DFC_EpmCrSNoSig_CA DINH_FId.DFC_EtaEngIdleNonCsers_CA DINH_FId.DFC_EtaEngPtlNonCsers_CA DINH_FId.DFC_FRAmax_CA DINH_FId.DFC_FRAmin_CA DINH_FId.DFC_FSTEmax_CA DINH_FId.DFC_FSTEmin_CA DINH_FId.DFC_FSTRmax_CA DINH_FId.DFC_FSTRmin_CA DINH_FId.DFC_FSTRnpl_CA DINH_FId.DFC_FSTmax_CA DINH_FId.DFC_FTDLAmax_CA DINH_FId.DFC_FTDLAmin_CA DINH_FId.DFC_FuPHiSnsrEleclmax_CA DINH_FId.DFC_FuPHiSnsrEleclmin_CA DINH_FId.DFC_FuPHiSnsrEleclnpl_CA DINH_FId.DFC_FuPHiSnsrURngMax_CA DINH_FId.DFC_FuPHiSnsrURngMin_CA DINH_FId.DFC_FuSnsrPhyRngMaxErr_CA DINH_FId.DFC_FuSnsrPhyRngMinErr_CA DINH_FId.DFC_GEVlvLockPinDiagIntkB1_CA DINH_FId.DFC_GEVlvPhaSlowIntkB1_CA DINH_FId.DFC_GEVlvPhaTargIntkB1_CA DINH_FId.DFC_GbxRvsSwtStk_CA DINH_FId.DFC_HDRKHmax_CA DINH_FId.DFC_HDRKHmin_CA DINH_FId.DFC_HDRPLmax_CA DINH_FId.DFC_HDRPLmin_CA DINH_FId.DFC_HDRmax_CA DINH_FId.DFC_HDRmin_CA DINH_FId.DFC_HEGOS2B1ElecMax_CA DINH_FId.DFC_HEGOS2B1ElecMin_CA DINH_FId.DFC_HEGOS2B1ElecSig_CA DINH_FId.DFC_HEGOS2B1HtgNpl_CA DINH_FId.DFC_HEV00max_CA DINH_FId.DFC_HEV01max_CA DINH_FId.DFC_HEV02max_CA DINH_FId.DFC_HEV03max_CA DINH_FId.DFC_HEVE0max_CA DINH_FId.DFC_HEVE1max_CA DINH_FId.DFC_HFMmax_CA DINH_FId.DFC_HiPSysHiPMaxLimExcdd_CA DINH_FId.DFC_IVGdiCtlCvoErrMax_0_CA DINH_FId.DFC_IVGdiCtlCvoErrMax_1_CA DINH_FId.DFC_IVGdiCtlCvoErrMax_2_CA DINH_FId.DFC_IVGdiCtlCvoErrMax_3_CA DINH_FId.DFC_IVGdiCtlCvoErrMin_0_CA DINH_FId.DFC_IVGdiCtlCvoErrMin_1_CA DINH_FId.DFC_IVGdiCtlCvoErrMin_2_CA DINH_FId.DFC_IVGdiCtlCvoErrMin_3_CA DINH_FId.DFC_IVGdiCtlCvoErrMinMax_CA DINH_FId.DFC_IVGdiCtlCvoSigPlausErrSmrCdn_CA DINH_FId.DFC_IVGdiCtl_CvoErr_CA DINH_FId.DFC_IVGdiCtl_CvoSigPlaus_0_CA DINH_FId.DFC_IVGdiCtl_CvoSigPlaus_1_CA DINH_FId.DFC_IVGdiCtl_CvoSigPlaus_2_CA DINH_FId.DFC_IVGdiCtl_CvoSigPlaus_3_CA DINH_FId.DFC_IntkAirTAirFltDsCrssMax_CA DINH_FId.DFC_IntkAirTAirFltDsCrssMin_CA DINH_FId.DFC_IntkAirTAirFltDsHSCMax_CA DINH_FId.DFC_IntkAirTAirFltDsImps_CA DINH_FId.DFC_IntkAirTAirFltDsPRCMax_CA DINH_FId.DFC_IntkAirTAirFltDsPRCMin_CA DINH_FId.DFC_IntkAirTAirFltDsSRCMax_CA DINH_FId.DFC_IntkAirTAirFltDsSRCMin_CA DINH_FId.DFC_IntkAirTAirFltDsSTC_CA DINH_FId.DFC_IntkAirTIntkMnfldCrssMax_CA DINH_FId.DFC_IntkAirTIntkMnfldCrssMin_CA DINH_FId.DFC_IntkAirTIntkMnfldHSCMax_CA DINH_FId.DFC_IntkAirTIntkMnfldImps_CA DINH_FId.DFC_IntkAirTIntkMnfldPRCMax_CA DINH_FId.DFC_IntkAirTIntkMnfldPRCMin_CA DINH_FId.DFC_IntkAirTIntkMnfldSRCMax_CA DINH_FId.DFC_IntkAirTIntkMnfldSRCMin_CA DINH_FId.DFC_IntkAirTIntkMnfldSTC_CA DINH_FId.DFC_KRREGRLMX_CA DINH_FId.DFC_KRVEKOCVLCI_CA DINH_FId.DFC_KRVEKOENCHMT_CA DINH_FId.DFC_KRVEKOENCHMT0_CA DINH_FId.DFC_KRVEKOENCHMT1_CA DINH_FId.DFC_KRVEKOENCHMT2_CA DINH_FId.DFC_KRVEKOENCHMT3_CA DINH_FId.DFC_KRVEKOENCHMT4_CA DINH_FId.DFC_KRVEKOENCHMT5_CA DINH_FId.DFC_KRVEKOENCHMT6_CA DINH_FId.DFC_KRVEKOENCHMT7_CA DINH_FId.DFC_KRVEKORLMX_CA DINH_FId.DFC_KRVEKORLMXL_CA DINH_FId.DFC_KS1max_CA DINH_FId.DFC_KS1min_CA DINH_FId.DFC_LMmax_CA DINH_FId.DFC_LZSRnpl_CA DINH_FId.DFC_LamDynDiagS1B1_CA DINH_FId.DFC_LeakIntkMnfldEmiInfl_CA DINH_FId.DFC_LinFrameErrDCDC_CA DINH_FId.DFC_LinOverrunErrDCDC_CA DINH_FId.DFC_MD00max_CA DINH_FId.DFC_MDBmax_CA DINH_FId.DFC_MDCat_CA DINH_FId.DFC_MDCatCrit_CA DINH_FId.DFC_MDCatCurr_CA DINH_FId.DFC_MDCyl_0_CA DINH_FId.DFC_MDCyl_1_CA DINH_FId.DFC_MDCyl_2_CA DINH_FId.DFC_MDCyl_3_CA DINH_FId.DFC_MDEmi_CA DINH_FId.DFC_MDEmiStrt_CA DINH_FId.DFC_MDFco_CA DINH_FId.DFC_MDMpl_CA DINH_FId.DFC_MDSegTiAdpn_CA DINH_FId.DFC_MDmax_CA DINH_FId.DFC_MFuOilMax_CA DINH_FId.DFC_MOXEMM_SMU_ALM0_0_CA DINH_FId.DFC_MOXEMM_SMU_ALM0_1_CA DINH_FId.DFC_MOXEMM_SMU_ALM0_10_CA DINH_FId.DFC_MOXEMM_SMU_ALM0_11_CA DINH_FId.DFC_MOXEMM_SMU_ALM0_13_CA DINH_FId.DFC_MOXEMM_SMU_ALM0_14_CA DINH_FId.DFC_MOXEMM_SMU_ALM0_2_CA DINH_FId.DFC_MOXEMM_SMU_ALM0_22_CA DINH_FId.DFC_MOXEMM_SMU_ALM0_23_CA DINH_FId.DFC_MOXEMM_SMU_ALM0_4_CA DINH_FId.DFC_MOXEMM_SMU_ALM0_5_CA DINH_FId.DFC_MOXEMM_SMU_ALM0_7_CA DINH_FId.DFC_MOXEMM_SMU_ALM0_8_CA DINH_FId.DFC_MOXEMM_SMU_ALM10_16_CA DINH_FId.DFC_MOXEMM_SMU_ALM10_17_CA DINH_FId.DFC_MOXEMM_SMU_ALM10_21_CA DINH_FId.DFC_MOXEMM_SMU_ALM11_0_CA DINH_FId.DFC_MOXEMM_SMU_ALM11_1_CA DINH_FId.DFC_MOXEMM_SMU_ALM11_2_CA DINH_FId.DFC_MOXEMM_SMU_ALM11_3_CA DINH_FId.DFC_MOXEMM_SMU_ALM11_4_CA DINH_FId.DFC_MOXEMM_SMU_ALM11_5_CA DINH_FId.DFC_MOXEMM_SMU_ALM11_8_CA DINH_FId.DFC_MOXEMM_SMU_ALM11_9_CA DINH_FId.DFC_MOXEMM_SMU_ALM1_0_CA DINH_FId.DFC_MOXEMM_SMU_ALM1_1_CA DINH_FId.DFC_MOXEMM_SMU_ALM1_10_CA DINH_FId.DFC_MOXEMM_SMU_ALM1_11_CA DINH_FId.DFC_MOXEMM_SMU_ALM1_13_CA DINH_FId.DFC_MOXEMM_SMU_ALM1_14_CA DINH_FId.DFC_MOXEMM_SMU_ALM1_2_CA DINH_FId.DFC_MOXEMM_SMU_ALM1_22_CA DINH_FId.DFC_MOXEMM_SMU_ALM1_23_CA DINH_FId.DFC_MOXEMM_SMU_ALM1_4_CA DINH_FId.DFC_MOXEMM_SMU_ALM1_5_CA DINH_FId.DFC_MOXEMM_SMU_ALM1_7_CA DINH_FId.DFC_MOXEMM_SMU_ALM1_8_CA DINH_FId.DFC_MOXEMM_SMU_ALM21_0_CA DINH_FId.DFC_MOXEMM_SMU_ALM21_16_CA DINH_FId.DFC_MOXEMM_SMU_ALM21_3_CA DINH_FId.DFC_MOXEMM_SMU_ALM2_1_CA DINH_FId.DFC_MOXEMM_SMU_ALM2_10_CA DINH_FId.DFC_MOXEMM_SMU_ALM2_11_CA DINH_FId.DFC_MOXEMM_SMU_ALM2_13_CA DINH_FId.DFC_MOXEMM_SMU_ALM2_14_CA DINH_FId.DFC_MOXEMM_SMU_ALM2_22_CA DINH_FId.DFC_MOXEMM_SMU_ALM2_23_CA DINH_FId.DFC_MOXEMM_SMU_ALM2_4_CA DINH_FId.DFC_MOXEMM_SMU_ALM2_5_CA DINH_FId.DFC_MOXEMM_SMU_ALM2_7_CA DINH_FId.DFC_MOXEMM_SMU_ALM2_8_CA DINH_FId.DFC_MOXEMM_SMU_ALM6_0_CA DINH_FId.DFC_MOXEMM_SMU_ALM6_11_CA DINH_FId.DFC_MOXEMM_SMU_ALM6_12_CA DINH_FId.DFC_MOXEMM_SMU_ALM6_14_CA DINH_FId.DFC_MOXEMM_SMU_ALM6_15_CA DINH_FId.DFC_MOXEMM_SMU_ALM6_17_CA DINH_FId.DFC_MOXEMM_SMU_ALM6_18_CA DINH_FId.DFC_MOXEMM_SMU_ALM6_20_CA DINH_FId.DFC_MOXEMM_SMU_ALM6_21_CA DINH_FId.DFC_MOXEMM_SMU_ALM6_25_CA DINH_FId.DFC_MOXEMM_SMU_ALM6_4_CA DINH_FId.DFC_MOXEMM_SMU_ALM6_5_CA DINH_FId.DFC_MOXEMM_SMU_ALM6_7_CA DINH_FId.DFC_MOXEMM_SMU_ALM6_8_CA DINH_FId.DFC_MOXEMM_SMU_ALM7_1_CA DINH_FId.DFC_MOXEMM_SMU_ALM7_12_CA DINH_FId.DFC_MOXEMM_SMU_ALM7_13_CA DINH_FId.DFC_MOXEMM_SMU_ALM7_14_CA DINH_FId.DFC_MOXEMM_SMU_ALM7_15_CA DINH_FId.DFC_MOXEMM_SMU_ALM7_16_CA DINH_FId.DFC_MOXEMM_SMU_ALM7_17_CA DINH_FId.DFC_MOXEMM_SMU_ALM7_2_CA DINH_FId.DFC_MOXEMM_SMU_ALM7_20_CA DINH_FId.DFC_MOXEMM_SMU_ALM7_25_CA DINH_FId.DFC_MOXEMM_SMU_ALM7_26_CA DINH_FId.DFC_MOXEMM_SMU_ALM7_28_CA DINH_FId.DFC_MOXEMM_SMU_ALM7_29_CA DINH_FId.DFC_MOXEMM_SMU_ALM7_30_CA DINH_FId.DFC_MOXEMM_SMU_ALM7_31_CA DINH_FId.DFC_MOXEMM_SMU_ALM8_0_CA DINH_FId.DFC_MOXEMM_SMU_ALM8_1_CA DINH_FId.DFC_MOXEMM_SMU_ALM8_10_CA DINH_FId.DFC_MOXEMM_SMU_ALM8_11_CA DINH_FId.DFC_MOXEMM_SMU_ALM8_12_CA DINH_FId.DFC_MOXEMM_SMU_ALM8_16_CA DINH_FId.DFC_MOXEMM_SMU_ALM8_18_CA DINH_FId.DFC_MOXEMM_SMU_ALM8_2_CA DINH_FId.DFC_MOXEMM_SMU_ALM8_3_CA DINH_FId.DFC_MOXEMM_SMU_ALM8_31_CA DINH_FId.DFC_MOXEMM_SMU_ALM8_4_CA DINH_FId.DFC_MOXEMM_SMU_ALM9_0_CA DINH_FId.DFC_MOXEMM_SMU_ALM9_15_CA DINH_FId.DFC_MOXEMM_SMU_ALM9_3_CA DINH_FId.DFC_MoCADCNTP_CA DINH_FId.DFC_MoCADCTst_CA DINH_FId.DFC_MoCSOPICO_CA DINH_FId.DFC_MoFAPP_CA DINH_FId.DFC_MoFAirFilgPrdc_CA DINH_FId.DFC_MoFAirFlCtOffGdi_CA DINH_FId.DFC_MoFAirFlCylGdi_CA DINH_FId.DFC_MoFAirFlFF_CA DINH_FId.DFC_MoFAirFlIn_CA DINH_FId.DFC_MoFAirFlMixCtlGdiChkAirFl_CA DINH_FId.DFC_MoFAirFlMixCtlGdiChkCtrl_CA DINH_FId.DFC_MoFAirFlMode_CA DINH_FId.DFC_MoFESpd_CA DINH_FId.DFC_MoFIACo_CA DINH_FId.DFC_MoFICOL1_CA DINH_FId.DFC_MoFICOL2_CA DINH_FId.DFC_MoFStrt_CA DINH_FId.DFC_MoFTrqCmp_CA DINH_FId.DFC_MoFTrqCmpMax_CA DINH_FId.DFC_MoFTrqCmpMin_CA DINH_FId.DFC_MoFVarPostBldSel_CA DINH_FId.DFC_MoXEMMHwLTMCUFW_CA DINH_FId.DFC_MoXEMMHwLTMonBIST_CA DINH_FId.DFC_MoXEMMHwLTRegMonTest_CA DINH_FId.DFC_MoXEMMHwLTStbySMUAlvTest_CA DINH_FId.DFC_MoXEMMHwLTTempSens_CA DINH_FId.DFC_MoXEMMHwLTUCBCfg_CA DINH_FId.DFC_NWSEmax_CA DINH_FId.DFC_NWSmax_CA DINH_FId.DFC_OCWDAABEActv_CA DINH_FId.DFC_OCWDACom_CA DINH_FId.DFC_OCWDAErrPin_CA DINH_FId.DFC_OCWDAOvrVltg_CA DINH_FId.DFC_ORAmax_CA DINH_FId.DFC_ORAmin_CA DINH_FId.DFC_OilPPlaus_CA DINH_FId.DFC_PLLSUmax_CA DINH_FId.DFC_PLLSUmin_CA DINH_FId.DFC_PSR1max_CA DINH_FId.DFC_PSRBmax_CA DINH_FId.DFC_PSRBmin_CA DINH_FId.DFC_PSRPmax_CA DINH_FId.DFC_PSRPmin_CA DINH_FId.DFC_PSRPsig_CA DINH_FId.DFC_PSRmax_CA DINH_FId.DFC_PUmax_CA DINH_FId.DFC_P_VSE11_OL_CA DINH_FId.DFC_P_VSE11_SCB_CA DINH_FId.DFC_P_VSE11_SCG_CA DINH_FId.DFC_PhyHighAPP1_CA DINH_FId.DFC_PhyHighAPP2_CA DINH_FId.DFC_PhyLowAPP1_CA DINH_FId.DFC_PhyLowAPP2_CA DINH_FId.DFC_SRCHighAPP1_CA DINH_FId.DFC_SRCHighAPP2_CA DINH_FId.DFC_SRCLowAPP1_CA DINH_FId.DFC_SRCLowAPP2_CA DINH_FId.DFC_SSpMon2_CA DINH_FId.DFC_STHDRmax_CA DINH_FId.DFC_SWReset_0_CA DINH_FId.DFC_SWReset_1_CA DINH_FId.DFC_SWReset_2_CA DINH_FId.DFC_SyncAPP_CA DINH_FId.DFC_TANKLnpl_CA DINH_FId.DFC_TAmax_Dummy_CA DINH_FId.DFC_TESFmax_CA DINH_FId.DFC_TESGmax_CA DINH_FId.DFC_TKAEmax_CA DINH_FId.DFC_TKAEmin_CA DINH_FId.DFC_TKARmax_CA DINH_FId.DFC_TKARnpl_CA DINH_FId.DFC_TMmax_Dummy_CA DINH_FId.DFC_TUMmax_Dummy_CA DINH_FId.DFC_TWCDPriCatB1_CA DINH_FId.DFC_ThrVlvClsdPosnFirstOffsLrnImpoB1_CA DINH_FId.DFC_ThrVlvClsdPosnOffsLrnImpoB1_CA DINH_FId.DFC_ThrVlvClsdPosnOffsLrnMaxB1_CA DINH_FId.DFC_ThrVlvClsdPosnOffsLrnMinB1_CA DINH_FId.DFC_ThrVlvCtrlDeB1_CA DINH_FId.DFC_ThrVlvDycB1_CA DINH_FId.DFC_ThrVlvLimpAirPosnMaxAbsltDriftB1_CA DINH_FId.DFC_ThrVlvLimpAirPosnMaxB1_CA DINH_FId.DFC_ThrVlvLimpAirPosnMaxRelDriftB1_CA DINH_FId.DFC_ThrVlvLimpAirPosnMinB1_CA DINH_FId.DFC_ThrVlvOpenLoadB1_CA DINH_FId.DFC_ThrVlvOpenSprgB1_CA DINH_FId.DFC_ThrVlvOpenSprgSprdB1_CA DINH_FId.DFC_ThrVlvOpenSprgTwnB1_CA DINH_FId.DFC_ThrVlvOverTB1_CA DINH_FId.DFC_ThrVlvRetSprgB1_CA DINH_FId.DFC_ThrVlvRetSprgSprdB1_CA DINH_FId.DFC_ThrVlvRetSprgTwnB1_CA DINH_FId.DFC_ThrVlvSens1MaxB1_CA DINH_FId.DFC_ThrVlvSens1NplB1_CA DINH_FId.DFC_ThrVlvSens2MaxB1_CA DINH_FId.DFC_ThrVlvSens2MinB1_CA DINH_FId.DFC_ThrVlvSens2NplB1_CA DINH_FId.DFC_ThrVlvShoCircB1_CA DINH_FId.DFC_ThrVlvSpiErrB1_CA DINH_FId.DFC_ThrvlvSens1MinB1_CA DINH_FId.DFC_TiOffTBasdChkFast_CA DINH_FId.DFC_TiOffTBasdChkSlow_CA DINH_FId.DFC_UEGOSnsrMntdS1B1_CA DINH_FId.DFC_VehVSig_CA DINH_FId.DFC_VlvLftFbSwtIntk11SpclFail_CA DINH_FId.DFC_VlvLftFbSwtIntk11StdFail_CA DINH_FId.DSQ_ACClntP_CA DINH_FId.DSQ_ACEvpT_CA DINH_FId.DSQ_AirCCmprActr_CA DINH_FId.DSQ_BattU_CA DINH_FId.DSQ_BattULo_CA DINH_FId.DSQ_BrkBstPMdl_CA DINH_FId.DSQ_BrkP_CA DINH_FId.DSQ_BrkPSnsr_CA DINH_FId.DSQ_CoVMDIDASFail_CA DINH_FId.DSQ_DSMInhibitAlways_CA DINH_FId.DSQ_EGRVlv_GovDesVal_CA DINH_FId.DSQ_ElecLd_CA DINH_FId.DSQ_EngICO_CA DINH_FId.DSQ_EpmCaSSigQuality_CA DINH_FId.DSQ_EpmReverseRun_CA DINH_FId.DSQ_FanDIO_0_CA DINH_FId.DSQ_FanDIO_1_CA DINH_FId.DSQ_FuelP_CA DINH_FId.DSQ_FuelT_CA DINH_FId.DSQ_GEVCtlTOilCylHd_CA DINH_FId.DSQ_GEVlvAgIntkB1_CA DINH_FId.DSQ_GbxPNPos_CA DINH_FId.DSQ_GbxPosNotPN_CA DINH_FId.DSQ_InjVlv_DI_CylOk_CA DINH_FId.DSQ_MRly_CA DINH_FId.DSQ_OilP_CA DINH_FId.DSQ_PEnvMeasVld_CA DINH_FId.DSQ_PEnvVld_CA DINH_FId.DSQ_PEnv_pRaw_CA DINH_FId.DSQ_PRail_CA DINH_FId.DSQ_PThrVlvUs_CA DINH_FId.DSQ_PThrVlvUsB1_CA DINH_FId.DSQ_StrtImobChk_CA DINH_FId.DSQ_TDevCenColdStrt_CA DINH_FId.DSQ_VehV_CA DINH_FId.DSQ_VehVSens_CA DINH_FId.DSQ_VehVSnsr_CA DINH_FId.DSQ_stAPP_CA DINH_FId.DSQ_stComEAT4_CA DINH_Lim.DFC_AAVEmax_CA DINH_Lim.DFC_AAVEmin_CA DINH_Lim.DFC_AAVEsig_CA DINH_Lim.DFC_AltIOACGFailr_CA DINH_Lim.DFC_AltIOACGHiVltg_CA DINH_Lim.DFC_AltIOACGLoVltg_CA DINH_Lim.DFC_AltIOACGTHi_CA DINH_Lim.DFC_AltIODConnACG_CA DINH_Lim.DFC_BGOELWAF_CA DINH_Lim.DFC_BattUHiFailr_CA DINH_Lim.DFC_BattULoFailr_CA DINH_Lim.DFC_BrkBstPDriftHiErr_CA DINH_Lim.DFC_BrkBstPDriftLoErr_CA DINH_Lim.DFC_BrkBstPSnsrStuck_CA DINH_Lim.DFC_BrkMnSwtContOn_CA DINH_Lim.DFC_BrkMnSwtNotStp_CA DINH_Lim.DFC_BrkNpl_CA DINH_Lim.DFC_BrkRdntSwtContOn_CA DINH_Lim.DFC_BrkRdntSwtNotStp_CA DINH_Lim.DFC_Clth3ONStuck_CA DINH_Lim.DFC_Clth4OFFStuck_CA DINH_Lim.DFC_ClthOFFStuck_CA DINH_Lim.DFC_ClthONStuck_CA DINH_Lim.DFC_ClthStkFailInfo_CA DINH_Lim.DFC_ComACFailInfo_CA DINH_Lim.DFC_ComATFTValErr_CA DINH_Lim.DFC_ComATMILReq_CA DINH_Lim.DFC_ComAYCAChksum_CA DINH_Lim.DFC_ComAYCARingCnt_CA DINH_Lim.DFC_ComAYCATOut_CA DINH_Lim.DFC_ComAYCDChkSum_CA DINH_Lim.DFC_ComAYCDTOut_CA DINH_Lim.DFC_ComAYCFChksum_CA DINH_Lim.DFC_ComAYCFRingCnt_CA DINH_Lim.DFC_ComAYCFTOut_CA DINH_Lim.DFC_ComAYCGChksum_CA DINH_Lim.DFC_ComAYCGRingCnt_CA DINH_Lim.DFC_ComAYCGTOut_CA DINH_Lim.DFC_ComAYCIChkSum_CA DINH_Lim.DFC_ComAYCIRingCnt_CA DINH_Lim.DFC_ComAYCITOut_CA DINH_Lim.DFC_ComBCM1ChkSum_CA DINH_Lim.DFC_ComBCM1RingCnt_CA DINH_Lim.DFC_ComBCM1TOut_CA DINH_Lim.DFC_ComCANABusOffErr_CA DINH_Lim.DFC_ComCANBBusOffErr_CA DINH_Lim.DFC_ComCANCBusOffErr_CA DINH_Lim.DFC_ComCGW1ChkSum_CA DINH_Lim.DFC_ComCGW1RingCnt_CA DINH_Lim.DFC_ComCGW1TOut_CA DINH_Lim.DFC_ComConvBoostErr_CA DINH_Lim.DFC_ComConvSlipErr_CA DINH_Lim.DFC_ComDCDCPrfmncErr_CA DINH_Lim.DFC_ComDCDCTempWarn_CA DINH_Lim.DFC_ComEAT10Chksum_CA DINH_Lim.DFC_ComEAT10RingCnt_CA DINH_Lim.DFC_ComEAT10TOut_CA DINH_Lim.DFC_ComEAT11ChkSum_CA DINH_Lim.DFC_ComEAT11RingCnt_CA DINH_Lim.DFC_ComEAT11TOut_CA DINH_Lim.DFC_ComEAT12ChkSum_CA DINH_Lim.DFC_ComEAT12RingCnt_CA DINH_Lim.DFC_ComEAT12TOut_CA DINH_Lim.DFC_ComEAT13ChkSum_CA DINH_Lim.DFC_ComEAT13RingCnt_CA DINH_Lim.DFC_ComEAT13TOut_CA DINH_Lim.DFC_ComEAT1Chksum_CA DINH_Lim.DFC_ComEAT1RingCnt_CA DINH_Lim.DFC_ComEAT1TOut_CA DINH_Lim.DFC_ComEAT2ChkSum_CA DINH_Lim.DFC_ComEAT2RingCnt_CA DINH_Lim.DFC_ComEAT2TOut_CA DINH_Lim.DFC_ComEAT4ChkSum_CA DINH_Lim.DFC_ComEAT4RingCnt_CA DINH_Lim.DFC_ComEAT4TOut_CA DINH_Lim.DFC_ComEAT6Chksum_CA DINH_Lim.DFC_ComEAT6RingCnt_CA DINH_Lim.DFC_ComEAT6TOut_CA DINH_Lim.DFC_ComEAT7Chksum_CA DINH_Lim.DFC_ComEAT7RingCnt_CA DINH_Lim.DFC_ComEAT7TOut_CA DINH_Lim.DFC_ComEAT8Chksum_CA DINH_Lim.DFC_ComEAT8RingCnt_CA DINH_Lim.DFC_ComEAT8TOut_CA DINH_Lim.DFC_ComEATAChksum_CA DINH_Lim.DFC_ComEATARingCnt_CA DINH_Lim.DFC_ComEATATOut_CA DINH_Lim.DFC_ComEATBChkSum_CA DINH_Lim.DFC_ComEATBRingCnt_CA DINH_Lim.DFC_ComEATBTOut_CA DINH_Lim.DFC_ComEATCChksum_CA DINH_Lim.DFC_ComEATCRingCnt_CA DINH_Lim.DFC_ComEATCTOut_CA DINH_Lim.DFC_ComEPBBChkSum_CA DINH_Lim.DFC_ComEPBBRingCnt_CA DINH_Lim.DFC_ComEPBBTOut_CA DINH_Lim.DFC_ComEPBChksum_CA DINH_Lim.DFC_ComEPBTOut_CA DINH_Lim.DFC_ComEPBctRing_CA DINH_Lim.DFC_ComEPS1Chksum_CA DINH_Lim.DFC_ComEPS1RingCnt_CA DINH_Lim.DFC_ComEPS1TOut_CA DINH_Lim.DFC_ComEngCanRxErr_CA DINH_Lim.DFC_ComGrvySnsrErr_CA DINH_Lim.DFC_ComGwIMG1ChkSum_CA DINH_Lim.DFC_ComGwIMG1RingCnt_CA DINH_Lim.DFC_ComGwIMG1TOut_CA DINH_Lim.DFC_ComGwIMG3ChkSum_CA DINH_Lim.DFC_ComGwIMG3RingCnt_CA DINH_Lim.DFC_ComGwIMG3TOut_CA DINH_Lim.DFC_ComGwIMG4ChkSum_CA DINH_Lim.DFC_ComGwIMG4RingCnt_CA DINH_Lim.DFC_ComGwIMG4TOut_CA DINH_Lim.DFC_ComGwIMG5ChkSum_CA DINH_Lim.DFC_ComGwIMG5RingCnt_CA DINH_Lim.DFC_ComGwIMG5TOut_CA DINH_Lim.DFC_ComGwIMG6ChkSum_CA DINH_Lim.DFC_ComGwIMG6RingCnt_CA DINH_Lim.DFC_ComGwIMG6TOut_CA DINH_Lim.DFC_ComIDASBChksum_CA DINH_Lim.DFC_ComIDASBRingCnt_CA DINH_Lim.DFC_ComIDASBTOut_CA DINH_Lim.DFC_ComIMGMILReq_CA DINH_Lim.DFC_ComISSPrms_CA DINH_Lim.DFC_ComMETAChksum_CA DINH_Lim.DFC_ComMETAChksumPstDrv_CA DINH_Lim.DFC_ComMETARingCnt_CA DINH_Lim.DFC_ComMETARingCntPstDrv_CA DINH_Lim.DFC_ComMETATOut_CA /end DEF_CHARACTERISTIC
 FUNCTION_VERSION "30000.27.0_1.0.0" /end FUNCTION
/begin COMPU_METHOD DINH_FIdVerb "" TAB_VERB "%6.3" "-" COMPU_TAB_REF DINH_FIdVerb /end COMPU_METHOD
/begin COMPU_VTAB DINH_FIdVerb "" TAB_VERB 969 0 "FId_Unused" 1 "FID_AFRA" 2 "FID_AORA" 3 "FID_ATEH" 4 "FID_ATEL" 5 "FID_ATEN" 6 "FID_ATLDI" 7 "FID_ATLDO" 8 "FID_BEONV" 9 "FId_EGSDCmnSeg1B1Parl" 10 "FID_BAGRA" 11 "FID_BAGRASD" 12 "FID_BDSTOF" 13 "FID_BFVDFRM" 14 "FID_BHOM" 15 "FID_BLLRH" 16 "FID_BLLRKH" 17 "FID_BPLSU" 18 "FID_FRAMBAVMB" 19 "FId_CatHeatgColdStrtReq" 20 "FId_CatHeatgWrmReq" 21 "FId_DSMBDEPHSpOpMode" 22 "FId_EGRVlvCoord" 23 "FId_EGSDO2FuTrmB1" 24 "FId_EGSDO2SnsrMntdRelsS1B1" 25 "FId_EGSDO2_LamOffsFastS1B1" 26 "FId_MisfDetDnAdpnNv" 27 "FId_bascadpncvo" 28 "FID_AGRS" 29 "FID_BBAGR" 30 "FID_BBAGRA" 31 "FID_BGFKMS" 32 "FID_BGMSDKS" 33 "FID_CAGRSUS" 34 "FID_CBGTFUELM" 35 "FID_CBGTHDEV" 36 "FID_CDESVF" 37 "FID_CDETHS" 38 "FID_CDRCTSTRT" 39 "FID_CDSKV" 40 "FID_CDSKVRNO" 41 "FID_CDSKVRPO" 42 "FID_CDSKVRaty" 43 "FID_CDSKVRng" 44 "FID_CDSKVS" 45 "FID_CDSTR" 46 "FID_CDSTTI" 47 "FID_CETHG" 48 "FID_CETHSPLnpl" 49 "FID_CETHSTPLnpl" 50 "FID_CETKHL" 51 "FID_CETKHT" 52 "FID_CGDISTRT" 53 "FID_CGLSRDP" 54 "FID_CHDR" 55 "FID_CHDRKH" 56 "FID_CHDRPL" 57 "FID_CLLKHV" 58 "FID_CLLRHV" 59 "FID_CLZSRDP" 60 "FID_CLZSRHP" 61 "FID_CNLHP" 62 "FID_CNLHP2" 63 "FID_CNLKO2" 64 "FID_CNLKO3" 65 "FID_CNLLP" 66 "FID_CNLPL" 67 "FID_CNLPS" 68 "FID_CNSAD" 69 "FID_CNSAD2" 70 "FID_CPSRB" 71 "FID_CPSRP" 72 "FID_CSTHDR" 73 "FID_CSTRTCTL" 74 "FID_CTESF" 75 "FID_CTESG" 76 "FID_CTHIPSTRT" 77 "FID_CTKACS" 78 "FID_CTMSV" 79 "FID_CTOSP" 80 "FID_DHFERR" 81 "FID_DKRSA" 82 "FID_DLLRBandEndTst" 83 "FID_DLLRShrtTrpSpdRmp" 84 "FID_FEDKAHB" 85 "FID_FEDKAPB" 86 "FID_FEDSSB" 87 "FID_FOFSTP" 88 "FID_FONSTP" 89 "FID_FUEDK" 90 "FID_FVLRA" 91 "FID_KRREGact" 92 "FID_KRREGloc" 93 "FID_LRADLSU" 94 "FID_LRALSVErr" 95 "FID_LRAPLLSU" 96 "FID_LUSTP" 97 "FID_LnKS1" 98 "FID_PLSUV" 99 "FID_PSRMOZDG" 100 "FID_PSRMOZG" 101 "FID_STRTDIA" 102 "FID_STRTSTM" 103 "FID_TFA1CSMW" 104 "FID_TFA2CSMW" 105 "FID_TKACSMW" 106 "FID_TMCSMW" 107 "FID_TOCHOilSwmpTQly" 108 "FID_TOCHTME" 109 "FID_TOSPCSMW" 110 "FID_TSRLX" 111 "FID_UEGOHeatrRlyS1B1" 112 "FID_VehStvSSEOk" 113 "FID_VldtLamPlausMaxS1B1" 114 "FID_VldtLamPlausMinS1B1" 115 "FId_ACClntPSSPMon" 116 "FId_ACCompComCANBusOff" 117 "FId_ACCompComCANErrMtr" 118 "FId_ACComp_HiUTWSnsrErr" 119 "FId_ACComp_LoUTWSnsrErr" 120 "FId_ACComp_PDSnsrErr" 121 "FId_ACComp_VehSpdSnsrErr" 122 "FId_ACCtl_ACStrtCut" 123 "FId_ACCtl_APP1" 124 "FId_ACCtl_APP2" 125 "FId_ACCtl_APPSync" 126 "FId_ACCtl_AcOff" 127 "FId_ACCtl_Clmb" 128 "FId_ACCtl_DK1" 129 "FId_ACCtl_DK2" 130 "FId_ACCtl_DKSync" 131 "FId_ACCtl_VehSpdSnsrErr" 132 "FId_ACCtl_pAC" 133 "FId_ACEvpTCANErr" 134 "FId_ACEvpTFrzVal" 135 "FId_ACEvpTPhysRng" 136 "FId_ACEvpTRplVal" 137 "FId_AFCLFailr" 138 "FId_AFS" 139 "FId_AFSPhyRng" 140 "FId_APP1SigPath" 141 "FId_APP2SigPath" 142 "FId_APPBrkErr" 143 "FId_APPLETVldnErr" 144 "FId_APPLrn" 145 "FId_APPVehVErr" 146 "FId_AccPedDrvModComErr" 147 "FId_AccPedDrvModFailr" 148 "FId_AccPedNMaxLim" 149 "FId_AccPedNMinLim" 150 "FId_AccPedNMinLimBrkApp" 151 "FId_AccPedTrqLim" 152 "FId_AfsDdDiag" 153 "FId_AfsDiagErr" 154 "FId_AfsDiagTst" 155 "FId_AfsPlausDiag" 156 "FId_AfsVrntDiag" 157 "FId_AirCClntPFrzVal" 158 "FId_AirCClntPRplVal" 159 "FId_AirCSwt" 160 "FId_AirDvPAdpnPEnv" 161 "FId_AirDvPAdpnPIntkVUsB1" 162 "FId_AirDvPPSnsrAdpn_PModeActv" 163 "FId_AltACGFailr" 164 "FId_AltAPPErrSt" 165 "FId_AltBattMngtFailr" 166 "FId_AltBrkErrSt" 167 "FId_AltComErr" 168 "FId_AltENGB" 169 "FId_AltElecLoadErr" 170 "FId_AltEnvTErr" 171 "FId_AltFFAltLoadFast" 172 "FId_AltFFAltLoadSlow" 173 "FId_AltIOACGErr" 174 "FId_AltIOACGLinComFailr" 175 "FId_AltIOComErr" 176 "FId_AltLinErr" 177 "FId_AltPwr" 178 "FId_AltVehVErrSt" 179 "FId_AltvCluFail" 180 "FId_BGAGRTS" 181 "FId_BGFKMSEPSR" 182 "FId_BGFKMSEPU" 183 "FId_BGFKMSESumClr" 184 "FId_BGFKMSHFME" 185 "FId_BGFKMSHFMZ" 186 "FId_BGFKMSZPSR" 187 "FId_BGOSCCat1B1" 188 "FId_BGOSCCat2B1" 189 "FId_BattAltFailr" 190 "FId_BattMngtFailr" 191 "FId_BattSigPtd" 192 "FId_BattU2MEDSRC" 193 "FId_BattUDrpPrvOff" 194 "FId_BattUFrzVal" 195 "FId_BattUHiFailrEna" 196 "FId_BattUIMGTCUCANFailr" 197 "FId_BattULoFailrEna" 198 "FId_BattUReplVal" 199 "FId_BattUSRC" 200 "FId_BlwrComErr" 201 "FId_BrkBstMdl" 202 "FId_BrkBstMdlBrkP" 203 "FId_BrkBstMdlBrkSt" 204 "FId_BrkBstMdlEnvP" 205 "FId_BrkBstPDetnInhbn" 206 "FId_BrkBstPMstCylPSnsrFail" 207 "FId_BrkBstPSnsrStuckDetn" 208 "FId_BrkBstSigPath" 209 "FId_BrkBstVehVv" 210 "FId_BrkMnSwtErr" 211 "FId_BrkPFrzVal" 212 "FId_BrkPOilPres" 213 "FId_BrkPReplVal" 214 "FId_BrkPedEngStopEna" 215 "FId_BrkRdntSwtErr" 216 "FId_CAGRSDS" 217 "FId_CEngDsTColdStrt" 218 "FId_CEngDsTColdStrtErr" 219 "FId_CEngDsTHSC" 220 "FId_CEngDsTLSC" 221 "FId_CEngDsTPlausErr" 222 "FId_CEngDsTReplMdlEngStop" 223 "FId_CEngDsTSTC" 224 "FId_CEngDsTSnsrElec" 225 "FId_CEngDsTSwtReplMdl" 226 "FId_CEngUsTColdChkErr" 227 "FId_CEngUsTCrssChk" 228 "FId_CEngUsTElecErr" 229 "FId_CEngUsTSnsrElecErr" 230 "FId_CEngUsTSwtReplMdl" 231 "FId_CInjCatHeatgDiag" 232 "FId_CMSUDKSOM1" 233 "FId_CMSUDKSOM2" 234 "FId_CatHeatgEomShtrpAct" 235 "FId_ChrctlAgrsErr" 236 "FId_ChrctlAgrscf" 237 "FId_ClntTempENGB" 238 "FId_Clth" 239 "FId_Clth2" 240 "FId_Clth3StuckOn" 241 "FId_Clth4" 242 "FId_ClthCAN" 243 "FId_ClthMax" 244 "FId_ClthStk" 245 "FId_ClthStkErr" 246 "FId_ClthStkFailr" 247 "FId_ClthStkOFFStuck" 248 "FId_ClthStkONStuck" 249 "FId_ClthSwtFailr" 250 "FId_CntrShaftFailr" 251 "FId_CoEOMGdiEomErrLcy" 252 "FId_CoESSBlowrVld" 253 "FId_CoETM" 254 "FId_CoETS_StTrqLimErr1" 255 "FId_CoETS_StTrqLimErr2" 256 "FId_CoEngStopEnblStSpEngT" 257 "FId_CoEngStopEnblStSpLSU" 258 "FId_CoEngStopEnblStSpTcT" 259 "FId_CoEngStopEnblSysErr" 260 "FId_CoEngVlvLftSpIntk" 261 "FId_CoPOMStrtgDevStrtr" 262 "FId_CoPOM_FirstStrtAut" 263 "FId_CoTS_SwtOff" 264 "FId_CoVOMACCComFailr" 265 "FId_CoVOMBrkPedISABSigFailr" 266 "FId_CoVOMEngCrkAbort" 267 "FId_CoVOMEngRstrtEnaCdn" 268 "FId_CoVOMISSEng" 269 "FId_ComACRly" 270 "FId_ComAPPSensFail" 271 "FId_ComAPedl" 272 "FId_ComAYCA" 273 "FId_ComAYCAMon" 274 "FId_ComAYCD" 275 "FId_ComAYCDMon" 276 "FId_ComAYCF" 277 "FId_ComAYCFMon" 278 "FId_ComAYCG" 279 "FId_ComAYCGMon" 280 "FId_ComAYCI" 281 "FId_ComAYCIMon" 282 "FId_ComAirPThrUsSnsrErr" 283 "FId_ComAltFail" 284 "FId_ComAppVehSnsrFailr" 285 "FId_ComBCM1" 286 "FId_ComBCM1Mon" 287 "FId_ComBCMUnitCfmdErr" 288 "FId_ComBCMUnitNotTstd" 289 "FId_ComBstCtrl" 290 "FId_ComCANVEHICLEBusOff" 291 "FId_ComCGW1" 292 "FId_ComCGW1Mon" 293 "FId_ComClthSt" 294 "FId_ComConvClth" 295 "FId_ComCrCtlReq" 296 "FId_ComCrsMaiIndcnLampReq" 297 "FId_ComCrsSetIndcnLampReq" 298 "FId_ComDCDCCdn" 299 "FId_ComDCDCErr" 300 "FId_ComDesGearCurr" 301 "FId_ComDetrmAirM" 302 "FId_ComDwnShiftCtrlReq" 303 "FId_ComEAT1" 304 "FId_ComEAT10" 305 "FId_ComEAT10Mon" 306 "FId_ComEAT11" 307 "FId_ComEAT11Mon" 308 "FId_ComEAT12" 309 "FId_ComEAT12Mon" 310 "FId_ComEAT13" 311 "FId_ComEAT13Mon" 312 "FId_ComEAT1Mon" 313 "FId_ComEAT2" 314 "FId_ComEAT2Mon" 315 "FId_ComEAT4" 316 "FId_ComEAT4Mon" 317 "FId_ComEAT6" 318 "FId_ComEAT6Mon" 319 "FId_ComEAT7" 320 "FId_ComEAT7Mon" 321 "FId_ComEAT8" 322 "FId_ComEAT8Mon" 323 "FId_ComEATA" 324 "FId_ComEATAMon" 325 "FId_ComEATB" 326 "FId_ComEATBMon" 327 "FId_ComEATC" 328 "FId_ComEATCMon" 329 "FId_ComEBSSelfDiagErr" 330 "FId_ComECUHwErr" 331 "FId_ComEGRVlvErr" 332 "FId_ComEMSIntAirTemp" 333 "FId_ComEPB" 334 "FId_ComEPBB" 335 "FId_ComEPBBMon" 336 "FId_ComEPBMon" 337 "FId_ComEPS1" 338 "FId_ComEPS1Mon" 339 "FId_ComEPSUnitCfmdErr" 340 "FId_ComEPSUnitNotTstd" 341 "FId_ComEngBrkOvrdInfo" 342 "FId_ComEngBrkOvrdMtr" 343 "FId_ComEngBrkSwErr" 344 "FId_ComEngPosng" 345 "FId_ComEngRPMLim" 346 "FId_ComEngTrqLim" 347 "FId_ComEnvtlAirPSnsrErr" 348 "FId_ComEstmTqNormJdg" 349 "FId_ComEthnlSErr" 350 "FId_ComFlSply" 351 "FId_ComFuCnsBitDurgIdleStop" 352 "FId_ComGEVCntrl" 353 "FId_ComGbxNPosFail" 354 "FId_ComGbxTemp" 355 "FId_ComGwIMG1" 356 "FId_ComGwIMG1Mon" 357 "FId_ComGwIMG3" 358 "FId_ComGwIMG3Mon" 359 "FId_ComGwIMG4" 360 "FId_ComGwIMG4Mon" 361 "FId_ComGwIMG5" 362 "FId_ComGwIMG5Mon" 363 "FId_ComGwIMG6" 364 "FId_ComGwIMG6Mon" 365 "FId_ComHFMSnsrErr" 366 "FId_ComIDASB" 367 "FId_ComIDASBMon" 368 "FId_ComIDASBUnitCfmdErr" 369 "FId_ComIDASBUnitNotTstd" 370 "FId_ComIDASEngFail" 371 "FId_ComIDASEngFailMil" 372 "FId_ComIMGUnitCfmdErr" 373 "FId_ComIMGUnitNotTstd" 374 "FId_ComISG2" 375 "FId_ComIgnCtrl" 376 "FId_ComInjCtrl" 377 "FId_ComIntkAirPSnsrErr" 378 "FId_ComLamCtrl" 379 "FId_ComMETA" 380 "FId_ComMETAMon" 381 "FId_ComMETC" 382 "FId_ComMETCMon" 383 "FId_ComMETD" 384 "FId_ComMETDMon" 385 "FId_ComMETE2" 386 "FId_ComMETE2Mon" 387 "FId_ComMETF" 388 "FId_ComMETFMon" 389 "FId_ComMETG" 390 "FId_ComMETGMon" 391 "FId_ComMETH" 392 "FId_ComMETH2" 393 "FId_ComMETH2Mon" 394 "FId_ComMETHMon" 395 "FId_ComMETI" 396 "FId_ComMETIMon" 397 "FId_ComMETK" 398 "FId_ComMETKMon" 399 "FId_ComMETL" 400 "FId_ComMETLMon" 401 "FId_ComMETM" 402 "FId_ComMETMMon" 403 "FId_ComMETN" 404 "FId_ComMETNMon" 405 "FId_ComMETUnitCfmdErr" 406 "FId_ComMETUnitNotTstd" 407 "FId_ComMisf" 408 "FId_ComMon" 409 "FId_ComNTrbn" 410 "FId_ComODOff" 411 "FId_ComOilLvlLamp" 412 "FId_ComOilPWarnLamp" 413 "FId_ComPASensFail" 414 "FId_ComPBSensFail" 415 "FId_ComPCU" 416 "FId_ComPCUMon" 417 "FId_ComPosActnSpdLimrFctReq" 418 "FId_ComSRS" 419 "FId_ComSRSA" 420 "FId_ComSRSAMon" 421 "FId_ComSRSB" 422 "FId_ComSRSBMon" 423 "FId_ComSRSMon" 424 "FId_ComSRSUnitCfmdErr" 425 "FId_ComSRSUnitNotTstd" 426 "FId_ComSTFlt" 427 "FId_ComSpdLimrDevActvn" 428 "FId_ComTCU01" 429 "FId_ComTCU02" 430 "FId_ComTCU1" 431 "FId_ComTCU11" 432 "FId_ComTCU12" 433 "FId_ComTCU13" 434 "FId_ComTCU14" 435 "FId_ComTCU2" 436 "FId_ComTCU3" 437 "FId_ComTCU4" 438 "FId_ComTCUGear" 439 "FId_ComTarGearDwnShift" 440 "FId_ComTarGearUpShift" 441 "FId_ComThrPosnFail" 442 "FId_ComThrVlv" 443 "FId_ComTrboChrgnErr" 444 "FId_ComTrqAccuracySlow" 445 "FId_ComTrqReqFast" 446 "FId_ComTrqReqSlow" 447 "FId_ComVSAErr" 448 "FId_ComVSAUnitCfmdErr" 449 "FId_ComVSAUnitNotTstd" 450 "FId_ComVehSpdFlLvl" 451 "FId_ComVehSpdFltChk" 452 "FId_ComVehSpdImpsErr" 453 "FId_ComVlvLftCtrl" 454 "FId_ComvolEng" 455 "FId_ConvLdCalcLvrPos" 456 "FId_ConvLdNTrbnCan" 457 "FId_ConvLdOilCoolrPmp" 458 "FId_ConvLdOilTemp" 459 "FId_ConvLdTrqLdCan" 460 "FId_ConvLdVel" 461 "FId_CooltTVldyTMdl" 462 "FId_CptProtnCamsft" 463 "FId_CptProtnExhTempMdl" 464 "FId_CptProtnO2SnsrB1" 465 "FId_CptProtnVVeh" 466 "FId_CrCUI1EFRxErr" 467 "FId_CrCUICANRxErr" 468 "FId_CrCUIFCMRxErr" 469 "FId_CrCUIMETDRxErr" 470 "FId_CrCtlACCRxErr" 471 "FId_CrCtlAppSnsrErr" 472 "FId_CrCtlShutOffEng" 473 "FId_CstrPurgGnrlTstrReq" 474 "FId_DAGRS" 475 "FId_DELibBrkBstP" 476 "FId_DELibCEngDsT" 477 "FId_DELibCEngUsT" 478 "FId_DELibEngDatEng" 479 "FId_DELibEnvP" 480 "FId_DELibEnvT" 481 "FId_DELibFuelT" 482 "FId_DELibIntkAirT" 483 "FId_DELibNRCat" 484 "FId_DELibOilP" 485 "FId_DELibOilSwmpT" 486 "FId_DELibPRelPfilDs" 487 "FId_DELibTEGRClrLPDs" 488 "FId_DEONVEBPEnv" 489 "FId_DEONVTCCpv1DteskLoLoadStuckClsd" 490 "FId_DEONVTCCpv1DteskLoLoadStuckOpen" 491 "FId_DIUMPRCldStrtMon" 492 "FId_DIUMPREvapMon" 493 "FId_DIUMPRGenDenom1" 494 "FId_DIUMPRGenDenom1PDTC" 495 "FId_DIUMPRGenDenom2" 496 "FId_DIUMPRGenDenom3" 497 "FId_DIUMPRIgn" 498 "FId_DOGov" 499 "FId_DSMWarmUpCycle" 500 "FId_DTESKEBCpv1DteskLoLoadStuckClsd" 501 "FId_DTESKEBCpv1DteskLoLoadStuckOpen" 502 "FId_DTESKEnvCondVld" 503 "FId_DTESKFuLvlCondVld" 504 "FId_DTESKvfz" 505 "FId_DdskvFraTstd" 506 "FId_DdskvOraTstd" 507 "FId_DewDetTKAMax" 508 "FId_DiagBlkdLine" 509 "FId_DiagCpv1DteskLoLoad" 510 "FId_DkrsaEpmNoSig" 511 "FId_EBBCANErrFrzVal" 512 "FId_EBBCANErrReplVal" 513 "FId_EGLZSR" 514 "FId_EGRVlvActrOff" 515 "FId_EGRVlvCldStrt" 516 "FId_EGRVlvClnVrfy" 517 "FId_EGRVlvCtrlErr" 518 "FId_EGRVlvEngTempDef" 519 "FId_EGRVlvFailSafeActv" 520 "FId_EGRVlvFrzVal" 521 "FId_EGRVlvGovOn" 522 "FId_EGRVlvGovOnCld" 523 "FId_EGRVlvGovrOnRelsFct" 524 "FId_EGRVlvILimn" 525 "FId_EGRVlvIni" 526 "FId_EGRVlvMon" 527 "FId_EGRVlvOfsLrnInhib" 528 "FId_EGRVlvPhysRng" 529 "FId_EGRVlvPsSwtOff" 530 "FId_EGRVlvPwrStgMonDis" 531 "FId_EGRVlvRplVal" 532 "FId_EGRVlvSSpMon" 533 "FId_EGRVlvSnsrErr" 534 "FId_EGRVlvTempCmp" 535 "FId_EGRVlvTempMdlEEPErr" 536 "FId_EGRVlvTmpErrCnt" 537 "FId_EGRVlvTrlPtr" 538 "FId_EGRVlv_VehvErr" 539 "FId_EGRVlviActIEfcLimn" 540 "FId_EGRVlvpDsbcInvld" 541 "FId_EGSDO2OffsRstDsmS1B1" 542 "FId_EGSDO2_LamOffsSlowS1" 543 "FId_EGSDO2_RstFltSuspcnOffsB1" 544 "FId_EGSDUS2B1DlyEvln" 545 "FId_EGSDUS2B1LtrDly" 546 "FId_EGSDUS2B1LtrPT1" 547 "FId_EGSDUS2B1PT1Evln" 548 "FId_EGSDUS2B1RtlDly" 549 "FId_EGSDUS2B1RtlPT1" 550 "FId_EGSDUS2B1TarEvln" 551 "FId_EGSDUS2B1TarLean" 552 "FId_EGSDUS2B1TarRich" 553 "FId_EGSSigO2S1B1" 554 "FId_ELZSR" 555 "FId_EPBErr" 556 "FId_EPBFrmErr" 557 "FId_EPBFrmErrClth" 558 "FId_ETHSCPErrDrvCyc" 559 "FId_EVPComFailr" 560 "FId_EbsLinErr" 561 "FId_ElecLdComErr" 562 "FId_ElecLdFrzVal" 563 "FId_ElecLdHdLiComErr" 564 "FId_ElecLdRplVal" 565 "FId_ElecLoadEPSComErr" 566 "FId_EngBlkTWrn" 567 "FId_EngCooltTFail" 568 "FId_EngDemTqLimnCamsftErr" 569 "FId_EngDemTqLimnErrThmstHeatCtrlCirc" 570 "FId_EngDemTqLimnOilPmp" 571 "FId_EngDemTrqLimErrAPP" 572 "FId_EngIntkAirFail" 573 "FId_EngPrtErrVehV" 574 "FId_EngSpd30DegFail" 575 "FId_EngStrtEnaEthAdap" 576 "FId_EngStrt_EnaCep" 577 "FId_EngStrt_InjProhb" 578 "FId_EngStrt_VehVInhb" 579 "FId_EngTqRvsnEnaFlg" 580 "FId_EnvTPrimMod" 581 "FId_EnvTPrimModIniVal" 582 "FId_EnvTSensSum" 583 "FId_EnvTtAirFltDs" 584 "FId_EnvTtCEngDsT" 585 "FId_EnvTtIntkMnfld" 586 "FId_EomCvoAllwd" 587 "FId_EpmBCr" 588 "FId_EpmCaSAdapCaSI1" 589 "FId_EpmCaSAdapRstI1" 590 "FId_EpmCaSDiagI1" 591 "FId_EpmCaSErrCaSI1" 592 "FId_EpmCaSOfsDiagCaSI1" 593 "FId_EpmCaSOfsErrCaSI1" 594 "FId_EpmCaSSegI1" 595 "FId_EpmCaSSpdPlausI1" 596 "FId_EpmCrSDiag" 597 "FId_EpmCrSDiagVeh" 598 "FId_EpmCrSErr" 599 "FId_EpmOpMode_ALELock" 600 "FId_EpmOpMode_DirStLock" 601 "FId_EpmRRSCrSFaultCheck" 602 "FId_EpmRRSDGIFaultCheck" 603 "FId_EpmRRSRdCheck" 604 "FId_EpmRRSVehVFaultChck" 605 "FId_EpmSynLockCaSSync" 606 "FId_EpmTmpSuppRvsRotCASI1" 607 "FId_EtaEngIdleNonCsers" 608 "FId_EtaEngPtlNonCsers" 609 "FId_EthnlSnsrErrCdn" 610 "FId_EvapActrCcvElecDiag" 611 "FId_EvapPSnsrTankPhyRngChk" 612 "FId_FanCtlACClntP" 613 "FId_FanCtlACGModFail" 614 "FId_FanCtlAPP1" 615 "FId_FanCtlAPP2" 616 "FId_FanCtlAPPSync" 617 "FId_FanCtlBlowrU" 618 "FId_FanCtlCooltT" 619 "FId_FanCtlCooltT2" 620 "FId_FanCtlEnvT" 621 "FId_FanCtlLiSwtInfo" 622 "FId_FanCtlSpd" 623 "FId_FanCtlTSnsrErr" 624 "FId_FanCtlThr1" 625 "FId_FanCtlThr2" 626 "FId_FcoReq" 627 "FId_FiMFID_rba_MRly_Diag_Stk" 628 "FId_FlComErr" 629 "FId_FlDevPlauDiagFuSnsr" 630 "FId_FlLvlNoSigErr" 631 "FId_FlLvlVehSpdSigErr" 632 "FId_FlLvlVehVErr" 633 "FId_FlMALamDynDiag" 634 "FId_FlSplGAltLin" 635 "FId_FlTnkQnt" 636 "FId_FuMixHotFilmErr" 637 "FId_FuMixUegoErrExcl" 638 "FId_FuPHiRailEthnlSnsrErr" 639 "FId_FuPurg_TEVError" 640 "FId_FuSnsrPhyRngErr" 641 "FId_GEVCtlAVCAdprCBBNWEErrIntk" 642 "FId_GEVCtlAVCAdprIntkB1" 643 "FId_GEVCtlAVCAdprNWSEErrIntk" 644 "FId_GEVCtlAdpnEnaIntk" 645 "FId_GEVCtlAdpnEnaShtrpActv" 646 "FId_GEVCtlClngIntk" 647 "FId_GEVCtlMinOvlIntk" 648 "FId_GEVCtlPOilSnsr" 649 "FId_GEVCtlPhaEnaIntk" 650 "FId_GEVCtlPhaSpTstrIntk" 651 "FId_GEVCtlRefAdpnMntChck" 652 "FId_GEVCtlRefAdpnMntChckTstd" 653 "FId_GEVCtlReqRefAdpnTstrIntk" 654 "FId_GEVCtlReqRefAdpnTstrIntkTstd" 655 "FId_GEVCtlVlvLftEnaIntk" 656 "FId_GEVCtlVlvOpenClsdIntkB1" 657 "FId_GEVlvLockPinDiagIntkB1" 658 "FId_GEVlvPhaDiagEnaCsersIntkB1" 659 "FId_GEVlvPhaDiagEnaIntkB1" 660 "FId_GEVlvPhaPsIntkB1" 661 "FId_GbxAnNeutPosnErr" 662 "FId_GbxCANDigPlausErr" 663 "FId_GbxCANNeutSigErr" 664 "FId_GbxPNPosSig" 665 "FId_GbxPNPosnComErr" 666 "FId_GbxPNPosnDiagDrvCdnRels" 667 "FId_GbxPNPosnDiagDrvCodnHealRels" 668 "FId_GbxPNPosnDiagPlausyRels" 669 "FId_GbxPNPosnSubsVal" 670 "FId_GbxRvsSwtStk" 671 "FId_GbxSnsrSplyUErr" 672 "FId_GbxSpstReqOk" 673 "FId_GlbDaLSumvXPtd" 674 "FId_GslThrVlvSnsrDiagB1" 675 "FId_HEGOS2B1DElec" 676 "FId_HEGOS2B1DHtg" 677 "FId_HEGOS2B1Htg" 678 "FId_HEGOS2B1HtrPsSt" 679 "FId_HEGOS2B1InVld" 680 "FId_HEGOS2B1LSPsDiaDi" 681 "FId_HLSDemBrkFlt" 682 "FId_HLSDemErr1" 683 "FId_HLSDemErr2" 684 "FId_HLSDemIntkAirTemp" 685 "FId_HLSDemMotTemp" 686 "FId_HLSDemMstCyldpVld" 687 "FId_HLSDemSpdClthGearAccrSigErr" 688 "FId_HLSDem_DrvOffSuprt" 689 "FId_HLSDem_DrvOffSuprtBrkHldSys" 690 "FId_HLSDem_DrvOffSuprtLAS" 691 "FId_HLSDem_PModeActv" 692 "FId_HLSDem_TModeActv" 693 "FId_HLSDem_TraSubFcn" 694 "FId_HLSDem_nMaxLimErr1" 695 "FId_HLSDem_nMaxLimErr2" 696 "FId_HLSDem_nMaxLimErr3" 697 "FId_HLSDem_nMaxVErr" 698 "FId_I14229APP" 699 "FId_I14229CANErr" 700 "FId_I14229FlLvlFltComErr" 701 "FId_I14229VTCErr" 702 "FId_IMGISABComErr" 703 "FId_InhbLamDynS1B1" 704 "FId_InhbnBlkdLineDiag" 705 "FId_InhibitAlways" 706 "FId_InhibitNever" 707 "FId_InjSysMulInjDiagErr" 708 "FId_InjVlvPs_Bank1OnlyErr" 709 "FId_InjVlvPs_Bank1Tested" 710 "FId_InjVlvPs_Bank2OnlyErr" 711 "FId_InjVlvPs_Bank2Tested" 712 "FId_InjVlvPs_Bank3OnlyErr" 713 "FId_InjVlvPs_Bank3Tested" 714 "FId_IntkAirTAirFltDsCrssChk" 715 "FId_IntkAirTAirFltDsPlausChk" 716 "FId_IntkAirTIntkMnfldCrssChk" 717 "FId_IntkAirTIntkMnfldPlausChk" 718 "FId_IntkAirTIntkMnfldRepl" 719 "FId_IntkAirTSnsr1Elec" 720 "FId_IntkAirTSnsr1PRC" 721 "FId_IntkAirTSnsr1Sum" 722 "FId_IntkAirTSnsr2Elec" 723 "FId_IntkAirTSnsr2PRC" 724 "FId_IntkAirTSnsr2Sum" 725 "FId_IntkArTempENGB" 726 "FId_LIGovDfrstI" 727 "FId_LIGovUndrBrk" 728 "FId_LINDCDCRxErr" 729 "FId_LLimAppSnsrErr" 730 "FId_LLimAppSnsrSyncErr" 731 "FId_LLimMTVehSpdSnsrErr" 732 "FId_LLimShutOffEng" 733 "FId_LRSEBMisf" 734 "FId_LZSR" 735 "FId_LeakToMnfld" 736 "FId_LeakToMnfldTstd" 737 "FId_LimpHomPsErrInjtr" 738 "FId_LinACGUnitCfmdErr" 739 "FId_LinACGUnitNotTstd" 740 "FId_LinAEVUnitCfmdErr" 741 "FId_LinAEVUnitNotTstd" 742 "FId_LinEBSUnitCfmdErr" 743 "FId_LinEBSUnitNotTstd" 744 "FId_LowPresOilP" 745 "FId_MFlowAirCrkcsSubVal" 746 "FId_MFuOilMax" 747 "FId_MaiLoadSnsr" 748 "FId_MaiShaftFailr" 749 "FId_MfPsDia1" 750 "FId_MisfDetDnAdpn" 751 "FId_MisfDetDnAdpnPlaus" 752 "FId_MisfDetEnvP" 753 "FId_MisfDetSegTiAdpnFco" 754 "FId_MisfDetShtrpAct" 755 "FId_MisfDetStc" 756 "FId_MisfDetV" 757 "FId_MisfDetVWhlFrntLe" 758 "FId_MisfDetVWhlFrntRi" 759 "FId_MisfDetVWhlReLe" 760 "FId_MisfDetVWhlReRi" 761 "FId_NLimVehHalt" 762 "FId_NSHTDAmbT" 763 "FId_NSHTDEngT" 764 "FId_NSHTILimHiAltiLoIdleSp" 765 "FId_NeutPosnFailr" 766 "FId_O2StorgMdlMD" 767 "FId_OilCmbdSen_LvlDfctHW" 768 "FId_OilPCtrlVlvNpl" 769 "FId_OilPFrzVal" 770 "FId_OilPPlaus" 771 "FId_OilPPlausAftRun" 772 "FId_OilPPlausMax" 773 "FId_OilPPlausMin" 774 "FId_OilPPlausT15" 775 "FId_OilPRplVal" 776 "FId_OilPSnsrErr" 777 "FId_OilPSwmpSRC" 778 "FId_OilSwmpTCEngDsTWrmUp" 779 "FId_OilSwmpT_B_tospg" 780 "FId_OilSwmpT_B_tospgg" 781 "FId_OilSwmpT_CmbdSnsrErr" 782 "FId_OilSwmpT_CmbdSnsrTiTErr" 783 "FId_OilSwmpT_EnvT" 784 "FId_OilSwmpT_TSnsrErr" 785 "FId_PEnvMeasVld" 786 "FId_PEnvModel" 787 "FId_PEnvPlausDiagVDD" 788 "FId_PEnvRawVldVDD" 789 "FId_PEnvRefSnsr" 790 "FId_PEnvSigRngVld" 791 "FId_PEnvSnsrPlausVDD" 792 "FId_PEnvVldVDD" 793 "FId_PIDA6SigSrcErr" 794 "FId_PIntkMnfldPlaus" 795 "FId_PIntkVUsElecDiagB1" 796 "FId_PSPCtlDisbl" 797 "FId_PSPCtlIntkAirVapLock" 798 "FId_PSPCtlPreRun" 799 "FId_PSPCtlVapLock" 800 "FId_PSPDiagDisbl" 801 "FId_PTGripConv" 802 "FId_PTGripConvStrt" 803 "FId_PTGripMnlClth" 804 "FId_PTGripMnlClthStrt" 805 "FId_PTTrqRatCANPtd" 806 "FId_PThrVlVUsVldB1" 807 "FId_PThrVlvUsMeasdVldB1" 808 "FId_P_VSE11_Diag" 809 "FId_PrmId03_FltRdnS1B1" 810 "FId_PrmId03_FltUegoS1B1" 811 "FId_RevLck" 812 "FId_RstAdpnPIntkMnfldAfs" 813 "FId_RvsPosnFailr" 814 "FId_SSEEPBRelease" 815 "FId_SSEFCANPRelease" 816 "FId_SSEPTCANPRelease" 817 "FId_SSEStartRelease" 818 "FId_SSEStartReleaseMTCl10" 819 "FId_SSEStartReleaseMTCl100" 820 "FId_SSEStartReleaseMTCl20" 821 "FId_SSEStartReleaseMTCl90" 822 "FId_SSEStartRequest" 823 "FId_SSEStopRelease" 824 "FId_SSEStrtStopRelease" 825 "FId_SSESysOff" 826 "FId_SSEUI2DCSysFailr" 827 "FId_SSEUIBCANErr" 828 "FId_SSEUISysFail" 829 "FId_SiaEEPErr" 830 "FId_SnglWhlErrDiagEna" 831 "FId_StrtCtlAutoCrkModeCdn" 832 "FId_StrtCtlComEngStrtErr" 833 "FId_StrtCtlNPCdnCncl" 834 "FId_StrtCtlNoCpuFailr" 835 "FId_StrtCtlNoFailCanLine" 836 "FId_StrtCtlNoFailPTCanLine" 837 "FId_StrtCtlPNPosnSubsVal" 838 "FId_StrtCtlSTMFailr" 839 "FId_StrtErrShaft" 840 "FId_SumErrHndlg" 841 "FId_SysDiagComErr" 842 "FId_SysDiagModInhbErr" 843 "FId_TOSPM" 844 "FId_TWCCILck" 845 "FId_TWCCILckExtd" 846 "FId_TWCCIRstB1" 847 "FId_TWCCIRstDSMClearB1" 848 "FId_TWCCLsuB1" 849 "FId_TWCCLsuCyc" 850 "FId_TWCCLsuDynB1" 851 "FId_TWCCMisfDetn" 852 "FId_TWCDPriCatParB1" 853 "FId_TWCDPriCatVldnB1" 854 "FId_TankPCpv1DteskLoLoadStuckClsd" 855 "FId_TankPCpv1DteskLoLoadStuckOpen" 856 "FId_TankPSnsrElecChkVld" 857 "FId_ThrVlvMon" 858 "FId_ThrVlvOffsLrnPrmsB1" 859 "FId_TiOffTBasdChkFast" 860 "FId_TiOffTBasdChkSlow" 861 "FId_TiOffVdClk" 862 "FId_TqDecelOffsInhb" 863 "FId_TraAddAirCANPtd" 864 "FId_TraAddClntCANPtd" 865 "FId_TraFwdRvsCluInfo" 866 "FId_TraGbxNPos" 867 "FId_TraGearInfoCanCom" 868 "FId_TraGearInfoDet" 869 "FId_TraGearInfoGearShftActv" 870 "FId_TraGearInfoInfoCan" 871 "FId_TraGearInfoLevPos" 872 "FId_TraGearInfoLoRng" 873 "FId_TraGearInfoRTra" 874 "FId_TraGearInfoRevGear" 875 "FId_TraGearReq" 876 "FId_TraNoShftIdctr" 877 "FId_TraPrtGearCANPtd" 878 "FId_TraPrtGearIndpdtProblem" 879 "FId_TraRPosn" 880 "FId_TraRtnIntfcASTIntv" 881 "FId_TraRtnIntfcIdlSetP" 882 "FId_TraRtnIntfcNMaxCan" 883 "FId_TraRtnIntfcNMaxVel" 884 "FId_TraTrqRedLmpHmeDec" 885 "FId_TraTrqRedLmpHmeInc" 886 "FId_TraTrqRedPTCanErr" 887 "FId_TraTrqRedTIIntvDes" 888 "FId_TraTrqRedTIIntvLead" 889 "FId_TraTrqRedTSCIntvDes" 890 "FId_TraTrqRedTSCIntvLead" 891 "FId_TraTrsmTypHw" 892 "FId_TranIdleDes" 893 "FId_UEGOHeatgUpRglS1B1" 894 "FId_UEGOHeatrCtrlS1B1" 895 "FId_UEGOHeatrPrfmncDiagRelsS1B1" 896 "FId_UEGOHeatrPwrStgDiagRelsS1B1" 897 "FId_UEGOModCtrlRelsS1B1" 898 "FId_UEGOStrtDiagInhRprtErrS1B1" 899 "FId_UEGOStrtDiagRelsS1B1" 900 "FId_UEGOTCeramicRelsS1B1" 901 "FId_UegoDiagRelsBattSplyOk" 902 "FId_UegoDiagSigEcuAsicS1B1" 903 "FId_UegoDiagSigEcuComS1B1" 904 "FId_UegoDiagSigOperPlausS1B1" 905 "FId_UegoDiagSigSnsrS1B1" 906 "FId_UegoDiagSigWireOlS1B1" 907 "FId_UegoDiagSigWireScS1B1" 908 "FId_UegoDiagSigWireScTstdS1B1" 909 "FId_UegoInhbOperRelsS1B1" 910 "FId_UegoO2HiPrcsnS1B1" 911 "FId_UegoO2PlausErrS1B1" 912 "FId_UegoO2VldS1B1" 913 "FId_UegoOperPlausBattSplyOk" 914 "FId_UegoPlausErrHndlg" 915 "FId_VMSIDCSRmpShOff" 916 "FId_VMSIDCSShOff" 917 "FId_VMSITCSRmpShOff" 918 "FId_VMSITCSShOff" 919 "FId_VSACANErr" 920 "FId_VehStcACGFailr" 921 "FId_VehStcBattMngFailr" 922 "FId_VehStcDCDCFailr" 923 "FId_VehStcEBSFailr" 924 "FId_VehStcMisf" 925 "FId_VehStcMtrComFailr" 926 "FId_VehStcNVMFailr" 927 "FId_VehVCANFrzVal" 928 "FId_VehVCANReplVal" 929 "FId_VehVCanSafeFrzVal" 930 "FId_VehVCanSafeReplVal" 931 "FId_VehVCom" 932 "FId_VehVExcdLim" 933 "FId_VehVFrzVal" 934 "FId_VehVNCSnsrElecFailr" 935 "FId_VehVOBDFrzVal" 936 "FId_VehVOBDReplVal" 937 "FId_VehVOutCanErr" 938 "FId_VehVPWMFrzVal" 939 "FId_VehVPWMReplVal" 940 "FId_VehVPhysRng" 941 "FId_VehVPlaus" 942 "FId_VehVPlausCan" 943 "FId_VehVPlausFco" 944 "FId_VehVPlausPwr" 945 "FId_VehVPlausV2N" 946 "FId_VehVReplVal" 947 "FId_VehVSigCan" 948 "FId_VehVSigCanSafe" 949 "FId_VehVSngWhlCanFrzVal" 950 "FId_VehVSngWhlCanReplVal" 951 "FId_VehVSnsrARngHi" 952 "FId_VehVSnsrBRngHi" 953 "FId_VehVSpdRtyDiag" 954 "FId_VehVSpdSnsrAElecFailr" 955 "FId_VehVSpdSnsrBElecFailr" 956 "FId_VehVvFLWhlSpd" 957 "FId_VehVvFRWhlSpd" 958 "FId_VehVvRLWhlSpd" 959 "FId_VehVvRRWhlSpd" 960 "FId_VldtLamDynS1B1" 961 "FId_VlvLftFbIntkOilPSnsr11SRC" 962 "FId_VlvLftFbSwtIntk11Diag" 963 "FId_ZGLZSR" 964 "FId_airIntkFltSnsrKnkPrtnIgn" 965 "FId_ctrladpncvo" 966 "FId_stChkChgnSys" 967 "FId_stChkChgnSys2DC" 968 "FId_tFltSnsrKnkPrtnIgn" DEFAULT_VALUE "---" /end COMPU_VTAB
/begin COMPU_METHOD DINH_LimDFCVerb "" TAB_VERB "%6.3" "-" COMPU_TAB_REF DINH_LimDFCVerb /end COMPU_METHOD
/begin COMPU_VTAB DINH_LimDFCVerb "" TAB_VERB 18 0 "No_Inhibit" 1 "Def50_Deb100" 2 "Def100_Deb100" 3 "Def50_Deb100_Tst" 4 "Def100_Deb100_Tst" 5 "Def50_Deb100_or_NTst" 6 "Def100_Deb100_or_NTst" 7 "Tested" 8 "NotTested" 9 "Def100_Deb0" 10 "Def50_Deb0" 11 "Def25_Deb0" 12 "Def0_Deb0" 13 "Def50_Deb100_Tst_Trip" 14 "Def100_Deb100_Tst_Trip" 15 "Def50_Deb100_MILOn" 16 "Def50_Deb100_Trip" 17 "Def100_Deb100_Trip" /end COMPU_VTAB
/begin RECORD_LAYOUT ValA_Wu16 FNC_VALUES 1 UWORD COLUMN_DIR DIRECT /end RECORD_LAYOUT
/begin RECORD_LAYOUT ValA_Wu8 FNC_VALUES 1 UBYTE COLUMN_DIR DIRECT /end RECORD_LAYOUT
/end MODULE
/end PROJECT
