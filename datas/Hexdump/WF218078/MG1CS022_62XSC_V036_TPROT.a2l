ASAP2_VERSION 1 60
/begin PROJECT MG1CS022 "MG1CS022"
/begin HEADER "" VERSION "MG1CS022_62XSC_V036_TPROT" PROJECT_NO MG1CS022 /end HEADER
/begin MODULE DIM ""
/begin MOD_COMMON "" BYTE_ORDER MSB_LAST ALIGNMENT_BYTE 1 ALIGNMENT_WORD 2 ALIGNMENT_LONG 4 ALIGNMENT_INT64 4 ALIGNMENT_FLOAT32_IEEE 4 ALIGNMENT_FLOAT64_IEEE 4 DATA_SIZE 32 /end MOD_COMMON
/begin CHARACTERISTIC UEGO_facAlpha0_C "Factor facAlpha0" VALUE 0x805817DC RB_Val_Ws16 655.3500 q1Em2_DIV_bar -327.6800 327.6700 FORMAT "%8.4" /end CHARACTERISTIC
/begin CHARACTERISTIC UEGO_facCrvtChartcCrvLeanFlexfu_C "" VALUE 0x8058177C RB_Val_Ws16 6.553500 q1Em4 -3.276800 3.276700 FORMAT "%8.6" /end CHARACTERISTIC
/begin CHARACTERISTIC UEGO_facCrvtChartcCrvLean_C "Quadratic coefficient of conversion from linear, pressure compensated oxygen to physical oxygen for gasoline or diesel in lean gas" VALUE 0x8058177E RB_Val_Ws16 6.553500 q1Em4 -3.276800 3.276700 FORMAT "%8.6" /end CHARACTERISTIC
/begin CHARACTERISTIC UEGO_facCrvtChartcCrvRichFlexfu_C "" VALUE 0x80581780 RB_Val_Ws16 6.553500 q1Em4 -3.276800 3.276700 FORMAT "%8.6" /end CHARACTERISTIC
/begin CHARACTERISTIC UEGO_facCrvtChartcCrvRich_C "Quadratic coefficient of conversion from linear, pressure compensated oxygen to physical oxygen for gasoline or diesel in rich gas" VALUE 0x80581782 RB_Val_Ws16 6.553500 q1Em4 -3.276800 3.276700 FORMAT "%8.6" /end CHARACTERISTIC
/begin CHARACTERISTIC UEGO_facGamma0_C "Factor facGamma0" VALUE 0x805817DE RB_Val_Ws16 6.553500 fak_q0p0001 -3.276800 3.276700 FORMAT "%8.6" /end CHARACTERISTIC
/begin CHARACTERISTIC UEGO_facLnrChartcCrvLeanFlexfu_C "" VALUE 0x80581784 RB_Val_Ws16 6553.500 q0p01_Perc_DIV_A -3276.800 3276.700 FORMAT "%8.3" /end CHARACTERISTIC
/begin CHARACTERISTIC UEGO_facLnrChartcCrvLean_C "Linear coefficient of characteristic curve Ip to O2 for gasoline or diesel in lean gas" VALUE 0x80581786 RB_Val_Ws16 6553.500 q0p01_Perc_DIV_A -3276.800 3276.700 FORMAT "%8.3" /end CHARACTERISTIC
/begin CHARACTERISTIC UEGO_facLnrChartcCrvRichFlexfu_C "" VALUE 0x80581788 RB_Val_Ws16 6553.500 q0p01_Perc_DIV_A -3276.800 3276.700 FORMAT "%8.3" /end CHARACTERISTIC
/begin CHARACTERISTIC UEGO_facLnrChartcCrvRich_C "Linear coefficient of characteristic curve Ip to O2 for gasoline or diesel in rich gas" VALUE 0x8058178A RB_Val_Ws16 6553.500 q0p01_Perc_DIV_A -3276.800 3276.700 FORMAT "%8.3" /end CHARACTERISTIC
/begin CHARACTERISTIC UEGO_facRCmpFilCon_C "filter constant for the calculation of the plug resistance and the parallel resistance" VALUE 0x805817FA RB_Val_Wu16 0.9999847 fak_uw_b1 0.00 0.9999847 FORMAT "%9.7" /end CHARACTERISTIC
/begin CHARACTERISTIC UEGO_facRParlFilCon_C "Filter constant for the filtering of parallel resistance measurement at compensation resistor circuit." VALUE 0x805817FC RB_Val_Wu16 0.9999847 fak_uw_b1 0.00 0.9999847 FORMAT "%9.7" /end CHARACTERISTIC
/begin CHARACTERISTIC UEGO_facTCorr_CUR "curve for temperature correction of pump current" CURVE 0x8058178C RB_Curve_S16_U16_Static 1.999969 fak_uw_b2 0.00 1.999969 FORMAT "%8.6"
 /begin AXIS_DESCR STD_AXIS NO_INPUT_QUANTITY temp_q0p0234 11 -768.0000 767.9766 FORMAT "%8.4" DEPOSIT ABSOLUTE /end AXIS_DESCR
/end CHARACTERISTIC
/begin CHARACTERISTIC UEGO_flgActvtFrzO2DurgIPmpRglnDstbc_C "Option to freeze Oxygen concentration signal if Pump current regulation is active but affected by some limited and ASIC submode-related disturbance." VALUE 0x805817BA RB_Val_Wboolean 1.00000000000 B_TRUE 0.00 1.00000000000 FORMAT "%13.11" /end CHARACTERISTIC
/begin CHARACTERISTIC UEGO_iIPmpSrvImpsVal_C "implausible value of pump current for tester service" VALUE 0x805817D8 RB_Val_Ws32 255999.000000 i_q1_uA -128000.000000 127999.000000 FORMAT "%13.6" EXTENDED_LIMITS -2147483648.00 2147483647.00 /end CHARACTERISTIC
/begin CHARACTERISTIC UEGO_iIsqDesRCmpEvln_C "desired current for compensation resistor measurement evaluation" VALUE 0x805817FE RB_Val_Wu16 0.02000000 i_q6p6667Em7_A 0.00 0.02000000 FORMAT "%10.8" EXTENDED_LIMITS 0.00 0.04369000 /end CHARACTERISTIC
/begin CHARACTERISTIC UEGO_nrRegSetDeb_C "number of register settings for debouncing" VALUE 0x805818EA RB_Val_Wu8 7.000 OneToOne 0.00 7.000 FORMAT "%5.3" EXTENDED_LIMITS 0.00 255.0 /end CHARACTERISTIC
/begin CHARACTERISTIC UEGO_nrSubModEnf_C "enforced software submode." VALUE 0x80581762 RB_Val_Wu8 111.000000000 UEGO_SubMod_COMPU_VERB 0.00 111.000000000 FORMAT "%13.9" /end CHARACTERISTIC
/begin CHARACTERISTIC UEGO_nrSubModNormPrio_CA "NORMAL sub-mode priority setting" VAL_BLK 0x80581763 RB_ValA_Wu8 15.00 dez 0.00 15.00 FORMAT "%5.2" EXTENDED_LIMITS 0.00 255.0 NUMBER 10 /end CHARACTERISTIC
/begin CHARACTERISTIC UEGO_nrSubModSwtOnPrio_CA "SWITCH-ON sub mode priority setting" VAL_BLK 0x8058176D RB_ValA_Wu8 15.00 dez 0.00 15.00 FORMAT "%5.2" EXTENDED_LIMITS 0.00 255.0 NUMBER 4 /end CHARACTERISTIC
/begin CHARACTERISTIC UEGO_pO2RefMdlTankIni_C "Initialisation value for the partial pressure of O2 reference Model" VALUE 0x805817E0 RB_Val_Wu32 4294.96729500 p_q1Em6_bar 0.00 4294.96729500 FORMAT "%13.8" /end CHARACTERISTIC
/begin CHARACTERISTIC UEGO_pO2RefMdlTankMax_C "Upper Limit of O2 Model" VALUE 0x805817E4 RB_Val_Wu32 4294.96729500 p_q1Em6_bar 0.00 4294.96729500 FORMAT "%13.8" /end CHARACTERISTIC
/begin CHARACTERISTIC UEGO_pO2RefMdlTankMin_C "Lower Limit of O2 Model" VALUE 0x805817E8 RB_Val_Wu32 4294.96729500 p_q1Em6_bar 0.00 4294.96729500 FORMAT "%13.8" /end CHARACTERISTIC
/begin CHARACTERISTIC UEGO_pO2RefMin_C "Minimum O2 Partial pressure in the reference chamber required for nernst principle" VALUE 0x805817EC RB_Val_Wu32 4294967295.00 Pres_hPa 0.00 4294967295.00 FORMAT "%13.2" /end CHARACTERISTIC
/begin CHARACTERISTIC UEGO_pPDpdLean_C "Pressure dependency of the pump current (k-value) in lean gas" VALUE 0x805817BC RB_Val_Wu16 5119.922 p_q0p078 0.00 5119.922 FORMAT "%8.3" /end CHARACTERISTIC
/begin CHARACTERISTIC UEGO_pPDpdRich_C "Pressure dependency of the pump current (k-value) in rich gas" VALUE 0x805817BE RB_Val_Wu16 5119.922 p_q0p078 0.00 5119.922 FORMAT "%8.3" /end CHARACTERISTIC
/begin CHARACTERISTIC UEGO_rRMeas_C "resistance between pin APE and pin MES" VALUE 0x80581800 RB_Val_Wu16 6553.500 r_q0p1_Ohm 0.00 6553.500 FORMAT "%8.3" /end CHARACTERISTIC
/begin CHARACTERISTIC UEGO_stEngStHeatgStgy_C "Calibration label heating strategy depenfing on engine status" VALUE 0x805817F4 RB_Val_Wu8 255.0 OneToOne 0.00 255.0 FORMAT "%5.1" /end CHARACTERISTIC
/begin CHARACTERISTIC UEGO_stEngStIPmpStgyMask_C "Bit mask to change pump current operation during stop phase" VALUE 0x805817C0 RB_Val_Wu8 255.0 OneToOne 0.00 255.0 FORMAT "%5.1" /end CHARACTERISTIC
/begin CHARACTERISTIC UEGO_stFastLiOffHeatg_C "Switch for Fast Ligth off (FLO)" VALUE 0x805817F8 RB_Val_Wu8 1.00000000000 B_TRUE 0.00 1.00000000000 FORMAT "%13.11" /end CHARACTERISTIC
/begin CHARACTERISTIC UEGO_stIPmpRelsMask_C "Mask for release conditions for pump current request." VALUE 0x805817C1 RB_Val_Wu8 255.0 OneToOne 0.00 255.0 FORMAT "%5.1" /end CHARACTERISTIC
/begin CHARACTERISTIC UEGO_stIPmpRglnDstbcModBitMask_C "Bit Mask to select which submodes is considered for setting flag for pump current regulation active but affected by disturbances (flgIPmpRglnDstbc)." VALUE 0x80581778 RB_Val_Wu8 255.0 OneToOne 0.00 255.0 FORMAT "%5.1" /end CHARACTERISTIC
/begin CHARACTERISTIC UEGO_stIPmpRglnVldBitMask_C "Bit Mask to select which ASIC submodes are considered for setting validity for pump current regulation" VALUE 0x80581779 RB_Val_Wu8 255.0 OneToOne 0.00 255.0 FORMAT "%5.1" /end CHARACTERISTIC
/begin CHARACTERISTIC UEGO_stModCtrl_C "status word for calibrating UEGO_ModCtrl" VALUE 0x80581772 RB_Val_Wu16 65535.00 dez 0.00 65535.00 FORMAT "%8.2" /end CHARACTERISTIC
/begin CHARACTERISTIC UEGO_stO2EquivHiPrcsnBitMask_C "Bit mask to select conditions that determine if O2 equivalent concentration gets high precision or not" VALUE 0x805817C2 RB_Val_Wu8 255.0 OneToOne 0.00 255.0 FORMAT "%5.1" /end CHARACTERISTIC
/begin CHARACTERISTIC UEGO_stO2RefRels_C "Status Label for O2Ref Model Release:" VALUE 0x805817F0 RB_Val_Wu8 255.0 OneToOne 0.00 255.0 FORMAT "%5.1" /end CHARACTERISTIC
/begin CHARACTERISTIC UEGO_stO2VldBitMask_C "Bit mask for O2 validity" VALUE 0x805817C3 RB_Val_Wu8 255.0 OneToOne 0.00 255.0 FORMAT "%5.1" /end CHARACTERISTIC
/begin CHARACTERISTIC UEGO_stOperRels_C "condition for sensor operation release" VALUE 0x805817F5 RB_Val_Wu8 255.0 OneToOne 0.00 255.0 FORMAT "%5.1" /end CHARACTERISTIC
/begin CHARACTERISTIC UEGO_stSysSuprtd_C "condition for system support" VALUE 0x805817F6 RB_Val_Wu8 255.0 OneToOne 0.00 255.0 FORMAT "%5.1" /end CHARACTERISTIC
/begin CHARACTERISTIC UEGO_tCeramicDeLrg_C "Temperature is within large temperature window around TCDs temperature setpoint." VALUE 0x805817C4 RB_Val_Wu16 1535.977 temp_q0p0234_o273 -273.150 1262.827 FORMAT "%8.3" /end CHARACTERISTIC
/begin CHARACTERISTIC UEGO_tCeramicDeSmall_C "Temperature is within small temperature window around TCDs temperature setpoint." VALUE 0x805817C6 RB_Val_Wu16 1535.977 temp_q0p0234_o273 -273.150 1262.827 FORMAT "%8.3" /end CHARACTERISTIC
/begin CHARACTERISTIC UEGO_tCeramicRef_C "Temperatur setpoint as per the TCD" VALUE 0x805817C8 RB_Val_Wu16 1535.977 temp_q0p0234_o273 -273.150 1262.827 FORMAT "%8.3" /end CHARACTERISTIC
/begin CHARACTERISTIC UEGO_tiDlyIPmpDurgStopPha_C "Time delay to sustain pump current during stop phase" VALUE 0x805817CA RB_Val_Wu16 655.3500 t_q0p01 0.00 655.3500 FORMAT "%8.4" /end CHARACTERISTIC
/begin CHARACTERISTIC UEGO_tiDlyIPmpReqOff_C "Duration of the TurnOn delay for detecting low sensor temperature" VALUE 0x805817CC RB_Val_Wu16 655.3500 t_q0p01 0.00 655.3500 FORMAT "%8.4" /end CHARACTERISTIC
/begin CHARACTERISTIC UEGO_tiDlyIPmpRglnDstbc_C "Turn off time delay to determine when Lambda is not disturbed anymore by limited and submode-related disturbances" VALUE 0x8058177A RB_Val_Wu8 1.275 t_q0p005 0.00 1.275 FORMAT "%5.3" /end CHARACTERISTIC
/begin CHARACTERISTIC UEGO_tiModSwtOnDly_C "" VALUE 0x80581774 RB_Val_Wu16 655.3500 t_q0p01 0.00 655.3500 FORMAT "%8.4" /end CHARACTERISTIC
/begin CHARACTERISTIC UEGO_tiO2VldTurnOff_C "Turn off delay of O2 validity" VALUE 0x805817CE RB_Val_Ws16 327.6700 Time_s 0.00 327.6700 FORMAT "%8.4" EXTENDED_LIMITS -327.6800 327.6700 /end CHARACTERISTIC
/begin CHARACTERISTIC UEGO_tiO2VldTurnOn_C "Turn on delay of O2 validity" VALUE 0x805817D0 RB_Val_Ws16 327.6700 Time_s 0.00 327.6700 FORMAT "%8.4" EXTENDED_LIMITS -327.6800 327.6700 /end CHARACTERISTIC
/begin CHARACTERISTIC UEGO_tIPmpReqOff_C "Minimum temperature required for the request of pump current with hysteresis to avoid mode oscillations." VALUE 0x805817D2 RB_Val_Wu16 1535.977 temp_q0p0234_o273 -273.150 1262.827 FORMAT "%8.3" /end CHARACTERISTIC
/begin CHARACTERISTIC UEGO_tIPmpReqOn_C "Maximum temperature required for pump current request with hysteresis to avoid mode oscillations." VALUE 0x805817D4 RB_Val_Wu16 1535.977 temp_q0p0234_o273 -273.150 1262.827 FORMAT "%8.3" /end CHARACTERISTIC
/begin CHARACTERISTIC UEGO_uRegFusks_C "" VALUE 0x80581776 RB_Val_Wu16 15073.05 spg_q0p23_V 0.00 15073.05 FORMAT "%8.2" /end CHARACTERISTIC
/begin MEASUREMENT UEGO_cntrModEvlnS1B1 "counter to evaluate validity of ASIC mode sensor 1 bank 1" SWORD dez 1 100 -255.0000 255.0000 FORMAT "%8.4" ECU_ADDRESS 0x60008EE0 /end MEASUREMENT
/begin MEASUREMENT UEGO_cntrSubModEvlnS1B1 "counter to evaluate validity of Sub-mode, sensor 1 bank 1" SWORD dez 1 100 -255.0000 255.0000 FORMAT "%8.4" ECU_ADDRESS 0x60008EDE /end MEASUREMENT
/begin MEASUREMENT UEGO_facCrvCorrnS1B1 "correction factor for pump current to compensate manufacturing tolerances of diffusion barrier properties (compensation resistor)" UWORD fak_uw_b2 1 100 0.00 1.999969 FORMAT "%8.6" ECU_ADDRESS 0x60008B72 /end MEASUREMENT
/begin MEASUREMENT UEGO_facCrvtChartcCrvS1B1 "Quadratic coefficient of conversion from linear, pressure compensated oxygen to physical oxygen for Sensor 1 Bank 1" SWORD fak_q1Em4 1 100 -3.276800 3.276700 FORMAT "%8.6" ECU_ADDRESS 0x60008EDC /end MEASUREMENT
/begin MEASUREMENT UEGO_flgDewPntRelsS1B1 "dew point release sensor 1 bank 1" UBYTE B_TRUE 1 100 0.00 1.00000000000 BIT_MASK 0x1 FORMAT "%13.11" ECU_ADDRESS 0x6000F079 /end MEASUREMENT
/begin MEASUREMENT UEGO_flgEngStHeatgStgyS1B1 "heater strategy based on the engine state for sensor 1 bank 1" UBYTE B_TRUE 1 100 0.00 1.00000000000 BIT_MASK 0x1 FORMAT "%13.11" ECU_ADDRESS 0x6000F077 /end MEASUREMENT
/begin MEASUREMENT UEGO_flgfacCrvCorrnHiPrcsnS1B1 "UEGO Valid status of pump current correction of sensor 1 and bank 1 with high precision" UBYTE B_TRUE 1 100 0.00 1.00000000000 BIT_MASK 0x1 FORMAT "%13.11" ECU_ADDRESS 0x700006D5 /end MEASUREMENT
/begin MEASUREMENT UEGO_flgfacCrvCorrnVldS1B1 "UEGO Valid status of correction of sensor 1 and bank 1" UBYTE B_TRUE 1 100 0.00 1.00000000000 BIT_MASK 0x1 FORMAT "%13.11" ECU_ADDRESS 0x700006D4 /end MEASUREMENT
/begin MEASUREMENT UEGO_flgIPmpRglnDstbcVldS1B1 "Pump current regulation of Sensor 1 Bank 1 is active but affected by some limited and ASIC submode-related disturbance" UBYTE B_TRUE 1 100 0.00 1.00000000000 BIT_MASK 0x1 FORMAT "%13.11" ECU_ADDRESS 0x70000717 /end MEASUREMENT
/begin MEASUREMENT UEGO_flgIPmpRglnVldS1B1 "Validity of pump current regulation for sensor 1 bank 1" UBYTE B_TRUE 1 100 0.00 1.00000000000 BIT_MASK 0x1 FORMAT "%13.11" ECU_ADDRESS 0x70000716 /end MEASUREMENT
/begin MEASUREMENT UEGO_flgO2EquivHiPrcsnS1B1 "High precision of O2 concentration equivalent for sensor 1 bank 1" UBYTE B_TRUE 1 100 0.00 1.00000000000 BIT_MASK 0x1 FORMAT "%13.11" ECU_ADDRESS 0x7000070C /end MEASUREMENT
/begin MEASUREMENT UEGO_flgO2EquivVldS1B1 "Validity of O2 concentration equivalent for sensor 1 bank 1" UBYTE B_TRUE 1 100 0.00 1.00000000000 BIT_MASK 0x1 FORMAT "%13.11" ECU_ADDRESS 0x7000070B /end MEASUREMENT
/begin MEASUREMENT UEGO_flgO2RefSuffS1B1 "Sufficient Oxygen present in the O2 Reference chamber for Nernst Principle operation S1B1" UBYTE B_TRUE 1 100 0.00 1.00000000000 BIT_MASK 0x1 FORMAT "%13.11" ECU_ADDRESS 0x7000070A /end MEASUREMENT
/begin MEASUREMENT UEGO_flgOperRelsPreEngStrtS1B1 "Activation of lambda sensor heating before engine starts, Sensor1 Bank1" UBYTE B_TRUE 1 100 0.00 1.00000000000 BIT_MASK 0x1 FORMAT "%13.11" ECU_ADDRESS 0x70000706 /end MEASUREMENT
/begin MEASUREMENT UEGO_flgOperRelsS1B1 "Sensor operation release, Sensor 1 Bank 1" UBYTE B_TRUE 1 100 0.00 1.00000000000 BIT_MASK 0x1 FORMAT "%13.11" ECU_ADDRESS 0x6000F06C /end MEASUREMENT
/begin MEASUREMENT UEGO_flgOperRelsWoDewPntS1B1 "Activation of lambda sensor heating before dew point release, Sensor1 Bank1" UBYTE B_TRUE 1 100 0.00 1.00000000000 BIT_MASK 0x1 FORMAT "%13.11" ECU_ADDRESS 0x70000705 /end MEASUREMENT
/begin MEASUREMENT UEGO_flgPO2RefVldS1B1 "Modelled Partial Pressure of Oxygen in the reference chamber valid" UBYTE B_TRUE 1 100 0.00 1.00000000000 BIT_MASK 0x1 FORMAT "%13.11" ECU_ADDRESS 0x70000704 /end MEASUREMENT
/begin MEASUREMENT UEGO_flgRamFailVldS1B1 "validity of ram failiur sensor 1 bank 1" UBYTE B_TRUE 1 100 0.00 1.00000000000 BIT_MASK 0x1 FORMAT "%13.11" ECU_ADDRESS 0x700006F2 /end MEASUREMENT
/begin MEASUREMENT UEGO_flgRCmpUseS1B1 "Status of compensation resistor measurement measurement validity in NORMAL mode" UBYTE B_TRUE 1 100 0.00 1.00000000000 BIT_MASK 0x1 FORMAT "%13.11" ECU_ADDRESS 0x70000700 /end MEASUREMENT
/begin MEASUREMENT UEGO_flgRCmpVldS1B1 "Flag shows that calculated value of Rcmp for Sensor1 Bank1 is valid" UBYTE B_TRUE 1 100 0.00 1.00000000000 BIT_MASK 0x1 FORMAT "%13.11" ECU_ADDRESS 0x700006FF /end MEASUREMENT
/begin MEASUREMENT UEGO_flgRegSetStS1B1 "flag giving the successful transmission of register values to the ASIC sensor 1 bank 1" UBYTE B_TRUE 1 100 0.00 1.00000000000 BIT_MASK 0x1 FORMAT "%13.11" ECU_ADDRESS 0x700006EB /end MEASUREMENT
/begin MEASUREMENT UEGO_flgRegSetStVldS1B1 "validity of the transmissionstate of register values to the ASIC sensor 1 bank 1" UBYTE B_TRUE 1 100 0.00 1.00000000000 BIT_MASK 0x1 FORMAT "%13.11" ECU_ADDRESS 0x700006EA /end MEASUREMENT
/begin MEASUREMENT UEGO_flgRParlVldS1B1 "Flag shows that calculated value of Rparl for Sensor1 Bank1 is valid" UBYTE B_TRUE 1 100 0.00 1.00000000000 BIT_MASK 0x1 FORMAT "%13.11" ECU_ADDRESS 0x700006F9 /end MEASUREMENT
/begin MEASUREMENT UEGO_flgSysSuprtdS1B1 "Indication, if mounted ASIC(Application specific Integrated Chip), Sensor and power stage are supported by software for Sensor 1 Bank 1" UBYTE B_TRUE 1 100 0.00 1.00000000000 BIT_MASK 0x1 FORMAT "%13.11" ECU_ADDRESS 0x6000F067 /end MEASUREMENT
/begin MEASUREMENT UEGO_flgTDeLrgSpS1B1 "Ceramic Temperature of Sensor 1 Bank 1 lies within the Large Temperature Window around TCDs temperature setpoint." UBYTE B_TRUE 1 100 0.00 1.00000000000 BIT_MASK 0x1 FORMAT "%13.11" ECU_ADDRESS 0x700006E3 /end MEASUREMENT
/begin MEASUREMENT UEGO_iIPmpElecCorrdS1B1 "electrically corrected pump current sensor 1 bank 1" SWORD i_q6p6667Em7_A 1 100 -0.02184533 0.02184467 FORMAT "%10.8" ECU_ADDRESS 0x60008ED8 /end MEASUREMENT
/begin MEASUREMENT UEGO_iIPmpSrvExtdS1B1 "Extended pump current for tester service" SLONG i_q1_uA 1 100 -128000.000000 127999.000000 FORMAT "%13.6" ECU_ADDRESS 0x600020EC /end MEASUREMENT
/begin MEASUREMENT UEGO_iIPmpSrvS1B1 "Pump current of sensor 1 bank 1 for tester service" SWORD i_q1_uA 1 100 -32768.00 32767.00 FORMAT "%8.2" ECU_ADDRESS 0x60006682 /end MEASUREMENT
/begin MEASUREMENT UEGO_IPmpReglnClassS1B1_I.cntrReiniCalc5ms "Pump current regulation status evaluation, Sensor 1 Bank 1 / Post drive leave 5 ms" UBYTE OneToOne 1 100 0.00 255.0 FORMAT "%5.1" ECU_ADDRESS 0x6000667A /end MEASUREMENT
/begin MEASUREMENT UEGO_IPmpReglnClassS1B1_I.flgIPmpRglnDstbc "Pump current regulation status evaluation, Sensor 1 Bank 1 / Pump current regulation is active but affected by some limited and ASIC submode-related disturbance." UBYTE B_TRUE 1 100 0.00 1.00000000000 BIT_MASK 0x1 FORMAT "%13.11" ECU_ADDRESS 0x6000667B /end MEASUREMENT
/begin MEASUREMENT UEGO_IPmpReglnClassS1B1_I.flgIPmpRglnDstbcVld "Pump current regulation status evaluation, Sensor 1 Bank 1 / Pump current regulation is active but affected by some limited and ASIC submode-related disturbance." UBYTE B_TRUE 1 100 0.00 1.00000000000 BIT_MASK 0x1 FORMAT "%13.11" ECU_ADDRESS 0x6000667C /end MEASUREMENT
/begin MEASUREMENT UEGO_IPmpReglnClassS1B1_I.flgIPmpRglnVld "Pump current regulation status evaluation, Sensor 1 Bank 1 / Validity of pump current regulation" UBYTE B_TRUE 1 100 0.00 1.00000000000 BIT_MASK 0x1 FORMAT "%13.11" ECU_ADDRESS 0x6000667D /end MEASUREMENT
/begin MEASUREMENT UEGO_IPmpReglnClassS1B1_I.stIPmpRglnDstbcMod "Pump current regulation status evaluation, Sensor 1 Bank 1 / Status word for Sensor x Bank y which indicate bitwise state of the special submodes (active or not) which are causing some limited disturbances on the pump current" UBYTE OneToOne 1 100 0.00 255.0 FORMAT "%5.1" ECU_ADDRESS 0x6000667E /end MEASUREMENT
/begin MEASUREMENT UEGO_IPmpReglnClassS1B1_I.stIPmpRglnVld "Pump current regulation status evaluation, Sensor 1 Bank 1 / Information, if ASIC subode relevant for pump current regulation validity is active" UBYTE OneToOne 1 100 0.00 255.0 FORMAT "%5.1" ECU_ADDRESS 0x6000667F /end MEASUREMENT
/begin MEASUREMENT UEGO_IPmpReglnClassS1B1_I.flgIPmpRglnDstbcTOFFV_NoMem.time "Pump current regulation status evaluation, Sensor 1 Bank 1 / Turn off delay block of Pump current regulation is active but affected by some limited and ASIC submode-related disturbance / delay time" UBYTE t_q0p005 1 100 0.00 1.275 FORMAT "%5.3" ECU_ADDRESS 0x60006680 /end MEASUREMENT
/begin MEASUREMENT UEGO_ModCtrlS1B1_I.cntrModEvln "control class instance of UEGO_ModCtrl sensor 1 bank 1 / counter to evaluate ASIC mode" SWORD dez 1 100 -255.0000 255.0000 FORMAT "%8.4" ECU_ADDRESS 0x60006684 /end MEASUREMENT
/begin MEASUREMENT UEGO_ModCtrlS1B1_I.cntrSubModEvln "control class instance of UEGO_ModCtrl sensor 1 bank 1 / current SW mode" SWORD dez 1 100 -255.0000 255.0000 FORMAT "%8.4" ECU_ADDRESS 0x60006686 /end MEASUREMENT
/begin MEASUREMENT UEGO_ModCtrlS1B1_I.flgCtrlModChng "control class instance of UEGO_ModCtrl sensor 1 bank 1 / ASIC mode change" UBYTE B_TRUE 1 100 0.00 1.00000000000 BIT_MASK 0x1 FORMAT "%13.11" ECU_ADDRESS 0x60006688 /end MEASUREMENT
/begin MEASUREMENT UEGO_ModCtrlS1B1_I.flgCtrlSubModChng "control class instance of UEGO_ModCtrl sensor 1 bank 1 / Status of change in desired Sub-Mode" UBYTE B_TRUE 1 100 0.00 1.00000000000 BIT_MASK 0x1 FORMAT "%13.11" ECU_ADDRESS 0x60006689 /end MEASUREMENT
/begin MEASUREMENT UEGO_ModCtrlS1B1_I.flgFailrMod "control class instance of UEGO_ModCtrl sensor 1 bank 1 / ASIC failure mode due to chip shut-off" UBYTE B_TRUE 1 100 0.00 1.00000000000 BIT_MASK 0x1 FORMAT "%13.11" ECU_ADDRESS 0x6000668A /end MEASUREMENT
/begin MEASUREMENT UEGO_ModCtrlS1B1_I.flgModCurrVrfd "control class instance of UEGO_ModCtrl sensor 1 bank 1 / verified current ASIC mode" UBYTE B_TRUE 1 100 0.00 1.00000000000 BIT_MASK 0x1 FORMAT "%13.11" ECU_ADDRESS 0x6000668B /end MEASUREMENT
/begin MEASUREMENT UEGO_ModCtrlS1B1_I.flgModMeasVrfd "control class instance of UEGO_ModCtrl sensor 1 bank 1 / verified measured ASIC mode" UBYTE B_TRUE 1 100 0.00 1.00000000000 BIT_MASK 0x1 FORMAT "%13.11" ECU_ADDRESS 0x6000668C /end MEASUREMENT
/begin MEASUREMENT UEGO_ModCtrlS1B1_I.flgModSwtOnReq "control class instance of UEGO_ModCtrl sensor 1 bank 1 / Request for operation mode switch-on" UBYTE B_TRUE 1 100 0.00 1.00000000000 BIT_MASK 0x1 FORMAT "%13.11" ECU_ADDRESS 0x6000668D /end MEASUREMENT
/begin MEASUREMENT UEGO_ModCtrlS1B1_I.flgModSwtOnReqEvl "control class instance of UEGO_ModCtrl sensor 1 bank 1 / Evaluated status of request for operation mode switch-on" UBYTE B_TRUE 1 100 0.00 1.00000000000 BIT_MASK 0x1 FORMAT "%13.11" ECU_ADDRESS 0x6000668E /end MEASUREMENT
/begin MEASUREMENT UEGO_ModCtrlS1B1_I.flgRamFailVld "control class instance of UEGO_ModCtrl sensor 1 bank 1 / validity of ram failure (10ms)" UBYTE B_TRUE 1 100 0.00 1.00000000000 BIT_MASK 0x1 FORMAT "%13.11" ECU_ADDRESS 0x6000668F /end MEASUREMENT
/begin MEASUREMENT UEGO_ModCtrlS1B1_I.flgRamFailVld_5ms "control class instance of UEGO_ModCtrl sensor 1 bank 1 / validity of ram failure (5ms)" UBYTE B_TRUE 1 100 0.00 1.00000000000 BIT_MASK 0x1 FORMAT "%13.11" ECU_ADDRESS 0x60006690 /end MEASUREMENT
/begin MEASUREMENT UEGO_ModCtrlS1B1_I.flgSetRegOk "control class instance of UEGO_ModCtrl sensor 1 bank 1 / register setting successful" UBYTE B_TRUE 1 100 0.00 1.00000000000 BIT_MASK 0x1 FORMAT "%13.11" ECU_ADDRESS 0x60006691 /end MEASUREMENT
/begin MEASUREMENT UEGO_ModCtrlS1B1_I.flgSetRegOkDspDiagDis "control class instance of UEGO_ModCtrl sensor 1 bank 1 / Class instance of the functional class of FC UEGO_- RegGet for bank 1 sensor 1 Status of register setting for register DSPDIAGDIS" UBYTE B_TRUE 1 100 0.00 1.00000000000 BIT_MASK 0x1 FORMAT "%13.11" ECU_ADDRESS 0x60006692 /end MEASUREMENT
/begin MEASUREMENT UEGO_ModCtrlS1B1_I.flgSetRegOkEnSp "control class instance of UEGO_ModCtrl sensor 1 bank 1 / Register set status of EnSp register" UBYTE B_TRUE 1 100 0.00 1.00000000000 BIT_MASK 0x1 FORMAT "%13.11" ECU_ADDRESS 0x60006693 /end MEASUREMENT
/begin MEASUREMENT UEGO_ModCtrlS1B1_I.flgSetRegOkFusks "control class instance of UEGO_ModCtrl sensor 1 bank 1 / Register set status of FUSKS register" UBYTE B_TRUE 1 100 0.00 1.00000000000 BIT_MASK 0x1 FORMAT "%13.11" ECU_ADDRESS 0x60006694 /end MEASUREMENT
/begin MEASUREMENT UEGO_ModCtrlS1B1_I.flgSubModMeasVrfd "control class instance of UEGO_ModCtrl sensor 1 bank 1 / Verification status of measured Sub-Mode" UBYTE B_TRUE 1 100 0.00 1.00000000000 BIT_MASK 0x1 FORMAT "%13.11" ECU_ADDRESS 0x60006695 /end MEASUREMENT
/begin MEASUREMENT UEGO_ModCtrlS1B1_I.nrModDesLst "control class instance of UEGO_ModCtrl sensor 1 bank 1 / Last requested mode" UBYTE UEGO_AsicState_COMPU_VERB 1 100 0.00 7.00000000000 FORMAT "%13.11" ECU_ADDRESS 0x60006696 /end MEASUREMENT
/begin MEASUREMENT UEGO_ModCtrlS1B1_I.nrModInt "control class instance of UEGO_ModCtrl sensor 1 bank 1 / internal mode of UEGO_ModCtrl" UBYTE UEGO_AsicState_COMPU_VERB 1 100 0.00 7.00000000000 FORMAT "%13.11" ECU_ADDRESS 0x60006697 /end MEASUREMENT
/begin MEASUREMENT UEGO_ModCtrlS1B1_I.nrModMeas "control class instance of UEGO_ModCtrl sensor 1 bank 1 / measured mode (10ms)" UBYTE UEGO_AsicState_COMPU_VERB 1 100 0.00 7.00000000000 FORMAT "%13.11" ECU_ADDRESS 0x60006698 /end MEASUREMENT
/begin MEASUREMENT UEGO_ModCtrlS1B1_I.nrModMeas_5ms "control class instance of UEGO_ModCtrl sensor 1 bank 1 / measured mode (5ms)" UBYTE UEGO_AsicState_COMPU_VERB 1 100 0.00 7.00000000000 FORMAT "%13.11" ECU_ADDRESS 0x60006699 /end MEASUREMENT
/begin MEASUREMENT UEGO_ModCtrlS1B1_I.nrModOld "control class instance of UEGO_ModCtrl sensor 1 bank 1 / internal mode of UEGO_ModCtrl (old value)" UBYTE UEGO_AsicState_COMPU_VERB 1 100 0.00 7.00000000000 FORMAT "%13.11" ECU_ADDRESS 0x6000669A /end MEASUREMENT
/begin MEASUREMENT UEGO_ModCtrlS1B1_I.nrModVrfd "control class instance of UEGO_ModCtrl sensor 1 bank 1 / verified ASIC mode" UBYTE UEGO_AsicState_COMPU_VERB 1 100 0.00 7.00000000000 FORMAT "%13.11" ECU_ADDRESS 0x6000669B /end MEASUREMENT
/begin MEASUREMENT UEGO_ModCtrlS1B1_I.nrRamFailPosn "control class instance of UEGO_ModCtrl sensor 1 bank 1 / position at which ram failure occured (10ms)" UBYTE dez 1 100 0.00 255.0 FORMAT "%5.1" ECU_ADDRESS 0x6000669C /end MEASUREMENT
/begin MEASUREMENT UEGO_ModCtrlS1B1_I.nrRamFailPosn_5ms "control class instance of UEGO_ModCtrl sensor 1 bank 1 / position at which ram failure occured (5ms)" UBYTE dez 1 100 0.00 255.0 FORMAT "%5.1" ECU_ADDRESS 0x6000669D /end MEASUREMENT
/begin MEASUREMENT UEGO_ModCtrlS1B1_I.nrRamFailSts1 "control class instance of UEGO_ModCtrl sensor 1 bank 1 / status word 1 of ram failure (10ms)" UWORD dez 1 100 0.00 65535.00 FORMAT "%8.2" ECU_ADDRESS 0x6000669E /end MEASUREMENT
/begin MEASUREMENT UEGO_ModCtrlS1B1_I.nrRamFailSts1_5ms "control class instance of UEGO_ModCtrl sensor 1 bank 1 / status word 1 of ram failure (5ms)" UWORD dez 1 100 0.00 65535.00 FORMAT "%8.2" ECU_ADDRESS 0x600066A0 /end MEASUREMENT
/begin MEASUREMENT UEGO_ModCtrlS1B1_I.nrRamFailSts2 "control class instance of UEGO_ModCtrl sensor 1 bank 1 / status word 2 of ram failure (10ms)" UWORD dez 1 100 0.00 65535.00 FORMAT "%8.2" ECU_ADDRESS 0x600066A2 /end MEASUREMENT
/begin MEASUREMENT UEGO_ModCtrlS1B1_I.nrRamFailSts2_5ms "control class instance of UEGO_ModCtrl sensor 1 bank 1 / status word 2 of ram failure (5ms)" UWORD dez 1 100 0.00 65535.00 FORMAT "%8.2" ECU_ADDRESS 0x600066A4 /end MEASUREMENT
/begin MEASUREMENT UEGO_ModCtrlS1B1_I.nrRamFailSts3 "control class instance of UEGO_ModCtrl sensor 1 bank 1 / status word 3 of ram failure (10ms)" UWORD dez 1 100 0.00 65535.00 FORMAT "%8.2" ECU_ADDRESS 0x600066A6 /end MEASUREMENT
/begin MEASUREMENT UEGO_ModCtrlS1B1_I.nrRamFailSts3_5ms "control class instance of UEGO_ModCtrl sensor 1 bank 1 / status word 3 of ram failure (5ms)" UWORD dez 1 100 0.00 65535.00 FORMAT "%8.2" ECU_ADDRESS 0x600066A8 /end MEASUREMENT
/begin MEASUREMENT UEGO_ModCtrlS1B1_I.nrSubModDes "control class instance of UEGO_ModCtrl sensor 1 bank 1 / desired sub-mode" UBYTE dez 1 100 0.00 15.00 FORMAT "%5.2" ECU_ADDRESS 0x600066AA /end MEASUREMENT
/begin MEASUREMENT UEGO_ModCtrlS1B1_I.nrSubModDesLst "control class instance of UEGO_ModCtrl sensor 1 bank 1 / Previous desired Sub-Mode" UBYTE dez 1 100 0.00 255.0 FORMAT "%5.1" ECU_ADDRESS 0x600066AB /end MEASUREMENT
/begin MEASUREMENT UEGO_ModCtrlS1B1_I.nrSubModDesOld "control class instance of UEGO_ModCtrl sensor 1 bank 1 / previously desired sub-mode" UBYTE dez 1 100 0.00 15.00 FORMAT "%5.2" ECU_ADDRESS 0x600066AC /end MEASUREMENT
/begin MEASUREMENT UEGO_ModCtrlS1B1_I.nrSubModEvln "control class instance of UEGO_ModCtrl sensor 1 bank 1 / current state of UEGO system" UBYTE UEGO_SubMod_COMPU_VERB 1 100 0.00 111.000000000 FORMAT "%13.9" ECU_ADDRESS 0x600066AD /end MEASUREMENT
/begin MEASUREMENT UEGO_ModCtrlS1B1_I.nrSubModMeas "control class instance of UEGO_ModCtrl sensor 1 bank 1 / Measured sub-mode." UBYTE dez 1 100 0.00 255.0 FORMAT "%5.1" ECU_ADDRESS 0x600066AE /end MEASUREMENT
/begin MEASUREMENT UEGO_ModCtrlS1B1_I.nrSubModMeas_5ms "control class instance of UEGO_ModCtrl sensor 1 bank 1 / Measured sub-mode in 5ms." UBYTE dez 1 100 0.00 255.0 FORMAT "%5.1" ECU_ADDRESS 0x600066AF /end MEASUREMENT
/begin MEASUREMENT UEGO_ModCtrlS1B1_I.nrSubModVrfd "control class instance of UEGO_ModCtrl sensor 1 bank 1 / verified Sub-Mode" UBYTE dez 1 100 0.00 255.0 FORMAT "%5.1" ECU_ADDRESS 0x600066B0 /end MEASUREMENT
/begin MEASUREMENT UEGO_ModCtrlS1B1_I.stEnSp "control class instance of UEGO_ModCtrl sensor 1 bank 1 / EnSp register" UBYTE dez 1 100 0.00 3.000 FORMAT "%5.3" ECU_ADDRESS 0x600066B1 /end MEASUREMENT
/begin MEASUREMENT UEGO_ModCtrlS1B1_I.stEnSpOld "control class instance of UEGO_ModCtrl sensor 1 bank 1 / EnSp register (old)" UBYTE dez 1 100 0.00 3.000 FORMAT "%5.3" ECU_ADDRESS 0x600066B2 /end MEASUREMENT
/begin MEASUREMENT UEGO_ModCtrlS1B1_I.uRegFusks "control class instance of UEGO_ModCtrl sensor 1 bank 1 / FUSKS register" UWORD spg_q0p23_V 1 100 0.00 15073.05 FORMAT "%8.2" ECU_ADDRESS 0x600066B4 /end MEASUREMENT
/begin MEASUREMENT UEGO_ModCtrlS1B1_I.uRegFusksOld "control class instance of UEGO_ModCtrl sensor 1 bank 1 / FUSKS register (old value)" UWORD spg_q0p23_V 1 100 0.00 15073.05 FORMAT "%8.2" ECU_ADDRESS 0x600066B6 /end MEASUREMENT
/begin MEASUREMENT UEGO_ModCtrlS1B1_I.UEGO_SwtOnTOFFVNM_I.time "control class instance of UEGO_ModCtrl sensor 1 bank 1 / Turn off delay for evaluation of operation mode switch-on / delay time" UWORD t_q0p01 1 100 0.00 655.3500 FORMAT "%8.4" ECU_ADDRESS 0x600066B8 /end MEASUREMENT
/begin MEASUREMENT UEGO_ModCtrlS1B1_I.flgRamFailVldERNM_I.oldSignal "control class instance of UEGO_ModCtrl sensor 1 bank 1 / delay for rising edge of ram failure / value of input signal last calculation" UBYTE B_TRUE 1 100 0.00 1.00000000000 BIT_MASK 0x1 FORMAT "%13.11" ECU_ADDRESS 0x600066BA /end MEASUREMENT
/begin MEASUREMENT UEGO_nrModVrfdS1B1 "counter for validiy of current mode sensor 1 bank 1" UBYTE dez 1 100 0.00 255.0 FORMAT "%5.1" ECU_ADDRESS 0x6000F323 /end MEASUREMENT
/begin MEASUREMENT UEGO_nrRamFailPosnS1B1 "position at which ram failure occured sensor 1 bank 1" UBYTE dez 1 100 0.00 255.0 FORMAT "%5.1" ECU_ADDRESS 0x6000F322 /end MEASUREMENT
/begin MEASUREMENT UEGO_nrRamFailSts1S1B1 "status word 1 of ram failure sensor 1 bank 1" UWORD dez 1 100 0.00 65535.00 FORMAT "%8.2" ECU_ADDRESS 0x60008B6C /end MEASUREMENT
/begin MEASUREMENT UEGO_nrRamFailSts2S1B1 "status word 2 of ram failure sensor 1 bank 1" UWORD dez 1 100 0.00 65535.00 FORMAT "%8.2" ECU_ADDRESS 0x60008B6A /end MEASUREMENT
/begin MEASUREMENT UEGO_nrRamFailSts3S1B1 "status word 3 of ram failure sensor 1 bank 1" UWORD dez 1 100 0.00 65535.00 FORMAT "%8.2" ECU_ADDRESS 0x60008B68 /end MEASUREMENT
/begin MEASUREMENT UEGO_nrSubModVrfdS1B1 "Verified Sub-Mode, Sensor 1 Bank 1" UBYTE dez 1 100 0.00 255.0 FORMAT "%5.1" ECU_ADDRESS 0x6000F321 /end MEASUREMENT
/begin MEASUREMENT UEGO_O2ClassS1B1_I.facCrvtChartcCrv "functional class of UEGO_O2 for sensor 1 bank 1 / Quadratic coefficient of conversion from linear, pressure compensated oxygen to physical oxygen" SWORD fak_q1Em4 1 100 -3.276800 3.276700 FORMAT "%8.6" ECU_ADDRESS 0x600020C6 /end MEASUREMENT
/begin MEASUREMENT UEGO_O2ClassS1B1_I.flgIPmpElecCorrdCalcd "functional class of UEGO_O2 for sensor 1 bank 1 / electrically corrected pump current calculated" UBYTE B_TRUE 1 100 0.00 1.00000000000 BIT_MASK 0x20 FORMAT "%13.11" ECU_ADDRESS 0x600020C4 /end MEASUREMENT
/begin MEASUREMENT UEGO_O2ClassS1B1_I.flgIPmpReq "functional class of UEGO_O2 for sensor 1 bank 1 / pump current is requested" UBYTE B_TRUE 1 100 0.00 1.00000000000 BIT_MASK 0x1 FORMAT "%13.11" ECU_ADDRESS 0x600020C8 /end MEASUREMENT
/begin MEASUREMENT UEGO_O2ClassS1B1_I.flgIPmpTCorrdCalcd "functional class of UEGO_O2 for sensor 1 bank 1 / temperature corrected pump current calculated" UBYTE B_TRUE 1 100 0.00 1.00000000000 BIT_MASK 0x8 FORMAT "%13.11" ECU_ADDRESS 0x600020C4 /end MEASUREMENT
/begin MEASUREMENT UEGO_O2ClassS1B1_I.flgO2EquivHiPrcsn "functional class of UEGO_O2 for sensor 1 bank 1 / O2 concentration high precision debounced status" UBYTE B_TRUE 1 100 0.00 1.00000000000 BIT_MASK 0x1 FORMAT "%13.11" ECU_ADDRESS 0x600020C9 /end MEASUREMENT
/begin MEASUREMENT UEGO_O2ClassS1B1_I.flgO2EquivHiPrcsnCurr "functional class of UEGO_O2 for sensor 1 bank 1 / O2 concentration high precision current status" UBYTE B_TRUE 1 100 0.00 1.00000000000 BIT_MASK 0x10 FORMAT "%13.11" ECU_ADDRESS 0x600020C4 /end MEASUREMENT
/begin MEASUREMENT UEGO_O2ClassS1B1_I.flgO2EquivVld "functional class of UEGO_O2 for sensor 1 bank 1 / O2 concentration valid debounced status" UBYTE B_TRUE 1 100 0.00 1.00000000000 BIT_MASK 0x1 FORMAT "%13.11" ECU_ADDRESS 0x600020CA /end MEASUREMENT
/begin MEASUREMENT UEGO_O2ClassS1B1_I.flgO2EquivVldCurr "functional class of UEGO_O2 for sensor 1 bank 1 / O2 concentration valid current status" UBYTE B_TRUE 1 100 0.00 1.00000000000 BIT_MASK 0x1 FORMAT "%13.11" ECU_ADDRESS 0x600020CB /end MEASUREMENT
/begin MEASUREMENT UEGO_O2ClassS1B1_I.flgO2TCorrdCalcd "functional class of UEGO_O2 for sensor 1 bank 1 / temperature corrected O2 concentration calculated" UBYTE B_TRUE 1 100 0.00 1.00000000000 BIT_MASK 0x4 FORMAT "%13.11" ECU_ADDRESS 0x600020C4 /end MEASUREMENT
/begin MEASUREMENT UEGO_O2ClassS1B1_I.flgTDeLrgSp "functional class of UEGO_O2 for sensor 1 bank 1 / Temperature is within large temperature window around TCDs temperature setpoint. This is used as some input to determine if O2 equivalent concentration is valid or not." UBYTE B_TRUE 1 100 0.00 1.00000000000 BIT_MASK 0x1 FORMAT "%13.11" ECU_ADDRESS 0x600020CC /end MEASUREMENT
/begin MEASUREMENT UEGO_O2ClassS1B1_I.flgTDeSmallSp "functional class of UEGO_O2 for sensor 1 bank 1 / Temperature is within small temperature window around TCDs temperature setpoint. This is used as some input to determine if O2 equivalent concentration get high precision or not." UBYTE B_TRUE 1 100 0.00 1.00000000000 BIT_MASK 0x1 FORMAT "%13.11" ECU_ADDRESS 0x600020CD /end MEASUREMENT
/begin MEASUREMENT UEGO_O2ClassS1B1_I.iIPmpElecCorrd "functional class of UEGO_O2 for sensor 1 bank 1 / electrically corrected pump current" SWORD i_q6p6667Em7_A 1 100 -0.02184533 0.02184467 FORMAT "%10.8" ECU_ADDRESS 0x600020CE /end MEASUREMENT
/begin MEASUREMENT UEGO_O2ClassS1B1_I.iIPmpTCorrd "functional class of UEGO_O2 for sensor 1 bank 1 / temperature corrected pump current" SWORD i_q6p6667Em7_A 1 100 -0.02184533 0.02184467 FORMAT "%10.8" ECU_ADDRESS 0x600020D0 /end MEASUREMENT
/begin MEASUREMENT UEGO_O2ClassS1B1_I.pPDpd "functional class of UEGO_O2 for sensor 1 bank 1 / Pressure dependency (=k-value)" UWORD p_q0p078 1 100 0.00 5119.922 FORMAT "%8.3" ECU_ADDRESS 0x600020D2 /end MEASUREMENT
/begin MEASUREMENT UEGO_O2ClassS1B1_I.ratO2EquivLnr "functional class of UEGO_O2 for sensor 1 bank 1 / Linear Oxygen Concentration" SWORD fak_q1Em5 1 100 -0.3276800 0.3276700 FORMAT "%9.7" ECU_ADDRESS 0x600020D4 /end MEASUREMENT
/begin MEASUREMENT UEGO_O2ClassS1B1_I.stEngStIPmpStgy "functional class of UEGO_O2 for sensor 1 bank 1 / Status list for pump current operation during stop phase" UBYTE OneToOne 1 100 0.00 255.0 FORMAT "%5.1" ECU_ADDRESS 0x600020D6 /end MEASUREMENT
/begin MEASUREMENT UEGO_O2ClassS1B1_I.stIPmpRels "functional class of UEGO_O2 for sensor 1 bank 1 / Output von BitStrng and input for comparison with mask UEGO_stIPmpRelsMask_C" UBYTE OneToOne 1 100 0.00 255.0 FORMAT "%5.1" ECU_ADDRESS 0x600020D7 /end MEASUREMENT
/begin MEASUREMENT UEGO_O2ClassS1B1_I.stO2EquivHiPrcsn "functional class of UEGO_O2 for sensor 1 bank 1 / resulting concatenation(before the filtering by the mask) of bits used to determine high precision flag" UBYTE OneToOne 1 100 0.00 255.0 FORMAT "%5.1" ECU_ADDRESS 0x600020D8 /end MEASUREMENT
/begin MEASUREMENT UEGO_O2ClassS1B1_I.stO2Vld "functional class of UEGO_O2 for sensor 1 bank 1 / status of O2 validity" UBYTE OneToOne 1 100 0.00 255.0 FORMAT "%5.1" ECU_ADDRESS 0x600020D9 /end MEASUREMENT
/begin MEASUREMENT UEGO_O2ClassS1B1_I.tDe "functional class of UEGO_O2 for sensor 1 bank 1 / Difference between temperature setpoint and actual measure temperature." SWORD temp_q0p0234_o273 1 100 -1041.150 494.827 FORMAT "%8.3" ECU_ADDRESS 0x600020DA /end MEASUREMENT
/begin MEASUREMENT UEGO_O2ClassS1B1_I.UEGO_TIPmpReqOnSW_I.timeCounter "functional class of UEGO_O2 for sensor 1 bank 1 / Timer benutzt in IPMP_REQUEST im Rahmen Submode Einführung / expired time since start" UWORD t_q0p01 1 100 0.00 655.3500 FORMAT "%8.4" ECU_ADDRESS 0x600020DC /end MEASUREMENT
/begin MEASUREMENT UEGO_O2ClassS1B1_I.flgEngRunngIPmpStgyTOFFV_I.outbit "functional class of UEGO_O2 for sensor 1 bank 1 / turn off delay of flgEngRunng / Output Bit" UBYTE B_TRUE 1 100 0.00 1.00000000000 BIT_MASK 0x1 FORMAT "%13.11" ECU_ADDRESS 0x600020DE /end MEASUREMENT
/begin MEASUREMENT UEGO_O2ClassS1B1_I.flgEngRunngIPmpStgyTOFFV_I.time "functional class of UEGO_O2 for sensor 1 bank 1 / turn off delay of flgEngRunng / Occured Time" UWORD t_q0p01 1 100 0.00 655.3500 FORMAT "%8.4" ECU_ADDRESS 0x600020E0 /end MEASUREMENT
/begin MEASUREMENT UEGO_O2ClassS1B1_I.flgO2VldDEB_I.Timer "functional class of UEGO_O2 for sensor 1 bank 1 / internal flag of debouncing element for O2 validity / Debounce timer for StrtStop Recognition." SLONG Per_Dur 1 100 -2147483648.00 2147483647.00 FORMAT "%13.2" ECU_ADDRESS 0x600020E4 /end MEASUREMENT
/begin MEASUREMENT UEGO_O2ClassS1B1_I.flgO2VldDEB_I.XOld "functional class of UEGO_O2 for sensor 1 bank 1 / internal flag of debouncing element for O2 validity / Debounce structure for StrtStop Recognition." UBYTE B_TRUE 1 100 0.00 1.00000000000 BIT_MASK 0x1 FORMAT "%13.11" ECU_ADDRESS 0x600020E8 /end MEASUREMENT
/begin MEASUREMENT UEGO_O2RefClassS1B1.flgMdlStrtd "UEGO_O2Ref Class S1B1 / O2 reference Model calculation started" UBYTE B_TRUE 1 100 0.00 1.00000000000 BIT_MASK 0x1 FORMAT "%13.11" ECU_ADDRESS 0x600020B0 /end MEASUREMENT
/begin MEASUREMENT UEGO_O2RefClassS1B1.flgO2RefSuff "UEGO_O2Ref Class S1B1 / Sufficient Oxygen present in O2 reference chamber" UBYTE B_TRUE 1 100 0.00 1.00000000000 BIT_MASK 0x1 FORMAT "%13.11" ECU_ADDRESS 0x600020B1 /end MEASUREMENT
/begin MEASUREMENT UEGO_O2RefClassS1B1.flgPO2RefVld "UEGO_O2Ref Class S1B1 / Calculated O2 Partial pressure valid" UBYTE B_TRUE 1 100 0.00 1.00000000000 BIT_MASK 0x1 FORMAT "%13.11" ECU_ADDRESS 0x600020B2 /end MEASUREMENT
/begin MEASUREMENT UEGO_O2RefClassS1B1.pO2Ref "UEGO_O2Ref Class S1B1 / Final O2 Partial Pressure in the O2 Reference Chamber" ULONG Pres_hPa 1 100 0.00 4294967295.00 FORMAT "%13.2" ECU_ADDRESS 0x600020B4 /end MEASUREMENT
/begin MEASUREMENT UEGO_O2RefClassS1B1.pO2RefMdlTank "UEGO_O2Ref Class S1B1 / O2 Partial Pressure in the O2 Reference Chamber in bars" ULONG p_q1Em6_bar 1 100 0.00 4294.96729500 FORMAT "%13.8" ARRAY_SIZE 1 ECU_ADDRESS 0x600020B8 /end MEASUREMENT
/begin MEASUREMENT UEGO_O2RefClassS1B1.pO2RefMdlTankLoss "UEGO_O2Ref Class S1B1 / Loss of O2 Partial pressure to subsequent Tanks of the MultiTank Model" SLONG p_q1Em6_bar 1 100 -2147.48364800 2147.48364700 FORMAT "%13.8" ARRAY_SIZE 1 ECU_ADDRESS 0x600020BC /end MEASUREMENT
/begin MEASUREMENT UEGO_O2RefClassS1B1.stO2RefRels "UEGO_O2Ref Class S1B1 / Status bit for O2Ref Model Release" UBYTE OneToOne 1 100 0.00 255.0 FORMAT "%5.1" ECU_ADDRESS 0x600020C0 /end MEASUREMENT
/begin MEASUREMENT UEGO_OperRelsS1B1_I.flgEngStHeatgStgy "Class instance of the functional class of FC UEGO_OperRels for Sensor 1 Bank 1 / Heater strategy depending on the engine state" UBYTE B_TRUE 1 100 0.00 1.00000000000 BIT_MASK 0x1 FORMAT "%13.11" ECU_ADDRESS 0x500057A4 /end MEASUREMENT
/begin MEASUREMENT UEGO_OperRelsS1B1_I.flgOperRels "Class instance of the functional class of FC UEGO_OperRels for Sensor 1 Bank 1 / Sensor operation release" UBYTE B_TRUE 1 100 0.00 1.00000000000 BIT_MASK 0x1 FORMAT "%13.11" ECU_ADDRESS 0x500057A5 /end MEASUREMENT
/begin MEASUREMENT UEGO_OperRelsS1B1_I.flgSysSuprtd "Class instance of the functional class of FC UEGO_OperRels for Sensor 1 Bank 1 / Indication, if mounted System is supported by SW" UBYTE B_TRUE 1 100 0.00 1.00000000000 BIT_MASK 0x1 FORMAT "%13.11" ECU_ADDRESS 0x500057A6 /end MEASUREMENT
/begin MEASUREMENT UEGO_OperRelsS1B1_I.stEngStHeatgStgy "Class instance of the functional class of FC UEGO_OperRels for Sensor 1 Bank 1 / Status word heater strategy depending on engine status" UBYTE OneToOne 1 100 0.00 255.0 FORMAT "%5.1" ECU_ADDRESS 0x500057A7 /end MEASUREMENT
/begin MEASUREMENT UEGO_OperRelsS1B1_I.stOperRels "Class instance of the functional class of FC UEGO_OperRels for Sensor 1 Bank 1 / observe the condition for sensor operation release" UBYTE OneToOne 1 100 0.00 255.0 FORMAT "%5.1" ECU_ADDRESS 0x500057A8 /end MEASUREMENT
/begin MEASUREMENT UEGO_OperRelsS1B1_I.stSysSuprtd "Class instance of the functional class of FC UEGO_OperRels for Sensor 1 Bank 1 / Condition status for system support" UBYTE OneToOne 1 100 0.00 255.0 FORMAT "%5.1" ECU_ADDRESS 0x500057A9 /end MEASUREMENT
/begin MEASUREMENT UEGO_OperRelsWoDewPntS1B1_I.flgFastLiOffActvSts "Class instance of the functional class of FC UEGO_OperRelsWoDewPnt for Sensor 1 Bank 1 / Status of fast light-off for Lambda sensor" UBYTE B_TRUE 1 100 0.00 1.00000000000 BIT_MASK 0x1 FORMAT "%13.11" ECU_ADDRESS 0x60006676 /end MEASUREMENT
/begin MEASUREMENT UEGO_OperRelsWoDewPntS1B1_I.flgOperRelsPreEngStrt "Class instance of the functional class of FC UEGO_OperRelsWoDewPnt for Sensor 1 Bank 1 / Activation of lambda sensor heating before engine start" UBYTE B_TRUE 1 100 0.00 1.00000000000 BIT_MASK 0x1 FORMAT "%13.11" ECU_ADDRESS 0x60006677 /end MEASUREMENT
/begin MEASUREMENT UEGO_OperRelsWoDewPntS1B1_I.flgOperRelsWoDewPnt "Class instance of the functional class of FC UEGO_OperRelsWoDewPnt for Sensor 1 Bank 1 / Activation of lambda sensor heating before dew point release" UBYTE B_TRUE 1 100 0.00 1.00000000000 BIT_MASK 0x1 FORMAT "%13.11" ECU_ADDRESS 0x60006678 /end MEASUREMENT
/begin MEASUREMENT UEGO_OperRelsWoDewPntS1B1_I.flgReqPreHeatg "Class instance of the functional class of FC UEGO_OperRelsWoDewPnt for Sensor 1 Bank 1 / Lambda sensor pre-heating request (through customer interfaces or ATS Tester)" UBYTE B_TRUE 1 100 0.00 1.00000000000 BIT_MASK 0x1 FORMAT "%13.11" ECU_ADDRESS 0x60006679 /end MEASUREMENT
/begin MEASUREMENT UEGO_pO2RefS1B1 "Modelled Partial Pressure of Oxygen in reference Chamber" ULONG Pres_hPa 1 100 0.00 4294967295.00 FORMAT "%13.2" ECU_ADDRESS 0x60003890 /end MEASUREMENT
/begin MEASUREMENT UEGO_pPDpdS1B1 "Pressure dependency of the pump current (k-value)" UWORD p_q0p078 1 100 0.00 5119.922 FORMAT "%8.3" ECU_ADDRESS 0x60008B66 /end MEASUREMENT
/begin MEASUREMENT UEGO_ratO2EquivLnrS1B1 "Linear Oxygen Concentration for Sensor 1 Bank 1" SWORD fak_q1Em5 1 100 -0.3276800 0.3276700 FORMAT "%9.7" ECU_ADDRESS 0x60008E3A /end MEASUREMENT
/begin MEASUREMENT UEGO_RCmpCtrlS1B1_I.flgRCmpMeasReq "class instance of control part of the function with the turn-on conditions for the resistance measurement (for sensor 1 on bank 1) / flag for request of compensation resistor measurements" UBYTE B_TRUE 1 100 0.00 1.00000000000 BIT_MASK 0x1 FORMAT "%13.11" ECU_ADDRESS 0x60006672 /end MEASUREMENT
/begin MEASUREMENT UEGO_RCmpCtrlS1B1_I.flgSetRegOk "class instance of control part of the function with the turn-on conditions for the resistance measurement (for sensor 1 on bank 1) / bit indicator for successful setting of the register CJ135_REGPART_SWTONRCODMEASOFF" UBYTE B_TRUE 1 100 0.00 1.00000000000 BIT_MASK 0x1 FORMAT "%13.11" ECU_ADDRESS 0x60006673 /end MEASUREMENT
/begin MEASUREMENT UEGO_RCmpCtrlS1B1_I.nrModIntCtrl "class instance of control part of the function with the turn-on conditions for the resistance measurement (for sensor 1 on bank 1) / numerical indication for the currently active control state of the RCmp measurement" UBYTE UEGO_ModRCmp_COMPU_VERB 1 100 1.00000000000 2.00000000000 FORMAT "%13.11" ECU_ADDRESS 0x60006674 /end MEASUREMENT
/begin MEASUREMENT UEGO_RCmpCtrlS1B1_I.nrModIntCtrlOld "class instance of control part of the function with the turn-on conditions for the resistance measurement (for sensor 1 on bank 1) / numerical indication for the previously active control state of the RCmp measurement" UBYTE UEGO_ModRCmp_COMPU_VERB 1 100 1.00000000000 2.00000000000 FORMAT "%13.11" ECU_ADDRESS 0x60006675 /end MEASUREMENT
/begin MEASUREMENT UEGO_RCmpEvlnS1B1_I.facCrvCorrn "class instance of evaluation part of the function with the resistance calculation (for sensor 1 on bank 1) / pump current correction factor of sensor adjustment" UWORD fak_uw_b2 1 100 0.00 1.999969 FORMAT "%8.6" ECU_ADDRESS 0x6000208C /end MEASUREMENT
/begin MEASUREMENT UEGO_RCmpEvlnS1B1_I.flgRCmpUse "class instance of evaluation part of the function with the resistance calculation (for sensor 1 on bank 1) / validity flag for valid compensation measurements used in other ASIC submode than UEGO_STSWITCHON_RCMP" UBYTE B_TRUE 1 100 0.00 1.00000000000 BIT_MASK 0x1 FORMAT "%13.11" ECU_ADDRESS 0x6000208E /end MEASUREMENT
/begin MEASUREMENT UEGO_RCmpEvlnS1B1_I.flgRCmpVld "class instance of evaluation part of the function with the resistance calculation (for sensor 1 on bank 1) / validity of the calculated plug resistor" UBYTE B_TRUE 1 100 0.00 1.00000000000 BIT_MASK 0x1 FORMAT "%13.11" ECU_ADDRESS 0x6000208F /end MEASUREMENT
/begin MEASUREMENT UEGO_RCmpEvlnS1B1_I.flgRParlUse "class instance of evaluation part of the function with the resistance calculation (for sensor 1 on bank 1) / validity flag for calculated parallel resistance between APE and MES used in other ASIC submode than UEGO_STSWITCHON_RCMP" UBYTE B_TRUE 1 100 0.00 1.00000000000 BIT_MASK 0x1 FORMAT "%13.11" ECU_ADDRESS 0x60002090 /end MEASUREMENT
/begin MEASUREMENT UEGO_RCmpEvlnS1B1_I.flgRParlVld "class instance of evaluation part of the function with the resistance calculation (for sensor 1 on bank 1) / validity of the calculated parallel resistor" UBYTE B_TRUE 1 100 0.00 1.00000000000 BIT_MASK 0x1 FORMAT "%13.11" ECU_ADDRESS 0x60002091 /end MEASUREMENT
/begin MEASUREMENT UEGO_RCmpEvlnS1B1_I.flgfacCrvCorrnHiPrcsn "class instance of evaluation part of the function with the resistance calculation (for sensor 1 on bank 1) / UEGO Gültigkeit des Faktors zur Korrektur des Pumpstroms mit hoher Genauigkeit" UBYTE B_TRUE 1 100 0.00 1.00000000000 BIT_MASK 0x1 FORMAT "%13.11" ECU_ADDRESS 0x60002092 /end MEASUREMENT
/begin MEASUREMENT UEGO_RCmpEvlnS1B1_I.flgfacCrvCorrnVld "class instance of evaluation part of the function with the resistance calculation (for sensor 1 on bank 1) / validity of the correction factor for the pump current" UBYTE B_TRUE 1 100 0.00 1.00000000000 BIT_MASK 0x1 FORMAT "%13.11" ECU_ADDRESS 0x60002093 /end MEASUREMENT
/begin MEASUREMENT UEGO_RCmpEvlnS1B1_I.nrModIntFacCrvCorrn "class instance of evaluation part of the function with the resistance calculation (for sensor 1 on bank 1) / numerical indication for the currently active evaluation state of the correction factor calculation" UBYTE UEGO_ModRCmpFacCrvCorr_COMPU_VERB 1 100 1.00000000000 5.00000000000 FORMAT "%13.11" ECU_ADDRESS 0x60002094 /end MEASUREMENT
/begin MEASUREMENT UEGO_RCmpEvlnS1B1_I.nrModIntFacCrvCorrnOld "class instance of evaluation part of the function with the resistance calculation (for sensor 1 on bank 1) / numerical indication for the previously active evaluation state of the correction factor calculation" UBYTE UEGO_ModRCmpFacCrvCorr_COMPU_VERB 1 100 1.00000000000 5.00000000000 FORMAT "%13.11" ECU_ADDRESS 0x60002095 /end MEASUREMENT
/begin MEASUREMENT UEGO_RCmpEvlnS1B1_I.nrModIntRCmp "class instance of evaluation part of the function with the resistance calculation (for sensor 1 on bank 1) / numerical indication for the currently active evaluation state of the plug resistor calculation" UBYTE UEGO_ModRCmpRCmp_COMPU_VERB 1 100 1.00000000000 4.00000000000 FORMAT "%13.11" ECU_ADDRESS 0x60002096 /end MEASUREMENT
/begin MEASUREMENT UEGO_RCmpEvlnS1B1_I.nrModIntRCmpOld "class instance of evaluation part of the function with the resistance calculation (for sensor 1 on bank 1) / numerical indication for the previously active evaluation state of the plug resistor calculation" UBYTE UEGO_ModRCmpRCmp_COMPU_VERB 1 100 1.00000000000 4.00000000000 FORMAT "%13.11" ECU_ADDRESS 0x60002097 /end MEASUREMENT
/begin MEASUREMENT UEGO_RCmpEvlnS1B1_I.nrModIntRParl "class instance of evaluation part of the function with the resistance calculation (for sensor 1 on bank 1) / numerical indication for the currently active evaluation state of the parallel resistor calculation" UBYTE UEGO_ModRCmpRParl_COMPU_VERB 1 100 1.00000000000 3.00000000000 FORMAT "%13.11" ECU_ADDRESS 0x60002098 /end MEASUREMENT
/begin MEASUREMENT UEGO_RCmpEvlnS1B1_I.nrModIntRParlOld "class instance of evaluation part of the function with the resistance calculation (for sensor 1 on bank 1) / numerical indication for the previously active evaluation state of the parallel resistor calculation" UBYTE UEGO_ModRCmpRParl_COMPU_VERB 1 100 1.00000000000 3.00000000000 FORMAT "%13.11" ECU_ADDRESS 0x60002099 /end MEASUREMENT
/begin MEASUREMENT UEGO_RCmpEvlnS1B1_I.rRCmp "class instance of evaluation part of the function with the resistance calculation (for sensor 1 on bank 1) / internal value of the calculated plug resistance" UWORD r_q0p1_Ohm 1 100 0.00 6553.500 FORMAT "%8.3" ECU_ADDRESS 0x6000209A /end MEASUREMENT
/begin MEASUREMENT UEGO_RCmpEvlnS1B1_I.rRParl "class instance of evaluation part of the function with the resistance calculation (for sensor 1 on bank 1) / internal value of the calculated parallel resistance" UWORD r_q0p1_Ohm 1 100 0.00 6553.500 FORMAT "%8.3" ECU_ADDRESS 0x6000209C /end MEASUREMENT
/begin MEASUREMENT UEGO_RCmpEvlnS1B1_I.UEGO_RCmpFil_I.flgEvlnStrtd "class instance of evaluation part of the function with the resistance calculation (for sensor 1 on bank 1) / filter instance for the plug resistance calculation / Flag to determine evaluation status." UBYTE B_TRUE 1 100 0.00 1.00000000000 BIT_MASK 0x1 FORMAT "%13.11" ECU_ADDRESS 0x600020A0 /end MEASUREMENT
/begin MEASUREMENT UEGO_RCmpEvlnS1B1_I.UEGO_RCmpFil_I.EvlnFil_DL_I.memory "class instance of evaluation part of the function with the resistance calculation (for sensor 1 on bank 1) / filter instance for the plug resistance calculation / Class instance of evaluation filter. / current lowpass value" ULONG r_q1p5259Em6_Ohm 1 100 0.00 6553.59999847 FORMAT "%13.8" ECU_ADDRESS 0x600020A4 /end MEASUREMENT
/begin MEASUREMENT UEGO_RCmpEvlnS1B1_I.UEGO_RParlFil_I.flgEvlnStrtd "class instance of evaluation part of the function with the resistance calculation (for sensor 1 on bank 1) / filter instance for the parallel resistance calculation / Flag to determine evaluation status." UBYTE B_TRUE 1 100 0.00 1.00000000000 BIT_MASK 0x1 FORMAT "%13.11" ECU_ADDRESS 0x600020A8 /end MEASUREMENT
/begin MEASUREMENT UEGO_RCmpEvlnS1B1_I.UEGO_RParlFil_I.EvlnFil_DL_I.memory "class instance of evaluation part of the function with the resistance calculation (for sensor 1 on bank 1) / filter instance for the parallel resistance calculation / Class instance of evaluation filter. / current lowpass value" ULONG r_q1p5259Em6_Ohm 1 100 0.00 6553.59999847 FORMAT "%13.8" ECU_ADDRESS 0x600020AC /end MEASUREMENT
/begin MEASUREMENT UEGO_RegGetPrmS1B1_I.flgDlyBlcknNxtPckVld "Class instance of the functional class of FC UEGO_RegGet for bank 1 sensor 1 / Validity of the THYS_BLACK register for the next cycle" UBYTE B_TRUE 1 100 0.00 1.00000000000 BIT_MASK 0x10 FORMAT "%13.11" ECU_ADDRESS 0x60006616 /end MEASUREMENT
/begin MEASUREMENT UEGO_RegGetPrmS1B1_I.flgDlyBlcknVld "Class instance of the functional class of FC UEGO_RegGet for bank 1 sensor 1 / Validity of the THYS_BLACK register" UBYTE B_TRUE 1 100 0.00 1.00000000000 BIT_MASK 0x20 FORMAT "%13.11" ECU_ADDRESS 0x60006616 /end MEASUREMENT
/begin MEASUREMENT UEGO_RegGetPrmS1B1_I.flgDspDiagDis "Class instance of the functional class of FC UEGO_RegGet for bank 1 sensor 1 / Status of DSP diagnosis" UBYTE B_TRUE 1 100 0.00 1.00000000000 BIT_MASK 0x20 FORMAT "%13.11" ECU_ADDRESS 0x6000661F /end MEASUREMENT
/begin MEASUREMENT UEGO_RegGetPrmS1B1_I.flgDspDiagDisNxtPck "Class instance of the functional class of FC UEGO_RegGet for bank 1 sensor 1 / Status of DSP diagnosis in the next cycle" UBYTE B_TRUE 1 100 0.00 1.00000000000 BIT_MASK 0x80 FORMAT "%13.11" ECU_ADDRESS 0x6000661F /end MEASUREMENT
/begin MEASUREMENT UEGO_RegGetPrmS1B1_I.flgDspDiagDisNxtPckVld "Class instance of the functional class of FC UEGO_RegGet for bank 1 sensor 1 / Validity of DSP diagnosis" UBYTE B_TRUE 1 100 0.00 1.00000000000 BIT_MASK 0x20 FORMAT "%13.11" ECU_ADDRESS 0x6000661E /end MEASUREMENT
/begin MEASUREMENT UEGO_RegGetPrmS1B1_I.flgDspDiagDisVld "Class instance of the functional class of FC UEGO_RegGet for bank 1 sensor 1 / Validity of DSP diagnosis in the next cycle" UBYTE B_TRUE 1 100 0.00 1.00000000000 BIT_MASK 0x80 FORMAT "%13.11" ECU_ADDRESS 0x60006616 /end MEASUREMENT
/begin MEASUREMENT UEGO_RegGetPrmS1B1_I.flgEnSpA "Class instance of the functional class of FC UEGO_RegGet for bank 1 sensor 1 / Status of the EN_SPI_A_M register" UBYTE B_TRUE 1 100 0.00 1.00000000000 BIT_MASK 0x1 FORMAT "%13.11" ECU_ADDRESS 0x6000660F /end MEASUREMENT
/begin MEASUREMENT UEGO_RegGetPrmS1B1_I.flgEnSpAVld "Class instance of the functional class of FC UEGO_RegGet for bank 1 sensor 1 / Validity of the EN_SPI_A_M register for the next cycle" UBYTE B_TRUE 1 100 0.00 1.00000000000 BIT_MASK 0x4 FORMAT "%13.11" ECU_ADDRESS 0x60006610 /end MEASUREMENT
/begin MEASUREMENT UEGO_RegGetPrmS1B1_I.flgEnSpE "Class instance of the functional class of FC UEGO_RegGet for bank 1 sensor 1 / Status of the EN_SPE register" UBYTE B_TRUE 1 100 0.00 1.00000000000 BIT_MASK 0x10 FORMAT "%13.11" ECU_ADDRESS 0x6000660F /end MEASUREMENT
/begin MEASUREMENT UEGO_RegGetPrmS1B1_I.flgEnSpEVld "Class instance of the functional class of FC UEGO_RegGet for bank 1 sensor 1 / Validity of the EN_SPE register" UBYTE B_TRUE 1 100 0.00 1.00000000000 BIT_MASK 0x40 FORMAT "%13.11" ECU_ADDRESS 0x6000660F /end MEASUREMENT
/begin MEASUREMENT UEGO_RegGetPrmS1B1_I.flgEnSpNxtPckVld "Class instance of the functional class of FC UEGO_RegGet for bank 1 sensor 1 / Validity of the EN_SP_AN register for the next cycle" UBYTE B_TRUE 1 100 0.00 1.00000000000 BIT_MASK 0x1 FORMAT "%13.11" ECU_ADDRESS 0x60006618 /end MEASUREMENT
/begin MEASUREMENT UEGO_RegGetPrmS1B1_I.flgEnSpVld "Class instance of the functional class of FC UEGO_RegGet for bank 1 sensor 1 / Validity of the EN_SP_AN register" UBYTE B_TRUE 1 100 0.00 1.00000000000 BIT_MASK 0x2 FORMAT "%13.11" ECU_ADDRESS 0x60006618 /end MEASUREMENT
/begin MEASUREMENT UEGO_RegGetPrmS1B1_I.flgIPmpBlcknNxtPckVld "Class instance of the functional class of FC UEGO_RegGet for bank 1 sensor 1 / Validity of the IPBLACK register for the next cycle" UBYTE B_TRUE 1 100 0.00 1.00000000000 BIT_MASK 0x4 FORMAT "%13.11" ECU_ADDRESS 0x60006618 /end MEASUREMENT
/begin MEASUREMENT UEGO_RegGetPrmS1B1_I.flgIPmpBlcknVld "Class instance of the functional class of FC UEGO_RegGet for bank 1 sensor 1 / Validity of the IPBLACK register" UBYTE B_TRUE 1 100 0.00 1.00000000000 BIT_MASK 0x8 FORMAT "%13.11" ECU_ADDRESS 0x60006618 /end MEASUREMENT
/begin MEASUREMENT UEGO_RegGetPrmS1B1_I.flgIPmpLimnHiVld "Class instance of the functional class of FC UEGO_RegGet for bank 1 sensor 1 / maximum pump current limitation validity" UBYTE B_TRUE 1 100 0.00 1.00000000000 BIT_MASK 0x4 FORMAT "%13.11" ECU_ADDRESS 0x6000661D /end MEASUREMENT
/begin MEASUREMENT UEGO_RegGetPrmS1B1_I.flgIPmpLimnLoVld "Class instance of the functional class of FC UEGO_RegGet for bank 1 sensor 1 / minimum pump current limitation valid" UBYTE B_TRUE 1 100 0.00 1.00000000000 BIT_MASK 0x8 FORMAT "%13.11" ECU_ADDRESS 0x6000661D /end MEASUREMENT
/begin MEASUREMENT UEGO_RegGetPrmS1B1_I.flgIPmpRst "Class instance of the functional class of FC UEGO_RegGet for bank 1 sensor 1 / Status of the SET_IP register" UBYTE B_TRUE 1 100 0.00 1.00000000000 BIT_MASK 0x1 FORMAT "%13.11" ECU_ADDRESS 0x60006622 /end MEASUREMENT
/begin MEASUREMENT UEGO_RegGetPrmS1B1_I.flgIPmpRstNxtPck "Class instance of the functional class of FC UEGO_RegGet for bank 1 sensor 1 / Status of the SET_IP register for the next cycle" UBYTE B_TRUE 1 100 0.00 1.00000000000 BIT_MASK 0x8 FORMAT "%13.11" ECU_ADDRESS 0x60006610 /end MEASUREMENT
/begin MEASUREMENT UEGO_RegGetPrmS1B1_I.flgIPmpRstNxtPckVld "Class instance of the functional class of FC UEGO_RegGet for bank 1 sensor 1 / Validity of the SET_IP register for the next cycle" UBYTE B_TRUE 1 100 0.00 1.00000000000 BIT_MASK 0x10 FORMAT "%13.11" ECU_ADDRESS 0x60006610 /end MEASUREMENT
/begin MEASUREMENT UEGO_RegGetPrmS1B1_I.flgIPmpRstVld "Class instance of the functional class of FC UEGO_RegGet for bank 1 sensor 1 / Validity of the SET_IP register" UBYTE B_TRUE 1 100 0.00 1.00000000000 BIT_MASK 0x20 FORMAT "%13.11" ECU_ADDRESS 0x60006610 /end MEASUREMENT
/begin MEASUREMENT UEGO_RegGetPrmS1B1_I.flgIPmpSm "Class instance of the functional class of FC UEGO_RegGet for bank 1 sensor 1 / Status of the IPSM register" UBYTE B_TRUE 1 100 0.00 1.00000000000 BIT_MASK 0x1 FORMAT "%13.11" ECU_ADDRESS 0x6000660E /end MEASUREMENT
/begin MEASUREMENT UEGO_RegGetPrmS1B1_I.flgIPmpSmNxtPck "Class instance of the functional class of FC UEGO_RegGet for bank 1 sensor 1 / Status of the IPSM register for the next cycle" UBYTE B_TRUE 1 100 0.00 1.00000000000 BIT_MASK 0x2 FORMAT "%13.11" ECU_ADDRESS 0x6000660E /end MEASUREMENT
/begin MEASUREMENT UEGO_RegGetPrmS1B1_I.flgIPmpSmNxtPckVld "Class instance of the functional class of FC UEGO_RegGet for bank 1 sensor 1 / Validity of the IPSM register" UBYTE B_TRUE 1 100 0.00 1.00000000000 BIT_MASK 0x40 FORMAT "%13.11" ECU_ADDRESS 0x60006610 /end MEASUREMENT
/begin MEASUREMENT UEGO_RegGetPrmS1B1_I.flgIPmpSmVld "Class instance of the functional class of FC UEGO_RegGet for bank 1 sensor 1 / Validity of the IPSM register for the next cycle" UBYTE B_TRUE 1 100 0.00 1.00000000000 BIT_MASK 0x80 FORMAT "%13.11" ECU_ADDRESS 0x60006610 /end MEASUREMENT
/begin MEASUREMENT UEGO_RegGetPrmS1B1_I.flgLCal "Class instance of the functional class of FC UEGO_RegGet for bank 1 sensor 1 / Status of the LCAL register" UBYTE B_TRUE 1 100 0.00 1.00000000000 BIT_MASK 0x80 FORMAT "%13.11" ECU_ADDRESS 0x6000660F /end MEASUREMENT
/begin MEASUREMENT UEGO_RegGetPrmS1B1_I.flgLCalVld "Class instance of the functional class of FC UEGO_RegGet for bank 1 sensor 1 / Validity of the LCAL register for the next cycle" UBYTE B_TRUE 1 100 0.00 1.00000000000 BIT_MASK 0x8 FORMAT "%13.11" ECU_ADDRESS 0x6000660F /end MEASUREMENT
/begin MEASUREMENT UEGO_RegGetPrmS1B1_I.flgLCurr "Class instance of the functional class of FC UEGO_RegGet for bank 1 sensor 1 / Status of the LCURR register" UBYTE B_TRUE 1 100 0.00 1.00000000000 BIT_MASK 0x40 FORMAT "%13.11" ECU_ADDRESS 0x60006621 /end MEASUREMENT
/begin MEASUREMENT UEGO_RegGetPrmS1B1_I.flgLCurrVld "Class instance of the functional class of FC UEGO_RegGet for bank 1 sensor 1 / Validity of the LCURR register for the next cycle" UBYTE B_TRUE 1 100 0.00 1.00000000000 BIT_MASK 0x4 FORMAT "%13.11" ECU_ADDRESS 0x60006612 /end MEASUREMENT
/begin MEASUREMENT UEGO_RegGetPrmS1B1_I.flgLDAC "Class instance of the functional class of FC UEGO_RegGet for bank 1 sensor 1 / Status of the LDAC register" UBYTE B_TRUE 1 100 0.00 1.00000000000 BIT_MASK 0x8 FORMAT "%13.11" ECU_ADDRESS 0x60006612 /end MEASUREMENT
/begin MEASUREMENT UEGO_RegGetPrmS1B1_I.flgLDACConf "Class instance of the functional class of FC UEGO_RegGet for bank 1 sensor 1 / Status of the DAC_CONF register" UBYTE B_TRUE 1 100 0.00 1.00000000000 BIT_MASK 0x2 FORMAT "%13.11" ECU_ADDRESS 0x60006622 /end MEASUREMENT
/begin MEASUREMENT UEGO_RegGetPrmS1B1_I.flgLDACConfVld "Class instance of the functional class of FC UEGO_RegGet for bank 1 sensor 1 / Validity of the DAC_CONF register" UBYTE B_TRUE 1 100 0.00 1.00000000000 BIT_MASK 0x40 FORMAT "%13.11" ECU_ADDRESS 0x60006612 /end MEASUREMENT
/begin MEASUREMENT UEGO_RegGetPrmS1B1_I.flgLDACVld "Class instance of the functional class of FC UEGO_RegGet for bank 1 sensor 1 / Validity of the LDAC register" UBYTE B_TRUE 1 100 0.00 1.00000000000 BIT_MASK 0x4 FORMAT "%13.11" ECU_ADDRESS 0x60006622 /end MEASUREMENT
/begin MEASUREMENT UEGO_RegGetPrmS1B1_I.flgLG0 "Class instance of the functional class of FC UEGO_RegGet for bank 1 sensor 1 / Status of the LG0 register" UBYTE B_TRUE 1 100 0.00 1.00000000000 BIT_MASK 0x8 FORMAT "%13.11" ECU_ADDRESS 0x60006622 /end MEASUREMENT
/begin MEASUREMENT UEGO_RegGetPrmS1B1_I.flgLG0Vld "Class instance of the functional class of FC UEGO_RegGet for bank 1 sensor 1 / Validity of the LG0 register" UBYTE B_TRUE 1 100 0.00 1.00000000000 BIT_MASK 0x8 FORMAT "%13.11" ECU_ADDRESS 0x60006613 /end MEASUREMENT
/begin MEASUREMENT UEGO_RegGetPrmS1B1_I.flgLN "Class instance of the functional class of FC UEGO_RegGet for bank 1 sensor 1 / Status of the LN register" UBYTE B_TRUE 1 100 0.00 1.00000000000 BIT_MASK 0x4 FORMAT "%13.11" ECU_ADDRESS 0x6000660E /end MEASUREMENT
/begin MEASUREMENT UEGO_RegGetPrmS1B1_I.flgLNNxtPck "Class instance of the functional class of FC UEGO_RegGet for bank 1 sensor 1 / Status of the LN register for the next cycle" UBYTE B_TRUE 1 100 0.00 1.00000000000 BIT_MASK 0x1 FORMAT "%13.11" ECU_ADDRESS 0x60006623 /end MEASUREMENT
/begin MEASUREMENT UEGO_RegGetPrmS1B1_I.flgLNNxtPckVld "Class instance of the functional class of FC UEGO_RegGet for bank 1 sensor 1 / Validity of the LN register for the next cycle" UBYTE B_TRUE 1 100 0.00 1.00000000000 BIT_MASK 0x10 FORMAT "%13.11" ECU_ADDRESS 0x60006613 /end MEASUREMENT
/begin MEASUREMENT UEGO_RegGetPrmS1B1_I.flgLNVld "Class instance of the functional class of FC UEGO_RegGet for bank 1 sensor 1 / Validity of the LN register" UBYTE B_TRUE 1 100 0.00 1.00000000000 BIT_MASK 0x20 FORMAT "%13.11" ECU_ADDRESS 0x60006613 /end MEASUREMENT
/begin MEASUREMENT UEGO_RegGetPrmS1B1_I.flgLP "Class instance of the functional class of FC UEGO_RegGet for bank 1 sensor 1 / Status of the LP register" UBYTE B_TRUE 1 100 0.00 1.00000000000 BIT_MASK 0x10 FORMAT "%13.11" ECU_ADDRESS 0x6000660E /end MEASUREMENT
/begin MEASUREMENT UEGO_RegGetPrmS1B1_I.flgLPNxtPck "Class instance of the functional class of FC UEGO_RegGet for bank 1 sensor 1 / Status of the LP register for the next cycle" UBYTE B_TRUE 1 100 0.00 1.00000000000 BIT_MASK 0x40 FORMAT "%13.11" ECU_ADDRESS 0x60006613 /end MEASUREMENT
/begin MEASUREMENT UEGO_RegGetPrmS1B1_I.flgLPNxtPckVld "Class instance of the functional class of FC UEGO_RegGet for bank 1 sensor 1 / Validity of the LP register for the next cycle" UBYTE B_TRUE 1 100 0.00 1.00000000000 BIT_MASK 0x80 FORMAT "%13.11" ECU_ADDRESS 0x60006613 /end MEASUREMENT
/begin MEASUREMENT UEGO_RegGetPrmS1B1_I.flgLPVld "Class instance of the functional class of FC UEGO_RegGet for bank 1 sensor 1 / Validity of the LP register" UBYTE B_TRUE 1 100 0.00 1.00000000000 BIT_MASK 0x20 FORMAT "%13.11" ECU_ADDRESS 0x6000660E /end MEASUREMENT
/begin MEASUREMENT UEGO_RegGetPrmS1B1_I.flgMKA "Class instance of the functional class of FC UEGO_RegGet for bank 1 sensor 1 / Status of the MKA register" UBYTE B_TRUE 1 100 0.00 1.00000000000 BIT_MASK 0x20 FORMAT "%13.11" ECU_ADDRESS 0x60006622 /end MEASUREMENT
/begin MEASUREMENT UEGO_RegGetPrmS1B1_I.flgMKAVld "Class instance of the functional class of FC UEGO_RegGet for bank 1 sensor 1 / Validity of the MKA register" UBYTE B_TRUE 1 100 0.00 1.00000000000 BIT_MASK 0x2 FORMAT "%13.11" ECU_ADDRESS 0x60006615 /end MEASUREMENT
/begin MEASUREMENT UEGO_RegGetPrmS1B1_I.flgMKE "Class instance of the functional class of FC UEGO_RegGet for bank 1 sensor 1 / Status of the MKE register" UBYTE B_TRUE 1 100 0.00 1.00000000000 BIT_MASK 0x80 FORMAT "%13.11" ECU_ADDRESS 0x60006622 /end MEASUREMENT
/begin MEASUREMENT UEGO_RegGetPrmS1B1_I.flgMKEVld "Class instance of the functional class of FC UEGO_RegGet for bank 1 sensor 1 / Validity of the MKE register" UBYTE B_TRUE 1 100 0.00 1.00000000000 BIT_MASK 0x8 FORMAT "%13.11" ECU_ADDRESS 0x60006615 /end MEASUREMENT
/begin MEASUREMENT UEGO_RegGetPrmS1B1_I.flgMKNxtPckVld "Class instance of the functional class of FC UEGO_RegGet for bank 1 sensor 1 / Status of the MK register for the next cycle" UBYTE B_TRUE 1 100 0.00 1.00000000000 BIT_MASK 0x10 FORMAT "%13.11" ECU_ADDRESS 0x60006615 /end MEASUREMENT
/begin MEASUREMENT UEGO_RegGetPrmS1B1_I.flgMKVld "Class instance of the functional class of FC UEGO_RegGet for bank 1 sensor 1 / Status of the MK register" UBYTE B_TRUE 1 100 0.00 1.00000000000 BIT_MASK 0x20 FORMAT "%13.11" ECU_ADDRESS 0x60006615 /end MEASUREMENT
/begin MEASUREMENT UEGO_RegGetPrmS1B1_I.flgN3MeasActvNxtPck "Class instance of the functional class of FC UEGO_RegGet for bank 1 sensor 1 / Active flag for Normal3 measurements for the next cycle" UBYTE B_TRUE 1 100 0.00 1.00000000000 BIT_MASK 0x80 FORMAT "%13.11" ECU_ADDRESS 0x6000660E /end MEASUREMENT
/begin MEASUREMENT UEGO_RegGetPrmS1B1_I.flgN3MeasActvNxtPckVld "Class instance of the functional class of FC UEGO_RegGet for bank 1 sensor 1 / Validity flag for Normal3 measurements for the next cycle" UBYTE B_TRUE 1 100 0.00 1.00000000000 BIT_MASK 0x1 FORMAT "%13.11" ECU_ADDRESS 0x60006619 /end MEASUREMENT
/begin MEASUREMENT UEGO_RegGetPrmS1B1_I.flgOFFNxtPckVld "Class instance of the functional class of FC UEGO_RegGet for bank 1 sensor 1 / validity of the OFF register for the next cycle" UBYTE B_TRUE 1 100 0.00 1.00000000000 BIT_MASK 0x2 FORMAT "%13.11" ECU_ADDRESS 0x60006617 /end MEASUREMENT
/begin MEASUREMENT UEGO_RegGetPrmS1B1_I.flgOFFVld "Class instance of the functional class of FC UEGO_RegGet for bank 1 sensor 1 / Validity of the OFF register" UBYTE B_TRUE 1 100 0.00 1.00000000000 BIT_MASK 0x4 FORMAT "%13.11" ECU_ADDRESS 0x60006617 /end MEASUREMENT
/begin MEASUREMENT UEGO_RegGetPrmS1B1_I.flgOPTNxtPckVld "Class instance of the functional class of FC UEGO_RegGet for bank 1 sensor 1 / Validity of the OPT register for the next cycle" UBYTE B_TRUE 1 100 0.00 1.00000000000 BIT_MASK 0x8 FORMAT "%13.11" ECU_ADDRESS 0x60006617 /end MEASUREMENT
/begin MEASUREMENT UEGO_RegGetPrmS1B1_I.flgOPTVld "Class instance of the functional class of FC UEGO_RegGet for bank 1 sensor 1 / Validity of the OPT register" UBYTE B_TRUE 1 100 0.00 1.00000000000 BIT_MASK 0x10 FORMAT "%13.11" ECU_ADDRESS 0x60006617 /end MEASUREMENT
/begin MEASUREMENT UEGO_RegGetPrmS1B1_I.flgPatNxtPckVld "Class instance of the functional class of FC UEGO_RegGet for bank 1 sensor 1 / Validity of the PATTERN register for the next cycle" UBYTE B_TRUE 1 100 0.00 1.00000000000 BIT_MASK 0x20 FORMAT "%13.11" ECU_ADDRESS 0x60006617 /end MEASUREMENT
/begin MEASUREMENT UEGO_RegGetPrmS1B1_I.flgPatVld "Class instance of the functional class of FC UEGO_RegGet for bank 1 sensor 1 / Validity of the PATTERN register" UBYTE B_TRUE 1 100 0.00 1.00000000000 BIT_MASK 0x40 FORMAT "%13.11" ECU_ADDRESS 0x60006617 /end MEASUREMENT
/begin MEASUREMENT UEGO_RegGetPrmS1B1_I.flgRCmpHeatrEdgeShiftAllwd "Class instance of the functional class of FC UEGO_RegGet for bank 1 sensor 1 / Status of SWTONRCODMEASOFF register" UBYTE B_TRUE 1 100 0.00 1.00000000000 BIT_MASK 0x1 FORMAT "%13.11" ECU_ADDRESS 0x6000661F /end MEASUREMENT
/begin MEASUREMENT UEGO_RegGetPrmS1B1_I.flgRCmpHeatrEdgeShiftAllwdNxtPck "Class instance of the functional class of FC UEGO_RegGet for bank 1 sensor 1 / Status of SWTONRCODMEASOFF register in the next cycle" UBYTE B_TRUE 1 100 0.00 1.00000000000 BIT_MASK 0x2 FORMAT "%13.11" ECU_ADDRESS 0x6000661F /end MEASUREMENT
/begin MEASUREMENT UEGO_RegGetPrmS1B1_I.flgRCmpHeatrEdgeShiftAllwdNxtPckVld "Class instance of the functional class of FC UEGO_RegGet for bank 1 sensor 1 / Validity of the SWTONRCODMEASOFF register in the next cycle" UBYTE B_TRUE 1 100 0.00 1.00000000000 BIT_MASK 0x4 FORMAT "%13.11" ECU_ADDRESS 0x6000661F /end MEASUREMENT
/begin MEASUREMENT UEGO_RegGetPrmS1B1_I.flgRCmpHeatrEdgeShiftAllwdVld "Class instance of the functional class of FC UEGO_RegGet for bank 1 sensor 1 / Validity of the SWTONRCODMEASOFF register" UBYTE B_TRUE 1 100 0.00 1.00000000000 BIT_MASK 0x8 FORMAT "%13.11" ECU_ADDRESS 0x6000661F /end MEASUREMENT
/begin MEASUREMENT UEGO_RegGetPrmS1B1_I.flgReStab "Class instance of the functional class of FC UEGO_RegGet for bank 1 sensor 1 / Status of the RE_STABLE register" UBYTE B_TRUE 1 100 0.00 1.00000000000 BIT_MASK 0x1 FORMAT "%13.11" ECU_ADDRESS 0x6000661E /end MEASUREMENT
/begin MEASUREMENT UEGO_RegGetPrmS1B1_I.flgReStabVld "Class instance of the functional class of FC UEGO_RegGet for bank 1 sensor 1 / Validity of the RE_STABLE register" UBYTE B_TRUE 1 100 0.00 1.00000000000 BIT_MASK 0x8 FORMAT "%13.11" ECU_ADDRESS 0x6000661C /end MEASUREMENT
/begin MEASUREMENT UEGO_RegGetPrmS1B1_I.flgRefNxtPckVld "Class instance of the functional class of FC UEGO_RegGet for bank 1 sensor 1 / Validity of the REF register for the next cycle" UBYTE B_TRUE 1 100 0.00 1.00000000000 BIT_MASK 0x80 FORMAT "%13.11" ECU_ADDRESS 0x60006617 /end MEASUREMENT
/begin MEASUREMENT UEGO_RegGetPrmS1B1_I.flgRefPatChng "Class instance of the functional class of FC UEGO_RegGet for bank 1 sensor 1 / Change in the validity of the REFPAT register" UBYTE B_TRUE 1 100 0.00 1.00000000000 BIT_MASK 0x4 FORMAT "%13.11" ECU_ADDRESS 0x60006619 /end MEASUREMENT
/begin MEASUREMENT UEGO_RegGetPrmS1B1_I.flgRefPatNxtPckVld "Class instance of the functional class of FC UEGO_RegGet for bank 1 sensor 1 / Validity of the REFPAT register for the next cycle" UBYTE B_TRUE 1 100 0.00 1.00000000000 BIT_MASK 0x10 FORMAT "%13.11" ECU_ADDRESS 0x60006619 /end MEASUREMENT
/begin MEASUREMENT UEGO_RegGetPrmS1B1_I.flgRefPatVld "Class instance of the functional class of FC UEGO_RegGet for bank 1 sensor 1 / Validity of the REFPAT register" UBYTE B_TRUE 1 100 0.00 1.00000000000 BIT_MASK 0x20 FORMAT "%13.11" ECU_ADDRESS 0x60006619 /end MEASUREMENT
/begin MEASUREMENT UEGO_RegGetPrmS1B1_I.flgRefVld "Class instance of the functional class of FC UEGO_RegGet for bank 1 sensor 1 / Validity of the REF register" UBYTE B_TRUE 1 100 0.00 1.00000000000 BIT_MASK 0x20 FORMAT "%13.11" ECU_ADDRESS 0x60006618 /end MEASUREMENT
/begin MEASUREMENT UEGO_RegGetPrmS1B1_I.flgRegIPmpSetNxtPckVld "Class instance of the functional class of FC UEGO_RegGet for bank 1 sensor 1 / Validity of the IPSET register for the next cycle" UBYTE B_TRUE 1 100 0.00 1.00000000000 BIT_MASK 0x40 FORMAT "%13.11" ECU_ADDRESS 0x60006618 /end MEASUREMENT
/begin MEASUREMENT UEGO_RegGetPrmS1B1_I.flgRegIPmpSetVld "Class instance of the functional class of FC UEGO_RegGet for bank 1 sensor 1 / Validity of the IPSET register" UBYTE B_TRUE 1 100 0.00 1.00000000000 BIT_MASK 0x80 FORMAT "%13.11" ECU_ADDRESS 0x60006618 /end MEASUREMENT
/begin MEASUREMENT UEGO_RegGetPrmS1B1_I.flgRegIpoffChng "Class instance of the functional class of FC UEGO_RegGet for bank 1 sensor 1 / Change in the register IPOFF" UBYTE B_TRUE 1 100 0.00 1.00000000000 BIT_MASK 0x40 FORMAT "%13.11" ECU_ADDRESS 0x60006619 /end MEASUREMENT
/begin MEASUREMENT UEGO_RegGetPrmS1B1_I.flgRegIpoffNxtPckVld "Class instance of the functional class of FC UEGO_RegGet for bank 1 sensor 1 / Validity of register IPOFF value for the next cycle" UBYTE B_TRUE 1 100 0.00 1.00000000000 BIT_MASK 0x80 FORMAT "%13.11" ECU_ADDRESS 0x60006619 /end MEASUREMENT
/begin MEASUREMENT UEGO_RegGetPrmS1B1_I.flgRegIpoffVld "Class instance of the functional class of FC UEGO_RegGet for bank 1 sensor 1 / Validity of register IPOFF value" UBYTE B_TRUE 1 100 0.00 1.00000000000 BIT_MASK 0x40 FORMAT "%13.11" ECU_ADDRESS 0x60006615 /end MEASUREMENT
/begin MEASUREMENT UEGO_RegGetPrmS1B1_I.flgRegModNxtPckVld "Class instance of the functional class of FC UEGO_RegGet for bank 1 sensor 1 / Validity of register MODE for the next cycle" UBYTE B_TRUE 1 100 0.00 1.00000000000 BIT_MASK 0x2 FORMAT "%13.11" ECU_ADDRESS 0x6000661E /end MEASUREMENT
/begin MEASUREMENT UEGO_RegGetPrmS1B1_I.flgRegModVld "Class instance of the functional class of FC UEGO_RegGet for bank 1 sensor 1 / Validity of register MODE" UBYTE B_TRUE 1 100 0.00 1.00000000000 BIT_MASK 0x4 FORMAT "%13.11" ECU_ADDRESS 0x6000661E /end MEASUREMENT
/begin MEASUREMENT UEGO_RegGetPrmS1B1_I.flgRegPartModNxtPckVld "Class instance of the functional class of FC UEGO_RegGet for bank 1 sensor 1 / Validity of register MODE for the next cycle" UBYTE B_TRUE 1 100 0.00 1.00000000000 BIT_MASK 0x1 FORMAT "%13.11" ECU_ADDRESS 0x6000661A /end MEASUREMENT
/begin MEASUREMENT UEGO_RegGetPrmS1B1_I.flgRegPartModVld "Class instance of the functional class of FC UEGO_RegGet for bank 1 sensor 1 / Validity of register MODE" UBYTE B_TRUE 1 100 0.00 1.00000000000 BIT_MASK 0x2 FORMAT "%13.11" ECU_ADDRESS 0x6000661A /end MEASUREMENT
/begin MEASUREMENT UEGO_RegGetPrmS1B1_I.flgRegUnsetNxtPckVld "Class instance of the functional class of FC UEGO_RegGet for bank 1 sensor 1 / Validity of register UNSET for the next cycle" UBYTE B_TRUE 1 100 0.00 1.00000000000 BIT_MASK 0x8 FORMAT "%13.11" ECU_ADDRESS 0x6000661E /end MEASUREMENT
/begin MEASUREMENT UEGO_RegGetPrmS1B1_I.flgRiaPatChng "Class instance of the functional class of FC UEGO_RegGet for bank 1 sensor 1 / Change in the status of the RIAPAT register" UBYTE B_TRUE 1 100 0.00 1.00000000000 BIT_MASK 0x8 FORMAT "%13.11" ECU_ADDRESS 0x60006619 /end MEASUREMENT
/begin MEASUREMENT UEGO_RegGetPrmS1B1_I.flgRiaPatVld "Class instance of the functional class of FC UEGO_RegGet for bank 1 sensor 1 / Validity of the RIAPAT register" UBYTE B_TRUE 1 100 0.00 1.00000000000 BIT_MASK 0x8 FORMAT "%13.11" ECU_ADDRESS 0x60006623 /end MEASUREMENT
/begin MEASUREMENT UEGO_RegGetPrmS1B1_I.flgRipVld "Class instance of the functional class of FC UEGO_RegGet for bank 1 sensor 1 / Validity of the RP register" UBYTE B_TRUE 1 100 0.00 1.00000000000 BIT_MASK 0x20 FORMAT "%13.11" ECU_ADDRESS 0x6000661C /end MEASUREMENT
/begin MEASUREMENT UEGO_RegGetPrmS1B1_I.flgSngCell "Class instance of the functional class of FC UEGO_RegGet for bank 1 sensor 1 / Status of the ONE_CEL register" UBYTE B_TRUE 1 100 0.00 1.00000000000 BIT_MASK 0x10 FORMAT "%13.11" ECU_ADDRESS 0x60006623 /end MEASUREMENT
/begin MEASUREMENT UEGO_RegGetPrmS1B1_I.flgSngCellVld "Class instance of the functional class of FC UEGO_RegGet for bank 1 sensor 1 / Validity of the ONE_CEL register" UBYTE B_TRUE 1 100 0.00 1.00000000000 BIT_MASK 0x4 FORMAT "%13.11" ECU_ADDRESS 0x60006614 /end MEASUREMENT
/begin MEASUREMENT UEGO_RegGetPrmS1B1_I.flgSteerPatChng "Class instance of the functional class of FC UEGO_RegGet for bank 1 sensor 1 / Change in the status of the STEERPAT register" UBYTE B_TRUE 1 100 0.00 1.00000000000 BIT_MASK 0x10 FORMAT "%13.11" ECU_ADDRESS 0x6000661E /end MEASUREMENT
/begin MEASUREMENT UEGO_RegGetPrmS1B1_I.flgSteerPatNxtPckVld "Class instance of the functional class of FC UEGO_RegGet for bank 1 sensor 1 / Change in the status of the STEERPAT register for the next cycle" UBYTE B_TRUE 1 100 0.00 1.00000000000 BIT_MASK 0x40 FORMAT "%13.11" ECU_ADDRESS 0x6000661E /end MEASUREMENT
/begin MEASUREMENT UEGO_RegGetPrmS1B1_I.flgSteerPatVld "Class instance of the functional class of FC UEGO_RegGet for bank 1 sensor 1 / Validity for the STEERPAT register" UBYTE B_TRUE 1 100 0.00 1.00000000000 BIT_MASK 0x80 FORMAT "%13.11" ECU_ADDRESS 0x6000661E /end MEASUREMENT
/begin MEASUREMENT UEGO_RegGetPrmS1B1_I.flgSubModMeasNxtPckVld "Class instance of the functional class of FC UEGO_RegGet for bank 1 sensor 1 / Validity of the measured Sub mode register in the next cycle" UBYTE B_TRUE 1 100 0.00 1.00000000000 BIT_MASK 0x10 FORMAT "%13.11" ECU_ADDRESS 0x60006618 /end MEASUREMENT
/begin MEASUREMENT UEGO_RegGetPrmS1B1_I.flgSubModMeasVld "Class instance of the functional class of FC UEGO_RegGet for bank 1 sensor 1 / Validity of the measured Sub mode register" UBYTE B_TRUE 1 100 0.00 1.00000000000 BIT_MASK 0x1 FORMAT "%13.11" ECU_ADDRESS 0x60006617 /end MEASUREMENT
/begin MEASUREMENT UEGO_RegGetPrmS1B1_I.flgSwVirtGnd "Class instance of the functional class of FC UEGO_RegGet for bank 1 sensor 1 / Status of the SW_VG register" UBYTE B_TRUE 1 100 0.00 1.00000000000 BIT_MASK 0x8 FORMAT "%13.11" ECU_ADDRESS 0x60006614 /end MEASUREMENT
/begin MEASUREMENT UEGO_RegGetPrmS1B1_I.flgSwVirtGndVld "Class instance of the functional class of FC UEGO_RegGet for bank 1 sensor 1 / Validity of the SW_VG register" UBYTE B_TRUE 1 100 0.00 1.00000000000 BIT_MASK 0x40 FORMAT "%13.11" ECU_ADDRESS 0x60006623 /end MEASUREMENT
/begin MEASUREMENT UEGO_RegGetPrmS1B1_I.flgTrimSqChng "Class instance of the functional class of FC UEGO_RegGet for bank 1 sensor 1 / Change in Trim register" UBYTE B_TRUE 1 100 0.00 1.00000000000 BIT_MASK 0x10 FORMAT "%13.11" ECU_ADDRESS 0x6000661F /end MEASUREMENT
/begin MEASUREMENT UEGO_RegGetPrmS1B1_I.flgTrimSqrCalChng "Class instance of the functional class of FC UEGO_RegGet for bank 1 sensor 1 / Change in TrimSqr register" UBYTE B_TRUE 1 100 0.00 1.00000000000 BIT_MASK 0x8 FORMAT "%13.11" ECU_ADDRESS 0x6000661B /end MEASUREMENT
/begin MEASUREMENT UEGO_RegGetPrmS1B1_I.flgTrimSqrChng "Class instance of the functional class of FC UEGO_RegGet for bank 1 sensor 1 / Change in Trim register" UBYTE B_TRUE 1 100 0.00 1.00000000000 BIT_MASK 0x40 FORMAT "%13.11" ECU_ADDRESS 0x6000661F /end MEASUREMENT
/begin MEASUREMENT UEGO_RegGetPrmS1B1_I.flgTrmNxtPckVld "Class instance of the functional class of FC UEGO_RegGet for bank 1 sensor 1 / Validity of Trim register" UBYTE B_TRUE 1 100 0.00 1.00000000000 BIT_MASK 0x1 FORMAT "%13.11" ECU_ADDRESS 0x60006620 /end MEASUREMENT
/begin MEASUREMENT UEGO_RegGetPrmS1B1_I.flgTrmSqCalOffSet "Class instance of the functional class of FC UEGO_RegGet for bank 1 sensor 1 / Status of SQMOFFSET register" UBYTE B_TRUE 1 100 0.00 1.00000000000 BIT_MASK 0x80 FORMAT "%13.11" ECU_ADDRESS 0x60006623 /end MEASUREMENT
/begin MEASUREMENT UEGO_RegGetPrmS1B1_I.flgTrmSqCalVld "Class instance of the functional class of FC UEGO_RegGet for bank 1 sensor 1 / Validity of SQM register" UBYTE B_TRUE 1 100 0.00 1.00000000000 BIT_MASK 0x80 FORMAT "%13.11" ECU_ADDRESS 0x60006615 /end MEASUREMENT
/begin MEASUREMENT UEGO_RegGetPrmS1B1_I.flgTrmSqOffSet "Class instance of the functional class of FC UEGO_RegGet for bank 1 sensor 1 / Status of SQOFFSET register" UBYTE B_TRUE 1 100 0.00 1.00000000000 BIT_MASK 0x2 FORMAT "%13.11" ECU_ADDRESS 0x60006624 /end MEASUREMENT
/begin MEASUREMENT UEGO_RegGetPrmS1B1_I.flgTrmSqOffSetVld "Class instance of the functional class of FC UEGO_RegGet for bank 1 sensor 1 / Validity of SQOFFSET register" UBYTE B_TRUE 1 100 0.00 1.00000000000 BIT_MASK 0x2 FORMAT "%13.11" ECU_ADDRESS 0x60006616 /end MEASUREMENT
/begin MEASUREMENT UEGO_RegGetPrmS1B1_I.flgTrmSqVld "Class instance of the functional class of FC UEGO_RegGet for bank 1 sensor 1 / Validity of Trim register" UBYTE B_TRUE 1 100 0.00 1.00000000000 BIT_MASK 0x4 FORMAT "%13.11" ECU_ADDRESS 0x60006620 /end MEASUREMENT
/begin MEASUREMENT UEGO_RegGetPrmS1B1_I.flgTrmSqrCalOffSet "Class instance of the functional class of FC UEGO_RegGet for bank 1 sensor 1 / Status of SQRMOFFSET register" UBYTE B_TRUE 1 100 0.00 1.00000000000 BIT_MASK 0x4 FORMAT "%13.11" ECU_ADDRESS 0x60006624 /end MEASUREMENT
/begin MEASUREMENT UEGO_RegGetPrmS1B1_I.flgTrmSqrCalVld "Class instance of the functional class of FC UEGO_RegGet for bank 1 sensor 1 / Validity of SQRM register" UBYTE B_TRUE 1 100 0.00 1.00000000000 BIT_MASK 0x8 FORMAT "%13.11" ECU_ADDRESS 0x60006616 /end MEASUREMENT
/begin MEASUREMENT UEGO_RegGetPrmS1B1_I.flgTrmSqrOffSet "Class instance of the functional class of FC UEGO_RegGet for bank 1 sensor 1 / Status of SQROFFSET register" UBYTE B_TRUE 1 100 0.00 1.00000000000 BIT_MASK 0x10 FORMAT "%13.11" ECU_ADDRESS 0x60006624 /end MEASUREMENT
/begin MEASUREMENT UEGO_RegGetPrmS1B1_I.flgTrmSqrOffSetVld "Class instance of the functional class of FC UEGO_RegGet for bank 1 sensor 1 / Validity of SQROFFSET register" UBYTE B_TRUE 1 100 0.00 1.00000000000 BIT_MASK 0x2 FORMAT "%13.11" ECU_ADDRESS 0x60006611 /end MEASUREMENT
/begin MEASUREMENT UEGO_RegGetPrmS1B1_I.flgTrmSqrVld "Class instance of the functional class of FC UEGO_RegGet for bank 1 sensor 1 / Validity of Trim register" UBYTE B_TRUE 1 100 0.00 1.00000000000 BIT_MASK 0x2 FORMAT "%13.11" ECU_ADDRESS 0x60006620 /end MEASUREMENT
/begin MEASUREMENT UEGO_RegGetPrmS1B1_I.flgUnsetVld "Class instance of the functional class of FC UEGO_RegGet for bank 1 sensor 1 / Validity for the UNSET register" UBYTE B_TRUE 1 100 0.00 1.00000000000 BIT_MASK 0x8 FORMAT "%13.11" ECU_ADDRESS 0x60006620 /end MEASUREMENT
/begin MEASUREMENT UEGO_RegGetPrmS1B1_I.flgUp0LeanNxtPckVld "Class instance of the functional class of FC UEGO_RegGet for bank 1 sensor 1 / Validity of UP0LEAN register for the next cycle" UBYTE B_TRUE 1 100 0.00 1.00000000000 BIT_MASK 0x10 FORMAT "%13.11" ECU_ADDRESS 0x6000661C /end MEASUREMENT
/begin MEASUREMENT UEGO_RegGetPrmS1B1_I.flgUp0LeanVld "Class instance of the functional class of FC UEGO_RegGet for bank 1 sensor 1 / Validity of UP0LEAN register" UBYTE B_TRUE 1 100 0.00 1.00000000000 BIT_MASK 0x8 FORMAT "%13.11" ECU_ADDRESS 0x6000661A /end MEASUREMENT
/begin MEASUREMENT UEGO_RegGetPrmS1B1_I.flgUp0RichNxtPckVld "Class instance of the functional class of FC UEGO_RegGet for bank 1 sensor 1 / Validity of UP0RICH register for the next cycle" UBYTE B_TRUE 1 100 0.00 1.00000000000 BIT_MASK 0x10 FORMAT "%13.11" ECU_ADDRESS 0x6000661A /end MEASUREMENT
/begin MEASUREMENT UEGO_RegGetPrmS1B1_I.flgUp0RichVld "Class instance of the functional class of FC UEGO_RegGet for bank 1 sensor 1 / Validity of UP0RICH register" UBYTE B_TRUE 1 100 0.00 1.00000000000 BIT_MASK 0x20 FORMAT "%13.11" ECU_ADDRESS 0x6000661A /end MEASUREMENT
/begin MEASUREMENT UEGO_RegGetPrmS1B1_I.flgUria "Class instance of the functional class of FC UEGO_RegGet for bank 1 sensor 1 / Status of URIA register" UBYTE B_TRUE 1 100 0.00 1.00000000000 BIT_MASK 0x10 FORMAT "%13.11" ECU_ADDRESS 0x60006620 /end MEASUREMENT
/begin MEASUREMENT UEGO_RegGetPrmS1B1_I.flgUriaNxtPck "Class instance of the functional class of FC UEGO_RegGet for bank 1 sensor 1 / Status of URIA register for the next cycle" UBYTE B_TRUE 1 100 0.00 1.00000000000 BIT_MASK 0x20 FORMAT "%13.11" ECU_ADDRESS 0x60006620 /end MEASUREMENT
/begin MEASUREMENT UEGO_RegGetPrmS1B1_I.flgUriaNxtPckVld "Class instance of the functional class of FC UEGO_RegGet for bank 1 sensor 1 / Validity of URIA register for the next cycle" UBYTE B_TRUE 1 100 0.00 1.00000000000 BIT_MASK 0x4 FORMAT "%13.11" ECU_ADDRESS 0x60006611 /end MEASUREMENT
/begin MEASUREMENT UEGO_RegGetPrmS1B1_I.flgUriaVld "Class instance of the functional class of FC UEGO_RegGet for bank 1 sensor 1 / Validity of URIA register" UBYTE B_TRUE 1 100 0.00 1.00000000000 BIT_MASK 0x8 FORMAT "%13.11" ECU_ADDRESS 0x60006611 /end MEASUREMENT
/begin MEASUREMENT UEGO_RegGetPrmS1B1_I.flgV1BF2NxtPckVld "Class instance of the functional class of FC UEGO_RegGet for bank 1 sensor 1 / Validity of V1BF2 register for the next cycle" UBYTE B_TRUE 1 100 0.00 1.00000000000 BIT_MASK 0x40 FORMAT "%13.11" ECU_ADDRESS 0x6000661A /end MEASUREMENT
/begin MEASUREMENT UEGO_RegGetPrmS1B1_I.flgV1BF2Vld "Class instance of the functional class of FC UEGO_RegGet for bank 1 sensor 1 / Validity of V1BF2 register" UBYTE B_TRUE 1 100 0.00 1.00000000000 BIT_MASK 0x80 FORMAT "%13.11" ECU_ADDRESS 0x6000661A /end MEASUREMENT
/begin MEASUREMENT UEGO_RegGetPrmS1B1_I.flgV1BF3NxtPckVld "Class instance of the functional class of FC UEGO_RegGet for bank 1 sensor 1 / Validity of V1BF3 register for the next cycle" UBYTE B_TRUE 1 100 0.00 1.00000000000 BIT_MASK 0x40 FORMAT "%13.11" ECU_ADDRESS 0x60006620 /end MEASUREMENT
/begin MEASUREMENT UEGO_RegGetPrmS1B1_I.flgV1BIT1 "Class instance of the functional class of FC UEGO_RegGet for bank 1 sensor 1 / Status of V1BIT1 register" UBYTE B_TRUE 1 100 0.00 1.00000000000 BIT_MASK 0x1 FORMAT "%13.11" ECU_ADDRESS 0x60006621 /end MEASUREMENT
/begin MEASUREMENT UEGO_RegGetPrmS1B1_I.flgV1BIT1NxtPck "Class instance of the functional class of FC UEGO_RegGet for bank 1 sensor 1 / Status of V1BIT1 register for the next cycle" UBYTE B_TRUE 1 100 0.00 1.00000000000 BIT_MASK 0x2 FORMAT "%13.11" ECU_ADDRESS 0x60006621 /end MEASUREMENT
/begin MEASUREMENT UEGO_RegGetPrmS1B1_I.flgV1BIT1NxtPckVld "Class instance of the functional class of FC UEGO_RegGet for bank 1 sensor 1 / Validity of V1BIT1 register for the next cycle" UBYTE B_TRUE 1 100 0.00 1.00000000000 BIT_MASK 0x4 FORMAT "%13.11" ECU_ADDRESS 0x60006621 /end MEASUREMENT
/begin MEASUREMENT UEGO_RegGetPrmS1B1_I.flgV1BIT1Vld "Class instance of the functional class of FC UEGO_RegGet for bank 1 sensor 1 / Validity of V1BIT1 register" UBYTE B_TRUE 1 100 0.00 1.00000000000 BIT_MASK 0x8 FORMAT "%13.11" ECU_ADDRESS 0x60006621 /end MEASUREMENT
/begin MEASUREMENT UEGO_RegGetPrmS1B1_I.flgV1BIT2 "Class instance of the functional class of FC UEGO_RegGet for bank 1 sensor 1 / Status of V1BIT2 register" UBYTE B_TRUE 1 100 0.00 1.00000000000 BIT_MASK 0x10 FORMAT "%13.11" ECU_ADDRESS 0x60006621 /end MEASUREMENT
/begin MEASUREMENT UEGO_RegGetPrmS1B1_I.flgV1BIT2NxtPck "Class instance of the functional class of FC UEGO_RegGet for bank 1 sensor 1 / Status of V1BIT2 register for the next cycle" UBYTE B_TRUE 1 100 0.00 1.00000000000 BIT_MASK 0x20 FORMAT "%13.11" ECU_ADDRESS 0x60006621 /end MEASUREMENT
/begin MEASUREMENT UEGO_RegGetPrmS1B1_I.flgV1BIT2NxtPckVld "Class instance of the functional class of FC UEGO_RegGet for bank 1 sensor 1 / Validity of V1BIT2 register for the next cycle" UBYTE B_TRUE 1 100 0.00 1.00000000000 BIT_MASK 0x10 FORMAT "%13.11" ECU_ADDRESS 0x60006611 /end MEASUREMENT
/begin MEASUREMENT UEGO_RegGetPrmS1B1_I.flgV1BIT2Vld "Class instance of the functional class of FC UEGO_RegGet for bank 1 sensor 1 / Validity of V1BIT2 register" UBYTE B_TRUE 1 100 0.00 1.00000000000 BIT_MASK 0x20 FORMAT "%13.11" ECU_ADDRESS 0x60006611 /end MEASUREMENT
/begin MEASUREMENT UEGO_RegGetPrmS1B1_I.flgV1BIT5 "Class instance of the functional class of FC UEGO_RegGet for bank 1 sensor 1 / Status of V1BIT5 register" UBYTE B_TRUE 1 100 0.00 1.00000000000 BIT_MASK 0x40 FORMAT "%13.11" ECU_ADDRESS 0x60006624 /end MEASUREMENT
/begin MEASUREMENT UEGO_RegGetPrmS1B1_I.flgV1BIT5NxtPck "Class instance of the functional class of FC UEGO_RegGet for bank 1 sensor 1 / Status of V1BIT5 register for the next cycle" UBYTE B_TRUE 1 100 0.00 1.00000000000 BIT_MASK 0x40 FORMAT "%13.11" ECU_ADDRESS 0x60006611 /end MEASUREMENT
/begin MEASUREMENT UEGO_RegGetPrmS1B1_I.flgV1BIT5NxtPckVld "Class instance of the functional class of FC UEGO_RegGet for bank 1 sensor 1 / Validity of V1BIT5 register for the next cycle" UBYTE B_TRUE 1 100 0.00 1.00000000000 BIT_MASK 0x80 FORMAT "%13.11" ECU_ADDRESS 0x60006611 /end MEASUREMENT
/begin MEASUREMENT UEGO_RegGetPrmS1B1_I.flgV1BIT5Vld "Class instance of the functional class of FC UEGO_RegGet for bank 1 sensor 1 / Validity of V1BIT5 register" UBYTE B_TRUE 1 100 0.00 1.00000000000 BIT_MASK 0x80 FORMAT "%13.11" ECU_ADDRESS 0x60006624 /end MEASUREMENT
/begin MEASUREMENT UEGO_RegGetPrmS1B1_I.flgWtrEleclyActv "Class instance of the functional class of FC UEGO_RegGet for bank 1 sensor 1 / Status of V1BIT4 register" UBYTE B_TRUE 1 100 0.00 1.00000000000 BIT_MASK 0x8 FORMAT "%13.11" ECU_ADDRESS 0x6000660E /end MEASUREMENT
/begin MEASUREMENT UEGO_RegGetPrmS1B1_I.flgWtrEleclyActvNxtPck "Class instance of the functional class of FC UEGO_RegGet for bank 1 sensor 1 / Status of V1BIT4 register for the next cycle" UBYTE B_TRUE 1 100 0.00 1.00000000000 BIT_MASK 0x80 FORMAT "%13.11" ECU_ADDRESS 0x60006621 /end MEASUREMENT
/begin MEASUREMENT UEGO_RegGetPrmS1B1_I.flgWtrEleclyActvNxtPckVld "Class instance of the functional class of FC UEGO_RegGet for bank 1 sensor 1 / Validity of V1BIT4 register for the next cycle" UBYTE B_TRUE 1 100 0.00 1.00000000000 BIT_MASK 0x1 FORMAT "%13.11" ECU_ADDRESS 0x60006614 /end MEASUREMENT
/begin MEASUREMENT UEGO_RegGetPrmS1B1_I.flgWtrEleclyActvVld "Class instance of the functional class of FC UEGO_RegGet for bank 1 sensor 1 / Validity of V1BIT4 register" UBYTE B_TRUE 1 100 0.00 1.00000000000 BIT_MASK 0x40 FORMAT "%13.11" ECU_ADDRESS 0x60006616 /end MEASUREMENT
/begin MEASUREMENT UEGO_RegGetPrmS1B1_I.flgZIsqrA "Class instance of the functional class of FC UEGO_RegGet for bank 1 sensor 1 / Status of Z_ISQRA register" UBYTE B_TRUE 1 100 0.00 1.00000000000 BIT_MASK 0x1 FORMAT "%13.11" ECU_ADDRESS 0x6000661B /end MEASUREMENT
/begin MEASUREMENT UEGO_RegGetPrmS1B1_I.flgZIsqrAVld "Class instance of the functional class of FC UEGO_RegGet for bank 1 sensor 1 / Validity of Z_ISQRA register" UBYTE B_TRUE 1 100 0.00 1.00000000000 BIT_MASK 0x10 FORMAT "%13.11" ECU_ADDRESS 0x6000661B /end MEASUREMENT
/begin MEASUREMENT UEGO_RegGetPrmS1B1_I.flgZIsqrE "Class instance of the functional class of FC UEGO_RegGet for bank 1 sensor 1 / Status of Z_ISQRE register" UBYTE B_TRUE 1 100 0.00 1.00000000000 BIT_MASK 0x20 FORMAT "%13.11" ECU_ADDRESS 0x6000661B /end MEASUREMENT
/begin MEASUREMENT UEGO_RegGetPrmS1B1_I.flgZIsqrEVld "Class instance of the functional class of FC UEGO_RegGet for bank 1 sensor 1 / Validity of Z_ISQRE register" UBYTE B_TRUE 1 100 0.00 1.00000000000 BIT_MASK 0x1 FORMAT "%13.11" ECU_ADDRESS 0x6000661C /end MEASUREMENT
/begin MEASUREMENT UEGO_RegGetPrmS1B1_I.nrIPmpBlcknNxtPck "Class instance of the functional class of FC UEGO_RegGet for bank 1 sensor 1 / Status of IPBLACK register for the next cycle" SWORD dez 1 100 -32768.00 32767.00 FORMAT "%8.2" ECU_ADDRESS 0x60006626 /end MEASUREMENT
/begin MEASUREMENT UEGO_RegGetPrmS1B1_I.nrIPmpLimnHi "Class instance of the functional class of FC UEGO_RegGet for bank 1 sensor 1 / maximum pump current limitation" SWORD dez 1 100 -32768.00 32767.00 FORMAT "%8.2" ECU_ADDRESS 0x60006628 /end MEASUREMENT
/begin MEASUREMENT UEGO_RegGetPrmS1B1_I.nrIPmpLimnLo "Class instance of the functional class of FC UEGO_RegGet for bank 1 sensor 1 / minimum pump current limitation" SWORD dez 1 100 -32768.00 32767.00 FORMAT "%8.2" ECU_ADDRESS 0x6000662A /end MEASUREMENT
/begin MEASUREMENT UEGO_RegGetPrmS1B1_I.nrPmpBlckn "Class instance of the functional class of FC UEGO_RegGet for bank 1 sensor 1 / Status of IPBLACK register" SWORD dez 1 100 -32768.00 32767.00 FORMAT "%8.2" ECU_ADDRESS 0x6000662C /end MEASUREMENT
/begin MEASUREMENT UEGO_RegGetPrmS1B1_I.nrRefPatNxtPck "Class instance of the functional class of FC UEGO_RegGet for bank 1 sensor 1 / Status of the REFPAT register for the next cycle" UWORD dez 1 100 0.00 65535.00 FORMAT "%8.2" ECU_ADDRESS 0x6000662E /end MEASUREMENT
/begin MEASUREMENT UEGO_RegGetPrmS1B1_I.nrRegIPmpSet "Class instance of the functional class of FC UEGO_RegGet for bank 1 sensor 1 / Status of the IPSET register" SWORD dez 1 100 -32768.00 32767.00 FORMAT "%8.2" ECU_ADDRESS 0x60006630 /end MEASUREMENT
/begin MEASUREMENT UEGO_RegGetPrmS1B1_I.nrRegIPmpSetNxtPck "Class instance of the functional class of FC UEGO_RegGet for bank 1 sensor 1 / Status of the IPSET register for the next cycle" SWORD dez 1 100 -32768.00 32767.00 FORMAT "%8.2" ECU_ADDRESS 0x60006632 /end MEASUREMENT
/begin MEASUREMENT UEGO_RegGetPrmS1B1_I.nrRegIpoff "Class instance of the functional class of FC UEGO_RegGet for bank 1 sensor 1 / Status of the IPOFF register" SWORD dez 1 100 -32768.00 32767.00 FORMAT "%8.2" ECU_ADDRESS 0x60006634 /end MEASUREMENT
/begin MEASUREMENT UEGO_RegGetPrmS1B1_I.nrRegMod "Class instance of the functional class of FC UEGO_RegGet for bank 1 sensor 1 / Status of the MODE register" UWORD dez 1 100 0.00 65535.00 FORMAT "%8.2" ECU_ADDRESS 0x60006636 /end MEASUREMENT
/begin MEASUREMENT UEGO_RegGetPrmS1B1_I.nrRegModNxtPck "Class instance of the functional class of FC UEGO_RegGet for bank 1 sensor 1 / Status of the MODE register for next cycle" UWORD dez 1 100 0.00 65535.00 FORMAT "%8.2" ECU_ADDRESS 0x60006638 /end MEASUREMENT
/begin MEASUREMENT UEGO_RegGetPrmS1B1_I.nrRegPartMod "Class instance of the functional class of FC UEGO_RegGet for bank 1 sensor 1 / Status of the REGPART MODE register" UBYTE UEGO_AsicState_COMPU_VERB 1 100 0.00 7.00000000000 FORMAT "%13.11" ECU_ADDRESS 0x6000663A /end MEASUREMENT
/begin MEASUREMENT UEGO_RegGetPrmS1B1_I.nrRegPartModNxtPck "Class instance of the functional class of FC UEGO_RegGet for bank 1 sensor 1 / Status of the REGPART MODE register for the next cycle" UBYTE UEGO_AsicState_COMPU_VERB 1 100 0.00 7.00000000000 FORMAT "%13.11" ECU_ADDRESS 0x6000663B /end MEASUREMENT
/begin MEASUREMENT UEGO_RegGetPrmS1B1_I.nrRegTrmNxtPck "Class instance of the functional class of FC UEGO_RegGet for bank 1 sensor 1 / Status of the TRIM register" UWORD dez 1 100 0.00 65535.00 FORMAT "%8.2" ECU_ADDRESS 0x6000663C /end MEASUREMENT
/begin MEASUREMENT UEGO_RegGetPrmS1B1_I.nrRegTrmSqNxtPck "Class instance of the functional class of FC UEGO_RegGet for bank 1 sensor 1 / Status of the TRIMSQ register for the next cycle" UBYTE dez 1 100 0.00 255.0 FORMAT "%5.1" ECU_ADDRESS 0x6000663E /end MEASUREMENT
/begin MEASUREMENT UEGO_RegGetPrmS1B1_I.nrRegTrmSqrNxtPck "Class instance of the functional class of FC UEGO_RegGet for bank 1 sensor 1 / Status of the TRIMSQR register for the next cycle" UBYTE dez 1 100 0.00 255.0 FORMAT "%5.1" ECU_ADDRESS 0x6000663F /end MEASUREMENT
/begin MEASUREMENT UEGO_RegGetPrmS1B1_I.nrRip "Class instance of the functional class of FC UEGO_RegGet for bank 1 sensor 1 / Status of the RP register" UWORD dez 1 100 0.00 65535.00 FORMAT "%8.2" ECU_ADDRESS 0x60006640 /end MEASUREMENT
/begin MEASUREMENT UEGO_RegGetPrmS1B1_I.nrSteerPatNxtPck "Class instance of the functional class of FC UEGO_RegGet for bank 1 sensor 1 / Status of the STEERPAT register for the next cycle" UWORD dez 1 100 0.00 65535.00 FORMAT "%8.2" ECU_ADDRESS 0x60006642 /end MEASUREMENT
/begin MEASUREMENT UEGO_RegGetPrmS1B1_I.nrSubModMeas "Class instance of the functional class of FC UEGO_RegGet for bank 1 sensor 1 / Status of the measured Sub mode register" UBYTE dez 1 100 0.00 255.0 FORMAT "%5.1" ECU_ADDRESS 0x60006644 /end MEASUREMENT
/begin MEASUREMENT UEGO_RegGetPrmS1B1_I.nrSubModMeasNxtPck "Class instance of the functional class of FC UEGO_RegGet for bank 1 sensor 1 / Status of the measured Sub mode register in the next cycle" UBYTE dez 1 100 0.00 255.0 FORMAT "%5.1" ECU_ADDRESS 0x60006645 /end MEASUREMENT
/begin MEASUREMENT UEGO_RegGetPrmS1B1_I.nrTrmSq "Class instance of the functional class of FC UEGO_RegGet for bank 1 sensor 1 / Status of the TRIMSQ register" UBYTE dez 1 100 0.00 255.0 FORMAT "%5.1" ECU_ADDRESS 0x60006646 /end MEASUREMENT
/begin MEASUREMENT UEGO_RegGetPrmS1B1_I.nrTrmSqCal "Class instance of the functional class of FC UEGO_RegGet for bank 1 sensor 1 / Status of the SQM register" UBYTE dez 1 100 0.00 255.0 FORMAT "%5.1" ECU_ADDRESS 0x60006647 /end MEASUREMENT
/begin MEASUREMENT UEGO_RegGetPrmS1B1_I.nrTrmSqr "Class instance of the functional class of FC UEGO_RegGet for bank 1 sensor 1 / Status of the SQR register" UBYTE dez 1 100 0.00 255.0 FORMAT "%5.1" ECU_ADDRESS 0x60006648 /end MEASUREMENT
/begin MEASUREMENT UEGO_RegGetPrmS1B1_I.nrTrmSqrCal "Class instance of the functional class of FC UEGO_RegGet for bank 1 sensor 1 / Status of the SQRM register" UBYTE dez 1 100 0.00 255.0 FORMAT "%5.1" ECU_ADDRESS 0x60006649 /end MEASUREMENT
/begin MEASUREMENT UEGO_RegGetPrmS1B1_I.nrUnset "Class instance of the functional class of FC UEGO_RegGet for bank 1 sensor 1 / Status of the UNSET register" SWORD dez 1 100 -32768.00 32767.00 FORMAT "%8.2" ECU_ADDRESS 0x6000664A /end MEASUREMENT
/begin MEASUREMENT UEGO_RegGetPrmS1B1_I.nrUnsetNxtPck "Class instance of the functional class of FC UEGO_RegGet for bank 1 sensor 1 / Status of the UNSET register for the next cycle" SWORD dez 1 100 -32768.00 32767.00 FORMAT "%8.2" ECU_ADDRESS 0x6000664C /end MEASUREMENT
/begin MEASUREMENT UEGO_RegGetPrmS1B1_I.nrUp0Lean "Class instance of the functional class of FC UEGO_RegGet for bank 1 sensor 1 / Status of the UP0LEAN register" SWORD dez 1 100 -32768.00 32767.00 FORMAT "%8.2" ECU_ADDRESS 0x6000664E /end MEASUREMENT
/begin MEASUREMENT UEGO_RegGetPrmS1B1_I.nrUp0LeanNxtPck "Class instance of the functional class of FC UEGO_RegGet for bank 1 sensor 1 / Status of the UP0LEAN register for the next cycle" SWORD dez 1 100 -32768.00 32767.00 FORMAT "%8.2" ECU_ADDRESS 0x60006650 /end MEASUREMENT
/begin MEASUREMENT UEGO_RegGetPrmS1B1_I.nrUp0Rich "Class instance of the functional class of FC UEGO_RegGet for bank 1 sensor 1 / Status of the UP0RICH" SWORD dez 1 100 -32768.00 32767.00 FORMAT "%8.2" ECU_ADDRESS 0x60006652 /end MEASUREMENT
/begin MEASUREMENT UEGO_RegGetPrmS1B1_I.nrUp0RichNxtPck "Class instance of the functional class of FC UEGO_RegGet for bank 1 sensor 1 / Status of the UP0RICH for the next cycle" SWORD dez 1 100 -32768.00 32767.00 FORMAT "%8.2" ECU_ADDRESS 0x60006654 /end MEASUREMENT
/begin MEASUREMENT UEGO_RegGetPrmS1B1_I.stDlyBlckn "Class instance of the functional class of FC UEGO_RegGet for bank 1 sensor 1 / Status of the THYS_BLACK" UBYTE dez 1 100 0.00 255.0 FORMAT "%5.1" ECU_ADDRESS 0x60006656 /end MEASUREMENT
/begin MEASUREMENT UEGO_RegGetPrmS1B1_I.stDlyBlcknNxtPck "Class instance of the functional class of FC UEGO_RegGet for bank 1 sensor 1 / Status of the THYS_BLACK for the next cycle" UBYTE dez 1 100 0.00 255.0 FORMAT "%5.1" ECU_ADDRESS 0x60006657 /end MEASUREMENT
/begin MEASUREMENT UEGO_RegGetPrmS1B1_I.stEnSp "Class instance of the functional class of FC UEGO_RegGet for bank 1 sensor 1 / Status of the EN_SP_AN" UBYTE dez 1 100 0.00 255.0 FORMAT "%5.1" ECU_ADDRESS 0x60006658 /end MEASUREMENT
/begin MEASUREMENT UEGO_RegGetPrmS1B1_I.stEnSpNxtPck "Class instance of the functional class of FC UEGO_RegGet for bank 1 sensor 1 / Status of the EN_SP_AN for the next cycle" UBYTE dez 1 100 0.00 255.0 FORMAT "%5.1" ECU_ADDRESS 0x60006659 /end MEASUREMENT
/begin MEASUREMENT UEGO_RegGetPrmS1B1_I.stMK "Class instance of the functional class of FC UEGO_RegGet for bank 1 sensor 1 / Status of the MK register" UBYTE dez 1 100 0.00 255.0 FORMAT "%5.1" ECU_ADDRESS 0x6000665A /end MEASUREMENT
/begin MEASUREMENT UEGO_RegGetPrmS1B1_I.stMKNxtPck "Class instance of the functional class of FC UEGO_RegGet for bank 1 sensor 1 / Status of the MK register for the next cycle" UBYTE dez 1 100 0.00 255.0 FORMAT "%5.1" ECU_ADDRESS 0x6000665B /end MEASUREMENT
/begin MEASUREMENT UEGO_RegGetPrmS1B1_I.stOFF "Class instance of the functional class of FC UEGO_RegGet for bank 1 sensor 1 / Status of the OFF register" UBYTE dez 1 100 0.00 255.0 FORMAT "%5.1" ECU_ADDRESS 0x6000665C /end MEASUREMENT
/begin MEASUREMENT UEGO_RegGetPrmS1B1_I.stOFFNxtPck "Class instance of the functional class of FC UEGO_RegGet for bank 1 sensor 1 / Status of the OFF register for the next cycle" UBYTE dez 1 100 0.00 255.0 FORMAT "%5.1" ECU_ADDRESS 0x6000665D /end MEASUREMENT
/begin MEASUREMENT UEGO_RegGetPrmS1B1_I.stOPT "Class instance of the functional class of FC UEGO_RegGet for bank 1 sensor 1 / Status of the OPT register" UBYTE dez 1 100 0.00 255.0 FORMAT "%5.1" ECU_ADDRESS 0x6000665E /end MEASUREMENT
/begin MEASUREMENT UEGO_RegGetPrmS1B1_I.stOPTNxtPck "Class instance of the functional class of FC UEGO_RegGet for bank 1 sensor 1 / Status of the OPT register for the next cycle" UBYTE dez 1 100 0.00 255.0 FORMAT "%5.1" ECU_ADDRESS 0x6000665F /end MEASUREMENT
/begin MEASUREMENT UEGO_RegGetPrmS1B1_I.stPat "Class instance of the functional class of FC UEGO_RegGet for bank 1 sensor 1 / Status of the PATTERN register" UWORD dez 1 100 0.00 65535.00 FORMAT "%8.2" ECU_ADDRESS 0x60006660 /end MEASUREMENT
/begin MEASUREMENT UEGO_RegGetPrmS1B1_I.stPatNxtPck "Class instance of the functional class of FC UEGO_RegGet for bank 1 sensor 1 / Status of the PATTERN register for the next cycle" UWORD dez 1 100 0.00 65535.00 FORMAT "%8.2" ECU_ADDRESS 0x60006662 /end MEASUREMENT
/begin MEASUREMENT UEGO_RegGetPrmS1B1_I.stRef "Class instance of the functional class of FC UEGO_RegGet for bank 1 sensor 1 / Status of the REF register" UBYTE dez 1 100 0.00 255.0 FORMAT "%5.1" ECU_ADDRESS 0x60006664 /end MEASUREMENT
/begin MEASUREMENT UEGO_RegGetPrmS1B1_I.stRefNxtPck "Class instance of the functional class of FC UEGO_RegGet for bank 1 sensor 1 / Status of the REF register for the next cycle" UBYTE dez 1 100 0.00 255.0 FORMAT "%5.1" ECU_ADDRESS 0x60006665 /end MEASUREMENT
/begin MEASUREMENT UEGO_RegGetPrmS1B1_I.stRefPat "Class instance of the functional class of FC UEGO_RegGet for bank 1 sensor 1 / Status of the REFPAT register" UWORD dez 1 100 0.00 65535.00 FORMAT "%8.2" ECU_ADDRESS 0x60006666 /end MEASUREMENT
/begin MEASUREMENT UEGO_RegGetPrmS1B1_I.stRegIpoffNxtPck "Class instance of the functional class of FC UEGO_RegGet for bank 1 sensor 1 / Status of the IPOFF register" SWORD dez 1 100 -32768.00 32767.00 FORMAT "%8.2" ECU_ADDRESS 0x60006668 /end MEASUREMENT
/begin MEASUREMENT UEGO_RegGetPrmS1B1_I.stRiaPat "Class instance of the functional class of FC UEGO_RegGet for bank 1 sensor 1 / Status of the RIAPAT register" UWORD dez 1 100 0.00 65535.00 FORMAT "%8.2" ECU_ADDRESS 0x6000666A /end MEASUREMENT
/begin MEASUREMENT UEGO_RegGetPrmS1B1_I.stSteerPat "Class instance of the functional class of FC UEGO_RegGet for bank 1 sensor 1 / Status of the STEERPAT register" UWORD dez 1 100 0.00 65535.00 FORMAT "%8.2" ECU_ADDRESS 0x6000666C /end MEASUREMENT
/begin MEASUREMENT UEGO_RegGetPrmS1B1_I.stV1BF2 "Class instance of the functional class of FC UEGO_RegGet for bank 1 sensor 1 / Status of the V1BF2 register" UBYTE dez 1 100 0.00 255.0 FORMAT "%5.1" ECU_ADDRESS 0x6000666E /end MEASUREMENT
/begin MEASUREMENT UEGO_RegGetPrmS1B1_I.stV1BF2NxtPck "Class instance of the functional class of FC UEGO_RegGet for bank 1 sensor 1 / Status of the V1BF2 register for the next cycle" UBYTE dez 1 100 0.00 255.0 FORMAT "%5.1" ECU_ADDRESS 0x6000666F /end MEASUREMENT
/begin MEASUREMENT UEGO_RegGetPrmS1B1_I.stV1BF3NxtPck "Class instance of the functional class of FC UEGO_RegGet for bank 1 sensor 1 / Status of the V1BF3 register for the next cycle" UBYTE dez 1 100 0.00 255.0 FORMAT "%5.1" ECU_ADDRESS 0x60006670 /end MEASUREMENT
/begin MEASUREMENT UEGO_RegSetS1B1_I.cntrRegSet "Class instance of the functional class of FC UEGO_RegSet for Bank 1 Sensor 1 / Counter of setting registers" UBYTE dez 1 100 0.00 255.0 FORMAT "%5.1" ECU_ADDRESS 0x6000206A /end MEASUREMENT
/begin MEASUREMENT UEGO_RegSetS1B1_I.flgCJ135An "Class instance of the functional class of FC UEGO_RegSet for Bank 1 Sensor 1 / CJ135 analogue present" UBYTE B_TRUE 1 100 0.00 1.00000000000 BIT_MASK 0x40 FORMAT "%13.11" ECU_ADDRESS 0x60002068 /end MEASUREMENT
/begin MEASUREMENT UEGO_RegSetS1B1_I.flgConvVld "Class instance of the functional class of FC UEGO_RegSet for Bank 1 Sensor 1 / convolution validity" UBYTE B_TRUE 1 100 0.00 1.00000000000 BIT_MASK 0x1 FORMAT "%13.11" ECU_ADDRESS 0x6000206B /end MEASUREMENT
/begin MEASUREMENT UEGO_RegSetS1B1_I.flgIPmpDes "Class instance of the functional class of FC UEGO_RegSet for Bank 1 Sensor 1 / Pump current desired" UBYTE B_TRUE 1 100 0.00 1.00000000000 BIT_MASK 0x1 FORMAT "%13.11" ECU_ADDRESS 0x60002069 /end MEASUREMENT
/begin MEASUREMENT UEGO_RegSetS1B1_I.flgIPmpPhyRels "Class instance of the functional class of FC UEGO_RegSet for Bank 1 Sensor 1 / pump current release" UBYTE B_TRUE 1 100 0.00 1.00000000000 BIT_MASK 0x1 FORMAT "%13.11" ECU_ADDRESS 0x6000206C /end MEASUREMENT
/begin MEASUREMENT UEGO_RegSetS1B1_I.flgIniFinshd "Class instance of the functional class of FC UEGO_RegSet for Bank 1 Sensor 1 / initialisation finished" UBYTE B_TRUE 1 100 0.00 1.00000000000 BIT_MASK 0x20 FORMAT "%13.11" ECU_ADDRESS 0x60002068 /end MEASUREMENT
/begin MEASUREMENT UEGO_RegSetS1B1_I.flgLoupeCURRDes "Class instance of the functional class of FC UEGO_RegSet for Bank 1 Sensor 1 / Desired stat of Loupe CURR" UBYTE B_TRUE 1 100 0.00 1.00000000000 BIT_MASK 0x8 FORMAT "%13.11" ECU_ADDRESS 0x60002068 /end MEASUREMENT
/begin MEASUREMENT UEGO_RegSetS1B1_I.flgLoupeDACDes "Class instance of the functional class of FC UEGO_RegSet for Bank 1 Sensor 1 / Desired state of Loupe DAC" UBYTE B_TRUE 1 100 0.00 1.00000000000 BIT_MASK 0x2 FORMAT "%13.11" ECU_ADDRESS 0x60002069 /end MEASUREMENT
/begin MEASUREMENT UEGO_RegSetS1B1_I.flgLoupeNDes "Class instance of the functional class of FC UEGO_RegSet for Bank 1 Sensor 1 / loupe nernst desired" UBYTE B_TRUE 1 100 0.00 1.00000000000 BIT_MASK 0x80 FORMAT "%13.11" ECU_ADDRESS 0x60002068 /end MEASUREMENT
/begin MEASUREMENT UEGO_RegSetS1B1_I.flgLoupePDes "Class instance of the functional class of FC UEGO_RegSet for Bank 1 Sensor 1 / loupe pump desired" UBYTE B_TRUE 1 100 0.00 1.00000000000 BIT_MASK 0x10 FORMAT "%13.11" ECU_ADDRESS 0x60002068 /end MEASUREMENT
/begin MEASUREMENT UEGO_RegSetS1B1_I.flgNewReq "Class instance of the functional class of FC UEGO_RegSet for Bank 1 Sensor 1 / new register requested" UBYTE B_TRUE 1 100 0.00 1.00000000000 BIT_MASK 0x2 FORMAT "%13.11" ECU_ADDRESS 0x60002068 /end MEASUREMENT
/begin MEASUREMENT UEGO_RegSetS1B1_I.flgRegSetSt "Class instance of the functional class of FC UEGO_RegSet for Bank 1 Sensor 1 / flag giving the successful transmission of register values to the ASIC" UBYTE B_TRUE 1 100 0.00 1.00000000000 BIT_MASK 0x1 FORMAT "%13.11" ECU_ADDRESS 0x6000206D /end MEASUREMENT
/begin MEASUREMENT UEGO_RegSetS1B1_I.flgRegSetStVld "Class instance of the functional class of FC UEGO_RegSet for Bank 1 Sensor 1 / validity of the transmissionstate of register values to the ASIC" UBYTE B_TRUE 1 100 0.00 1.00000000000 BIT_MASK 0x1 FORMAT "%13.11" ECU_ADDRESS 0x6000206E /end MEASUREMENT
/begin MEASUREMENT UEGO_RegSetS1B1_I.flgReqAcptd "Class instance of the functional class of FC UEGO_RegSet for Bank 1 Sensor 1 / new register request accepted" UBYTE B_TRUE 1 100 0.00 1.00000000000 BIT_MASK 0x1 FORMAT "%13.11" ECU_ADDRESS 0x6000206F /end MEASUREMENT
/begin MEASUREMENT UEGO_RegSetS1B1_I.flgSetRegOk "Class instance of the functional class of FC UEGO_RegSet for Bank 1 Sensor 1 / register setting successful" UBYTE B_TRUE 1 100 0.00 1.00000000000 BIT_MASK 0x4 FORMAT "%13.11" ECU_ADDRESS 0x60002068 /end MEASUREMENT
/begin MEASUREMENT UEGO_RegSetS1B1_I.flgTakeDataOk "Class instance of the functional class of FC UEGO_RegSet for Bank 1 Sensor 1 / successful copy of register values from buffer to ASIC" UBYTE B_TRUE 1 100 0.00 1.00000000000 BIT_MASK 0x1 FORMAT "%13.11" ECU_ADDRESS 0x60002070 /end MEASUREMENT
/begin MEASUREMENT UEGO_RegSetS1B1_I.idxChp "Class instance of the functional class of FC UEGO_RegSet for Bank 1 Sensor 1 / chip type" ULONG OneToOne 1 100 0.00 4294967295.00 FORMAT "%13.2" ECU_ADDRESS 0x60002074 /end MEASUREMENT
/begin MEASUREMENT UEGO_RegSetS1B1_I.nrIdleSubMode "Class instance of the functional class of FC UEGO_RegSet for Bank 1 Sensor 1 / request for submode idle" UWORD OneToOne 1 100 0.00 65535.00 FORMAT "%8.2" ECU_ADDRESS 0x60002078 /end MEASUREMENT
/begin MEASUREMENT UEGO_RegSetS1B1_I.nrModDes "Class instance of the functional class of FC UEGO_RegSet for Bank 1 Sensor 1 / desired ASIC mode" UBYTE UEGO_AsicState_COMPU_VERB 1 100 0.00 7.00000000000 FORMAT "%13.11" ECU_ADDRESS 0x6000207A /end MEASUREMENT
/begin MEASUREMENT UEGO_RegSetS1B1_I.nrNormSubMode "Class instance of the functional class of FC UEGO_RegSet for Bank 1 Sensor 1 / request for submode normal" UWORD OneToOne 1 100 0.00 65535.00 FORMAT "%8.2" ECU_ADDRESS 0x6000207C /end MEASUREMENT
/begin MEASUREMENT UEGO_RegSetS1B1_I.nrRegSet "Class instance of the functional class of FC UEGO_RegSet for Bank 1 Sensor 1 / register value set in the IPOFF register during requested submodes." SWORD OneToOne 1 100 -6012.000 6012.000 FORMAT "%8.3" ECU_ADDRESS 0x6000207E /end MEASUREMENT
/begin MEASUREMENT UEGO_RegSetS1B1_I.nrSubModDes "Class instance of the functional class of FC UEGO_RegSet for Bank 1 Sensor 1 / Desired submode" UBYTE dez 1 100 0.00 15.00 FORMAT "%5.2" ECU_ADDRESS 0x60002080 /end MEASUREMENT
/begin MEASUREMENT UEGO_RegSetS1B1_I.nrSwtOnSubMode "Class instance of the functional class of FC UEGO_RegSet for Bank 1 Sensor 1 / request for submode switchon" UWORD OneToOne 1 100 0.00 65535.00 FORMAT "%8.2" ECU_ADDRESS 0x60002082 /end MEASUREMENT
/begin MEASUREMENT UEGO_RegSetS1B1_I.nrTrmSq "Class instance of the functional class of FC UEGO_RegSet for Bank 1 Sensor 1 / ISQ register value." UBYTE dez 1 100 0.00 127.0 FORMAT "%5.1" ECU_ADDRESS 0x60002084 /end MEASUREMENT
/begin MEASUREMENT UEGO_RegSetS1B1_I.nrWrmUpSubMode "Class instance of the functional class of FC UEGO_RegSet for Bank 1 Sensor 1 / request for submode warmup" UWORD OneToOne 1 100 0.00 65535.00 FORMAT "%8.2" ECU_ADDRESS 0x60002086 /end MEASUREMENT
/begin MEASUREMENT UEGO_RegSetS1B1_I.stRegSet "Class instance of the functional class of FC UEGO_RegSet for Bank 1 Sensor 1 / status of register setting" UBYTE OneToOne 1 100 0.00 255.0 FORMAT "%5.1" ECU_ADDRESS 0x60002088 /end MEASUREMENT
/begin MEASUREMENT UEGO_RegSetS1B1_I.stRegSetVld "Class instance of the functional class of FC UEGO_RegSet for Bank 1 Sensor 1 / validity of register setting" UBYTE OneToOne 1 100 0.00 255.0 FORMAT "%5.1" ECU_ADDRESS 0x60002089 /end MEASUREMENT
/begin MEASUREMENT UEGO_RegSetS1B1_I.tmpVar "Class instance of the functional class of FC UEGO_RegSet for Bank 1 Sensor 1 / Temporory variable to remove MISRA warning" UBYTE B_TRUE 1 100 0.00 1.00000000000 BIT_MASK 0x1 FORMAT "%13.11" ECU_ADDRESS 0x6000208A /end MEASUREMENT
/begin MEASUREMENT UEGO_rRCmpS1B1 "calculated plug resistor sensor 1 bank 1" UWORD r_q0p1_Ohm 1 100 0.00 6553.500 FORMAT "%8.3" ECU_ADDRESS 0x60008B62 /end MEASUREMENT
/begin MEASUREMENT UEGO_rRParlS1B1 "Calculated parallel resistance between APE and MES for Bank 1 Sensor 1" UWORD r_q0p1_Ohm 1 100 0.00 6553.500 FORMAT "%8.3" ECU_ADDRESS 0x60008B5C /end MEASUREMENT
/begin MEASUREMENT UEGO_stO2VldS1B1 "Status bit for O2 signal validity" UBYTE OneToOne 1 100 0.00 255.0 FORMAT "%5.1" ECU_ADDRESS 0x6000F313 /end MEASUREMENT
/begin FUNCTION UEGO_ModCtrl "1.16.0    UEGO Mode sequence control"
 /begin DEF_CHARACTERISTIC UEGO_nrSubModEnf_C UEGO_nrSubModNormPrio_CA UEGO_nrSubModSwtOnPrio_CA UEGO_stModCtrl_C UEGO_tiModSwtOnDly_C UEGO_uRegFusks_C /end DEF_CHARACTERISTIC
 /begin IN_MEASUREMENT UEGO_DataSplyClsS1B1_I.flgCj135An UEGO_DataSplyClsS1B1_I.flgDACOff UEGO_DataSplyClsS1B1_I.flgErrSpiRamRet UEGO_DataSplyClsS1B1_I.flgFKal1Vld UEGO_DataSplyClsS1B1_I.flgFKal2Vld UEGO_DataSplyClsS1B1_I.flgFKal3Vld UEGO_DataSplyClsS1B1_I.flgIPmpActvd UEGO_DataSplyClsS1B1_I.flgISQrA UEGO_DataSplyClsS1B1_I.flgISQrE UEGO_DataSplyClsS1B1_I.flgLCURR UEGO_DataSplyClsS1B1_I.flgLNMeas UEGO_DataSplyClsS1B1_I.flgLPMeas UEGO_DataSplyClsS1B1_I.flgLoupeCAL UEGO_DataSplyClsS1B1_I.flgLoupeG0 UEGO_DataSplyClsS1B1_I.flgLstPckAbort UEGO_DataSplyClsS1B1_I.flgMKA UEGO_DataSplyClsS1B1_I.flgMKE UEGO_DataSplyClsS1B1_I.flgNewIPmpDacPckAry UEGO_DataSplyClsS1B1_I.flgNewIPmpOK UEGO_DataSplyClsS1B1_I.flgNewIPmpPckAry UEGO_DataSplyClsS1B1_I.flgNewIPmpTM UEGO_DataSplyClsS1B1_I.flgNewPck UEGO_DataSplyClsS1B1_I.flgNewPckCstnc UEGO_DataSplyClsS1B1_I.flgNewPckMiss UEGO_DataSplyClsS1B1_I.flgNewPckVld UEGO_DataSplyClsS1B1_I.flgNewTiPck UEGO_DataSplyClsS1B1_I.flgNewURmVG4MeasAryVld UEGO_DataSplyClsS1B1_I.flgNewUa2Pck UEGO_DataSplyClsS1B1_I.flgNewUa31Pck UEGO_DataSplyClsS1B1_I.flgNewUa32Pck UEGO_DataSplyClsS1B1_I.flgNewUa33Pck UEGO_DataSplyClsS1B1_I.flgNewUamPck UEGO_DataSplyClsS1B1_I.flgNewUapePck UEGO_DataSplyClsS1B1_I.flgNewUcalMaxPck UEGO_DataSplyClsS1B1_I.flgNewUcalPck UEGO_DataSplyClsS1B1_I.flgNewUg0Pck UEGO_DataSplyClsS1B1_I.flgNewUg0PckAry UEGO_DataSplyClsS1B1_I.flgNewUg0aPck UEGO_DataSplyClsS1B1_I.flgNewUg0ePck UEGO_DataSplyClsS1B1_I.flgNewUg0iPck UEGO_DataSplyClsS1B1_I.flgNewUg0iPckAry UEGO_DataSplyClsS1B1_I.flgNewUg0iaiPck UEGO_DataSplyClsS1B1_I.flgNewUg0ieiPck UEGO_DataSplyClsS1B1_I.flgNewUg0ix7PckAry UEGO_DataSplyClsS1B1_I.flgNewUg0ix9PckAry UEGO_DataSplyClsS1B1_I.flgNewUg0ixPckAry UEGO_DataSplyClsS1B1_I.flgNewUg0mPck UEGO_DataSplyClsS1B1_I.flgNewUgaPck UEGO_DataSplyClsS1B1_I.flgNewUgiPckAry UEGO_DataSplyClsS1B1_I.flgNewUgkAvrgPck UEGO_DataSplyClsS1B1_I.flgNewUguaPck UEGO_DataSplyClsS1B1_I.flgNewUguaZ2Pck UEGO_DataSplyClsS1B1_I.flgNewUguiPck UEGO_DataSplyClsS1B1_I.flgNewUguiZ1Pck UEGO_DataSplyClsS1B1_I.flgNewUi21PckAry UEGO_DataSplyClsS1B1_I.flgNewUi22Pck UEGO_DataSplyClsS1B1_I.flgNewUi23Pck UEGO_DataSplyClsS1B1_I.flgNewUi24Pck UEGO_DataSplyClsS1B1_I.flgNewUi4Pck UEGO_DataSplyClsS1B1_I.flgNewUi4Z2Pck UEGO_DataSplyClsS1B1_I.flgNewUigPckAry UEGO_DataSplyClsS1B1_I.flgNewUigmkPckAry UEGO_DataSplyClsS1B1_I.flgNewUipcalAvrgPck UEGO_DataSplyClsS1B1_I.flgNewUn0Pck UEGO_DataSplyClsS1B1_I.flgNewUn0Pck4Ary UEGO_DataSplyClsS1B1_I.flgNewUn0Pck5Ary UEGO_DataSplyClsS1B1_I.flgNewUn0PckAry UEGO_DataSplyClsS1B1_I.flgNewUnPckAry UEGO_DataSplyClsS1B1_I.flgNewUnSetPck UEGO_DataSplyClsS1B1_I.flgNewUnx3PckAry UEGO_DataSplyClsS1B1_I.flgNewUnx4PckAry UEGO_DataSplyClsS1B1_I.flgNewUp0Pck UEGO_DataSplyClsS1B1_I.flgNewUp0Pck4 UEGO_DataSplyClsS1B1_I.flgNewUp0Pck5Ary UEGO_DataSplyClsS1B1_I.flgNewUp0PckAry UEGO_DataSplyClsS1B1_I.flgNewUpPckAry UEGO_DataSplyClsS1B1_I.flgNewUpx3PckAry UEGO_DataSplyClsS1B1_I.flgNewUpx4PckAry UEGO_DataSplyClsS1B1_I.flgNewUriaPckVld UEGO_DataSplyClsS1B1_I.flgNewUriePckAry UEGO_DataSplyClsS1B1_I.flgNewUx6PckAry UEGO_DataSplyClsS1B1_I.flgNewUx7PckAry UEGO_DataSplyClsS1B1_I.flgNewUx8PckAry UEGO_DataSplyClsS1B1_I.flgNewUx9PckAry UEGO_DataSplyClsS1B1_I.flgNewUxPckAry UEGO_DataSplyClsS1B1_I.flgReStable UEGO_DataSplyClsS1B1_I.flgSngCell UEGO_DataSplyClsS1B1_I.flgUical0Vld UEGO_DataSplyClsS1B1_I.flgUicalVld UEGO_DataSplyClsS1B1_I.flgUoffipe1Vld UEGO_DataSplyClsS1B1_I.flgUoffipe2Vld UEGO_DataSplyClsS1B1_I.flgUoffipe3Vld UEGO_DataSplyClsS1B1_I.flgUoffvcc1Vld UEGO_DataSplyClsS1B1_I.flgUoffvcc2Vld UEGO_DataSplyClsS1B1_I.flgUoffvcc3Vld UEGO_DataSplyClsS1B1_I.flgUriaMeas UEGO_DataSplyClsS1B1_I.nrIPmpDacPckAry UEGO_DataSplyClsS1B1_I.nrIpPckAry UEGO_DataSplyClsS1B1_I.nrModeMeas UEGO_DataSplyClsS1B1_I.nrRamFailPosn UEGO_DataSplyClsS1B1_I.nrRamMod UEGO_DataSplyClsS1B1_I.nrRamRegMod UEGO_DataSplyClsS1B1_I.nrRamSts1 UEGO_DataSplyClsS1B1_I.nrRamSts2 UEGO_DataSplyClsS1B1_I.nrRamSts3 UEGO_DataSplyClsS1B1_I.nrURmVG4PckAry UEGO_DataSplyClsS1B1_I.nrUa2PckAry UEGO_DataSplyClsS1B1_I.nrUcalMaxCorrd UEGO_DataSplyClsS1B1_I.nrUg0PckAry UEGO_DataSplyClsS1B1_I.nrUg0iPckAry UEGO_DataSplyClsS1B1_I.nrUg0ix7PckAry UEGO_DataSplyClsS1B1_I.nrUg0ix9PckAry UEGO_DataSplyClsS1B1_I.nrUg0ixPckAry UEGO_DataSplyClsS1B1_I.nrUgaPckAry UEGO_DataSplyClsS1B1_I.nrUgiPckAry UEGO_DataSplyClsS1B1_I.nrUi21PckAry UEGO_DataSplyClsS1B1_I.nrUical0PckCorrd UEGO_DataSplyClsS1B1_I.nrUicalPckCorrd UEGO_DataSplyClsS1B1_I.nrUigPckAry UEGO_DataSplyClsS1B1_I.nrUigmkPckAry UEGO_DataSplyClsS1B1_I.nrUn0Pck4Ary UEGO_DataSplyClsS1B1_I.nrUn0Pck5Ary UEGO_DataSplyClsS1B1_I.nrUn0PckAry UEGO_DataSplyClsS1B1_I.nrUnPckAry UEGO_DataSplyClsS1B1_I.nrUnx3PckAry UEGO_DataSplyClsS1B1_I.nrUnx4PckAry UEGO_DataSplyClsS1B1_I.nrUoffipe1 UEGO_DataSplyClsS1B1_I.nrUoffipe2 UEGO_DataSplyClsS1B1_I.nrUoffipe3 UEGO_DataSplyClsS1B1_I.nrUoffvcc1 UEGO_DataSplyClsS1B1_I.nrUoffvcc2 UEGO_DataSplyClsS1B1_I.nrUoffvcc3 UEGO_DataSplyClsS1B1_I.nrUp0Pck5Ary UEGO_DataSplyClsS1B1_I.nrUp0PckAry UEGO_DataSplyClsS1B1_I.nrUpPckAry UEGO_DataSplyClsS1B1_I.nrUpx3PckAry UEGO_DataSplyClsS1B1_I.nrUpx4PckAry UEGO_DataSplyClsS1B1_I.nrUriePckAry UEGO_DataSplyClsS1B1_I.nrUx6PckAry UEGO_DataSplyClsS1B1_I.nrUx7PckAry UEGO_DataSplyClsS1B1_I.nrUx8PckAry UEGO_DataSplyClsS1B1_I.nrUx9PckAry UEGO_DataSplyClsS1B1_I.nrUxPckAry UEGO_DataSplyClsS1B1_I.stIPmpOK UEGO_DataSplyClsS1B1_I.stIPmpTM UEGO_DataSplyClsS1B1_I.stIPmpTM2L UEGO_DataSplyClsS1B1_I.stIPmpTM2R UEGO_DataSplyClsS1B1_I.stLsmRetValMod UEGO_DataSplyClsS1B1_I.stMKMeas UEGO_DataSplyClsS1B1_I.stOFFMeas UEGO_DataSplyClsS1B1_I.stOPTMeas UEGO_DataSplyClsS1B1_I.stREFMeas UEGO_DataSplyClsS1B1_I.stUa2PckAry UEGO_DataSplyClsS1B1_I.stUa2Z1PckAry UEGO_DataSplyClsS1B1_I.stUg0iPckAry UEGO_DataSplyClsS1B1_I.stUg0ix7IActvPckAry UEGO_DataSplyClsS1B1_I.stUg0ix7PmpIActvPckAry UEGO_DataSplyClsS1B1_I.stUg0ix9IActvPckAry UEGO_DataSplyClsS1B1_I.stUg0ix9PmpIActvPckAry UEGO_DataSplyClsS1B1_I.stUg0ixIActvPckAry UEGO_DataSplyClsS1B1_I.stUg0ixPmpIActvPckAry UEGO_DataSplyClsS1B1_I.stUi21PckAry UEGO_DataSplyClsS1B1_I.stUi21Z1PckAry UEGO_DataSplyClsS1B1_I.stUigmkNernstIActvPckAry UEGO_DataSplyClsS1B1_I.stUigmkPmpIActvPckAry UEGO_DataSplyClsS1B1_I.stUn0PckAry UEGO_DataSplyClsS1B1_I.stUn0Z2PckAry UEGO_DataSplyClsS1B1_I.stUnPckAry UEGO_DataSplyClsS1B1_I.stUnx3IActvAcrsNernstCellPckAry UEGO_DataSplyClsS1B1_I.stUnx3IActvAcrsPmpCellPckAry UEGO_DataSplyClsS1B1_I.stUnx4IActvAcrsNernstCellPckAry UEGO_DataSplyClsS1B1_I.stUnx4IActvAcrsPmpCellPckAry UEGO_DataSplyClsS1B1_I.stUp0PckAry UEGO_DataSplyClsS1B1_I.stUp0Z2PckAry UEGO_DataSplyClsS1B1_I.stUpPckAry UEGO_DataSplyClsS1B1_I.stUpZ2PckAry UEGO_DataSplyClsS1B1_I.stUpx3IActvAcrsNernstCellPckAry UEGO_DataSplyClsS1B1_I.stUpx3IActvAcrsPmpCellPckAry UEGO_DataSplyClsS1B1_I.stUpx4IActvAcrsNernstCellPckAry UEGO_DataSplyClsS1B1_I.stUpx4IActvAcrsPmpCellPckAry UEGO_DataSplyClsS1B1_I.stUriePckAry UEGO_DataSplyClsS1B1_I.stUx6IActvPckAry UEGO_DataSplyClsS1B1_I.stUx6MeasAcrsPmpCellPckAry UEGO_DataSplyClsS1B1_I.stUx7IActvPckAry UEGO_DataSplyClsS1B1_I.stUx7MeasAcrsPmpCellPckAry UEGO_DataSplyClsS1B1_I.stUx8IActvPckAry UEGO_DataSplyClsS1B1_I.stUx8MeasAcrsPmpCellPckAry UEGO_DataSplyClsS1B1_I.stUx9IActvPckAry UEGO_DataSplyClsS1B1_I.stUx9MeasAcrsPmpCellPckAry UEGO_DataSplyClsS1B1_I.stUxIActvPckAry UEGO_DataSplyClsS1B1_I.stUxMeasAcrsPmpCell UEGO_DataSplyClsS1B1_I.tiUEGOPck UEGO_DataSplyClsS1B1_I.uFkal1 UEGO_DataSplyClsS1B1_I.uFkal2 UEGO_DataSplyClsS1B1_I.uFkal3 UEGO_DataSplyClsS1B1_I.uUCalPck UEGO_DataSplyClsS1B1_I.uUa31Pck UEGO_DataSplyClsS1B1_I.uUa32Pck UEGO_DataSplyClsS1B1_I.uUa33Pck UEGO_DataSplyClsS1B1_I.uUamPck UEGO_DataSplyClsS1B1_I.uUapePck UEGO_DataSplyClsS1B1_I.uUcalMaxPck UEGO_DataSplyClsS1B1_I.uUg0Pck UEGO_DataSplyClsS1B1_I.uUg0aPck UEGO_DataSplyClsS1B1_I.uUg0ePck UEGO_DataSplyClsS1B1_I.uUg0iPck UEGO_DataSplyClsS1B1_I.uUg0iaiPck UEGO_DataSplyClsS1B1_I.uUg0ieiPck UEGO_DataSplyClsS1B1_I.uUg0mPck UEGO_DataSplyClsS1B1_I.uUgkAvrgPck UEGO_DataSplyClsS1B1_I.uUguaPck UEGO_DataSplyClsS1B1_I.uUguaZ2Pck UEGO_DataSplyClsS1B1_I.uUguiPck UEGO_DataSplyClsS1B1_I.uUguiZ1Pck UEGO_DataSplyClsS1B1_I.uUi22Pck UEGO_DataSplyClsS1B1_I.uUi23Pck UEGO_DataSplyClsS1B1_I.uUi24Pck UEGO_DataSplyClsS1B1_I.uUi4Pck UEGO_DataSplyClsS1B1_I.uUi4Z2Pck UEGO_DataSplyClsS1B1_I.uUipcalAvrgPck UEGO_DataSplyClsS1B1_I.uUn0Pck UEGO_DataSplyClsS1B1_I.uUnSet UEGO_DataSplyClsS1B1_I.uUp0Pck UEGO_DataSplyClsS1B1_I.uUp0Pck4 UEGO_DataSplyClsS1B1_I.uUriaPck UEGO_DataSplyClsS1B1_I.uVCC1Corrd UEGO_DataSplyClsS1B1_I.uVCC3Ref UEGO_flgCJ135AnS1B1 UEGO_flgOperRelsS1B1 UEGO_flgSysSuprtdS1B1 UEGO_nrModCurrS1B1 UEGO_RegGetPrmS1B1_I.flgDlyBlcknNxtPckVld UEGO_RegGetPrmS1B1_I.flgDlyBlcknVld UEGO_RegGetPrmS1B1_I.flgDspDiagDis UEGO_RegGetPrmS1B1_I.flgDspDiagDisNxtPck UEGO_RegGetPrmS1B1_I.flgDspDiagDisNxtPckVld UEGO_RegGetPrmS1B1_I.flgDspDiagDisVld UEGO_RegGetPrmS1B1_I.flgEnSpA UEGO_RegGetPrmS1B1_I.flgEnSpAVld UEGO_RegGetPrmS1B1_I.flgEnSpE UEGO_RegGetPrmS1B1_I.flgEnSpEVld UEGO_RegGetPrmS1B1_I.flgEnSpNxtPckVld UEGO_RegGetPrmS1B1_I.flgEnSpVld UEGO_RegGetPrmS1B1_I.flgIPmpBlcknNxtPckVld UEGO_RegGetPrmS1B1_I.flgIPmpBlcknVld UEGO_RegGetPrmS1B1_I.flgIPmpLimnHiVld UEGO_RegGetPrmS1B1_I.flgIPmpLimnLoVld UEGO_RegGetPrmS1B1_I.flgIPmpRst UEGO_RegGetPrmS1B1_I.flgIPmpRstNxtPck UEGO_RegGetPrmS1B1_I.flgIPmpRstNxtPckVld UEGO_RegGetPrmS1B1_I.flgIPmpRstVld UEGO_RegGetPrmS1B1_I.flgIPmpSm UEGO_RegGetPrmS1B1_I.flgIPmpSmNxtPck UEGO_RegGetPrmS1B1_I.flgIPmpSmNxtPckVld UEGO_RegGetPrmS1B1_I.flgIPmpSmVld UEGO_RegGetPrmS1B1_I.flgLCal UEGO_RegGetPrmS1B1_I.flgLCalVld UEGO_RegGetPrmS1B1_I.flgLCurr UEGO_RegGetPrmS1B1_I.flgLCurrVld UEGO_RegGetPrmS1B1_I.flgLDAC UEGO_RegGetPrmS1B1_I.flgLDACConf UEGO_RegGetPrmS1B1_I.flgLDACConfVld UEGO_RegGetPrmS1B1_I.flgLDACVld UEGO_RegGetPrmS1B1_I.flgLG0 UEGO_RegGetPrmS1B1_I.flgLG0Vld UEGO_RegGetPrmS1B1_I.flgLN UEGO_RegGetPrmS1B1_I.flgLNNxtPck UEGO_RegGetPrmS1B1_I.flgLNNxtPckVld UEGO_RegGetPrmS1B1_I.flgLNVld UEGO_RegGetPrmS1B1_I.flgLP UEGO_RegGetPrmS1B1_I.flgLPNxtPck UEGO_RegGetPrmS1B1_I.flgLPNxtPckVld UEGO_RegGetPrmS1B1_I.flgLPVld UEGO_RegGetPrmS1B1_I.flgMKA UEGO_RegGetPrmS1B1_I.flgMKAVld UEGO_RegGetPrmS1B1_I.flgMKE UEGO_RegGetPrmS1B1_I.flgMKEVld UEGO_RegGetPrmS1B1_I.flgMKNxtPckVld UEGO_RegGetPrmS1B1_I.flgMKVld UEGO_RegGetPrmS1B1_I.flgN3MeasActvNxtPck UEGO_RegGetPrmS1B1_I.flgN3MeasActvNxtPckVld UEGO_RegGetPrmS1B1_I.flgOFFNxtPckVld UEGO_RegGetPrmS1B1_I.flgOFFVld UEGO_RegGetPrmS1B1_I.flgOPTNxtPckVld UEGO_RegGetPrmS1B1_I.flgOPTVld UEGO_RegGetPrmS1B1_I.flgPatNxtPckVld UEGO_RegGetPrmS1B1_I.flgPatVld UEGO_RegGetPrmS1B1_I.flgRCmpHeatrEdgeShiftAllwd UEGO_RegGetPrmS1B1_I.flgRCmpHeatrEdgeShiftAllwdNxtPck UEGO_RegGetPrmS1B1_I.flgRCmpHeatrEdgeShiftAllwdNxtPckVld UEGO_RegGetPrmS1B1_I.flgRCmpHeatrEdgeShiftAllwdVld UEGO_RegGetPrmS1B1_I.flgReStab UEGO_RegGetPrmS1B1_I.flgReStabVld UEGO_RegGetPrmS1B1_I.flgRefNxtPckVld UEGO_RegGetPrmS1B1_I.flgRefPatChng UEGO_RegGetPrmS1B1_I.flgRefPatNxtPckVld UEGO_RegGetPrmS1B1_I.flgRefPatVld UEGO_RegGetPrmS1B1_I.flgRefVld UEGO_RegGetPrmS1B1_I.flgRegIPmpSetNxtPckVld UEGO_RegGetPrmS1B1_I.flgRegIPmpSetVld UEGO_RegGetPrmS1B1_I.flgRegIpoffChng UEGO_RegGetPrmS1B1_I.flgRegIpoffNxtPckVld UEGO_RegGetPrmS1B1_I.flgRegIpoffVld UEGO_RegGetPrmS1B1_I.flgRegModNxtPckVld UEGO_RegGetPrmS1B1_I.flgRegModVld UEGO_RegGetPrmS1B1_I.flgRegPartModNxtPckVld UEGO_RegGetPrmS1B1_I.flgRegPartModVld UEGO_RegGetPrmS1B1_I.flgRegUnsetNxtPckVld UEGO_RegGetPrmS1B1_I.flgRiaPatChng UEGO_RegGetPrmS1B1_I.flgRiaPatVld UEGO_RegGetPrmS1B1_I.flgRipVld UEGO_RegGetPrmS1B1_I.flgSngCell UEGO_RegGetPrmS1B1_I.flgSngCellVld UEGO_RegGetPrmS1B1_I.flgSteerPatChng UEGO_RegGetPrmS1B1_I.flgSteerPatNxtPckVld UEGO_RegGetPrmS1B1_I.flgSteerPatVld UEGO_RegGetPrmS1B1_I.flgSubModMeasNxtPckVld UEGO_RegGetPrmS1B1_I.flgSubModMeasVld UEGO_RegGetPrmS1B1_I.flgSwVirtGnd UEGO_RegGetPrmS1B1_I.flgSwVirtGndVld UEGO_RegGetPrmS1B1_I.flgTrimSqChng UEGO_RegGetPrmS1B1_I.flgTrimSqrCalChng UEGO_RegGetPrmS1B1_I.flgTrimSqrChng UEGO_RegGetPrmS1B1_I.flgTrmNxtPckVld UEGO_RegGetPrmS1B1_I.flgTrmSqCalOffSet UEGO_RegGetPrmS1B1_I.flgTrmSqCalVld UEGO_RegGetPrmS1B1_I.flgTrmSqOffSet UEGO_RegGetPrmS1B1_I.flgTrmSqOffSetVld UEGO_RegGetPrmS1B1_I.flgTrmSqVld UEGO_RegGetPrmS1B1_I.flgTrmSqrCalOffSet UEGO_RegGetPrmS1B1_I.flgTrmSqrCalVld UEGO_RegGetPrmS1B1_I.flgTrmSqrOffSet UEGO_RegGetPrmS1B1_I.flgTrmSqrOffSetVld UEGO_RegGetPrmS1B1_I.flgTrmSqrVld UEGO_RegGetPrmS1B1_I.flgUnsetVld UEGO_RegGetPrmS1B1_I.flgUp0LeanNxtPckVld UEGO_RegGetPrmS1B1_I.flgUp0LeanVld UEGO_RegGetPrmS1B1_I.flgUp0RichNxtPckVld UEGO_RegGetPrmS1B1_I.flgUp0RichVld UEGO_RegGetPrmS1B1_I.flgUria UEGO_RegGetPrmS1B1_I.flgUriaNxtPck UEGO_RegGetPrmS1B1_I.flgUriaNxtPckVld UEGO_RegGetPrmS1B1_I.flgUriaVld UEGO_RegGetPrmS1B1_I.flgV1BF2NxtPckVld UEGO_RegGetPrmS1B1_I.flgV1BF2Vld UEGO_RegGetPrmS1B1_I.flgV1BF3NxtPckVld UEGO_RegGetPrmS1B1_I.flgV1BIT1 UEGO_RegGetPrmS1B1_I.flgV1BIT1NxtPck UEGO_RegGetPrmS1B1_I.flgV1BIT1NxtPckVld UEGO_RegGetPrmS1B1_I.flgV1BIT1Vld UEGO_RegGetPrmS1B1_I.flgV1BIT2 UEGO_RegGetPrmS1B1_I.flgV1BIT2NxtPck UEGO_RegGetPrmS1B1_I.flgV1BIT2NxtPckVld UEGO_RegGetPrmS1B1_I.flgV1BIT2Vld UEGO_RegGetPrmS1B1_I.flgV1BIT5 UEGO_RegGetPrmS1B1_I.flgV1BIT5NxtPck UEGO_RegGetPrmS1B1_I.flgV1BIT5NxtPckVld UEGO_RegGetPrmS1B1_I.flgV1BIT5Vld UEGO_RegGetPrmS1B1_I.flgWtrEleclyActv UEGO_RegGetPrmS1B1_I.flgWtrEleclyActvNxtPck UEGO_RegGetPrmS1B1_I.flgWtrEleclyActvNxtPckVld UEGO_RegGetPrmS1B1_I.flgWtrEleclyActvVld UEGO_RegGetPrmS1B1_I.flgZIsqrA UEGO_RegGetPrmS1B1_I.flgZIsqrAVld UEGO_RegGetPrmS1B1_I.flgZIsqrE UEGO_RegGetPrmS1B1_I.flgZIsqrEVld UEGO_RegGetPrmS1B1_I.nrIPmpBlcknNxtPck UEGO_RegGetPrmS1B1_I.nrIPmpLimnHi UEGO_RegGetPrmS1B1_I.nrIPmpLimnLo UEGO_RegGetPrmS1B1_I.nrPmpBlckn UEGO_RegGetPrmS1B1_I.nrRefPatNxtPck UEGO_RegGetPrmS1B1_I.nrRegIPmpSet UEGO_RegGetPrmS1B1_I.nrRegIPmpSetNxtPck UEGO_RegGetPrmS1B1_I.nrRegIpoff UEGO_RegGetPrmS1B1_I.nrRegMod UEGO_RegGetPrmS1B1_I.nrRegModNxtPck UEGO_RegGetPrmS1B1_I.nrRegPartMod UEGO_RegGetPrmS1B1_I.nrRegPartModNxtPck UEGO_RegGetPrmS1B1_I.nrRegTrmNxtPck UEGO_RegGetPrmS1B1_I.nrRegTrmSqNxtPck UEGO_RegGetPrmS1B1_I.nrRegTrmSqrNxtPck UEGO_RegGetPrmS1B1_I.nrRip UEGO_RegGetPrmS1B1_I.nrSteerPatNxtPck UEGO_RegGetPrmS1B1_I.nrSubModMeas UEGO_RegGetPrmS1B1_I.nrSubModMeasNxtPck UEGO_RegGetPrmS1B1_I.nrTrmSq UEGO_RegGetPrmS1B1_I.nrTrmSqCal UEGO_RegGetPrmS1B1_I.nrTrmSqr UEGO_RegGetPrmS1B1_I.nrTrmSqrCal UEGO_RegGetPrmS1B1_I.nrUnset UEGO_RegGetPrmS1B1_I.nrUnsetNxtPck UEGO_RegGetPrmS1B1_I.nrUp0Lean UEGO_RegGetPrmS1B1_I.nrUp0LeanNxtPck UEGO_RegGetPrmS1B1_I.nrUp0Rich UEGO_RegGetPrmS1B1_I.nrUp0RichNxtPck UEGO_RegGetPrmS1B1_I.stDlyBlckn UEGO_RegGetPrmS1B1_I.stDlyBlcknNxtPck UEGO_RegGetPrmS1B1_I.stEnSp UEGO_RegGetPrmS1B1_I.stEnSpNxtPck UEGO_RegGetPrmS1B1_I.stMK UEGO_RegGetPrmS1B1_I.stMKNxtPck UEGO_RegGetPrmS1B1_I.stOFF UEGO_RegGetPrmS1B1_I.stOFFNxtPck UEGO_RegGetPrmS1B1_I.stOPT UEGO_RegGetPrmS1B1_I.stOPTNxtPck UEGO_RegGetPrmS1B1_I.stPat UEGO_RegGetPrmS1B1_I.stPatNxtPck UEGO_RegGetPrmS1B1_I.stRef UEGO_RegGetPrmS1B1_I.stRefNxtPck UEGO_RegGetPrmS1B1_I.stRefPat UEGO_RegGetPrmS1B1_I.stRegIpoffNxtPck UEGO_RegGetPrmS1B1_I.stRiaPat UEGO_RegGetPrmS1B1_I.stSteerPat UEGO_RegGetPrmS1B1_I.stV1BF2 UEGO_RegGetPrmS1B1_I.stV1BF2NxtPck UEGO_RegGetPrmS1B1_I.stV1BF3NxtPck UEGO_RegSetS1B1_I.cntrRegSet UEGO_RegSetS1B1_I.flgCJ135An UEGO_RegSetS1B1_I.flgConvVld UEGO_RegSetS1B1_I.flgIPmpDes UEGO_RegSetS1B1_I.flgIPmpPhyRels UEGO_RegSetS1B1_I.flgIniFinshd UEGO_RegSetS1B1_I.flgLoupeCURRDes UEGO_RegSetS1B1_I.flgLoupeDACDes UEGO_RegSetS1B1_I.flgLoupeNDes UEGO_RegSetS1B1_I.flgLoupePDes UEGO_RegSetS1B1_I.flgNewReq UEGO_RegSetS1B1_I.flgRegSetSt UEGO_RegSetS1B1_I.flgRegSetStVld UEGO_RegSetS1B1_I.flgReqAcptd UEGO_RegSetS1B1_I.flgSetRegOk UEGO_RegSetS1B1_I.flgTakeDataOk UEGO_RegSetS1B1_I.idxChp UEGO_RegSetS1B1_I.nrIdleSubMode UEGO_RegSetS1B1_I.nrModDes UEGO_RegSetS1B1_I.nrNormSubMode UEGO_RegSetS1B1_I.nrRegSet UEGO_RegSetS1B1_I.nrSubModDes UEGO_RegSetS1B1_I.nrSwtOnSubMode UEGO_RegSetS1B1_I.nrTrmSq UEGO_RegSetS1B1_I.nrWrmUpSubMode UEGO_RegSetS1B1_I.stRegSet UEGO_RegSetS1B1_I.stRegSetVld UEGO_RegSetS1B1_I.tmpVar /end IN_MEASUREMENT
 /begin OUT_MEASUREMENT UEGO_cntrModEvlnS1B1 UEGO_cntrSubModEvlnS1B1 UEGO_flgRamFailVldS1B1 UEGO_nrModVrfdS1B1 UEGO_nrRamFailPosnS1B1 UEGO_nrRamFailSts1S1B1 UEGO_nrRamFailSts2S1B1 UEGO_nrRamFailSts3S1B1 UEGO_nrSubModVrfdS1B1 /end OUT_MEASUREMENT
 /begin LOC_MEASUREMENT UEGO_ModCtrlS1B1_I.cntrModEvln UEGO_ModCtrlS1B1_I.cntrSubModEvln UEGO_ModCtrlS1B1_I.flgCtrlModChng UEGO_ModCtrlS1B1_I.flgCtrlSubModChng UEGO_ModCtrlS1B1_I.flgFailrMod UEGO_ModCtrlS1B1_I.flgModCurrVrfd UEGO_ModCtrlS1B1_I.flgModMeasVrfd UEGO_ModCtrlS1B1_I.flgModSwtOnReq UEGO_ModCtrlS1B1_I.flgModSwtOnReqEvl UEGO_ModCtrlS1B1_I.flgRamFailVld UEGO_ModCtrlS1B1_I.flgRamFailVld_5ms UEGO_ModCtrlS1B1_I.flgSetRegOk UEGO_ModCtrlS1B1_I.flgSetRegOkDspDiagDis UEGO_ModCtrlS1B1_I.flgSetRegOkEnSp UEGO_ModCtrlS1B1_I.flgSetRegOkFusks UEGO_ModCtrlS1B1_I.flgSubModMeasVrfd UEGO_ModCtrlS1B1_I.nrModDesLst UEGO_ModCtrlS1B1_I.nrModInt UEGO_ModCtrlS1B1_I.nrModMeas UEGO_ModCtrlS1B1_I.nrModMeas_5ms UEGO_ModCtrlS1B1_I.nrModOld UEGO_ModCtrlS1B1_I.nrModVrfd UEGO_ModCtrlS1B1_I.nrRamFailPosn UEGO_ModCtrlS1B1_I.nrRamFailPosn_5ms UEGO_ModCtrlS1B1_I.nrRamFailSts1 UEGO_ModCtrlS1B1_I.nrRamFailSts1_5ms UEGO_ModCtrlS1B1_I.nrRamFailSts2 UEGO_ModCtrlS1B1_I.nrRamFailSts2_5ms UEGO_ModCtrlS1B1_I.nrRamFailSts3 UEGO_ModCtrlS1B1_I.nrRamFailSts3_5ms UEGO_ModCtrlS1B1_I.nrSubModDes UEGO_ModCtrlS1B1_I.nrSubModDesLst UEGO_ModCtrlS1B1_I.nrSubModDesOld UEGO_ModCtrlS1B1_I.nrSubModEvln UEGO_ModCtrlS1B1_I.nrSubModMeas UEGO_ModCtrlS1B1_I.nrSubModMeas_5ms UEGO_ModCtrlS1B1_I.nrSubModVrfd UEGO_ModCtrlS1B1_I.stEnSp UEGO_ModCtrlS1B1_I.stEnSpOld UEGO_ModCtrlS1B1_I.uRegFusks UEGO_ModCtrlS1B1_I.uRegFusksOld UEGO_ModCtrlS1B1_I.UEGO_SwtOnTOFFVNM_I.time UEGO_ModCtrlS1B1_I.flgRamFailVldERNM_I.oldSignal /end LOC_MEASUREMENT
 FUNCTION_VERSION "1.16.0" /end FUNCTION
/begin FUNCTION UEGO_O2 "1.26.0    UEGO oxygen concentration calculation and signal correction"
 /begin DEF_CHARACTERISTIC UEGO_stIPmpRglnDstbcModBitMask_C UEGO_stIPmpRglnVldBitMask_C UEGO_tiDlyIPmpRglnDstbc_C UEGO_facCrvtChartcCrvLeanFlexfu_C UEGO_facCrvtChartcCrvLean_C UEGO_facCrvtChartcCrvRichFlexfu_C UEGO_facCrvtChartcCrvRich_C UEGO_facLnrChartcCrvLeanFlexfu_C UEGO_facLnrChartcCrvLean_C UEGO_facLnrChartcCrvRichFlexfu_C UEGO_facLnrChartcCrvRich_C UEGO_facTCorr_CUR UEGO_flgActvtFrzO2DurgIPmpRglnDstbc_C UEGO_pPDpdLean_C UEGO_pPDpdRich_C UEGO_stEngStIPmpStgyMask_C UEGO_stIPmpRelsMask_C UEGO_stO2EquivHiPrcsnBitMask_C UEGO_stO2VldBitMask_C UEGO_tCeramicDeLrg_C UEGO_tCeramicDeSmall_C UEGO_tCeramicRef_C UEGO_tiDlyIPmpDurgStopPha_C UEGO_tiDlyIPmpReqOff_C UEGO_tiO2VldTurnOff_C UEGO_tiO2VldTurnOn_C UEGO_tIPmpReqOff_C UEGO_tIPmpReqOn_C UEGO_iIPmpSrvImpsVal_C /end DEF_CHARACTERISTIC
 /begin IN_MEASUREMENT fethmnmx_w_msg SyC_ctPostDrvLeave UEGO_DataSplyClsS1B1_I.flgCj135An UEGO_DataSplyClsS1B1_I.flgDACOff UEGO_DataSplyClsS1B1_I.flgErrSpiRamRet UEGO_DataSplyClsS1B1_I.flgFKal1Vld UEGO_DataSplyClsS1B1_I.flgFKal2Vld UEGO_DataSplyClsS1B1_I.flgFKal3Vld UEGO_DataSplyClsS1B1_I.flgIPmpActvd UEGO_DataSplyClsS1B1_I.flgISQrA UEGO_DataSplyClsS1B1_I.flgISQrE UEGO_DataSplyClsS1B1_I.flgLCURR UEGO_DataSplyClsS1B1_I.flgLNMeas UEGO_DataSplyClsS1B1_I.flgLPMeas UEGO_DataSplyClsS1B1_I.flgLoupeCAL UEGO_DataSplyClsS1B1_I.flgLoupeG0 UEGO_DataSplyClsS1B1_I.flgLstPckAbort UEGO_DataSplyClsS1B1_I.flgMKA UEGO_DataSplyClsS1B1_I.flgMKE UEGO_DataSplyClsS1B1_I.flgNewIPmpDacPckAry UEGO_DataSplyClsS1B1_I.flgNewIPmpOK UEGO_DataSplyClsS1B1_I.flgNewIPmpPckAry UEGO_DataSplyClsS1B1_I.flgNewIPmpTM UEGO_DataSplyClsS1B1_I.flgNewPck UEGO_DataSplyClsS1B1_I.flgNewPckCstnc UEGO_DataSplyClsS1B1_I.flgNewPckMiss UEGO_DataSplyClsS1B1_I.flgNewPckVld UEGO_DataSplyClsS1B1_I.flgNewTiPck UEGO_DataSplyClsS1B1_I.flgNewURmVG4MeasAryVld UEGO_DataSplyClsS1B1_I.flgNewUa2Pck UEGO_DataSplyClsS1B1_I.flgNewUa31Pck UEGO_DataSplyClsS1B1_I.flgNewUa32Pck UEGO_DataSplyClsS1B1_I.flgNewUa33Pck UEGO_DataSplyClsS1B1_I.flgNewUamPck UEGO_DataSplyClsS1B1_I.flgNewUapePck UEGO_DataSplyClsS1B1_I.flgNewUcalMaxPck UEGO_DataSplyClsS1B1_I.flgNewUcalPck UEGO_DataSplyClsS1B1_I.flgNewUg0Pck UEGO_DataSplyClsS1B1_I.flgNewUg0PckAry UEGO_DataSplyClsS1B1_I.flgNewUg0aPck UEGO_DataSplyClsS1B1_I.flgNewUg0ePck UEGO_DataSplyClsS1B1_I.flgNewUg0iPck UEGO_DataSplyClsS1B1_I.flgNewUg0iPckAry UEGO_DataSplyClsS1B1_I.flgNewUg0iaiPck UEGO_DataSplyClsS1B1_I.flgNewUg0ieiPck UEGO_DataSplyClsS1B1_I.flgNewUg0ix7PckAry UEGO_DataSplyClsS1B1_I.flgNewUg0ix9PckAry UEGO_DataSplyClsS1B1_I.flgNewUg0ixPckAry UEGO_DataSplyClsS1B1_I.flgNewUg0mPck UEGO_DataSplyClsS1B1_I.flgNewUgaPck UEGO_DataSplyClsS1B1_I.flgNewUgiPckAry UEGO_DataSplyClsS1B1_I.flgNewUgkAvrgPck UEGO_DataSplyClsS1B1_I.flgNewUguaPck UEGO_DataSplyClsS1B1_I.flgNewUguaZ2Pck UEGO_DataSplyClsS1B1_I.flgNewUguiPck UEGO_DataSplyClsS1B1_I.flgNewUguiZ1Pck UEGO_DataSplyClsS1B1_I.flgNewUi21PckAry UEGO_DataSplyClsS1B1_I.flgNewUi22Pck UEGO_DataSplyClsS1B1_I.flgNewUi23Pck UEGO_DataSplyClsS1B1_I.flgNewUi24Pck UEGO_DataSplyClsS1B1_I.flgNewUi4Pck UEGO_DataSplyClsS1B1_I.flgNewUi4Z2Pck UEGO_DataSplyClsS1B1_I.flgNewUigPckAry UEGO_DataSplyClsS1B1_I.flgNewUigmkPckAry UEGO_DataSplyClsS1B1_I.flgNewUipcalAvrgPck UEGO_DataSplyClsS1B1_I.flgNewUn0Pck UEGO_DataSplyClsS1B1_I.flgNewUn0Pck4Ary UEGO_DataSplyClsS1B1_I.flgNewUn0Pck5Ary UEGO_DataSplyClsS1B1_I.flgNewUn0PckAry UEGO_DataSplyClsS1B1_I.flgNewUnPckAry UEGO_DataSplyClsS1B1_I.flgNewUnSetPck UEGO_DataSplyClsS1B1_I.flgNewUnx3PckAry UEGO_DataSplyClsS1B1_I.flgNewUnx4PckAry UEGO_DataSplyClsS1B1_I.flgNewUp0Pck UEGO_DataSplyClsS1B1_I.flgNewUp0Pck4 UEGO_DataSplyClsS1B1_I.flgNewUp0Pck5Ary UEGO_DataSplyClsS1B1_I.flgNewUp0PckAry UEGO_DataSplyClsS1B1_I.flgNewUpPckAry UEGO_DataSplyClsS1B1_I.flgNewUpx3PckAry UEGO_DataSplyClsS1B1_I.flgNewUpx4PckAry UEGO_DataSplyClsS1B1_I.flgNewUriaPckVld UEGO_DataSplyClsS1B1_I.flgNewUriePckAry UEGO_DataSplyClsS1B1_I.flgNewUx6PckAry UEGO_DataSplyClsS1B1_I.flgNewUx7PckAry UEGO_DataSplyClsS1B1_I.flgNewUx8PckAry UEGO_DataSplyClsS1B1_I.flgNewUx9PckAry UEGO_DataSplyClsS1B1_I.flgNewUxPckAry UEGO_DataSplyClsS1B1_I.flgReStable UEGO_DataSplyClsS1B1_I.flgSngCell UEGO_DataSplyClsS1B1_I.flgUical0Vld UEGO_DataSplyClsS1B1_I.flgUicalVld UEGO_DataSplyClsS1B1_I.flgUoffipe1Vld UEGO_DataSplyClsS1B1_I.flgUoffipe2Vld UEGO_DataSplyClsS1B1_I.flgUoffipe3Vld UEGO_DataSplyClsS1B1_I.flgUoffvcc1Vld UEGO_DataSplyClsS1B1_I.flgUoffvcc2Vld UEGO_DataSplyClsS1B1_I.flgUoffvcc3Vld UEGO_DataSplyClsS1B1_I.flgUriaMeas UEGO_DataSplyClsS1B1_I.nrIPmpDacPckAry UEGO_DataSplyClsS1B1_I.nrIpPckAry UEGO_DataSplyClsS1B1_I.nrModeMeas UEGO_DataSplyClsS1B1_I.nrRamFailPosn UEGO_DataSplyClsS1B1_I.nrRamMod UEGO_DataSplyClsS1B1_I.nrRamRegMod UEGO_DataSplyClsS1B1_I.nrRamSts1 UEGO_DataSplyClsS1B1_I.nrRamSts2 UEGO_DataSplyClsS1B1_I.nrRamSts3 UEGO_DataSplyClsS1B1_I.nrURmVG4PckAry UEGO_DataSplyClsS1B1_I.nrUa2PckAry UEGO_DataSplyClsS1B1_I.nrUcalMaxCorrd UEGO_DataSplyClsS1B1_I.nrUg0PckAry UEGO_DataSplyClsS1B1_I.nrUg0iPckAry UEGO_DataSplyClsS1B1_I.nrUg0ix7PckAry UEGO_DataSplyClsS1B1_I.nrUg0ix9PckAry UEGO_DataSplyClsS1B1_I.nrUg0ixPckAry UEGO_DataSplyClsS1B1_I.nrUgaPckAry UEGO_DataSplyClsS1B1_I.nrUgiPckAry UEGO_DataSplyClsS1B1_I.nrUi21PckAry UEGO_DataSplyClsS1B1_I.nrUical0PckCorrd UEGO_DataSplyClsS1B1_I.nrUicalPckCorrd UEGO_DataSplyClsS1B1_I.nrUigPckAry UEGO_DataSplyClsS1B1_I.nrUigmkPckAry UEGO_DataSplyClsS1B1_I.nrUn0Pck4Ary UEGO_DataSplyClsS1B1_I.nrUn0Pck5Ary UEGO_DataSplyClsS1B1_I.nrUn0PckAry UEGO_DataSplyClsS1B1_I.nrUnPckAry UEGO_DataSplyClsS1B1_I.nrUnx3PckAry UEGO_DataSplyClsS1B1_I.nrUnx4PckAry UEGO_DataSplyClsS1B1_I.nrUoffipe1 UEGO_DataSplyClsS1B1_I.nrUoffipe2 UEGO_DataSplyClsS1B1_I.nrUoffipe3 UEGO_DataSplyClsS1B1_I.nrUoffvcc1 UEGO_DataSplyClsS1B1_I.nrUoffvcc2 UEGO_DataSplyClsS1B1_I.nrUoffvcc3 UEGO_DataSplyClsS1B1_I.nrUp0Pck5Ary UEGO_DataSplyClsS1B1_I.nrUp0PckAry UEGO_DataSplyClsS1B1_I.nrUpPckAry UEGO_DataSplyClsS1B1_I.nrUpx3PckAry UEGO_DataSplyClsS1B1_I.nrUpx4PckAry UEGO_DataSplyClsS1B1_I.nrUriePckAry UEGO_DataSplyClsS1B1_I.nrUx6PckAry UEGO_DataSplyClsS1B1_I.nrUx7PckAry UEGO_DataSplyClsS1B1_I.nrUx8PckAry UEGO_DataSplyClsS1B1_I.nrUx9PckAry UEGO_DataSplyClsS1B1_I.nrUxPckAry UEGO_DataSplyClsS1B1_I.stIPmpOK UEGO_DataSplyClsS1B1_I.stIPmpTM UEGO_DataSplyClsS1B1_I.stIPmpTM2L UEGO_DataSplyClsS1B1_I.stIPmpTM2R UEGO_DataSplyClsS1B1_I.stLsmRetValMod UEGO_DataSplyClsS1B1_I.stMKMeas UEGO_DataSplyClsS1B1_I.stOFFMeas UEGO_DataSplyClsS1B1_I.stOPTMeas UEGO_DataSplyClsS1B1_I.stREFMeas UEGO_DataSplyClsS1B1_I.stUa2PckAry UEGO_DataSplyClsS1B1_I.stUa2Z1PckAry UEGO_DataSplyClsS1B1_I.stUg0iPckAry UEGO_DataSplyClsS1B1_I.stUg0ix7IActvPckAry UEGO_DataSplyClsS1B1_I.stUg0ix7PmpIActvPckAry UEGO_DataSplyClsS1B1_I.stUg0ix9IActvPckAry UEGO_DataSplyClsS1B1_I.stUg0ix9PmpIActvPckAry UEGO_DataSplyClsS1B1_I.stUg0ixIActvPckAry UEGO_DataSplyClsS1B1_I.stUg0ixPmpIActvPckAry UEGO_DataSplyClsS1B1_I.stUi21PckAry UEGO_DataSplyClsS1B1_I.stUi21Z1PckAry UEGO_DataSplyClsS1B1_I.stUigmkNernstIActvPckAry UEGO_DataSplyClsS1B1_I.stUigmkPmpIActvPckAry UEGO_DataSplyClsS1B1_I.stUn0PckAry UEGO_DataSplyClsS1B1_I.stUn0Z2PckAry UEGO_DataSplyClsS1B1_I.stUnPckAry UEGO_DataSplyClsS1B1_I.stUnx3IActvAcrsNernstCellPckAry UEGO_DataSplyClsS1B1_I.stUnx3IActvAcrsPmpCellPckAry UEGO_DataSplyClsS1B1_I.stUnx4IActvAcrsNernstCellPckAry UEGO_DataSplyClsS1B1_I.stUnx4IActvAcrsPmpCellPckAry UEGO_DataSplyClsS1B1_I.stUp0PckAry UEGO_DataSplyClsS1B1_I.stUp0Z2PckAry UEGO_DataSplyClsS1B1_I.stUpPckAry UEGO_DataSplyClsS1B1_I.stUpZ2PckAry UEGO_DataSplyClsS1B1_I.stUpx3IActvAcrsNernstCellPckAry UEGO_DataSplyClsS1B1_I.stUpx3IActvAcrsPmpCellPckAry UEGO_DataSplyClsS1B1_I.stUpx4IActvAcrsNernstCellPckAry UEGO_DataSplyClsS1B1_I.stUpx4IActvAcrsPmpCellPckAry UEGO_DataSplyClsS1B1_I.stUriePckAry UEGO_DataSplyClsS1B1_I.stUx6IActvPckAry UEGO_DataSplyClsS1B1_I.stUx6MeasAcrsPmpCellPckAry UEGO_DataSplyClsS1B1_I.stUx7IActvPckAry UEGO_DataSplyClsS1B1_I.stUx7MeasAcrsPmpCellPckAry UEGO_DataSplyClsS1B1_I.stUx8IActvPckAry UEGO_DataSplyClsS1B1_I.stUx8MeasAcrsPmpCellPckAry UEGO_DataSplyClsS1B1_I.stUx9IActvPckAry UEGO_DataSplyClsS1B1_I.stUx9MeasAcrsPmpCellPckAry UEGO_DataSplyClsS1B1_I.stUxIActvPckAry UEGO_DataSplyClsS1B1_I.stUxMeasAcrsPmpCell UEGO_DataSplyClsS1B1_I.tiUEGOPck UEGO_DataSplyClsS1B1_I.uFkal1 UEGO_DataSplyClsS1B1_I.uFkal2 UEGO_DataSplyClsS1B1_I.uFkal3 UEGO_DataSplyClsS1B1_I.uUCalPck UEGO_DataSplyClsS1B1_I.uUa31Pck UEGO_DataSplyClsS1B1_I.uUa32Pck UEGO_DataSplyClsS1B1_I.uUa33Pck UEGO_DataSplyClsS1B1_I.uUamPck UEGO_DataSplyClsS1B1_I.uUapePck UEGO_DataSplyClsS1B1_I.uUcalMaxPck UEGO_DataSplyClsS1B1_I.uUg0Pck UEGO_DataSplyClsS1B1_I.uUg0aPck UEGO_DataSplyClsS1B1_I.uUg0ePck UEGO_DataSplyClsS1B1_I.uUg0iPck UEGO_DataSplyClsS1B1_I.uUg0iaiPck UEGO_DataSplyClsS1B1_I.uUg0ieiPck UEGO_DataSplyClsS1B1_I.uUg0mPck UEGO_DataSplyClsS1B1_I.uUgkAvrgPck UEGO_DataSplyClsS1B1_I.uUguaPck UEGO_DataSplyClsS1B1_I.uUguaZ2Pck UEGO_DataSplyClsS1B1_I.uUguiPck UEGO_DataSplyClsS1B1_I.uUguiZ1Pck UEGO_DataSplyClsS1B1_I.uUi22Pck UEGO_DataSplyClsS1B1_I.uUi23Pck UEGO_DataSplyClsS1B1_I.uUi24Pck UEGO_DataSplyClsS1B1_I.uUi4Pck UEGO_DataSplyClsS1B1_I.uUi4Z2Pck UEGO_DataSplyClsS1B1_I.uUipcalAvrgPck UEGO_DataSplyClsS1B1_I.uUn0Pck UEGO_DataSplyClsS1B1_I.uUnSet UEGO_DataSplyClsS1B1_I.uUp0Pck UEGO_DataSplyClsS1B1_I.uUp0Pck4 UEGO_DataSplyClsS1B1_I.uUriaPck UEGO_DataSplyClsS1B1_I.uVCC1Corrd UEGO_DataSplyClsS1B1_I.uVCC3Ref UEGO_facCrvCorrnS1B1 UEGO_flgCmbEngTmpStop UEGO_flgDsmVld UEGO_flgEngRunng UEGO_flgfacCrvCorrnHiPrcsnS1B1 UEGO_flgfacCrvCorrnVldS1B1 UEGO_flgIPmpCtrlHiPrcsnS1B1 UEGO_flgIPmpCtrlVldS1B1 UEGO_flgIPmpHiPrcsnS1B1 UEGO_flgIPmpSegVldS1B1 UEGO_flgO2RefSuffS1B1 UEGO_flgOperRelsS1B1 UEGO_flgSysSuprtdS1B1 UEGO_flgTCeramicHiPrcsnS1B1 UEGO_flgTCeramicVldS1B1 UEGO_flgUNernstInRngS1B1 UEGO_flgUPmpLimnActvS1B1 UEGO_flgUPmpLimnActvVldS1B1 UEGO_iIPmpSegS1B1 UEGO_RegGetPrmS1B1_I.flgDlyBlcknNxtPckVld UEGO_RegGetPrmS1B1_I.flgDlyBlcknVld UEGO_RegGetPrmS1B1_I.flgDspDiagDis UEGO_RegGetPrmS1B1_I.flgDspDiagDisNxtPck UEGO_RegGetPrmS1B1_I.flgDspDiagDisNxtPckVld UEGO_RegGetPrmS1B1_I.flgDspDiagDisVld UEGO_RegGetPrmS1B1_I.flgEnSpA UEGO_RegGetPrmS1B1_I.flgEnSpAVld UEGO_RegGetPrmS1B1_I.flgEnSpE UEGO_RegGetPrmS1B1_I.flgEnSpEVld UEGO_RegGetPrmS1B1_I.flgEnSpNxtPckVld UEGO_RegGetPrmS1B1_I.flgEnSpVld UEGO_RegGetPrmS1B1_I.flgIPmpBlcknNxtPckVld UEGO_RegGetPrmS1B1_I.flgIPmpBlcknVld UEGO_RegGetPrmS1B1_I.flgIPmpLimnHiVld UEGO_RegGetPrmS1B1_I.flgIPmpLimnLoVld UEGO_RegGetPrmS1B1_I.flgIPmpRst UEGO_RegGetPrmS1B1_I.flgIPmpRstNxtPck UEGO_RegGetPrmS1B1_I.flgIPmpRstNxtPckVld UEGO_RegGetPrmS1B1_I.flgIPmpRstVld UEGO_RegGetPrmS1B1_I.flgIPmpSm UEGO_RegGetPrmS1B1_I.flgIPmpSmNxtPck UEGO_RegGetPrmS1B1_I.flgIPmpSmNxtPckVld UEGO_RegGetPrmS1B1_I.flgIPmpSmVld UEGO_RegGetPrmS1B1_I.flgLCal UEGO_RegGetPrmS1B1_I.flgLCalVld UEGO_RegGetPrmS1B1_I.flgLCurr UEGO_RegGetPrmS1B1_I.flgLCurrVld UEGO_RegGetPrmS1B1_I.flgLDAC UEGO_RegGetPrmS1B1_I.flgLDACConf UEGO_RegGetPrmS1B1_I.flgLDACConfVld UEGO_RegGetPrmS1B1_I.flgLDACVld UEGO_RegGetPrmS1B1_I.flgLG0 UEGO_RegGetPrmS1B1_I.flgLG0Vld UEGO_RegGetPrmS1B1_I.flgLN UEGO_RegGetPrmS1B1_I.flgLNNxtPck UEGO_RegGetPrmS1B1_I.flgLNNxtPckVld UEGO_RegGetPrmS1B1_I.flgLNVld UEGO_RegGetPrmS1B1_I.flgLP UEGO_RegGetPrmS1B1_I.flgLPNxtPck UEGO_RegGetPrmS1B1_I.flgLPNxtPckVld UEGO_RegGetPrmS1B1_I.flgLPVld UEGO_RegGetPrmS1B1_I.flgMKA UEGO_RegGetPrmS1B1_I.flgMKAVld UEGO_RegGetPrmS1B1_I.flgMKE UEGO_RegGetPrmS1B1_I.flgMKEVld UEGO_RegGetPrmS1B1_I.flgMKNxtPckVld UEGO_RegGetPrmS1B1_I.flgMKVld UEGO_RegGetPrmS1B1_I.flgN3MeasActvNxtPck UEGO_RegGetPrmS1B1_I.flgN3MeasActvNxtPckVld UEGO_RegGetPrmS1B1_I.flgOFFNxtPckVld UEGO_RegGetPrmS1B1_I.flgOFFVld UEGO_RegGetPrmS1B1_I.flgOPTNxtPckVld UEGO_RegGetPrmS1B1_I.flgOPTVld UEGO_RegGetPrmS1B1_I.flgPatNxtPckVld UEGO_RegGetPrmS1B1_I.flgPatVld UEGO_RegGetPrmS1B1_I.flgRCmpHeatrEdgeShiftAllwd UEGO_RegGetPrmS1B1_I.flgRCmpHeatrEdgeShiftAllwdNxtPck UEGO_RegGetPrmS1B1_I.flgRCmpHeatrEdgeShiftAllwdNxtPckVld UEGO_RegGetPrmS1B1_I.flgRCmpHeatrEdgeShiftAllwdVld UEGO_RegGetPrmS1B1_I.flgReStab UEGO_RegGetPrmS1B1_I.flgReStabVld UEGO_RegGetPrmS1B1_I.flgRefNxtPckVld UEGO_RegGetPrmS1B1_I.flgRefPatChng UEGO_RegGetPrmS1B1_I.flgRefPatNxtPckVld UEGO_RegGetPrmS1B1_I.flgRefPatVld UEGO_RegGetPrmS1B1_I.flgRefVld UEGO_RegGetPrmS1B1_I.flgRegIPmpSetNxtPckVld UEGO_RegGetPrmS1B1_I.flgRegIPmpSetVld UEGO_RegGetPrmS1B1_I.flgRegIpoffChng UEGO_RegGetPrmS1B1_I.flgRegIpoffNxtPckVld UEGO_RegGetPrmS1B1_I.flgRegIpoffVld UEGO_RegGetPrmS1B1_I.flgRegModNxtPckVld UEGO_RegGetPrmS1B1_I.flgRegModVld UEGO_RegGetPrmS1B1_I.flgRegPartModNxtPckVld UEGO_RegGetPrmS1B1_I.flgRegPartModVld UEGO_RegGetPrmS1B1_I.flgRegUnsetNxtPckVld UEGO_RegGetPrmS1B1_I.flgRiaPatChng UEGO_RegGetPrmS1B1_I.flgRiaPatVld UEGO_RegGetPrmS1B1_I.flgRipVld UEGO_RegGetPrmS1B1_I.flgSngCell UEGO_RegGetPrmS1B1_I.flgSngCellVld UEGO_RegGetPrmS1B1_I.flgSteerPatChng UEGO_RegGetPrmS1B1_I.flgSteerPatNxtPckVld UEGO_RegGetPrmS1B1_I.flgSteerPatVld UEGO_RegGetPrmS1B1_I.flgSubModMeasNxtPckVld UEGO_RegGetPrmS1B1_I.flgSubModMeasVld UEGO_RegGetPrmS1B1_I.flgSwVirtGnd UEGO_RegGetPrmS1B1_I.flgSwVirtGndVld UEGO_RegGetPrmS1B1_I.flgTrimSqChng UEGO_RegGetPrmS1B1_I.flgTrimSqrCalChng UEGO_RegGetPrmS1B1_I.flgTrimSqrChng UEGO_RegGetPrmS1B1_I.flgTrmNxtPckVld UEGO_RegGetPrmS1B1_I.flgTrmSqCalOffSet UEGO_RegGetPrmS1B1_I.flgTrmSqCalVld UEGO_RegGetPrmS1B1_I.flgTrmSqOffSet UEGO_RegGetPrmS1B1_I.flgTrmSqOffSetVld UEGO_RegGetPrmS1B1_I.flgTrmSqVld UEGO_RegGetPrmS1B1_I.flgTrmSqrCalOffSet UEGO_RegGetPrmS1B1_I.flgTrmSqrCalVld UEGO_RegGetPrmS1B1_I.flgTrmSqrOffSet UEGO_RegGetPrmS1B1_I.flgTrmSqrOffSetVld UEGO_RegGetPrmS1B1_I.flgTrmSqrVld UEGO_RegGetPrmS1B1_I.flgUnsetVld UEGO_RegGetPrmS1B1_I.flgUp0LeanNxtPckVld UEGO_RegGetPrmS1B1_I.flgUp0LeanVld UEGO_RegGetPrmS1B1_I.flgUp0RichNxtPckVld UEGO_RegGetPrmS1B1_I.flgUp0RichVld UEGO_RegGetPrmS1B1_I.flgUria UEGO_RegGetPrmS1B1_I.flgUriaNxtPck UEGO_RegGetPrmS1B1_I.flgUriaNxtPckVld UEGO_RegGetPrmS1B1_I.flgUriaVld UEGO_RegGetPrmS1B1_I.flgV1BF2NxtPckVld UEGO_RegGetPrmS1B1_I.flgV1BF2Vld UEGO_RegGetPrmS1B1_I.flgV1BF3NxtPckVld UEGO_RegGetPrmS1B1_I.flgV1BIT1 UEGO_RegGetPrmS1B1_I.flgV1BIT1NxtPck UEGO_RegGetPrmS1B1_I.flgV1BIT1NxtPckVld UEGO_RegGetPrmS1B1_I.flgV1BIT1Vld UEGO_RegGetPrmS1B1_I.flgV1BIT2 UEGO_RegGetPrmS1B1_I.flgV1BIT2NxtPck UEGO_RegGetPrmS1B1_I.flgV1BIT2NxtPckVld UEGO_RegGetPrmS1B1_I.flgV1BIT2Vld UEGO_RegGetPrmS1B1_I.flgV1BIT5 UEGO_RegGetPrmS1B1_I.flgV1BIT5NxtPck UEGO_RegGetPrmS1B1_I.flgV1BIT5NxtPckVld UEGO_RegGetPrmS1B1_I.flgV1BIT5Vld UEGO_RegGetPrmS1B1_I.flgWtrEleclyActv UEGO_RegGetPrmS1B1_I.flgWtrEleclyActvNxtPck UEGO_RegGetPrmS1B1_I.flgWtrEleclyActvNxtPckVld UEGO_RegGetPrmS1B1_I.flgWtrEleclyActvVld UEGO_RegGetPrmS1B1_I.flgZIsqrA UEGO_RegGetPrmS1B1_I.flgZIsqrAVld UEGO_RegGetPrmS1B1_I.flgZIsqrE UEGO_RegGetPrmS1B1_I.flgZIsqrEVld UEGO_RegGetPrmS1B1_I.nrIPmpBlcknNxtPck UEGO_RegGetPrmS1B1_I.nrIPmpLimnHi UEGO_RegGetPrmS1B1_I.nrIPmpLimnLo UEGO_RegGetPrmS1B1_I.nrPmpBlckn UEGO_RegGetPrmS1B1_I.nrRefPatNxtPck UEGO_RegGetPrmS1B1_I.nrRegIPmpSet UEGO_RegGetPrmS1B1_I.nrRegIPmpSetNxtPck UEGO_RegGetPrmS1B1_I.nrRegIpoff UEGO_RegGetPrmS1B1_I.nrRegMod UEGO_RegGetPrmS1B1_I.nrRegModNxtPck UEGO_RegGetPrmS1B1_I.nrRegPartMod UEGO_RegGetPrmS1B1_I.nrRegPartModNxtPck UEGO_RegGetPrmS1B1_I.nrRegTrmNxtPck UEGO_RegGetPrmS1B1_I.nrRegTrmSqNxtPck UEGO_RegGetPrmS1B1_I.nrRegTrmSqrNxtPck UEGO_RegGetPrmS1B1_I.nrRip UEGO_RegGetPrmS1B1_I.nrSteerPatNxtPck UEGO_RegGetPrmS1B1_I.nrSubModMeas UEGO_RegGetPrmS1B1_I.nrSubModMeasNxtPck UEGO_RegGetPrmS1B1_I.nrTrmSq UEGO_RegGetPrmS1B1_I.nrTrmSqCal UEGO_RegGetPrmS1B1_I.nrTrmSqr UEGO_RegGetPrmS1B1_I.nrTrmSqrCal UEGO_RegGetPrmS1B1_I.nrUnset UEGO_RegGetPrmS1B1_I.nrUnsetNxtPck UEGO_RegGetPrmS1B1_I.nrUp0Lean UEGO_RegGetPrmS1B1_I.nrUp0LeanNxtPck UEGO_RegGetPrmS1B1_I.nrUp0Rich UEGO_RegGetPrmS1B1_I.nrUp0RichNxtPck UEGO_RegGetPrmS1B1_I.stDlyBlckn UEGO_RegGetPrmS1B1_I.stDlyBlcknNxtPck UEGO_RegGetPrmS1B1_I.stEnSp UEGO_RegGetPrmS1B1_I.stEnSpNxtPck UEGO_RegGetPrmS1B1_I.stMK UEGO_RegGetPrmS1B1_I.stMKNxtPck UEGO_RegGetPrmS1B1_I.stOFF UEGO_RegGetPrmS1B1_I.stOFFNxtPck UEGO_RegGetPrmS1B1_I.stOPT UEGO_RegGetPrmS1B1_I.stOPTNxtPck UEGO_RegGetPrmS1B1_I.stPat UEGO_RegGetPrmS1B1_I.stPatNxtPck UEGO_RegGetPrmS1B1_I.stRef UEGO_RegGetPrmS1B1_I.stRefNxtPck UEGO_RegGetPrmS1B1_I.stRefPat UEGO_RegGetPrmS1B1_I.stRegIpoffNxtPck UEGO_RegGetPrmS1B1_I.stRiaPat UEGO_RegGetPrmS1B1_I.stSteerPat UEGO_RegGetPrmS1B1_I.stV1BF2 UEGO_RegGetPrmS1B1_I.stV1BF2NxtPck UEGO_RegGetPrmS1B1_I.stV1BF3NxtPck UEGO_RegSetS1B1_I.cntrRegSet UEGO_RegSetS1B1_I.flgCJ135An UEGO_RegSetS1B1_I.flgConvVld UEGO_RegSetS1B1_I.flgIPmpDes UEGO_RegSetS1B1_I.flgIPmpPhyRels UEGO_RegSetS1B1_I.flgIniFinshd UEGO_RegSetS1B1_I.flgLoupeCURRDes UEGO_RegSetS1B1_I.flgLoupeDACDes UEGO_RegSetS1B1_I.flgLoupeNDes UEGO_RegSetS1B1_I.flgLoupePDes UEGO_RegSetS1B1_I.flgNewReq UEGO_RegSetS1B1_I.flgRegSetSt UEGO_RegSetS1B1_I.flgRegSetStVld UEGO_RegSetS1B1_I.flgReqAcptd UEGO_RegSetS1B1_I.flgSetRegOk UEGO_RegSetS1B1_I.flgTakeDataOk UEGO_RegSetS1B1_I.idxChp UEGO_RegSetS1B1_I.nrIdleSubMode UEGO_RegSetS1B1_I.nrModDes UEGO_RegSetS1B1_I.nrNormSubMode UEGO_RegSetS1B1_I.nrRegSet UEGO_RegSetS1B1_I.nrSubModDes UEGO_RegSetS1B1_I.nrSwtOnSubMode UEGO_RegSetS1B1_I.nrTrmSq UEGO_RegSetS1B1_I.nrWrmUpSubMode UEGO_RegSetS1B1_I.stRegSet UEGO_RegSetS1B1_I.stRegSetVld UEGO_RegSetS1B1_I.tmpVar UEGO_tCeramicS1B1 /end IN_MEASUREMENT
 /begin OUT_MEASUREMENT UEGO_facCrvtChartcCrvS1B1 UEGO_flgIPmpRglnDstbcVldS1B1 UEGO_flgIPmpRglnVldS1B1 UEGO_flgO2EquivHiPrcsnS1B1 UEGO_flgO2EquivVldS1B1 UEGO_flgTDeLrgSpS1B1 UEGO_iIPmpElecCorrdS1B1 UEGO_pPDpdS1B1 UEGO_ratO2EquivLnrS1B1 UEGO_stO2VldS1B1 /end OUT_MEASUREMENT
 /begin LOC_MEASUREMENT UEGO_iIPmpSrvExtdS1B1 UEGO_iIPmpSrvS1B1 UEGO_IPmpReglnClassS1B1_I.cntrReiniCalc5ms UEGO_IPmpReglnClassS1B1_I.flgIPmpRglnDstbc UEGO_IPmpReglnClassS1B1_I.flgIPmpRglnDstbcVld UEGO_IPmpReglnClassS1B1_I.flgIPmpRglnVld UEGO_IPmpReglnClassS1B1_I.stIPmpRglnDstbcMod UEGO_IPmpReglnClassS1B1_I.stIPmpRglnVld UEGO_IPmpReglnClassS1B1_I.flgIPmpRglnDstbcTOFFV_NoMem.time UEGO_O2ClassS1B1_I.facCrvtChartcCrv UEGO_O2ClassS1B1_I.flgIPmpElecCorrdCalcd UEGO_O2ClassS1B1_I.flgIPmpReq UEGO_O2ClassS1B1_I.flgIPmpTCorrdCalcd UEGO_O2ClassS1B1_I.flgO2EquivHiPrcsn UEGO_O2ClassS1B1_I.flgO2EquivHiPrcsnCurr UEGO_O2ClassS1B1_I.flgO2EquivVld UEGO_O2ClassS1B1_I.flgO2EquivVldCurr UEGO_O2ClassS1B1_I.flgO2TCorrdCalcd UEGO_O2ClassS1B1_I.flgTDeLrgSp UEGO_O2ClassS1B1_I.flgTDeSmallSp UEGO_O2ClassS1B1_I.iIPmpElecCorrd UEGO_O2ClassS1B1_I.iIPmpTCorrd UEGO_O2ClassS1B1_I.pPDpd UEGO_O2ClassS1B1_I.ratO2EquivLnr UEGO_O2ClassS1B1_I.stEngStIPmpStgy UEGO_O2ClassS1B1_I.stIPmpRels UEGO_O2ClassS1B1_I.stO2EquivHiPrcsn UEGO_O2ClassS1B1_I.stO2Vld UEGO_O2ClassS1B1_I.tDe UEGO_O2ClassS1B1_I.UEGO_TIPmpReqOnSW_I.timeCounter UEGO_O2ClassS1B1_I.flgEngRunngIPmpStgyTOFFV_I.outbit UEGO_O2ClassS1B1_I.flgEngRunngIPmpStgyTOFFV_I.time UEGO_O2ClassS1B1_I.flgO2VldDEB_I.Timer UEGO_O2ClassS1B1_I.flgO2VldDEB_I.XOld /end LOC_MEASUREMENT
 FUNCTION_VERSION "1.26.0" /end FUNCTION
/begin FUNCTION UEGO_O2Ref "1.6.0     UEGO O2 reference model"
 /begin DEF_CHARACTERISTIC UEGO_facAlpha0_C UEGO_facGamma0_C UEGO_pO2RefMdlTankIni_C UEGO_pO2RefMdlTankMax_C UEGO_pO2RefMdlTankMin_C UEGO_pO2RefMin_C UEGO_stO2RefRels_C /end DEF_CHARACTERISTIC
 /begin IN_MEASUREMENT EnvP_p UEGO_flgIPmpPckVldS1B1 UEGO_flgNernstIsqrVldS1B1 UEGO_flgOperRelsS1B1 UEGO_flgPmpIsqrVldS1B1 UEGO_flgSnglCellS1B1 UEGO_flgSysSuprtdS1B1 UEGO_iIPmpPckAvrgS1B1 UEGO_iNernstIsqrS1B1 UEGO_iPmpIsqrS1B1 /end IN_MEASUREMENT
 /begin OUT_MEASUREMENT UEGO_flgO2RefSuffS1B1 UEGO_flgPO2RefVldS1B1 UEGO_pO2RefS1B1 /end OUT_MEASUREMENT
 /begin LOC_MEASUREMENT UEGO_O2RefClassS1B1.flgMdlStrtd UEGO_O2RefClassS1B1.flgO2RefSuff UEGO_O2RefClassS1B1.flgPO2RefVld UEGO_O2RefClassS1B1.pO2Ref UEGO_O2RefClassS1B1.pO2RefMdlTank UEGO_O2RefClassS1B1.pO2RefMdlTankLoss UEGO_O2RefClassS1B1.stO2RefRels /end LOC_MEASUREMENT
 FUNCTION_VERSION "1.6.0" /end FUNCTION
/begin FUNCTION UEGO_OperRels "1.16.0    Sensor operation release"
 /begin DEF_CHARACTERISTIC UEGO_stEngStHeatgStgy_C UEGO_stOperRels_C UEGO_stSysSuprtd_C /end DEF_CHARACTERISTIC
 /begin IN_MEASUREMENT ExhMod_flgDewPntEndS1B1 ExhMod_flgHeatgTspS1B1 SyC_stSub UEGO_flgChpSuprtdS1B1 UEGO_flgCmbEngTmpStop UEGO_flgEngRunng UEGO_flgHeatrPwrStgSuprtdS1B1 UEGO_flgOperRelsWoDewPntS1B1 UEGO_flgSnsrSuprtdS1B1 UEGO_idxTypS1B1 /end IN_MEASUREMENT
 /begin OUT_MEASUREMENT UEGO_flgDewPntRelsS1B1 UEGO_flgEngStHeatgStgyS1B1 UEGO_flgOperRelsS1B1 UEGO_flgSysSuprtdS1B1 /end OUT_MEASUREMENT
 /begin LOC_MEASUREMENT UEGO_OperRelsS1B1_I.flgEngStHeatgStgy UEGO_OperRelsS1B1_I.flgOperRels UEGO_OperRelsS1B1_I.flgSysSuprtd UEGO_OperRelsS1B1_I.stEngStHeatgStgy UEGO_OperRelsS1B1_I.stOperRels UEGO_OperRelsS1B1_I.stSysSuprtd /end LOC_MEASUREMENT
 FUNCTION_VERSION "1.16.0" /end FUNCTION
/begin FUNCTION UEGO_OperRelsWoDewPnt "1.15.0    Sensor Operation release independent of dew point" /begin DEF_CHARACTERISTIC UEGO_stFastLiOffHeatg_C /end DEF_CHARACTERISTIC /begin IN_MEASUREMENT UEGO_flgSysSuprtdS1B1 UEGO_flgTstrRelsS1B1 /end IN_MEASUREMENT
 /begin OUT_MEASUREMENT UEGO_flgOperRelsPreEngStrtS1B1 UEGO_flgOperRelsWoDewPntS1B1 /end OUT_MEASUREMENT
 /begin LOC_MEASUREMENT UEGO_OperRelsWoDewPntS1B1_I.flgFastLiOffActvSts UEGO_OperRelsWoDewPntS1B1_I.flgOperRelsPreEngStrt UEGO_OperRelsWoDewPntS1B1_I.flgOperRelsWoDewPnt UEGO_OperRelsWoDewPntS1B1_I.flgReqPreHeatg /end LOC_MEASUREMENT
 FUNCTION_VERSION "1.15.0" /end FUNCTION
/begin FUNCTION UEGO_RCmp "1.17.0    UEGO Determination of Compensation Resistor"
 /begin DEF_CHARACTERISTIC UEGO_facRCmpFilCon_C UEGO_facRParlFilCon_C UEGO_iIsqDesRCmpEvln_C UEGO_rRMeas_C /end DEF_CHARACTERISTIC
 /begin REF_CHARACTERISTIC UEGO_resRGnd_C UEGO_rRFe_C /end REF_CHARACTERISTIC
 /begin IN_MEASUREMENT UEGO_DataSplyClsS1B1_I.flgCj135An UEGO_DataSplyClsS1B1_I.flgDACOff UEGO_DataSplyClsS1B1_I.flgErrSpiRamRet UEGO_DataSplyClsS1B1_I.flgFKal1Vld UEGO_DataSplyClsS1B1_I.flgFKal2Vld UEGO_DataSplyClsS1B1_I.flgFKal3Vld UEGO_DataSplyClsS1B1_I.flgIPmpActvd UEGO_DataSplyClsS1B1_I.flgISQrA UEGO_DataSplyClsS1B1_I.flgISQrE UEGO_DataSplyClsS1B1_I.flgLCURR UEGO_DataSplyClsS1B1_I.flgLNMeas UEGO_DataSplyClsS1B1_I.flgLPMeas UEGO_DataSplyClsS1B1_I.flgLoupeCAL UEGO_DataSplyClsS1B1_I.flgLoupeG0 UEGO_DataSplyClsS1B1_I.flgLstPckAbort UEGO_DataSplyClsS1B1_I.flgMKA UEGO_DataSplyClsS1B1_I.flgMKE UEGO_DataSplyClsS1B1_I.flgNewIPmpDacPckAry UEGO_DataSplyClsS1B1_I.flgNewIPmpOK UEGO_DataSplyClsS1B1_I.flgNewIPmpPckAry UEGO_DataSplyClsS1B1_I.flgNewIPmpTM UEGO_DataSplyClsS1B1_I.flgNewPck UEGO_DataSplyClsS1B1_I.flgNewPckCstnc UEGO_DataSplyClsS1B1_I.flgNewPckMiss UEGO_DataSplyClsS1B1_I.flgNewPckVld UEGO_DataSplyClsS1B1_I.flgNewTiPck UEGO_DataSplyClsS1B1_I.flgNewURmVG4MeasAryVld UEGO_DataSplyClsS1B1_I.flgNewUa2Pck UEGO_DataSplyClsS1B1_I.flgNewUa31Pck UEGO_DataSplyClsS1B1_I.flgNewUa32Pck UEGO_DataSplyClsS1B1_I.flgNewUa33Pck UEGO_DataSplyClsS1B1_I.flgNewUamPck UEGO_DataSplyClsS1B1_I.flgNewUapePck UEGO_DataSplyClsS1B1_I.flgNewUcalMaxPck UEGO_DataSplyClsS1B1_I.flgNewUcalPck UEGO_DataSplyClsS1B1_I.flgNewUg0Pck UEGO_DataSplyClsS1B1_I.flgNewUg0PckAry UEGO_DataSplyClsS1B1_I.flgNewUg0aPck UEGO_DataSplyClsS1B1_I.flgNewUg0ePck UEGO_DataSplyClsS1B1_I.flgNewUg0iPck UEGO_DataSplyClsS1B1_I.flgNewUg0iPckAry UEGO_DataSplyClsS1B1_I.flgNewUg0iaiPck UEGO_DataSplyClsS1B1_I.flgNewUg0ieiPck UEGO_DataSplyClsS1B1_I.flgNewUg0ix7PckAry UEGO_DataSplyClsS1B1_I.flgNewUg0ix9PckAry UEGO_DataSplyClsS1B1_I.flgNewUg0ixPckAry UEGO_DataSplyClsS1B1_I.flgNewUg0mPck UEGO_DataSplyClsS1B1_I.flgNewUgaPck UEGO_DataSplyClsS1B1_I.flgNewUgiPckAry UEGO_DataSplyClsS1B1_I.flgNewUgkAvrgPck UEGO_DataSplyClsS1B1_I.flgNewUguaPck UEGO_DataSplyClsS1B1_I.flgNewUguaZ2Pck UEGO_DataSplyClsS1B1_I.flgNewUguiPck UEGO_DataSplyClsS1B1_I.flgNewUguiZ1Pck UEGO_DataSplyClsS1B1_I.flgNewUi21PckAry UEGO_DataSplyClsS1B1_I.flgNewUi22Pck UEGO_DataSplyClsS1B1_I.flgNewUi23Pck UEGO_DataSplyClsS1B1_I.flgNewUi24Pck UEGO_DataSplyClsS1B1_I.flgNewUi4Pck UEGO_DataSplyClsS1B1_I.flgNewUi4Z2Pck UEGO_DataSplyClsS1B1_I.flgNewUigPckAry UEGO_DataSplyClsS1B1_I.flgNewUigmkPckAry UEGO_DataSplyClsS1B1_I.flgNewUipcalAvrgPck UEGO_DataSplyClsS1B1_I.flgNewUn0Pck UEGO_DataSplyClsS1B1_I.flgNewUn0Pck4Ary UEGO_DataSplyClsS1B1_I.flgNewUn0Pck5Ary UEGO_DataSplyClsS1B1_I.flgNewUn0PckAry UEGO_DataSplyClsS1B1_I.flgNewUnPckAry UEGO_DataSplyClsS1B1_I.flgNewUnSetPck UEGO_DataSplyClsS1B1_I.flgNewUnx3PckAry UEGO_DataSplyClsS1B1_I.flgNewUnx4PckAry UEGO_DataSplyClsS1B1_I.flgNewUp0Pck UEGO_DataSplyClsS1B1_I.flgNewUp0Pck4 UEGO_DataSplyClsS1B1_I.flgNewUp0Pck5Ary UEGO_DataSplyClsS1B1_I.flgNewUp0PckAry UEGO_DataSplyClsS1B1_I.flgNewUpPckAry UEGO_DataSplyClsS1B1_I.flgNewUpx3PckAry UEGO_DataSplyClsS1B1_I.flgNewUpx4PckAry UEGO_DataSplyClsS1B1_I.flgNewUriaPckVld UEGO_DataSplyClsS1B1_I.flgNewUriePckAry UEGO_DataSplyClsS1B1_I.flgNewUx6PckAry UEGO_DataSplyClsS1B1_I.flgNewUx7PckAry UEGO_DataSplyClsS1B1_I.flgNewUx8PckAry UEGO_DataSplyClsS1B1_I.flgNewUx9PckAry UEGO_DataSplyClsS1B1_I.flgNewUxPckAry UEGO_DataSplyClsS1B1_I.flgReStable UEGO_DataSplyClsS1B1_I.flgSngCell UEGO_DataSplyClsS1B1_I.flgUical0Vld UEGO_DataSplyClsS1B1_I.flgUicalVld UEGO_DataSplyClsS1B1_I.flgUoffipe1Vld UEGO_DataSplyClsS1B1_I.flgUoffipe2Vld UEGO_DataSplyClsS1B1_I.flgUoffipe3Vld UEGO_DataSplyClsS1B1_I.flgUoffvcc1Vld UEGO_DataSplyClsS1B1_I.flgUoffvcc2Vld UEGO_DataSplyClsS1B1_I.flgUoffvcc3Vld UEGO_DataSplyClsS1B1_I.flgUriaMeas UEGO_DataSplyClsS1B1_I.nrIPmpDacPckAry UEGO_DataSplyClsS1B1_I.nrIpPckAry UEGO_DataSplyClsS1B1_I.nrModeMeas UEGO_DataSplyClsS1B1_I.nrRamFailPosn UEGO_DataSplyClsS1B1_I.nrRamMod UEGO_DataSplyClsS1B1_I.nrRamRegMod UEGO_DataSplyClsS1B1_I.nrRamSts1 UEGO_DataSplyClsS1B1_I.nrRamSts2 UEGO_DataSplyClsS1B1_I.nrRamSts3 UEGO_DataSplyClsS1B1_I.nrURmVG4PckAry UEGO_DataSplyClsS1B1_I.nrUa2PckAry UEGO_DataSplyClsS1B1_I.nrUcalMaxCorrd UEGO_DataSplyClsS1B1_I.nrUg0PckAry UEGO_DataSplyClsS1B1_I.nrUg0iPckAry UEGO_DataSplyClsS1B1_I.nrUg0ix7PckAry UEGO_DataSplyClsS1B1_I.nrUg0ix9PckAry UEGO_DataSplyClsS1B1_I.nrUg0ixPckAry UEGO_DataSplyClsS1B1_I.nrUgaPckAry UEGO_DataSplyClsS1B1_I.nrUgiPckAry UEGO_DataSplyClsS1B1_I.nrUi21PckAry UEGO_DataSplyClsS1B1_I.nrUical0PckCorrd UEGO_DataSplyClsS1B1_I.nrUicalPckCorrd UEGO_DataSplyClsS1B1_I.nrUigPckAry UEGO_DataSplyClsS1B1_I.nrUigmkPckAry UEGO_DataSplyClsS1B1_I.nrUn0Pck4Ary UEGO_DataSplyClsS1B1_I.nrUn0Pck5Ary UEGO_DataSplyClsS1B1_I.nrUn0PckAry UEGO_DataSplyClsS1B1_I.nrUnPckAry UEGO_DataSplyClsS1B1_I.nrUnx3PckAry UEGO_DataSplyClsS1B1_I.nrUnx4PckAry UEGO_DataSplyClsS1B1_I.nrUoffipe1 UEGO_DataSplyClsS1B1_I.nrUoffipe2 UEGO_DataSplyClsS1B1_I.nrUoffipe3 UEGO_DataSplyClsS1B1_I.nrUoffvcc1 UEGO_DataSplyClsS1B1_I.nrUoffvcc2 UEGO_DataSplyClsS1B1_I.nrUoffvcc3 UEGO_DataSplyClsS1B1_I.nrUp0Pck5Ary UEGO_DataSplyClsS1B1_I.nrUp0PckAry UEGO_DataSplyClsS1B1_I.nrUpPckAry UEGO_DataSplyClsS1B1_I.nrUpx3PckAry UEGO_DataSplyClsS1B1_I.nrUpx4PckAry UEGO_DataSplyClsS1B1_I.nrUriePckAry UEGO_DataSplyClsS1B1_I.nrUx6PckAry UEGO_DataSplyClsS1B1_I.nrUx7PckAry UEGO_DataSplyClsS1B1_I.nrUx8PckAry UEGO_DataSplyClsS1B1_I.nrUx9PckAry UEGO_DataSplyClsS1B1_I.nrUxPckAry UEGO_DataSplyClsS1B1_I.stIPmpOK UEGO_DataSplyClsS1B1_I.stIPmpTM UEGO_DataSplyClsS1B1_I.stIPmpTM2L UEGO_DataSplyClsS1B1_I.stIPmpTM2R UEGO_DataSplyClsS1B1_I.stLsmRetValMod UEGO_DataSplyClsS1B1_I.stMKMeas UEGO_DataSplyClsS1B1_I.stOFFMeas UEGO_DataSplyClsS1B1_I.stOPTMeas UEGO_DataSplyClsS1B1_I.stREFMeas UEGO_DataSplyClsS1B1_I.stUa2PckAry UEGO_DataSplyClsS1B1_I.stUa2Z1PckAry UEGO_DataSplyClsS1B1_I.stUg0iPckAry UEGO_DataSplyClsS1B1_I.stUg0ix7IActvPckAry UEGO_DataSplyClsS1B1_I.stUg0ix7PmpIActvPckAry UEGO_DataSplyClsS1B1_I.stUg0ix9IActvPckAry UEGO_DataSplyClsS1B1_I.stUg0ix9PmpIActvPckAry UEGO_DataSplyClsS1B1_I.stUg0ixIActvPckAry UEGO_DataSplyClsS1B1_I.stUg0ixPmpIActvPckAry UEGO_DataSplyClsS1B1_I.stUi21PckAry UEGO_DataSplyClsS1B1_I.stUi21Z1PckAry UEGO_DataSplyClsS1B1_I.stUigmkNernstIActvPckAry UEGO_DataSplyClsS1B1_I.stUigmkPmpIActvPckAry UEGO_DataSplyClsS1B1_I.stUn0PckAry UEGO_DataSplyClsS1B1_I.stUn0Z2PckAry UEGO_DataSplyClsS1B1_I.stUnPckAry UEGO_DataSplyClsS1B1_I.stUnx3IActvAcrsNernstCellPckAry UEGO_DataSplyClsS1B1_I.stUnx3IActvAcrsPmpCellPckAry UEGO_DataSplyClsS1B1_I.stUnx4IActvAcrsNernstCellPckAry UEGO_DataSplyClsS1B1_I.stUnx4IActvAcrsPmpCellPckAry UEGO_DataSplyClsS1B1_I.stUp0PckAry UEGO_DataSplyClsS1B1_I.stUp0Z2PckAry UEGO_DataSplyClsS1B1_I.stUpPckAry UEGO_DataSplyClsS1B1_I.stUpZ2PckAry UEGO_DataSplyClsS1B1_I.stUpx3IActvAcrsNernstCellPckAry UEGO_DataSplyClsS1B1_I.stUpx3IActvAcrsPmpCellPckAry UEGO_DataSplyClsS1B1_I.stUpx4IActvAcrsNernstCellPckAry UEGO_DataSplyClsS1B1_I.stUpx4IActvAcrsPmpCellPckAry UEGO_DataSplyClsS1B1_I.stUriePckAry UEGO_DataSplyClsS1B1_I.stUx6IActvPckAry UEGO_DataSplyClsS1B1_I.stUx6MeasAcrsPmpCellPckAry UEGO_DataSplyClsS1B1_I.stUx7IActvPckAry UEGO_DataSplyClsS1B1_I.stUx7MeasAcrsPmpCellPckAry UEGO_DataSplyClsS1B1_I.stUx8IActvPckAry UEGO_DataSplyClsS1B1_I.stUx8MeasAcrsPmpCellPckAry UEGO_DataSplyClsS1B1_I.stUx9IActvPckAry UEGO_DataSplyClsS1B1_I.stUx9MeasAcrsPmpCellPckAry UEGO_DataSplyClsS1B1_I.stUxIActvPckAry UEGO_DataSplyClsS1B1_I.stUxMeasAcrsPmpCell UEGO_DataSplyClsS1B1_I.tiUEGOPck UEGO_DataSplyClsS1B1_I.uFkal1 UEGO_DataSplyClsS1B1_I.uFkal2 UEGO_DataSplyClsS1B1_I.uFkal3 UEGO_DataSplyClsS1B1_I.uUCalPck UEGO_DataSplyClsS1B1_I.uUa31Pck UEGO_DataSplyClsS1B1_I.uUa32Pck UEGO_DataSplyClsS1B1_I.uUa33Pck UEGO_DataSplyClsS1B1_I.uUamPck UEGO_DataSplyClsS1B1_I.uUapePck UEGO_DataSplyClsS1B1_I.uUcalMaxPck UEGO_DataSplyClsS1B1_I.uUg0Pck UEGO_DataSplyClsS1B1_I.uUg0aPck UEGO_DataSplyClsS1B1_I.uUg0ePck UEGO_DataSplyClsS1B1_I.uUg0iPck UEGO_DataSplyClsS1B1_I.uUg0iaiPck UEGO_DataSplyClsS1B1_I.uUg0ieiPck UEGO_DataSplyClsS1B1_I.uUg0mPck UEGO_DataSplyClsS1B1_I.uUgkAvrgPck UEGO_DataSplyClsS1B1_I.uUguaPck UEGO_DataSplyClsS1B1_I.uUguaZ2Pck UEGO_DataSplyClsS1B1_I.uUguiPck UEGO_DataSplyClsS1B1_I.uUguiZ1Pck UEGO_DataSplyClsS1B1_I.uUi22Pck UEGO_DataSplyClsS1B1_I.uUi23Pck UEGO_DataSplyClsS1B1_I.uUi24Pck UEGO_DataSplyClsS1B1_I.uUi4Pck UEGO_DataSplyClsS1B1_I.uUi4Z2Pck UEGO_DataSplyClsS1B1_I.uUipcalAvrgPck UEGO_DataSplyClsS1B1_I.uUn0Pck UEGO_DataSplyClsS1B1_I.uUnSet UEGO_DataSplyClsS1B1_I.uUp0Pck UEGO_DataSplyClsS1B1_I.uUp0Pck4 UEGO_DataSplyClsS1B1_I.uUriaPck UEGO_DataSplyClsS1B1_I.uVCC1Corrd UEGO_DataSplyClsS1B1_I.uVCC3Ref UEGO_flgCJ135AnS1B1 UEGO_flgDiagRprtRelsS1B1 UEGO_flgDiagSigWireOlRstS1B1 UEGO_flgRCmpPrsntS1B1 UEGO_flgSysSuprtdS1B1 UEGO_idxTypS1B1 UEGO_RegGetPrmS1B1_I.flgDlyBlcknNxtPckVld UEGO_RegGetPrmS1B1_I.flgDlyBlcknVld UEGO_RegGetPrmS1B1_I.flgDspDiagDis UEGO_RegGetPrmS1B1_I.flgDspDiagDisNxtPck UEGO_RegGetPrmS1B1_I.flgDspDiagDisNxtPckVld UEGO_RegGetPrmS1B1_I.flgDspDiagDisVld UEGO_RegGetPrmS1B1_I.flgEnSpA UEGO_RegGetPrmS1B1_I.flgEnSpAVld UEGO_RegGetPrmS1B1_I.flgEnSpE UEGO_RegGetPrmS1B1_I.flgEnSpEVld UEGO_RegGetPrmS1B1_I.flgEnSpNxtPckVld UEGO_RegGetPrmS1B1_I.flgEnSpVld UEGO_RegGetPrmS1B1_I.flgIPmpBlcknNxtPckVld UEGO_RegGetPrmS1B1_I.flgIPmpBlcknVld UEGO_RegGetPrmS1B1_I.flgIPmpLimnHiVld UEGO_RegGetPrmS1B1_I.flgIPmpLimnLoVld UEGO_RegGetPrmS1B1_I.flgIPmpRst UEGO_RegGetPrmS1B1_I.flgIPmpRstNxtPck UEGO_RegGetPrmS1B1_I.flgIPmpRstNxtPckVld UEGO_RegGetPrmS1B1_I.flgIPmpRstVld UEGO_RegGetPrmS1B1_I.flgIPmpSm UEGO_RegGetPrmS1B1_I.flgIPmpSmNxtPck UEGO_RegGetPrmS1B1_I.flgIPmpSmNxtPckVld UEGO_RegGetPrmS1B1_I.flgIPmpSmVld UEGO_RegGetPrmS1B1_I.flgLCal UEGO_RegGetPrmS1B1_I.flgLCalVld UEGO_RegGetPrmS1B1_I.flgLCurr UEGO_RegGetPrmS1B1_I.flgLCurrVld UEGO_RegGetPrmS1B1_I.flgLDAC UEGO_RegGetPrmS1B1_I.flgLDACConf UEGO_RegGetPrmS1B1_I.flgLDACConfVld UEGO_RegGetPrmS1B1_I.flgLDACVld UEGO_RegGetPrmS1B1_I.flgLG0 UEGO_RegGetPrmS1B1_I.flgLG0Vld UEGO_RegGetPrmS1B1_I.flgLN UEGO_RegGetPrmS1B1_I.flgLNNxtPck UEGO_RegGetPrmS1B1_I.flgLNNxtPckVld UEGO_RegGetPrmS1B1_I.flgLNVld UEGO_RegGetPrmS1B1_I.flgLP UEGO_RegGetPrmS1B1_I.flgLPNxtPck UEGO_RegGetPrmS1B1_I.flgLPNxtPckVld UEGO_RegGetPrmS1B1_I.flgLPVld UEGO_RegGetPrmS1B1_I.flgMKA UEGO_RegGetPrmS1B1_I.flgMKAVld UEGO_RegGetPrmS1B1_I.flgMKE UEGO_RegGetPrmS1B1_I.flgMKEVld UEGO_RegGetPrmS1B1_I.flgMKNxtPckVld UEGO_RegGetPrmS1B1_I.flgMKVld UEGO_RegGetPrmS1B1_I.flgN3MeasActvNxtPck UEGO_RegGetPrmS1B1_I.flgN3MeasActvNxtPckVld UEGO_RegGetPrmS1B1_I.flgOFFNxtPckVld UEGO_RegGetPrmS1B1_I.flgOFFVld UEGO_RegGetPrmS1B1_I.flgOPTNxtPckVld UEGO_RegGetPrmS1B1_I.flgOPTVld UEGO_RegGetPrmS1B1_I.flgPatNxtPckVld UEGO_RegGetPrmS1B1_I.flgPatVld UEGO_RegGetPrmS1B1_I.flgRCmpHeatrEdgeShiftAllwd UEGO_RegGetPrmS1B1_I.flgRCmpHeatrEdgeShiftAllwdNxtPck UEGO_RegGetPrmS1B1_I.flgRCmpHeatrEdgeShiftAllwdNxtPckVld UEGO_RegGetPrmS1B1_I.flgRCmpHeatrEdgeShiftAllwdVld UEGO_RegGetPrmS1B1_I.flgReStab UEGO_RegGetPrmS1B1_I.flgReStabVld UEGO_RegGetPrmS1B1_I.flgRefNxtPckVld UEGO_RegGetPrmS1B1_I.flgRefPatChng UEGO_RegGetPrmS1B1_I.flgRefPatNxtPckVld UEGO_RegGetPrmS1B1_I.flgRefPatVld UEGO_RegGetPrmS1B1_I.flgRefVld UEGO_RegGetPrmS1B1_I.flgRegIPmpSetNxtPckVld UEGO_RegGetPrmS1B1_I.flgRegIPmpSetVld UEGO_RegGetPrmS1B1_I.flgRegIpoffChng UEGO_RegGetPrmS1B1_I.flgRegIpoffNxtPckVld UEGO_RegGetPrmS1B1_I.flgRegIpoffVld UEGO_RegGetPrmS1B1_I.flgRegModNxtPckVld UEGO_RegGetPrmS1B1_I.flgRegModVld UEGO_RegGetPrmS1B1_I.flgRegPartModNxtPckVld UEGO_RegGetPrmS1B1_I.flgRegPartModVld UEGO_RegGetPrmS1B1_I.flgRegUnsetNxtPckVld UEGO_RegGetPrmS1B1_I.flgRiaPatChng UEGO_RegGetPrmS1B1_I.flgRiaPatVld UEGO_RegGetPrmS1B1_I.flgRipVld UEGO_RegGetPrmS1B1_I.flgSngCell UEGO_RegGetPrmS1B1_I.flgSngCellVld UEGO_RegGetPrmS1B1_I.flgSteerPatChng UEGO_RegGetPrmS1B1_I.flgSteerPatNxtPckVld UEGO_RegGetPrmS1B1_I.flgSteerPatVld UEGO_RegGetPrmS1B1_I.flgSubModMeasNxtPckVld UEGO_RegGetPrmS1B1_I.flgSubModMeasVld UEGO_RegGetPrmS1B1_I.flgSwVirtGnd UEGO_RegGetPrmS1B1_I.flgSwVirtGndVld UEGO_RegGetPrmS1B1_I.flgTrimSqChng UEGO_RegGetPrmS1B1_I.flgTrimSqrCalChng UEGO_RegGetPrmS1B1_I.flgTrimSqrChng UEGO_RegGetPrmS1B1_I.flgTrmNxtPckVld UEGO_RegGetPrmS1B1_I.flgTrmSqCalOffSet UEGO_RegGetPrmS1B1_I.flgTrmSqCalVld UEGO_RegGetPrmS1B1_I.flgTrmSqOffSet UEGO_RegGetPrmS1B1_I.flgTrmSqOffSetVld UEGO_RegGetPrmS1B1_I.flgTrmSqVld UEGO_RegGetPrmS1B1_I.flgTrmSqrCalOffSet UEGO_RegGetPrmS1B1_I.flgTrmSqrCalVld UEGO_RegGetPrmS1B1_I.flgTrmSqrOffSet UEGO_RegGetPrmS1B1_I.flgTrmSqrOffSetVld UEGO_RegGetPrmS1B1_I.flgTrmSqrVld UEGO_RegGetPrmS1B1_I.flgUnsetVld UEGO_RegGetPrmS1B1_I.flgUp0LeanNxtPckVld UEGO_RegGetPrmS1B1_I.flgUp0LeanVld UEGO_RegGetPrmS1B1_I.flgUp0RichNxtPckVld UEGO_RegGetPrmS1B1_I.flgUp0RichVld UEGO_RegGetPrmS1B1_I.flgUria UEGO_RegGetPrmS1B1_I.flgUriaNxtPck UEGO_RegGetPrmS1B1_I.flgUriaNxtPckVld UEGO_RegGetPrmS1B1_I.flgUriaVld UEGO_RegGetPrmS1B1_I.flgV1BF2NxtPckVld UEGO_RegGetPrmS1B1_I.flgV1BF2Vld UEGO_RegGetPrmS1B1_I.flgV1BF3NxtPckVld UEGO_RegGetPrmS1B1_I.flgV1BIT1 UEGO_RegGetPrmS1B1_I.flgV1BIT1NxtPck UEGO_RegGetPrmS1B1_I.flgV1BIT1NxtPckVld UEGO_RegGetPrmS1B1_I.flgV1BIT1Vld UEGO_RegGetPrmS1B1_I.flgV1BIT2 UEGO_RegGetPrmS1B1_I.flgV1BIT2NxtPck UEGO_RegGetPrmS1B1_I.flgV1BIT2NxtPckVld UEGO_RegGetPrmS1B1_I.flgV1BIT2Vld UEGO_RegGetPrmS1B1_I.flgV1BIT5 UEGO_RegGetPrmS1B1_I.flgV1BIT5NxtPck UEGO_RegGetPrmS1B1_I.flgV1BIT5NxtPckVld UEGO_RegGetPrmS1B1_I.flgV1BIT5Vld UEGO_RegGetPrmS1B1_I.flgWtrEleclyActv UEGO_RegGetPrmS1B1_I.flgWtrEleclyActvNxtPck UEGO_RegGetPrmS1B1_I.flgWtrEleclyActvNxtPckVld UEGO_RegGetPrmS1B1_I.flgWtrEleclyActvVld UEGO_RegGetPrmS1B1_I.flgZIsqrA UEGO_RegGetPrmS1B1_I.flgZIsqrAVld UEGO_RegGetPrmS1B1_I.flgZIsqrE UEGO_RegGetPrmS1B1_I.flgZIsqrEVld UEGO_RegGetPrmS1B1_I.nrIPmpBlcknNxtPck UEGO_RegGetPrmS1B1_I.nrIPmpLimnHi UEGO_RegGetPrmS1B1_I.nrIPmpLimnLo UEGO_RegGetPrmS1B1_I.nrPmpBlckn UEGO_RegGetPrmS1B1_I.nrRefPatNxtPck UEGO_RegGetPrmS1B1_I.nrRegIPmpSet UEGO_RegGetPrmS1B1_I.nrRegIPmpSetNxtPck UEGO_RegGetPrmS1B1_I.nrRegIpoff UEGO_RegGetPrmS1B1_I.nrRegMod UEGO_RegGetPrmS1B1_I.nrRegModNxtPck UEGO_RegGetPrmS1B1_I.nrRegPartMod UEGO_RegGetPrmS1B1_I.nrRegPartModNxtPck UEGO_RegGetPrmS1B1_I.nrRegTrmNxtPck UEGO_RegGetPrmS1B1_I.nrRegTrmSqNxtPck UEGO_RegGetPrmS1B1_I.nrRegTrmSqrNxtPck UEGO_RegGetPrmS1B1_I.nrRip UEGO_RegGetPrmS1B1_I.nrSteerPatNxtPck UEGO_RegGetPrmS1B1_I.nrSubModMeas UEGO_RegGetPrmS1B1_I.nrSubModMeasNxtPck UEGO_RegGetPrmS1B1_I.nrTrmSq UEGO_RegGetPrmS1B1_I.nrTrmSqCal UEGO_RegGetPrmS1B1_I.nrTrmSqr UEGO_RegGetPrmS1B1_I.nrTrmSqrCal UEGO_RegGetPrmS1B1_I.nrUnset UEGO_RegGetPrmS1B1_I.nrUnsetNxtPck UEGO_RegGetPrmS1B1_I.nrUp0Lean UEGO_RegGetPrmS1B1_I.nrUp0LeanNxtPck UEGO_RegGetPrmS1B1_I.nrUp0Rich UEGO_RegGetPrmS1B1_I.nrUp0RichNxtPck UEGO_RegGetPrmS1B1_I.stDlyBlckn UEGO_RegGetPrmS1B1_I.stDlyBlcknNxtPck UEGO_RegGetPrmS1B1_I.stEnSp UEGO_RegGetPrmS1B1_I.stEnSpNxtPck UEGO_RegGetPrmS1B1_I.stMK UEGO_RegGetPrmS1B1_I.stMKNxtPck UEGO_RegGetPrmS1B1_I.stOFF UEGO_RegGetPrmS1B1_I.stOFFNxtPck UEGO_RegGetPrmS1B1_I.stOPT UEGO_RegGetPrmS1B1_I.stOPTNxtPck UEGO_RegGetPrmS1B1_I.stPat UEGO_RegGetPrmS1B1_I.stPatNxtPck UEGO_RegGetPrmS1B1_I.stRef UEGO_RegGetPrmS1B1_I.stRefNxtPck UEGO_RegGetPrmS1B1_I.stRefPat UEGO_RegGetPrmS1B1_I.stRegIpoffNxtPck UEGO_RegGetPrmS1B1_I.stRiaPat UEGO_RegGetPrmS1B1_I.stSteerPat UEGO_RegGetPrmS1B1_I.stV1BF2 UEGO_RegGetPrmS1B1_I.stV1BF2NxtPck UEGO_RegGetPrmS1B1_I.stV1BF3NxtPck UEGO_RegSetS1B1_I.cntrRegSet UEGO_RegSetS1B1_I.flgCJ135An UEGO_RegSetS1B1_I.flgConvVld UEGO_RegSetS1B1_I.flgIPmpDes UEGO_RegSetS1B1_I.flgIPmpPhyRels UEGO_RegSetS1B1_I.flgIniFinshd UEGO_RegSetS1B1_I.flgLoupeCURRDes UEGO_RegSetS1B1_I.flgLoupeDACDes UEGO_RegSetS1B1_I.flgLoupeNDes UEGO_RegSetS1B1_I.flgLoupePDes UEGO_RegSetS1B1_I.flgNewReq UEGO_RegSetS1B1_I.flgRegSetSt UEGO_RegSetS1B1_I.flgRegSetStVld UEGO_RegSetS1B1_I.flgReqAcptd UEGO_RegSetS1B1_I.flgSetRegOk UEGO_RegSetS1B1_I.flgTakeDataOk UEGO_RegSetS1B1_I.idxChp UEGO_RegSetS1B1_I.nrIdleSubMode UEGO_RegSetS1B1_I.nrModDes UEGO_RegSetS1B1_I.nrNormSubMode UEGO_RegSetS1B1_I.nrRegSet UEGO_RegSetS1B1_I.nrSubModDes UEGO_RegSetS1B1_I.nrSwtOnSubMode UEGO_RegSetS1B1_I.nrTrmSq UEGO_RegSetS1B1_I.nrWrmUpSubMode UEGO_RegSetS1B1_I.stRegSet UEGO_RegSetS1B1_I.stRegSetVld UEGO_RegSetS1B1_I.tmpVar /end IN_MEASUREMENT
 /begin OUT_MEASUREMENT UEGO_facCrvCorrnS1B1 UEGO_flgfacCrvCorrnHiPrcsnS1B1 UEGO_flgfacCrvCorrnVldS1B1 UEGO_flgRCmpUseS1B1 UEGO_flgRCmpVldS1B1 UEGO_flgRParlVldS1B1 UEGO_rRCmpS1B1 UEGO_rRParlS1B1 /end OUT_MEASUREMENT
 /begin LOC_MEASUREMENT UEGO_RCmpCtrlS1B1_I.flgRCmpMeasReq UEGO_RCmpCtrlS1B1_I.flgSetRegOk UEGO_RCmpCtrlS1B1_I.nrModIntCtrl UEGO_RCmpCtrlS1B1_I.nrModIntCtrlOld UEGO_RCmpEvlnS1B1_I.facCrvCorrn UEGO_RCmpEvlnS1B1_I.flgRCmpUse UEGO_RCmpEvlnS1B1_I.flgRCmpVld UEGO_RCmpEvlnS1B1_I.flgRParlUse UEGO_RCmpEvlnS1B1_I.flgRParlVld UEGO_RCmpEvlnS1B1_I.flgfacCrvCorrnHiPrcsn UEGO_RCmpEvlnS1B1_I.flgfacCrvCorrnVld UEGO_RCmpEvlnS1B1_I.nrModIntFacCrvCorrn UEGO_RCmpEvlnS1B1_I.nrModIntFacCrvCorrnOld UEGO_RCmpEvlnS1B1_I.nrModIntRCmp UEGO_RCmpEvlnS1B1_I.nrModIntRCmpOld UEGO_RCmpEvlnS1B1_I.nrModIntRParl UEGO_RCmpEvlnS1B1_I.nrModIntRParlOld UEGO_RCmpEvlnS1B1_I.rRCmp UEGO_RCmpEvlnS1B1_I.rRParl UEGO_RCmpEvlnS1B1_I.UEGO_RCmpFil_I.flgEvlnStrtd UEGO_RCmpEvlnS1B1_I.UEGO_RCmpFil_I.EvlnFil_DL_I.memory UEGO_RCmpEvlnS1B1_I.UEGO_RParlFil_I.flgEvlnStrtd UEGO_RCmpEvlnS1B1_I.UEGO_RParlFil_I.EvlnFil_DL_I.memory /end LOC_MEASUREMENT
 FUNCTION_VERSION "1.17.0" /end FUNCTION
/begin FUNCTION UEGO_RegGet "1.14.0    UEGO Aquisition of Register Settings" /begin REF_CHARACTERISTIC UEGO_idxHWES1B1_C /end REF_CHARACTERISTIC
 /begin IN_MEASUREMENT UEGO_DataSplyClsS1B1_I.flgCj135An UEGO_DataSplyClsS1B1_I.flgDACOff UEGO_DataSplyClsS1B1_I.flgErrSpiRamRet UEGO_DataSplyClsS1B1_I.flgFKal1Vld UEGO_DataSplyClsS1B1_I.flgFKal2Vld UEGO_DataSplyClsS1B1_I.flgFKal3Vld UEGO_DataSplyClsS1B1_I.flgIPmpActvd UEGO_DataSplyClsS1B1_I.flgISQrA UEGO_DataSplyClsS1B1_I.flgISQrE UEGO_DataSplyClsS1B1_I.flgLCURR UEGO_DataSplyClsS1B1_I.flgLNMeas UEGO_DataSplyClsS1B1_I.flgLPMeas UEGO_DataSplyClsS1B1_I.flgLoupeCAL UEGO_DataSplyClsS1B1_I.flgLoupeG0 UEGO_DataSplyClsS1B1_I.flgLstPckAbort UEGO_DataSplyClsS1B1_I.flgMKA UEGO_DataSplyClsS1B1_I.flgMKE UEGO_DataSplyClsS1B1_I.flgNewIPmpDacPckAry UEGO_DataSplyClsS1B1_I.flgNewIPmpOK UEGO_DataSplyClsS1B1_I.flgNewIPmpPckAry UEGO_DataSplyClsS1B1_I.flgNewIPmpTM UEGO_DataSplyClsS1B1_I.flgNewPck UEGO_DataSplyClsS1B1_I.flgNewPckCstnc UEGO_DataSplyClsS1B1_I.flgNewPckMiss UEGO_DataSplyClsS1B1_I.flgNewPckVld UEGO_DataSplyClsS1B1_I.flgNewTiPck UEGO_DataSplyClsS1B1_I.flgNewURmVG4MeasAryVld UEGO_DataSplyClsS1B1_I.flgNewUa2Pck UEGO_DataSplyClsS1B1_I.flgNewUa31Pck UEGO_DataSplyClsS1B1_I.flgNewUa32Pck UEGO_DataSplyClsS1B1_I.flgNewUa33Pck UEGO_DataSplyClsS1B1_I.flgNewUamPck UEGO_DataSplyClsS1B1_I.flgNewUapePck UEGO_DataSplyClsS1B1_I.flgNewUcalMaxPck UEGO_DataSplyClsS1B1_I.flgNewUcalPck UEGO_DataSplyClsS1B1_I.flgNewUg0Pck UEGO_DataSplyClsS1B1_I.flgNewUg0PckAry UEGO_DataSplyClsS1B1_I.flgNewUg0aPck UEGO_DataSplyClsS1B1_I.flgNewUg0ePck UEGO_DataSplyClsS1B1_I.flgNewUg0iPck UEGO_DataSplyClsS1B1_I.flgNewUg0iPckAry UEGO_DataSplyClsS1B1_I.flgNewUg0iaiPck UEGO_DataSplyClsS1B1_I.flgNewUg0ieiPck UEGO_DataSplyClsS1B1_I.flgNewUg0ix7PckAry UEGO_DataSplyClsS1B1_I.flgNewUg0ix9PckAry UEGO_DataSplyClsS1B1_I.flgNewUg0ixPckAry UEGO_DataSplyClsS1B1_I.flgNewUg0mPck UEGO_DataSplyClsS1B1_I.flgNewUgaPck UEGO_DataSplyClsS1B1_I.flgNewUgiPckAry UEGO_DataSplyClsS1B1_I.flgNewUgkAvrgPck UEGO_DataSplyClsS1B1_I.flgNewUguaPck UEGO_DataSplyClsS1B1_I.flgNewUguaZ2Pck UEGO_DataSplyClsS1B1_I.flgNewUguiPck UEGO_DataSplyClsS1B1_I.flgNewUguiZ1Pck UEGO_DataSplyClsS1B1_I.flgNewUi21PckAry UEGO_DataSplyClsS1B1_I.flgNewUi22Pck UEGO_DataSplyClsS1B1_I.flgNewUi23Pck UEGO_DataSplyClsS1B1_I.flgNewUi24Pck UEGO_DataSplyClsS1B1_I.flgNewUi4Pck UEGO_DataSplyClsS1B1_I.flgNewUi4Z2Pck UEGO_DataSplyClsS1B1_I.flgNewUigPckAry UEGO_DataSplyClsS1B1_I.flgNewUigmkPckAry UEGO_DataSplyClsS1B1_I.flgNewUipcalAvrgPck UEGO_DataSplyClsS1B1_I.flgNewUn0Pck UEGO_DataSplyClsS1B1_I.flgNewUn0Pck4Ary UEGO_DataSplyClsS1B1_I.flgNewUn0Pck5Ary UEGO_DataSplyClsS1B1_I.flgNewUn0PckAry UEGO_DataSplyClsS1B1_I.flgNewUnPckAry UEGO_DataSplyClsS1B1_I.flgNewUnSetPck UEGO_DataSplyClsS1B1_I.flgNewUnx3PckAry UEGO_DataSplyClsS1B1_I.flgNewUnx4PckAry UEGO_DataSplyClsS1B1_I.flgNewUp0Pck UEGO_DataSplyClsS1B1_I.flgNewUp0Pck4 UEGO_DataSplyClsS1B1_I.flgNewUp0Pck5Ary UEGO_DataSplyClsS1B1_I.flgNewUp0PckAry UEGO_DataSplyClsS1B1_I.flgNewUpPckAry UEGO_DataSplyClsS1B1_I.flgNewUpx3PckAry UEGO_DataSplyClsS1B1_I.flgNewUpx4PckAry UEGO_DataSplyClsS1B1_I.flgNewUriaPckVld UEGO_DataSplyClsS1B1_I.flgNewUriePckAry UEGO_DataSplyClsS1B1_I.flgNewUx6PckAry UEGO_DataSplyClsS1B1_I.flgNewUx7PckAry UEGO_DataSplyClsS1B1_I.flgNewUx8PckAry UEGO_DataSplyClsS1B1_I.flgNewUx9PckAry UEGO_DataSplyClsS1B1_I.flgNewUxPckAry UEGO_DataSplyClsS1B1_I.flgReStable UEGO_DataSplyClsS1B1_I.flgSngCell UEGO_DataSplyClsS1B1_I.flgUical0Vld UEGO_DataSplyClsS1B1_I.flgUicalVld UEGO_DataSplyClsS1B1_I.flgUoffipe1Vld UEGO_DataSplyClsS1B1_I.flgUoffipe2Vld UEGO_DataSplyClsS1B1_I.flgUoffipe3Vld UEGO_DataSplyClsS1B1_I.flgUoffvcc1Vld UEGO_DataSplyClsS1B1_I.flgUoffvcc2Vld UEGO_DataSplyClsS1B1_I.flgUoffvcc3Vld UEGO_DataSplyClsS1B1_I.flgUriaMeas UEGO_DataSplyClsS1B1_I.nrIPmpDacPckAry UEGO_DataSplyClsS1B1_I.nrIpPckAry UEGO_DataSplyClsS1B1_I.nrModeMeas UEGO_DataSplyClsS1B1_I.nrRamFailPosn UEGO_DataSplyClsS1B1_I.nrRamMod UEGO_DataSplyClsS1B1_I.nrRamRegMod UEGO_DataSplyClsS1B1_I.nrRamSts1 UEGO_DataSplyClsS1B1_I.nrRamSts2 UEGO_DataSplyClsS1B1_I.nrRamSts3 UEGO_DataSplyClsS1B1_I.nrURmVG4PckAry UEGO_DataSplyClsS1B1_I.nrUa2PckAry UEGO_DataSplyClsS1B1_I.nrUcalMaxCorrd UEGO_DataSplyClsS1B1_I.nrUg0PckAry UEGO_DataSplyClsS1B1_I.nrUg0iPckAry UEGO_DataSplyClsS1B1_I.nrUg0ix7PckAry UEGO_DataSplyClsS1B1_I.nrUg0ix9PckAry UEGO_DataSplyClsS1B1_I.nrUg0ixPckAry UEGO_DataSplyClsS1B1_I.nrUgaPckAry UEGO_DataSplyClsS1B1_I.nrUgiPckAry UEGO_DataSplyClsS1B1_I.nrUi21PckAry UEGO_DataSplyClsS1B1_I.nrUical0PckCorrd UEGO_DataSplyClsS1B1_I.nrUicalPckCorrd UEGO_DataSplyClsS1B1_I.nrUigPckAry UEGO_DataSplyClsS1B1_I.nrUigmkPckAry UEGO_DataSplyClsS1B1_I.nrUn0Pck4Ary UEGO_DataSplyClsS1B1_I.nrUn0Pck5Ary UEGO_DataSplyClsS1B1_I.nrUn0PckAry UEGO_DataSplyClsS1B1_I.nrUnPckAry UEGO_DataSplyClsS1B1_I.nrUnx3PckAry UEGO_DataSplyClsS1B1_I.nrUnx4PckAry UEGO_DataSplyClsS1B1_I.nrUoffipe1 UEGO_DataSplyClsS1B1_I.nrUoffipe2 UEGO_DataSplyClsS1B1_I.nrUoffipe3 UEGO_DataSplyClsS1B1_I.nrUoffvcc1 UEGO_DataSplyClsS1B1_I.nrUoffvcc2 UEGO_DataSplyClsS1B1_I.nrUoffvcc3 UEGO_DataSplyClsS1B1_I.nrUp0Pck5Ary UEGO_DataSplyClsS1B1_I.nrUp0PckAry UEGO_DataSplyClsS1B1_I.nrUpPckAry UEGO_DataSplyClsS1B1_I.nrUpx3PckAry UEGO_DataSplyClsS1B1_I.nrUpx4PckAry UEGO_DataSplyClsS1B1_I.nrUriePckAry UEGO_DataSplyClsS1B1_I.nrUx6PckAry UEGO_DataSplyClsS1B1_I.nrUx7PckAry UEGO_DataSplyClsS1B1_I.nrUx8PckAry UEGO_DataSplyClsS1B1_I.nrUx9PckAry UEGO_DataSplyClsS1B1_I.nrUxPckAry UEGO_DataSplyClsS1B1_I.stIPmpOK UEGO_DataSplyClsS1B1_I.stIPmpTM UEGO_DataSplyClsS1B1_I.stIPmpTM2L UEGO_DataSplyClsS1B1_I.stIPmpTM2R UEGO_DataSplyClsS1B1_I.stLsmRetValMod UEGO_DataSplyClsS1B1_I.stMKMeas UEGO_DataSplyClsS1B1_I.stOFFMeas UEGO_DataSplyClsS1B1_I.stOPTMeas UEGO_DataSplyClsS1B1_I.stREFMeas UEGO_DataSplyClsS1B1_I.stUa2PckAry UEGO_DataSplyClsS1B1_I.stUa2Z1PckAry UEGO_DataSplyClsS1B1_I.stUg0iPckAry UEGO_DataSplyClsS1B1_I.stUg0ix7IActvPckAry UEGO_DataSplyClsS1B1_I.stUg0ix7PmpIActvPckAry UEGO_DataSplyClsS1B1_I.stUg0ix9IActvPckAry UEGO_DataSplyClsS1B1_I.stUg0ix9PmpIActvPckAry UEGO_DataSplyClsS1B1_I.stUg0ixIActvPckAry UEGO_DataSplyClsS1B1_I.stUg0ixPmpIActvPckAry UEGO_DataSplyClsS1B1_I.stUi21PckAry UEGO_DataSplyClsS1B1_I.stUi21Z1PckAry UEGO_DataSplyClsS1B1_I.stUigmkNernstIActvPckAry UEGO_DataSplyClsS1B1_I.stUigmkPmpIActvPckAry UEGO_DataSplyClsS1B1_I.stUn0PckAry UEGO_DataSplyClsS1B1_I.stUn0Z2PckAry UEGO_DataSplyClsS1B1_I.stUnPckAry UEGO_DataSplyClsS1B1_I.stUnx3IActvAcrsNernstCellPckAry UEGO_DataSplyClsS1B1_I.stUnx3IActvAcrsPmpCellPckAry UEGO_DataSplyClsS1B1_I.stUnx4IActvAcrsNernstCellPckAry UEGO_DataSplyClsS1B1_I.stUnx4IActvAcrsPmpCellPckAry UEGO_DataSplyClsS1B1_I.stUp0PckAry UEGO_DataSplyClsS1B1_I.stUp0Z2PckAry UEGO_DataSplyClsS1B1_I.stUpPckAry UEGO_DataSplyClsS1B1_I.stUpZ2PckAry UEGO_DataSplyClsS1B1_I.stUpx3IActvAcrsNernstCellPckAry UEGO_DataSplyClsS1B1_I.stUpx3IActvAcrsPmpCellPckAry UEGO_DataSplyClsS1B1_I.stUpx4IActvAcrsNernstCellPckAry UEGO_DataSplyClsS1B1_I.stUpx4IActvAcrsPmpCellPckAry UEGO_DataSplyClsS1B1_I.stUriePckAry UEGO_DataSplyClsS1B1_I.stUx6IActvPckAry UEGO_DataSplyClsS1B1_I.stUx6MeasAcrsPmpCellPckAry UEGO_DataSplyClsS1B1_I.stUx7IActvPckAry UEGO_DataSplyClsS1B1_I.stUx7MeasAcrsPmpCellPckAry UEGO_DataSplyClsS1B1_I.stUx8IActvPckAry UEGO_DataSplyClsS1B1_I.stUx8MeasAcrsPmpCellPckAry UEGO_DataSplyClsS1B1_I.stUx9IActvPckAry UEGO_DataSplyClsS1B1_I.stUx9MeasAcrsPmpCellPckAry UEGO_DataSplyClsS1B1_I.stUxIActvPckAry UEGO_DataSplyClsS1B1_I.stUxMeasAcrsPmpCell UEGO_DataSplyClsS1B1_I.tiUEGOPck UEGO_DataSplyClsS1B1_I.uFkal1 UEGO_DataSplyClsS1B1_I.uFkal2 UEGO_DataSplyClsS1B1_I.uFkal3 UEGO_DataSplyClsS1B1_I.uUCalPck UEGO_DataSplyClsS1B1_I.uUa31Pck UEGO_DataSplyClsS1B1_I.uUa32Pck UEGO_DataSplyClsS1B1_I.uUa33Pck UEGO_DataSplyClsS1B1_I.uUamPck UEGO_DataSplyClsS1B1_I.uUapePck UEGO_DataSplyClsS1B1_I.uUcalMaxPck UEGO_DataSplyClsS1B1_I.uUg0Pck UEGO_DataSplyClsS1B1_I.uUg0aPck UEGO_DataSplyClsS1B1_I.uUg0ePck UEGO_DataSplyClsS1B1_I.uUg0iPck UEGO_DataSplyClsS1B1_I.uUg0iaiPck UEGO_DataSplyClsS1B1_I.uUg0ieiPck UEGO_DataSplyClsS1B1_I.uUg0mPck UEGO_DataSplyClsS1B1_I.uUgkAvrgPck UEGO_DataSplyClsS1B1_I.uUguaPck UEGO_DataSplyClsS1B1_I.uUguaZ2Pck UEGO_DataSplyClsS1B1_I.uUguiPck UEGO_DataSplyClsS1B1_I.uUguiZ1Pck UEGO_DataSplyClsS1B1_I.uUi22Pck UEGO_DataSplyClsS1B1_I.uUi23Pck UEGO_DataSplyClsS1B1_I.uUi24Pck UEGO_DataSplyClsS1B1_I.uUi4Pck UEGO_DataSplyClsS1B1_I.uUi4Z2Pck UEGO_DataSplyClsS1B1_I.uUipcalAvrgPck UEGO_DataSplyClsS1B1_I.uUn0Pck UEGO_DataSplyClsS1B1_I.uUnSet UEGO_DataSplyClsS1B1_I.uUp0Pck UEGO_DataSplyClsS1B1_I.uUp0Pck4 UEGO_DataSplyClsS1B1_I.uUriaPck UEGO_DataSplyClsS1B1_I.uVCC1Corrd UEGO_DataSplyClsS1B1_I.uVCC3Ref UEGO_flgCJ135AnS1B1 UEGO_flgSysSuprtdS1B1 /end IN_MEASUREMENT
 /begin OUT_MEASUREMENT UEGO_RegGetPrmS1B1_I.flgDlyBlcknNxtPckVld UEGO_RegGetPrmS1B1_I.flgDlyBlcknVld UEGO_RegGetPrmS1B1_I.flgDspDiagDis UEGO_RegGetPrmS1B1_I.flgDspDiagDisNxtPck UEGO_RegGetPrmS1B1_I.flgDspDiagDisNxtPckVld UEGO_RegGetPrmS1B1_I.flgDspDiagDisVld UEGO_RegGetPrmS1B1_I.flgEnSpA UEGO_RegGetPrmS1B1_I.flgEnSpAVld UEGO_RegGetPrmS1B1_I.flgEnSpE UEGO_RegGetPrmS1B1_I.flgEnSpEVld UEGO_RegGetPrmS1B1_I.flgEnSpNxtPckVld UEGO_RegGetPrmS1B1_I.flgEnSpVld UEGO_RegGetPrmS1B1_I.flgIPmpBlcknNxtPckVld UEGO_RegGetPrmS1B1_I.flgIPmpBlcknVld UEGO_RegGetPrmS1B1_I.flgIPmpLimnHiVld UEGO_RegGetPrmS1B1_I.flgIPmpLimnLoVld UEGO_RegGetPrmS1B1_I.flgIPmpRst UEGO_RegGetPrmS1B1_I.flgIPmpRstNxtPck UEGO_RegGetPrmS1B1_I.flgIPmpRstNxtPckVld UEGO_RegGetPrmS1B1_I.flgIPmpRstVld UEGO_RegGetPrmS1B1_I.flgIPmpSm UEGO_RegGetPrmS1B1_I.flgIPmpSmNxtPck UEGO_RegGetPrmS1B1_I.flgIPmpSmNxtPckVld UEGO_RegGetPrmS1B1_I.flgIPmpSmVld UEGO_RegGetPrmS1B1_I.flgLCal UEGO_RegGetPrmS1B1_I.flgLCalVld UEGO_RegGetPrmS1B1_I.flgLCurr UEGO_RegGetPrmS1B1_I.flgLCurrVld UEGO_RegGetPrmS1B1_I.flgLDAC UEGO_RegGetPrmS1B1_I.flgLDACConf UEGO_RegGetPrmS1B1_I.flgLDACConfVld UEGO_RegGetPrmS1B1_I.flgLDACVld UEGO_RegGetPrmS1B1_I.flgLG0 UEGO_RegGetPrmS1B1_I.flgLG0Vld UEGO_RegGetPrmS1B1_I.flgLN UEGO_RegGetPrmS1B1_I.flgLNNxtPck UEGO_RegGetPrmS1B1_I.flgLNNxtPckVld UEGO_RegGetPrmS1B1_I.flgLNVld UEGO_RegGetPrmS1B1_I.flgLP UEGO_RegGetPrmS1B1_I.flgLPNxtPck UEGO_RegGetPrmS1B1_I.flgLPNxtPckVld UEGO_RegGetPrmS1B1_I.flgLPVld UEGO_RegGetPrmS1B1_I.flgMKA UEGO_RegGetPrmS1B1_I.flgMKAVld UEGO_RegGetPrmS1B1_I.flgMKE UEGO_RegGetPrmS1B1_I.flgMKEVld UEGO_RegGetPrmS1B1_I.flgMKNxtPckVld UEGO_RegGetPrmS1B1_I.flgMKVld UEGO_RegGetPrmS1B1_I.flgN3MeasActvNxtPck UEGO_RegGetPrmS1B1_I.flgN3MeasActvNxtPckVld UEGO_RegGetPrmS1B1_I.flgOFFNxtPckVld UEGO_RegGetPrmS1B1_I.flgOFFVld UEGO_RegGetPrmS1B1_I.flgOPTNxtPckVld UEGO_RegGetPrmS1B1_I.flgOPTVld UEGO_RegGetPrmS1B1_I.flgPatNxtPckVld UEGO_RegGetPrmS1B1_I.flgPatVld UEGO_RegGetPrmS1B1_I.flgRCmpHeatrEdgeShiftAllwd UEGO_RegGetPrmS1B1_I.flgRCmpHeatrEdgeShiftAllwdNxtPck UEGO_RegGetPrmS1B1_I.flgRCmpHeatrEdgeShiftAllwdNxtPckVld UEGO_RegGetPrmS1B1_I.flgRCmpHeatrEdgeShiftAllwdVld UEGO_RegGetPrmS1B1_I.flgReStab UEGO_RegGetPrmS1B1_I.flgReStabVld UEGO_RegGetPrmS1B1_I.flgRefNxtPckVld UEGO_RegGetPrmS1B1_I.flgRefPatChng UEGO_RegGetPrmS1B1_I.flgRefPatNxtPckVld UEGO_RegGetPrmS1B1_I.flgRefPatVld UEGO_RegGetPrmS1B1_I.flgRefVld UEGO_RegGetPrmS1B1_I.flgRegIPmpSetNxtPckVld UEGO_RegGetPrmS1B1_I.flgRegIPmpSetVld UEGO_RegGetPrmS1B1_I.flgRegIpoffChng UEGO_RegGetPrmS1B1_I.flgRegIpoffNxtPckVld UEGO_RegGetPrmS1B1_I.flgRegIpoffVld UEGO_RegGetPrmS1B1_I.flgRegModNxtPckVld UEGO_RegGetPrmS1B1_I.flgRegModVld UEGO_RegGetPrmS1B1_I.flgRegPartModNxtPckVld UEGO_RegGetPrmS1B1_I.flgRegPartModVld UEGO_RegGetPrmS1B1_I.flgRegUnsetNxtPckVld UEGO_RegGetPrmS1B1_I.flgRiaPatChng UEGO_RegGetPrmS1B1_I.flgRiaPatVld UEGO_RegGetPrmS1B1_I.flgRipVld UEGO_RegGetPrmS1B1_I.flgSngCell UEGO_RegGetPrmS1B1_I.flgSngCellVld UEGO_RegGetPrmS1B1_I.flgSteerPatChng UEGO_RegGetPrmS1B1_I.flgSteerPatNxtPckVld UEGO_RegGetPrmS1B1_I.flgSteerPatVld UEGO_RegGetPrmS1B1_I.flgSubModMeasNxtPckVld UEGO_RegGetPrmS1B1_I.flgSubModMeasVld UEGO_RegGetPrmS1B1_I.flgSwVirtGnd UEGO_RegGetPrmS1B1_I.flgSwVirtGndVld UEGO_RegGetPrmS1B1_I.flgTrimSqChng UEGO_RegGetPrmS1B1_I.flgTrimSqrCalChng UEGO_RegGetPrmS1B1_I.flgTrimSqrChng UEGO_RegGetPrmS1B1_I.flgTrmNxtPckVld UEGO_RegGetPrmS1B1_I.flgTrmSqCalOffSet UEGO_RegGetPrmS1B1_I.flgTrmSqCalVld UEGO_RegGetPrmS1B1_I.flgTrmSqOffSet UEGO_RegGetPrmS1B1_I.flgTrmSqOffSetVld UEGO_RegGetPrmS1B1_I.flgTrmSqVld UEGO_RegGetPrmS1B1_I.flgTrmSqrCalOffSet UEGO_RegGetPrmS1B1_I.flgTrmSqrCalVld UEGO_RegGetPrmS1B1_I.flgTrmSqrOffSet UEGO_RegGetPrmS1B1_I.flgTrmSqrOffSetVld UEGO_RegGetPrmS1B1_I.flgTrmSqrVld UEGO_RegGetPrmS1B1_I.flgUnsetVld UEGO_RegGetPrmS1B1_I.flgUp0LeanNxtPckVld UEGO_RegGetPrmS1B1_I.flgUp0LeanVld UEGO_RegGetPrmS1B1_I.flgUp0RichNxtPckVld UEGO_RegGetPrmS1B1_I.flgUp0RichVld UEGO_RegGetPrmS1B1_I.flgUria UEGO_RegGetPrmS1B1_I.flgUriaNxtPck UEGO_RegGetPrmS1B1_I.flgUriaNxtPckVld UEGO_RegGetPrmS1B1_I.flgUriaVld UEGO_RegGetPrmS1B1_I.flgV1BF2NxtPckVld UEGO_RegGetPrmS1B1_I.flgV1BF2Vld UEGO_RegGetPrmS1B1_I.flgV1BF3NxtPckVld UEGO_RegGetPrmS1B1_I.flgV1BIT1 UEGO_RegGetPrmS1B1_I.flgV1BIT1NxtPck UEGO_RegGetPrmS1B1_I.flgV1BIT1NxtPckVld UEGO_RegGetPrmS1B1_I.flgV1BIT1Vld UEGO_RegGetPrmS1B1_I.flgV1BIT2 UEGO_RegGetPrmS1B1_I.flgV1BIT2NxtPck UEGO_RegGetPrmS1B1_I.flgV1BIT2NxtPckVld UEGO_RegGetPrmS1B1_I.flgV1BIT2Vld UEGO_RegGetPrmS1B1_I.flgV1BIT5 UEGO_RegGetPrmS1B1_I.flgV1BIT5NxtPck UEGO_RegGetPrmS1B1_I.flgV1BIT5NxtPckVld UEGO_RegGetPrmS1B1_I.flgV1BIT5Vld UEGO_RegGetPrmS1B1_I.flgWtrEleclyActv UEGO_RegGetPrmS1B1_I.flgWtrEleclyActvNxtPck UEGO_RegGetPrmS1B1_I.flgWtrEleclyActvNxtPckVld UEGO_RegGetPrmS1B1_I.flgWtrEleclyActvVld UEGO_RegGetPrmS1B1_I.flgZIsqrA UEGO_RegGetPrmS1B1_I.flgZIsqrAVld UEGO_RegGetPrmS1B1_I.flgZIsqrE UEGO_RegGetPrmS1B1_I.flgZIsqrEVld UEGO_RegGetPrmS1B1_I.nrIPmpBlcknNxtPck UEGO_RegGetPrmS1B1_I.nrIPmpLimnHi UEGO_RegGetPrmS1B1_I.nrIPmpLimnLo UEGO_RegGetPrmS1B1_I.nrPmpBlckn UEGO_RegGetPrmS1B1_I.nrRefPatNxtPck UEGO_RegGetPrmS1B1_I.nrRegIPmpSet UEGO_RegGetPrmS1B1_I.nrRegIPmpSetNxtPck UEGO_RegGetPrmS1B1_I.nrRegIpoff UEGO_RegGetPrmS1B1_I.nrRegMod UEGO_RegGetPrmS1B1_I.nrRegModNxtPck UEGO_RegGetPrmS1B1_I.nrRegPartMod UEGO_RegGetPrmS1B1_I.nrRegPartModNxtPck UEGO_RegGetPrmS1B1_I.nrRegTrmNxtPck UEGO_RegGetPrmS1B1_I.nrRegTrmSqNxtPck UEGO_RegGetPrmS1B1_I.nrRegTrmSqrNxtPck UEGO_RegGetPrmS1B1_I.nrRip UEGO_RegGetPrmS1B1_I.nrSteerPatNxtPck UEGO_RegGetPrmS1B1_I.nrSubModMeas UEGO_RegGetPrmS1B1_I.nrSubModMeasNxtPck UEGO_RegGetPrmS1B1_I.nrTrmSq UEGO_RegGetPrmS1B1_I.nrTrmSqCal UEGO_RegGetPrmS1B1_I.nrTrmSqr UEGO_RegGetPrmS1B1_I.nrTrmSqrCal UEGO_RegGetPrmS1B1_I.nrUnset UEGO_RegGetPrmS1B1_I.nrUnsetNxtPck UEGO_RegGetPrmS1B1_I.nrUp0Lean UEGO_RegGetPrmS1B1_I.nrUp0LeanNxtPck UEGO_RegGetPrmS1B1_I.nrUp0Rich UEGO_RegGetPrmS1B1_I.nrUp0RichNxtPck UEGO_RegGetPrmS1B1_I.stDlyBlckn UEGO_RegGetPrmS1B1_I.stDlyBlcknNxtPck UEGO_RegGetPrmS1B1_I.stEnSp UEGO_RegGetPrmS1B1_I.stEnSpNxtPck UEGO_RegGetPrmS1B1_I.stMK UEGO_RegGetPrmS1B1_I.stMKNxtPck UEGO_RegGetPrmS1B1_I.stOFF UEGO_RegGetPrmS1B1_I.stOFFNxtPck UEGO_RegGetPrmS1B1_I.stOPT UEGO_RegGetPrmS1B1_I.stOPTNxtPck UEGO_RegGetPrmS1B1_I.stPat UEGO_RegGetPrmS1B1_I.stPatNxtPck UEGO_RegGetPrmS1B1_I.stRef UEGO_RegGetPrmS1B1_I.stRefNxtPck UEGO_RegGetPrmS1B1_I.stRefPat UEGO_RegGetPrmS1B1_I.stRegIpoffNxtPck UEGO_RegGetPrmS1B1_I.stRiaPat UEGO_RegGetPrmS1B1_I.stSteerPat UEGO_RegGetPrmS1B1_I.stV1BF2 UEGO_RegGetPrmS1B1_I.stV1BF2NxtPck UEGO_RegGetPrmS1B1_I.stV1BF3NxtPck /end OUT_MEASUREMENT
 FUNCTION_VERSION "1.14.0" /end FUNCTION
/begin FUNCTION UEGO_RegSet "1.16.1    UEGO Communication of Register Settings" /begin DEF_CHARACTERISTIC UEGO_nrRegSetDeb_C /end DEF_CHARACTERISTIC /begin REF_CHARACTERISTIC UEGO_idxHWES1B1_C /end REF_CHARACTERISTIC
 /begin IN_MEASUREMENT UEGO_flgCJ135AnS1B1 UEGO_flgDiagSigEcuComRstS1B1 UEGO_flgSysSuprtdS1B1 /end IN_MEASUREMENT
 /begin OUT_MEASUREMENT UEGO_flgRegSetStS1B1 UEGO_flgRegSetStVldS1B1 UEGO_RegSetS1B1_I.cntrRegSet UEGO_RegSetS1B1_I.flgCJ135An UEGO_RegSetS1B1_I.flgConvVld UEGO_RegSetS1B1_I.flgIPmpDes UEGO_RegSetS1B1_I.flgIPmpPhyRels UEGO_RegSetS1B1_I.flgIniFinshd UEGO_RegSetS1B1_I.flgLoupeCURRDes UEGO_RegSetS1B1_I.flgLoupeDACDes UEGO_RegSetS1B1_I.flgLoupeNDes UEGO_RegSetS1B1_I.flgLoupePDes UEGO_RegSetS1B1_I.flgNewReq UEGO_RegSetS1B1_I.flgRegSetSt UEGO_RegSetS1B1_I.flgRegSetStVld UEGO_RegSetS1B1_I.flgReqAcptd UEGO_RegSetS1B1_I.flgSetRegOk UEGO_RegSetS1B1_I.flgTakeDataOk UEGO_RegSetS1B1_I.idxChp UEGO_RegSetS1B1_I.nrIdleSubMode UEGO_RegSetS1B1_I.nrModDes UEGO_RegSetS1B1_I.nrNormSubMode UEGO_RegSetS1B1_I.nrRegSet UEGO_RegSetS1B1_I.nrSubModDes UEGO_RegSetS1B1_I.nrSwtOnSubMode UEGO_RegSetS1B1_I.nrTrmSq UEGO_RegSetS1B1_I.nrWrmUpSubMode UEGO_RegSetS1B1_I.stRegSet UEGO_RegSetS1B1_I.stRegSetVld UEGO_RegSetS1B1_I.tmpVar /end OUT_MEASUREMENT
 FUNCTION_VERSION "1.16.1" /end FUNCTION
/begin COMPU_METHOD B_TRUE "" TAB_VERB "%6.3" "" COMPU_TAB_REF B_TRUE /end COMPU_METHOD
/begin COMPU_VTAB B_TRUE "" TAB_VERB 2 0 "FALSE" 1 "TRUE" /end COMPU_VTAB
/begin COMPU_METHOD dez "" RAT_FUNC "%6.2" "" COEFFS 0 1 0 0 0 1 /end COMPU_METHOD
/begin COMPU_METHOD fak_q0p0001 "" RAT_FUNC "%7.6" "-" COEFFS 0 1 0 0 0 0.0001 /end COMPU_METHOD
/begin COMPU_METHOD fak_q1Em4 "" RAT_FUNC "%7.6" "" COEFFS 0 10000 0 0 0 1 /end COMPU_METHOD
/begin COMPU_METHOD fak_q1Em5 "" RAT_FUNC "%8.7" "-" COEFFS 0 100000 0 0 0 1 /end COMPU_METHOD
/begin COMPU_METHOD fak_uw_b1 "" RAT_FUNC "%7.6" "-" COEFFS 0 65536 0 0 0 1 /end COMPU_METHOD
/begin COMPU_METHOD fak_uw_b2 "" RAT_FUNC "%7.6" "-" COEFFS 0 65536 0 0 0 2 /end COMPU_METHOD
/begin COMPU_METHOD i_q1_uA "" RAT_FUNC "%6.2" "uA" COEFFS 0 1 0 0 0 1 /end COMPU_METHOD
/begin COMPU_METHOD i_q6p6667Em7_A "" RAT_FUNC "%9.8" "A" COEFFS 0 1500000 0 0 0 1 /end COMPU_METHOD
/begin COMPU_METHOD OneToOne "" RAT_FUNC "%6.2" "-" COEFFS 0 1 0 0 0 1 /end COMPU_METHOD
/begin COMPU_METHOD Per_Dur "" RAT_FUNC "%6.2" "usec" COEFFS 0 1 0 0 0 1 /end COMPU_METHOD
/begin COMPU_METHOD Pres_hPa "" RAT_FUNC "%6.2" "hPa" COEFFS 0 1 0 0 0 1 /end COMPU_METHOD
/begin COMPU_METHOD p_q0p078 "" RAT_FUNC "%6.4" "hPa" COEFFS 0 64 0 0 0 5 /end COMPU_METHOD
/begin COMPU_METHOD p_q1Em6_bar "" RAT_FUNC "%9.8" "bar" COEFFS 0 1000000 0 0 0 1 /end COMPU_METHOD
/begin COMPU_METHOD q0p01_Perc_DIV_A "" RAT_FUNC "%6.3" "%/A" COEFFS 0 10 0 0 0 1 /end COMPU_METHOD
/begin COMPU_METHOD q1Em2_DIV_bar "" RAT_FUNC "%6.4" "1/bar" COEFFS 0 100 0 0 0 1 /end COMPU_METHOD
/begin COMPU_METHOD q1Em4 "" RAT_FUNC "%7.6" "-" COEFFS 0 10000 0 0 0 1 /end COMPU_METHOD
/begin COMPU_METHOD r_q0p1_Ohm "" RAT_FUNC "%6.3" "Ohm" COEFFS 0 10 0 0 0 1 /end COMPU_METHOD
/begin COMPU_METHOD r_q1p5259Em6_Ohm "" RAT_FUNC "%8.7" "Ohm" COEFFS 0 655360 0 0 0 1 /end COMPU_METHOD
/begin COMPU_METHOD spg_q0p23_V "" RAT_FUNC "%6.3" "V" COEFFS 0 1000 0 0 0 230 /end COMPU_METHOD
/begin COMPU_METHOD temp_q0p0234 "" RAT_FUNC "%6.4" "K" COEFFS 0 256 0 0 0 6 /end COMPU_METHOD
/begin COMPU_METHOD temp_q0p0234_o273 "" RAT_FUNC "%6.1" "Grad C" COEFFS 0 1 273.15 0 0 0.0234375 /end COMPU_METHOD
/begin COMPU_METHOD Time_s "" RAT_FUNC "%6.4" "s" COEFFS 0 100 0 0 0 1 /end COMPU_METHOD
/begin COMPU_METHOD t_q0p005 "" RAT_FUNC "%6.4" "s" COEFFS 0 1000 0 0 0 5 /end COMPU_METHOD
/begin COMPU_METHOD t_q0p01 "" RAT_FUNC "%6.4" "s" COEFFS 0 100 0 0 0 1 /end COMPU_METHOD
/begin COMPU_METHOD UEGO_AsicState_COMPU_VERB "" TAB_VERB "%6.3" "" COMPU_TAB_REF UEGO_AsicState_COMPU_VERB /end COMPU_METHOD
/begin COMPU_VTAB UEGO_AsicState_COMPU_VERB "" TAB_VERB 8 0 "RESET" 1 "IDLE" 2 "SWITCHON" 3 "NORMAL1" 4 "NORMAL2" 5 "WARMUP" 6 "NORMAL3" 7 "FAILURE" /end COMPU_VTAB
/begin COMPU_METHOD UEGO_ModRCmpFacCrvCorr_COMPU_VERB "" TAB_VERB "%6.3" "" COMPU_TAB_REF UEGO_ModRCmpFacCrvCorr_COMPU_VERB /end COMPU_METHOD
/begin COMPU_VTAB UEGO_ModRCmpFacCrvCorr_COMPU_VERB "" TAB_VERB 5 1 "RCMP_FACCRVCORR_NOCMP" 2 "RCMP_FACCRVCORR_FREEZE" 3 "RCMP_FACCRVCORR_INVALIDCMP" 4 "RCMP_FACCRVCORR_COMPUTE_TYP2" 5 "RCMP_FACCRVCORR_COMPUTE_TYP1" /end COMPU_VTAB
/begin COMPU_METHOD UEGO_ModRCmpRCmp_COMPU_VERB "" TAB_VERB "%6.3" "" COMPU_TAB_REF UEGO_ModRCmpRCmp_COMPU_VERB /end COMPU_METHOD
/begin COMPU_VTAB UEGO_ModRCmpRCmp_COMPU_VERB "" TAB_VERB 4 1 "RCMP_RCMP_NOCMP" 2 "RCMP_RCMP_RESET" 3 "RCMP_RCMP_COMPUTE" 4 "RCMP_RCMP_FREEZE" /end COMPU_VTAB
/begin COMPU_METHOD UEGO_ModRCmpRParl_COMPU_VERB "" TAB_VERB "%6.3" "" COMPU_TAB_REF UEGO_ModRCmpRParl_COMPU_VERB /end COMPU_METHOD
/begin COMPU_VTAB UEGO_ModRCmpRParl_COMPU_VERB "" TAB_VERB 3 1 "RCMP_RPARL_RESET" 2 "RCMP_RPARL_COMPUTE" 3 "RCMP_RPARL_FREEZE" /end COMPU_VTAB
/begin COMPU_METHOD UEGO_ModRCmp_COMPU_VERB "" TAB_VERB "%6.3" "" COMPU_TAB_REF UEGO_ModRCmp_COMPU_VERB /end COMPU_METHOD
/begin COMPU_VTAB UEGO_ModRCmp_COMPU_VERB "" TAB_VERB 2 1 "RCMP_RCMPMEASOFF" 2 "RCMP_RCMPMEASON" /end COMPU_VTAB
/begin COMPU_METHOD UEGO_SEPUBATTTHDRIDIAG_SC_Compu "" TAB_VERB "%6.3" "" COMPU_TAB_REF UEGO_SEPUBATTTHDRIDIAG_SC_Compu /end COMPU_METHOD
/begin COMPU_VTAB UEGO_SEPUBATTTHDRIDIAG_SC_Compu "" TAB_VERB 2 0 "False" 1 "True" /end COMPU_VTAB
/begin COMPU_METHOD UEGO_SNSR1BNK1_SC_Compu "" TAB_VERB "%6.3" "" COMPU_TAB_REF UEGO_SNSR1BNK1_SC_Compu /end COMPU_METHOD
/begin COMPU_VTAB UEGO_SNSR1BNK1_SC_Compu "" TAB_VERB 2 0 "False" 1 "True" /end COMPU_VTAB
/begin COMPU_METHOD UEGO_SNSR1BNK2_SC_Compu "" TAB_VERB "%6.3" "" COMPU_TAB_REF UEGO_SNSR1BNK2_SC_Compu /end COMPU_METHOD
/begin COMPU_VTAB UEGO_SNSR1BNK2_SC_Compu "" TAB_VERB 2 0 "False" 1 "True" /end COMPU_VTAB
/begin COMPU_METHOD UEGO_SNSR1INTK1_SC_Compu "" TAB_VERB "%6.3" "" COMPU_TAB_REF UEGO_SNSR1INTK1_SC_Compu /end COMPU_METHOD
/begin COMPU_VTAB UEGO_SNSR1INTK1_SC_Compu "" TAB_VERB 2 0 "False" 1 "True" /end COMPU_VTAB
/begin COMPU_METHOD UEGO_SNSR2BNK1_SC_Compu "" TAB_VERB "%6.3" "" COMPU_TAB_REF UEGO_SNSR2BNK1_SC_Compu /end COMPU_METHOD
/begin COMPU_VTAB UEGO_SNSR2BNK1_SC_Compu "" TAB_VERB 2 0 "False" 1 "True" /end COMPU_VTAB
/begin COMPU_METHOD UEGO_SNSR2BNK2_SC_Compu "" TAB_VERB "%6.3" "" COMPU_TAB_REF UEGO_SNSR2BNK2_SC_Compu /end COMPU_METHOD
/begin COMPU_VTAB UEGO_SNSR2BNK2_SC_Compu "" TAB_VERB 2 0 "False" 1 "True" /end COMPU_VTAB
/begin COMPU_METHOD UEGO_SNSR3BNK1_SC_Compu "" TAB_VERB "%6.3" "" COMPU_TAB_REF UEGO_SNSR3BNK1_SC_Compu /end COMPU_METHOD
/begin COMPU_VTAB UEGO_SNSR3BNK1_SC_Compu "" TAB_VERB 2 0 "False" 1 "True" /end COMPU_VTAB
/begin COMPU_METHOD UEGO_SNSR3BNK2_SC_Compu "" TAB_VERB "%6.3" "" COMPU_TAB_REF UEGO_SNSR3BNK2_SC_Compu /end COMPU_METHOD
/begin COMPU_VTAB UEGO_SNSR3BNK2_SC_Compu "" TAB_VERB 2 0 "False" 1 "True" /end COMPU_VTAB
/begin COMPU_METHOD UEGO_SNSROPERPREENGSTRT_SC_Compu "" TAB_VERB "%6.3" "" COMPU_TAB_REF UEGO_SNSROPERPREENGSTRT_SC_Compu /end COMPU_METHOD
/begin COMPU_VTAB UEGO_SNSROPERPREENGSTRT_SC_Compu "" TAB_VERB 2 0 "False" 1 "True" /end COMPU_VTAB
/begin COMPU_METHOD UEGO_SNSRPRETRBOCHRGRSNSR0BNK1_SC_Compu "" TAB_VERB "%6.3" "" COMPU_TAB_REF UEGO_SNSRPRETRBOCHRGRSNSR0BNK1_SC_Compu /end COMPU_METHOD
/begin COMPU_VTAB UEGO_SNSRPRETRBOCHRGRSNSR0BNK1_SC_Compu "" TAB_VERB 2 0 "False" 1 "True" /end COMPU_VTAB
/begin COMPU_METHOD UEGO_SubMod_COMPU_VERB "" TAB_VERB "%6.3" "" COMPU_TAB_REF UEGO_SubMod_COMPU_VERB /end COMPU_METHOD
/begin COMPU_VTAB UEGO_SubMod_COMPU_VERB "" TAB_VERB 37 0 "RESET" 16 "UEGO_STIDLE_STOPOPER" 17 "UEGO_STIDLE_STABLE" 18 "UEGO_STIDLE_DIAGNOSIS" 19 "UEGO_STIDLE_NOOPERRELS" 31 "UEGO_STIDLE_FAILURE" 32 "UEGO_STSWITCHON_SCHIISQ" 33 "UEGO_STSWITCHON_SCLOISQ" 34 "UEGO_STSWITCHON_RCMP" 35 "UEGO_STSWITCHON_INTER" 47 "UEGO_STSWITCHON_FAILURE" 80 "UEGO_STWARMUP_SNSRCOLD" 81 "UEGO_STWARMUP_OLDIAG" 82 "UEGO_STWARMUP_TEVLN" 95 "UEGO_STWARMUP_FAILURE" 48 "UEGO_STNORMAL1_SAFE" 49 "UEGO_STNORMAL1_WTRELECLY" 50 "UEGO_STNORMAL1_RVSCHRGUIMEAS" 51 "UEGO_STNORMAL1_RVSCHRGCMEAS" 52 "UEGO_STNORMAL1_WTRELECLYDIAG" 53 "UEGO_STNORMAL1_CPSNSRADPN" 54 "UEGO_STNORMAL1_IPMPRVS" 55 "UEGO_STNORMAL1_ILEAKIPEMEAS" 56 "UEGO_STNORMAL1_RWIREAPEMEAS" 57 "UEGO_STNORMAL1_STANDARD" 63 "UEGO_STNORMAL1_FAILURE" 96 "UEGO_STNORMAL3_SAFE" 97 "UEGO_STNORMAL3_WTRELECLY" 98 "UEGO_STNORMAL3_RVSCHRGUIMEAS" 99 "UEGO_STNORMAL3_RVSCHRGCMEAS" 100 "UEGO_STNORMAL3_WTRELECLYDIAG" 101 "UEGO_STNORMAL3_CPSNSRADPN" 102 "UEGO_STNORMAL3_IPMPRVS" 103 "UEGO_STNORMAL3_ILEAKIPEMEAS" 104 "UEGO_STNORMAL3_RWIREAPEMEAS" 105 "UEGO_STNORMAL3_STANDARD" 111 "UEGO_STNORMAL3_FAILURE" /end COMPU_VTAB
/begin COMPU_METHOD UEGO_SUMERR_SY_Compu "" TAB_VERB "%6.3" "" COMPU_TAB_REF UEGO_SUMERR_SY_Compu /end COMPU_METHOD
/begin COMPU_VTAB UEGO_SUMERR_SY_Compu "" TAB_VERB 2 0 "False" 1 "True" /end COMPU_VTAB
/begin COMPU_METHOD UEGO_UNERNSTSETCTRLENA_SC_Compu "" TAB_VERB "%6.3" "" COMPU_TAB_REF UEGO_UNERNSTSETCTRLENA_SC_Compu /end COMPU_METHOD
/begin COMPU_VTAB UEGO_UNERNSTSETCTRLENA_SC_Compu "" TAB_VERB 2 0 "False" 1 "True" /end COMPU_VTAB
/begin COMPU_METHOD UEGO_VAR_SY_Compu "" TAB_VERB "%6.3" "" COMPU_TAB_REF UEGO_VAR_SY_Compu /end COMPU_METHOD
/begin COMPU_VTAB UEGO_VAR_SY_Compu "" TAB_VERB 45 0 "kein Kundenbezug" 1 "DAI" 3 "VWW" 4 "POR" 5 "AUD" 6 "OPE" 9 "FIA" 11 "BMW" 14 "PSA" 15 "REN" 17 "ALF" 18 "SAB" 19 "VOL" 20 "NIS" 21 "GMU" 22 "FOR" 26 "IMJ" 51 "SEA" 53 "CHR" 54 "JAG" 55 "ROL" 69 "FER" 72 "TOY" 123 "MIT" 147 "HYU" 159 "HON" 160 "MAZ" 183 "CU" 190 "LRG" 204 "VVW" 214 "AVT" 242 "Iveco" 243 "DMC" 248 "SUZ" 267 "SSANGYONG" 270 "KEF" 289 "AMG" 308 "TAT" 319 "MVM" 385 "UAES" 590 "Scania" 828 "RBCD" 999 "ALL" 2887 "Nonox" 9454 "Fuso" /end COMPU_VTAB
/begin COMPU_METHOD UEGO_VCCMEAS_SC_Compu "" TAB_VERB "%6.3" "" COMPU_TAB_REF UEGO_VCCMEAS_SC_Compu /end COMPU_METHOD
/begin COMPU_VTAB UEGO_VCCMEAS_SC_Compu "" TAB_VERB 2 0 "False" 1 "True" /end COMPU_VTAB
/begin COMPU_METHOD UEGO_VRNTSELN_SC_Compu "" TAB_VERB "%6.3" "" COMPU_TAB_REF UEGO_VRNTSELN_SC_Compu /end COMPU_METHOD
/begin COMPU_VTAB UEGO_VRNTSELN_SC_Compu "" TAB_VERB 3 0 "0" 42 "42" 56 "56" /end COMPU_VTAB
/begin COMPU_METHOD UEGO_WIRESIGOLDSTCN_SC_Compu "" TAB_VERB "%6.3" "" COMPU_TAB_REF UEGO_WIRESIGOLDSTCN_SC_Compu /end COMPU_METHOD
/begin COMPU_VTAB UEGO_WIRESIGOLDSTCN_SC_Compu "" TAB_VERB 2 0 "False" 1 "True" /end COMPU_VTAB
/begin COMPU_METHOD UEGO_WTRELECLYENA_SC_Compu "" TAB_VERB "%6.3" "" COMPU_TAB_REF UEGO_WTRELECLYENA_SC_Compu /end COMPU_METHOD
/begin COMPU_VTAB UEGO_WTRELECLYENA_SC_Compu "" TAB_VERB 2 0 "Deactivate" 1 "Activate" /end COMPU_VTAB
/begin COMPU_METHOD UKBA_SY_Compu "" TAB_VERB "%6.3" "" COMPU_TAB_REF UKBA_SY_Compu /end COMPU_METHOD
/begin COMPU_VTAB UKBA_SY_Compu "" TAB_VERB 2 0 "ZERO" 1 "ONE" /end COMPU_VTAB
/begin COMPU_METHOD undefined "" RAT_FUNC "%6.2" "" COEFFS 0 1 0 0 0 1 /end COMPU_METHOD
/begin COMPU_METHOD UNIAIRINTKLIVOMOD_SC_Compu "" TAB_VERB "%6.3" "" COMPU_TAB_REF UNIAIRINTKLIVOMOD_SC_Compu /end COMPU_METHOD
/begin COMPU_VTAB UNIAIRINTKLIVOMOD_SC_Compu "" TAB_VERB 2 0 "NO_LIVO" 1 "LIVO" /end COMPU_VTAB
/begin RECORD_LAYOUT RB_Curve_S16_U16_Static NO_AXIS_PTS_X 1 SWORD AXIS_PTS_X 2 SWORD INDEX_INCR DIRECT FNC_VALUES 3 UWORD COLUMN_DIR DIRECT STATIC_RECORD_LAYOUT /end RECORD_LAYOUT
/begin RECORD_LAYOUT RB_ValA_Wu8 FNC_VALUES 1 UBYTE COLUMN_DIR DIRECT /end RECORD_LAYOUT
/begin RECORD_LAYOUT RB_Val_Wboolean FNC_VALUES 1 UBYTE COLUMN_DIR DIRECT /end RECORD_LAYOUT
/begin RECORD_LAYOUT RB_Val_Ws16 FNC_VALUES 1 SWORD COLUMN_DIR DIRECT /end RECORD_LAYOUT
/begin RECORD_LAYOUT RB_Val_Ws32 FNC_VALUES 1 SLONG COLUMN_DIR DIRECT /end RECORD_LAYOUT
/begin RECORD_LAYOUT RB_Val_Wu16 FNC_VALUES 1 UWORD COLUMN_DIR DIRECT /end RECORD_LAYOUT
/begin RECORD_LAYOUT RB_Val_Wu32 FNC_VALUES 1 ULONG COLUMN_DIR DIRECT /end RECORD_LAYOUT
/begin RECORD_LAYOUT RB_Val_Wu8 FNC_VALUES 1 UBYTE COLUMN_DIR DIRECT /end RECORD_LAYOUT
/end MODULE
/end PROJECT
