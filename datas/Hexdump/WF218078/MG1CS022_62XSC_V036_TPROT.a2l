ASAP2_VERSION 1 60
/begin PROJECT MG1CS022 "MG1CS022"
/begin HEADER "" VERSION "MG1CS022_62XSC_V036_TPROT" PROJECT_NO MG1CS022 /end HEADER
/begin MODULE DIM ""
/begin MOD_COMMON "" BYTE_ORDER MSB_LAST ALIGNMENT_BYTE 1 ALIGNMENT_WORD 2 ALIGNMENT_LONG 4 ALIGNMENT_INT64 4 ALIGNMENT_FLOAT32_IEEE 4 ALIGNMENT_FLOAT64_IEEE 4 DATA_SIZE 32 /end MOD_COMMON
/begin CHARACTERISTIC rba_TrapLog_ResetLog_C "Reset the logs of the trap logger" VALUE 0x804D8574 DefaultValueRecordLayout_AUTOSAR_Platform_BaseTypes_uint8 255.0 RB_RBA_rba_TrapLog_CompuMethods_rba_TrapLog_ResetLogCompuMethod 0.0 255. FORMAT "%1.0" /end CHARACTERISTIC
/begin MEASUREMENT CanSM_BORMode_au8 "Variable to SET/RESET the BOR mode" UBYTE RB_RBA_Common_CentralElements_CompuMethods_Identical 1 100 0.0 255. FORMAT "%5.0" ARRAY_SIZE 3 ECU_ADDRESS 0x600105D6 /end MEASUREMENT
/begin MEASUREMENT CanSM_BusOffISRPend_ab "To Set the BOR ISR Pending Request to True or False" UBYTE RB_RBA_Common_CentralElements_CompuMethods_Identical 1 100 0.0 255. FORMAT "%5.0" ARRAY_SIZE 3 ECU_ADDRESS 0x60012390 /end MEASUREMENT
/begin MEASUREMENT CanSM_BusOff_Cntr_au8 "Bus-Off counter for CanSM" UBYTE RB_RBA_Common_CentralElements_CompuMethods_Identical 1 100 0.0 255. FORMAT "%5.0" ARRAY_SIZE 3 ECU_ADDRESS 0x600105D9 /end MEASUREMENT
/begin MEASUREMENT CanSM_CurrNw_Mode_en "current ComM mode" UBYTE AUTOSAR_CanSM_CompuMethods_CanSM_NetworkModeStateType_Enum_comp 1 100 0.0 255. FORMAT "%5.0" ARRAY_SIZE 3 ECU_ADDRESS 0x5000634C /end MEASUREMENT
/begin MEASUREMENT CanSM_MutexMode_au8 "Used to set" UBYTE RB_RBA_Common_CentralElements_CompuMethods_Identical 1 100 0.0 255. FORMAT "%5.0" ARRAY_SIZE 3 ECU_ADDRESS 0x600105D3 /end MEASUREMENT
/begin MEASUREMENT CanSM_Network_Init_ab "Setting this leads to initialisation of the network" UBYTE RB_RBA_Common_CentralElements_CompuMethods_Identical 1 100 0.0 255. FORMAT "%5.0" ARRAY_SIZE 3 ECU_ADDRESS 0x6001237B /end MEASUREMENT
/begin MEASUREMENT CanSM_ReqComM_Mode_en "stores the requested communication mode" UBYTE RB_RBA_Common_CentralElements_CompuMethods_Identical 1 100 0.0 255. FORMAT "%5.0" ARRAY_SIZE 3 ECU_ADDRESS 0x60012396 /end MEASUREMENT
/begin MEASUREMENT CanSM_TimerConfig_ast[0].cntTick_u16 "CanSM timer configuration[0]/" UWORD RB_RBA_Common_CentralElements_CompuMethods_Identical 1 100 0.0 65535. FORMAT "%5.0" ECU_ADDRESS 0x50006358 /end MEASUREMENT
/begin MEASUREMENT CanSM_TimerConfig_ast[1].cntTick_u16 "CanSM timer configuration[1]/" UWORD RB_RBA_Common_CentralElements_CompuMethods_Identical 1 100 0.0 65535. FORMAT "%5.0" ECU_ADDRESS 0x5000635C /end MEASUREMENT
/begin MEASUREMENT CanSM_TimerConfig_ast[2].cntTick_u16 "CanSM timer configuration[2]/" UWORD RB_RBA_Common_CentralElements_CompuMethods_Identical 1 100 0.0 65535. FORMAT "%5.0" ECU_ADDRESS 0x50006360 /end MEASUREMENT
/begin MEASUREMENT CanSM_TimerConfig_ast[0].stTimer "CanSM timer configuration[0]/" UBYTE AUTOSAR_CanSM_CompuMethods_CanSM_TimerStateType_Enum_comp 1 100 0.0 255. FORMAT "%5.0" ECU_ADDRESS 0x50006356 /end MEASUREMENT
/begin MEASUREMENT CanSM_TimerConfig_ast[1].stTimer "CanSM timer configuration[1]/" UBYTE AUTOSAR_CanSM_CompuMethods_CanSM_TimerStateType_Enum_comp 1 100 0.0 255. FORMAT "%5.0" ECU_ADDRESS 0x5000635A /end MEASUREMENT
/begin MEASUREMENT CanSM_TimerConfig_ast[2].stTimer "CanSM timer configuration[2]/" UBYTE AUTOSAR_CanSM_CompuMethods_CanSM_TimerStateType_Enum_comp 1 100 0.0 255. FORMAT "%5.0" ECU_ADDRESS 0x5000635E /end MEASUREMENT
/begin MEASUREMENT CanSM_currBOR_State_en "Current Bus-Off recovery state for CanSM" UBYTE AUTOSAR_CanSM_CompuMethods_CanSM_BusOffRecoveryStateType_Enum_comp 1 100 0.0 255. FORMAT "%5.0" ARRAY_SIZE 3 ECU_ADDRESS 0x50006368 /end MEASUREMENT
/begin MEASUREMENT CanTp_MainState "MainState of CanTp indicating whether Tp Communication on CanStack is possible." UBYTE DefaultIdenticalCompu 1 100 0.0 255.0 FORMAT "%5.1" ECU_ADDRESS 0x6000FA31 /end MEASUREMENT
/begin MEASUREMENT rba_TrapLog_CallStackCore1_a_u32[0][0] "Callstack from the Core1[0][0]" ULONG RB_RBA_rba_TrapLog_CompuMethods_rba_TrapLog_oneToOne 1 100 0.0 4.E9 FORMAT "%32.0" ECU_ADDRESS 0x600358B4
 /begin ANNOTATION ANNOTATION_LABEL "Description (coming from AUTOSAR DESC field)" /begin ANNOTATION_TEXT "Callstack from the Core1\r\n" /end ANNOTATION_TEXT /end ANNOTATION
/end MEASUREMENT
/begin MEASUREMENT rba_TrapLog_CallStackCore1_a_u32[0][1] "Callstack from the Core1[0][1]" ULONG RB_RBA_rba_TrapLog_CompuMethods_rba_TrapLog_oneToOne 1 100 0.0 4.E9 FORMAT "%32.0" ECU_ADDRESS 0x600358B8
 /begin ANNOTATION ANNOTATION_LABEL "Description (coming from AUTOSAR DESC field)" /begin ANNOTATION_TEXT "Callstack from the Core1\r\n" /end ANNOTATION_TEXT /end ANNOTATION
/end MEASUREMENT
/begin MEASUREMENT rba_TrapLog_CallStackCore1_a_u32[0][2] "Callstack from the Core1[0][2]" ULONG RB_RBA_rba_TrapLog_CompuMethods_rba_TrapLog_oneToOne 1 100 0.0 4.E9 FORMAT "%32.0" ECU_ADDRESS 0x600358BC
 /begin ANNOTATION ANNOTATION_LABEL "Description (coming from AUTOSAR DESC field)" /begin ANNOTATION_TEXT "Callstack from the Core1\r\n" /end ANNOTATION_TEXT /end ANNOTATION
/end MEASUREMENT
/begin MEASUREMENT rba_TrapLog_CallStackCore1_a_u32[0][3] "Callstack from the Core1[0][3]" ULONG RB_RBA_rba_TrapLog_CompuMethods_rba_TrapLog_oneToOne 1 100 0.0 4.E9 FORMAT "%32.0" ECU_ADDRESS 0x600358C0
 /begin ANNOTATION ANNOTATION_LABEL "Description (coming from AUTOSAR DESC field)" /begin ANNOTATION_TEXT "Callstack from the Core1\r\n" /end ANNOTATION_TEXT /end ANNOTATION
/end MEASUREMENT
/begin MEASUREMENT rba_TrapLog_CallStackCore1_a_u32[0][4] "Callstack from the Core1[0][4]" ULONG RB_RBA_rba_TrapLog_CompuMethods_rba_TrapLog_oneToOne 1 100 0.0 4.E9 FORMAT "%32.0" ECU_ADDRESS 0x600358C4
 /begin ANNOTATION ANNOTATION_LABEL "Description (coming from AUTOSAR DESC field)" /begin ANNOTATION_TEXT "Callstack from the Core1\r\n" /end ANNOTATION_TEXT /end ANNOTATION
/end MEASUREMENT
/begin MEASUREMENT rba_TrapLog_CallStackCore1_a_u32[0][5] "Callstack from the Core1[0][5]" ULONG RB_RBA_rba_TrapLog_CompuMethods_rba_TrapLog_oneToOne 1 100 0.0 4.E9 FORMAT "%32.0" ECU_ADDRESS 0x600358C8
 /begin ANNOTATION ANNOTATION_LABEL "Description (coming from AUTOSAR DESC field)" /begin ANNOTATION_TEXT "Callstack from the Core1\r\n" /end ANNOTATION_TEXT /end ANNOTATION
/end MEASUREMENT
/begin MEASUREMENT rba_TrapLog_CallStackCore1_a_u32[0][6] "Callstack from the Core1[0][6]" ULONG RB_RBA_rba_TrapLog_CompuMethods_rba_TrapLog_oneToOne 1 100 0.0 4.E9 FORMAT "%32.0" ECU_ADDRESS 0x600358CC
 /begin ANNOTATION ANNOTATION_LABEL "Description (coming from AUTOSAR DESC field)" /begin ANNOTATION_TEXT "Callstack from the Core1\r\n" /end ANNOTATION_TEXT /end ANNOTATION
/end MEASUREMENT
/begin MEASUREMENT rba_TrapLog_CallStackCore1_a_u32[0][7] "Callstack from the Core1[0][7]" ULONG RB_RBA_rba_TrapLog_CompuMethods_rba_TrapLog_oneToOne 1 100 0.0 4.E9 FORMAT "%32.0" ECU_ADDRESS 0x600358D0
 /begin ANNOTATION ANNOTATION_LABEL "Description (coming from AUTOSAR DESC field)" /begin ANNOTATION_TEXT "Callstack from the Core1\r\n" /end ANNOTATION_TEXT /end ANNOTATION
/end MEASUREMENT
/begin MEASUREMENT rba_TrapLog_CallStackCore1_a_u32[1][0] "Callstack from the Core1[1][0]" ULONG RB_RBA_rba_TrapLog_CompuMethods_rba_TrapLog_oneToOne 1 100 0.0 4.E9 FORMAT "%32.0" ECU_ADDRESS 0x600358D4
 /begin ANNOTATION ANNOTATION_LABEL "Description (coming from AUTOSAR DESC field)" /begin ANNOTATION_TEXT "Callstack from the Core1\r\n" /end ANNOTATION_TEXT /end ANNOTATION
/end MEASUREMENT
/begin MEASUREMENT rba_TrapLog_CallStackCore1_a_u32[1][1] "Callstack from the Core1[1][1]" ULONG RB_RBA_rba_TrapLog_CompuMethods_rba_TrapLog_oneToOne 1 100 0.0 4.E9 FORMAT "%32.0" ECU_ADDRESS 0x600358D8
 /begin ANNOTATION ANNOTATION_LABEL "Description (coming from AUTOSAR DESC field)" /begin ANNOTATION_TEXT "Callstack from the Core1\r\n" /end ANNOTATION_TEXT /end ANNOTATION
/end MEASUREMENT
/begin MEASUREMENT rba_TrapLog_CallStackCore1_a_u32[1][2] "Callstack from the Core1[1][2]" ULONG RB_RBA_rba_TrapLog_CompuMethods_rba_TrapLog_oneToOne 1 100 0.0 4.E9 FORMAT "%32.0" ECU_ADDRESS 0x600358DC
 /begin ANNOTATION ANNOTATION_LABEL "Description (coming from AUTOSAR DESC field)" /begin ANNOTATION_TEXT "Callstack from the Core1\r\n" /end ANNOTATION_TEXT /end ANNOTATION
/end MEASUREMENT
/begin MEASUREMENT rba_TrapLog_CallStackCore1_a_u32[1][3] "Callstack from the Core1[1][3]" ULONG RB_RBA_rba_TrapLog_CompuMethods_rba_TrapLog_oneToOne 1 100 0.0 4.E9 FORMAT "%32.0" ECU_ADDRESS 0x600358E0
 /begin ANNOTATION ANNOTATION_LABEL "Description (coming from AUTOSAR DESC field)" /begin ANNOTATION_TEXT "Callstack from the Core1\r\n" /end ANNOTATION_TEXT /end ANNOTATION
/end MEASUREMENT
/begin MEASUREMENT rba_TrapLog_CallStackCore1_a_u32[1][4] "Callstack from the Core1[1][4]" ULONG RB_RBA_rba_TrapLog_CompuMethods_rba_TrapLog_oneToOne 1 100 0.0 4.E9 FORMAT "%32.0" ECU_ADDRESS 0x600358E4
 /begin ANNOTATION ANNOTATION_LABEL "Description (coming from AUTOSAR DESC field)" /begin ANNOTATION_TEXT "Callstack from the Core1\r\n" /end ANNOTATION_TEXT /end ANNOTATION
/end MEASUREMENT
/begin MEASUREMENT rba_TrapLog_CallStackCore1_a_u32[1][5] "Callstack from the Core1[1][5]" ULONG RB_RBA_rba_TrapLog_CompuMethods_rba_TrapLog_oneToOne 1 100 0.0 4.E9 FORMAT "%32.0" ECU_ADDRESS 0x600358E8
 /begin ANNOTATION ANNOTATION_LABEL "Description (coming from AUTOSAR DESC field)" /begin ANNOTATION_TEXT "Callstack from the Core1\r\n" /end ANNOTATION_TEXT /end ANNOTATION
/end MEASUREMENT
/begin MEASUREMENT rba_TrapLog_CallStackCore1_a_u32[1][6] "Callstack from the Core1[1][6]" ULONG RB_RBA_rba_TrapLog_CompuMethods_rba_TrapLog_oneToOne 1 100 0.0 4.E9 FORMAT "%32.0" ECU_ADDRESS 0x600358EC
 /begin ANNOTATION ANNOTATION_LABEL "Description (coming from AUTOSAR DESC field)" /begin ANNOTATION_TEXT "Callstack from the Core1\r\n" /end ANNOTATION_TEXT /end ANNOTATION
/end MEASUREMENT
/begin MEASUREMENT rba_TrapLog_CallStackCore1_a_u32[1][7] "Callstack from the Core1[1][7]" ULONG RB_RBA_rba_TrapLog_CompuMethods_rba_TrapLog_oneToOne 1 100 0.0 4.E9 FORMAT "%32.0" ECU_ADDRESS 0x600358F0
 /begin ANNOTATION ANNOTATION_LABEL "Description (coming from AUTOSAR DESC field)" /begin ANNOTATION_TEXT "Callstack from the Core1\r\n" /end ANNOTATION_TEXT /end ANNOTATION
/end MEASUREMENT
/begin MEASUREMENT rba_TrapLog_CallStackCore1_a_u32[2][0] "Callstack from the Core1[2][0]" ULONG RB_RBA_rba_TrapLog_CompuMethods_rba_TrapLog_oneToOne 1 100 0.0 4.E9 FORMAT "%32.0" ECU_ADDRESS 0x600358F4
 /begin ANNOTATION ANNOTATION_LABEL "Description (coming from AUTOSAR DESC field)" /begin ANNOTATION_TEXT "Callstack from the Core1\r\n" /end ANNOTATION_TEXT /end ANNOTATION
/end MEASUREMENT
/begin MEASUREMENT rba_TrapLog_CallStackCore1_a_u32[2][1] "Callstack from the Core1[2][1]" ULONG RB_RBA_rba_TrapLog_CompuMethods_rba_TrapLog_oneToOne 1 100 0.0 4.E9 FORMAT "%32.0" ECU_ADDRESS 0x600358F8
 /begin ANNOTATION ANNOTATION_LABEL "Description (coming from AUTOSAR DESC field)" /begin ANNOTATION_TEXT "Callstack from the Core1\r\n" /end ANNOTATION_TEXT /end ANNOTATION
/end MEASUREMENT
/begin MEASUREMENT rba_TrapLog_CallStackCore1_a_u32[2][2] "Callstack from the Core1[2][2]" ULONG RB_RBA_rba_TrapLog_CompuMethods_rba_TrapLog_oneToOne 1 100 0.0 4.E9 FORMAT "%32.0" ECU_ADDRESS 0x600358FC
 /begin ANNOTATION ANNOTATION_LABEL "Description (coming from AUTOSAR DESC field)" /begin ANNOTATION_TEXT "Callstack from the Core1\r\n" /end ANNOTATION_TEXT /end ANNOTATION
/end MEASUREMENT
/begin MEASUREMENT rba_TrapLog_CallStackCore1_a_u32[2][3] "Callstack from the Core1[2][3]" ULONG RB_RBA_rba_TrapLog_CompuMethods_rba_TrapLog_oneToOne 1 100 0.0 4.E9 FORMAT "%32.0" ECU_ADDRESS 0x60035900
 /begin ANNOTATION ANNOTATION_LABEL "Description (coming from AUTOSAR DESC field)" /begin ANNOTATION_TEXT "Callstack from the Core1\r\n" /end ANNOTATION_TEXT /end ANNOTATION
/end MEASUREMENT
/begin MEASUREMENT rba_TrapLog_CallStackCore1_a_u32[2][4] "Callstack from the Core1[2][4]" ULONG RB_RBA_rba_TrapLog_CompuMethods_rba_TrapLog_oneToOne 1 100 0.0 4.E9 FORMAT "%32.0" ECU_ADDRESS 0x60035904
 /begin ANNOTATION ANNOTATION_LABEL "Description (coming from AUTOSAR DESC field)" /begin ANNOTATION_TEXT "Callstack from the Core1\r\n" /end ANNOTATION_TEXT /end ANNOTATION
/end MEASUREMENT
/begin MEASUREMENT rba_TrapLog_CallStackCore1_a_u32[2][5] "Callstack from the Core1[2][5]" ULONG RB_RBA_rba_TrapLog_CompuMethods_rba_TrapLog_oneToOne 1 100 0.0 4.E9 FORMAT "%32.0" ECU_ADDRESS 0x60035908
 /begin ANNOTATION ANNOTATION_LABEL "Description (coming from AUTOSAR DESC field)" /begin ANNOTATION_TEXT "Callstack from the Core1\r\n" /end ANNOTATION_TEXT /end ANNOTATION
/end MEASUREMENT
/begin MEASUREMENT rba_TrapLog_CallStackCore1_a_u32[2][6] "Callstack from the Core1[2][6]" ULONG RB_RBA_rba_TrapLog_CompuMethods_rba_TrapLog_oneToOne 1 100 0.0 4.E9 FORMAT "%32.0" ECU_ADDRESS 0x6003590C
 /begin ANNOTATION ANNOTATION_LABEL "Description (coming from AUTOSAR DESC field)" /begin ANNOTATION_TEXT "Callstack from the Core1\r\n" /end ANNOTATION_TEXT /end ANNOTATION
/end MEASUREMENT
/begin MEASUREMENT rba_TrapLog_CallStackCore1_a_u32[2][7] "Callstack from the Core1[2][7]" ULONG RB_RBA_rba_TrapLog_CompuMethods_rba_TrapLog_oneToOne 1 100 0.0 4.E9 FORMAT "%32.0" ECU_ADDRESS 0x60035910
 /begin ANNOTATION ANNOTATION_LABEL "Description (coming from AUTOSAR DESC field)" /begin ANNOTATION_TEXT "Callstack from the Core1\r\n" /end ANNOTATION_TEXT /end ANNOTATION
/end MEASUREMENT
/begin MEASUREMENT rba_TrapLog_CallStackCore1_a_u32[3][0] "Callstack from the Core1[3][0]" ULONG RB_RBA_rba_TrapLog_CompuMethods_rba_TrapLog_oneToOne 1 100 0.0 4.E9 FORMAT "%32.0" ECU_ADDRESS 0x60035914
 /begin ANNOTATION ANNOTATION_LABEL "Description (coming from AUTOSAR DESC field)" /begin ANNOTATION_TEXT "Callstack from the Core1\r\n" /end ANNOTATION_TEXT /end ANNOTATION
/end MEASUREMENT
/begin MEASUREMENT rba_TrapLog_CallStackCore1_a_u32[3][1] "Callstack from the Core1[3][1]" ULONG RB_RBA_rba_TrapLog_CompuMethods_rba_TrapLog_oneToOne 1 100 0.0 4.E9 FORMAT "%32.0" ECU_ADDRESS 0x60035918
 /begin ANNOTATION ANNOTATION_LABEL "Description (coming from AUTOSAR DESC field)" /begin ANNOTATION_TEXT "Callstack from the Core1\r\n" /end ANNOTATION_TEXT /end ANNOTATION
/end MEASUREMENT
/begin MEASUREMENT rba_TrapLog_CallStackCore1_a_u32[3][2] "Callstack from the Core1[3][2]" ULONG RB_RBA_rba_TrapLog_CompuMethods_rba_TrapLog_oneToOne 1 100 0.0 4.E9 FORMAT "%32.0" ECU_ADDRESS 0x6003591C
 /begin ANNOTATION ANNOTATION_LABEL "Description (coming from AUTOSAR DESC field)" /begin ANNOTATION_TEXT "Callstack from the Core1\r\n" /end ANNOTATION_TEXT /end ANNOTATION
/end MEASUREMENT
/begin MEASUREMENT rba_TrapLog_CallStackCore1_a_u32[3][3] "Callstack from the Core1[3][3]" ULONG RB_RBA_rba_TrapLog_CompuMethods_rba_TrapLog_oneToOne 1 100 0.0 4.E9 FORMAT "%32.0" ECU_ADDRESS 0x60035920
 /begin ANNOTATION ANNOTATION_LABEL "Description (coming from AUTOSAR DESC field)" /begin ANNOTATION_TEXT "Callstack from the Core1\r\n" /end ANNOTATION_TEXT /end ANNOTATION
/end MEASUREMENT
/begin MEASUREMENT rba_TrapLog_CallStackCore1_a_u32[3][4] "Callstack from the Core1[3][4]" ULONG RB_RBA_rba_TrapLog_CompuMethods_rba_TrapLog_oneToOne 1 100 0.0 4.E9 FORMAT "%32.0" ECU_ADDRESS 0x60035924
 /begin ANNOTATION ANNOTATION_LABEL "Description (coming from AUTOSAR DESC field)" /begin ANNOTATION_TEXT "Callstack from the Core1\r\n" /end ANNOTATION_TEXT /end ANNOTATION
/end MEASUREMENT
/begin MEASUREMENT rba_TrapLog_CallStackCore1_a_u32[3][5] "Callstack from the Core1[3][5]" ULONG RB_RBA_rba_TrapLog_CompuMethods_rba_TrapLog_oneToOne 1 100 0.0 4.E9 FORMAT "%32.0" ECU_ADDRESS 0x60035928
 /begin ANNOTATION ANNOTATION_LABEL "Description (coming from AUTOSAR DESC field)" /begin ANNOTATION_TEXT "Callstack from the Core1\r\n" /end ANNOTATION_TEXT /end ANNOTATION
/end MEASUREMENT
/begin MEASUREMENT rba_TrapLog_CallStackCore1_a_u32[3][6] "Callstack from the Core1[3][6]" ULONG RB_RBA_rba_TrapLog_CompuMethods_rba_TrapLog_oneToOne 1 100 0.0 4.E9 FORMAT "%32.0" ECU_ADDRESS 0x6003592C
 /begin ANNOTATION ANNOTATION_LABEL "Description (coming from AUTOSAR DESC field)" /begin ANNOTATION_TEXT "Callstack from the Core1\r\n" /end ANNOTATION_TEXT /end ANNOTATION
/end MEASUREMENT
/begin MEASUREMENT rba_TrapLog_CallStackCore1_a_u32[3][7] "Callstack from the Core1[3][7]" ULONG RB_RBA_rba_TrapLog_CompuMethods_rba_TrapLog_oneToOne 1 100 0.0 4.E9 FORMAT "%32.0" ECU_ADDRESS 0x60035930
 /begin ANNOTATION ANNOTATION_LABEL "Description (coming from AUTOSAR DESC field)" /begin ANNOTATION_TEXT "Callstack from the Core1\r\n" /end ANNOTATION_TEXT /end ANNOTATION
/end MEASUREMENT
/begin MEASUREMENT rba_TrapLog_CallStackCore1_a_u32[4][0] "Callstack from the Core1[4][0]" ULONG RB_RBA_rba_TrapLog_CompuMethods_rba_TrapLog_oneToOne 1 100 0.0 4.E9 FORMAT "%32.0" ECU_ADDRESS 0x60035934
 /begin ANNOTATION ANNOTATION_LABEL "Description (coming from AUTOSAR DESC field)" /begin ANNOTATION_TEXT "Callstack from the Core1\r\n" /end ANNOTATION_TEXT /end ANNOTATION
/end MEASUREMENT
/begin MEASUREMENT rba_TrapLog_CallStackCore1_a_u32[4][1] "Callstack from the Core1[4][1]" ULONG RB_RBA_rba_TrapLog_CompuMethods_rba_TrapLog_oneToOne 1 100 0.0 4.E9 FORMAT "%32.0" ECU_ADDRESS 0x60035938
 /begin ANNOTATION ANNOTATION_LABEL "Description (coming from AUTOSAR DESC field)" /begin ANNOTATION_TEXT "Callstack from the Core1\r\n" /end ANNOTATION_TEXT /end ANNOTATION
/end MEASUREMENT
/begin MEASUREMENT rba_TrapLog_CallStackCore1_a_u32[4][2] "Callstack from the Core1[4][2]" ULONG RB_RBA_rba_TrapLog_CompuMethods_rba_TrapLog_oneToOne 1 100 0.0 4.E9 FORMAT "%32.0" ECU_ADDRESS 0x6003593C
 /begin ANNOTATION ANNOTATION_LABEL "Description (coming from AUTOSAR DESC field)" /begin ANNOTATION_TEXT "Callstack from the Core1\r\n" /end ANNOTATION_TEXT /end ANNOTATION
/end MEASUREMENT
/begin MEASUREMENT rba_TrapLog_CallStackCore1_a_u32[4][3] "Callstack from the Core1[4][3]" ULONG RB_RBA_rba_TrapLog_CompuMethods_rba_TrapLog_oneToOne 1 100 0.0 4.E9 FORMAT "%32.0" ECU_ADDRESS 0x60035940
 /begin ANNOTATION ANNOTATION_LABEL "Description (coming from AUTOSAR DESC field)" /begin ANNOTATION_TEXT "Callstack from the Core1\r\n" /end ANNOTATION_TEXT /end ANNOTATION
/end MEASUREMENT
/begin MEASUREMENT rba_TrapLog_CallStackCore1_a_u32[4][4] "Callstack from the Core1[4][4]" ULONG RB_RBA_rba_TrapLog_CompuMethods_rba_TrapLog_oneToOne 1 100 0.0 4.E9 FORMAT "%32.0" ECU_ADDRESS 0x60035944
 /begin ANNOTATION ANNOTATION_LABEL "Description (coming from AUTOSAR DESC field)" /begin ANNOTATION_TEXT "Callstack from the Core1\r\n" /end ANNOTATION_TEXT /end ANNOTATION
/end MEASUREMENT
/begin MEASUREMENT rba_TrapLog_CallStackCore1_a_u32[4][5] "Callstack from the Core1[4][5]" ULONG RB_RBA_rba_TrapLog_CompuMethods_rba_TrapLog_oneToOne 1 100 0.0 4.E9 FORMAT "%32.0" ECU_ADDRESS 0x60035948
 /begin ANNOTATION ANNOTATION_LABEL "Description (coming from AUTOSAR DESC field)" /begin ANNOTATION_TEXT "Callstack from the Core1\r\n" /end ANNOTATION_TEXT /end ANNOTATION
/end MEASUREMENT
/begin MEASUREMENT rba_TrapLog_CallStackCore1_a_u32[4][6] "Callstack from the Core1[4][6]" ULONG RB_RBA_rba_TrapLog_CompuMethods_rba_TrapLog_oneToOne 1 100 0.0 4.E9 FORMAT "%32.0" ECU_ADDRESS 0x6003594C
 /begin ANNOTATION ANNOTATION_LABEL "Description (coming from AUTOSAR DESC field)" /begin ANNOTATION_TEXT "Callstack from the Core1\r\n" /end ANNOTATION_TEXT /end ANNOTATION
/end MEASUREMENT
/begin MEASUREMENT rba_TrapLog_CallStackCore1_a_u32[4][7] "Callstack from the Core1[4][7]" ULONG RB_RBA_rba_TrapLog_CompuMethods_rba_TrapLog_oneToOne 1 100 0.0 4.E9 FORMAT "%32.0" ECU_ADDRESS 0x60035950
 /begin ANNOTATION ANNOTATION_LABEL "Description (coming from AUTOSAR DESC field)" /begin ANNOTATION_TEXT "Callstack from the Core1\r\n" /end ANNOTATION_TEXT /end ANNOTATION
/end MEASUREMENT
/begin MEASUREMENT rba_TrapLog_CallStackCore1_a_u32[5][0] "Callstack from the Core1[5][0]" ULONG RB_RBA_rba_TrapLog_CompuMethods_rba_TrapLog_oneToOne 1 100 0.0 4.E9 FORMAT "%32.0" ECU_ADDRESS 0x60035954
 /begin ANNOTATION ANNOTATION_LABEL "Description (coming from AUTOSAR DESC field)" /begin ANNOTATION_TEXT "Callstack from the Core1\r\n" /end ANNOTATION_TEXT /end ANNOTATION
/end MEASUREMENT
/begin MEASUREMENT rba_TrapLog_CallStackCore1_a_u32[5][1] "Callstack from the Core1[5][1]" ULONG RB_RBA_rba_TrapLog_CompuMethods_rba_TrapLog_oneToOne 1 100 0.0 4.E9 FORMAT "%32.0" ECU_ADDRESS 0x60035958
 /begin ANNOTATION ANNOTATION_LABEL "Description (coming from AUTOSAR DESC field)" /begin ANNOTATION_TEXT "Callstack from the Core1\r\n" /end ANNOTATION_TEXT /end ANNOTATION
/end MEASUREMENT
/begin MEASUREMENT rba_TrapLog_CallStackCore1_a_u32[5][2] "Callstack from the Core1[5][2]" ULONG RB_RBA_rba_TrapLog_CompuMethods_rba_TrapLog_oneToOne 1 100 0.0 4.E9 FORMAT "%32.0" ECU_ADDRESS 0x6003595C
 /begin ANNOTATION ANNOTATION_LABEL "Description (coming from AUTOSAR DESC field)" /begin ANNOTATION_TEXT "Callstack from the Core1\r\n" /end ANNOTATION_TEXT /end ANNOTATION
/end MEASUREMENT
/begin MEASUREMENT rba_TrapLog_CallStackCore1_a_u32[5][3] "Callstack from the Core1[5][3]" ULONG RB_RBA_rba_TrapLog_CompuMethods_rba_TrapLog_oneToOne 1 100 0.0 4.E9 FORMAT "%32.0" ECU_ADDRESS 0x60035960
 /begin ANNOTATION ANNOTATION_LABEL "Description (coming from AUTOSAR DESC field)" /begin ANNOTATION_TEXT "Callstack from the Core1\r\n" /end ANNOTATION_TEXT /end ANNOTATION
/end MEASUREMENT
/begin MEASUREMENT rba_TrapLog_CallStackCore1_a_u32[5][4] "Callstack from the Core1[5][4]" ULONG RB_RBA_rba_TrapLog_CompuMethods_rba_TrapLog_oneToOne 1 100 0.0 4.E9 FORMAT "%32.0" ECU_ADDRESS 0x60035964
 /begin ANNOTATION ANNOTATION_LABEL "Description (coming from AUTOSAR DESC field)" /begin ANNOTATION_TEXT "Callstack from the Core1\r\n" /end ANNOTATION_TEXT /end ANNOTATION
/end MEASUREMENT
/begin MEASUREMENT rba_TrapLog_CallStackCore1_a_u32[5][5] "Callstack from the Core1[5][5]" ULONG RB_RBA_rba_TrapLog_CompuMethods_rba_TrapLog_oneToOne 1 100 0.0 4.E9 FORMAT "%32.0" ECU_ADDRESS 0x60035968
 /begin ANNOTATION ANNOTATION_LABEL "Description (coming from AUTOSAR DESC field)" /begin ANNOTATION_TEXT "Callstack from the Core1\r\n" /end ANNOTATION_TEXT /end ANNOTATION
/end MEASUREMENT
/begin MEASUREMENT rba_TrapLog_CallStackCore1_a_u32[5][6] "Callstack from the Core1[5][6]" ULONG RB_RBA_rba_TrapLog_CompuMethods_rba_TrapLog_oneToOne 1 100 0.0 4.E9 FORMAT "%32.0" ECU_ADDRESS 0x6003596C
 /begin ANNOTATION ANNOTATION_LABEL "Description (coming from AUTOSAR DESC field)" /begin ANNOTATION_TEXT "Callstack from the Core1\r\n" /end ANNOTATION_TEXT /end ANNOTATION
/end MEASUREMENT
/begin MEASUREMENT rba_TrapLog_CallStackCore1_a_u32[5][7] "Callstack from the Core1[5][7]" ULONG RB_RBA_rba_TrapLog_CompuMethods_rba_TrapLog_oneToOne 1 100 0.0 4.E9 FORMAT "%32.0" ECU_ADDRESS 0x60035970
 /begin ANNOTATION ANNOTATION_LABEL "Description (coming from AUTOSAR DESC field)" /begin ANNOTATION_TEXT "Callstack from the Core1\r\n" /end ANNOTATION_TEXT /end ANNOTATION
/end MEASUREMENT
/begin MEASUREMENT rba_TrapLog_CallStackCore2_a_u32[0][0] "Callstack from the Core2[0][0]" ULONG RB_RBA_rba_TrapLog_CompuMethods_rba_TrapLog_oneToOne 1 100 0.0 4.E9 FORMAT "%32.0" ECU_ADDRESS 0x600357F4
 /begin ANNOTATION ANNOTATION_LABEL "Description (coming from AUTOSAR DESC field)" /begin ANNOTATION_TEXT "Callstack from the Core2\r\n" /end ANNOTATION_TEXT /end ANNOTATION
/end MEASUREMENT
/begin MEASUREMENT rba_TrapLog_CallStackCore2_a_u32[0][1] "Callstack from the Core2[0][1]" ULONG RB_RBA_rba_TrapLog_CompuMethods_rba_TrapLog_oneToOne 1 100 0.0 4.E9 FORMAT "%32.0" ECU_ADDRESS 0x600357F8
 /begin ANNOTATION ANNOTATION_LABEL "Description (coming from AUTOSAR DESC field)" /begin ANNOTATION_TEXT "Callstack from the Core2\r\n" /end ANNOTATION_TEXT /end ANNOTATION
/end MEASUREMENT
/begin MEASUREMENT rba_TrapLog_CallStackCore2_a_u32[0][2] "Callstack from the Core2[0][2]" ULONG RB_RBA_rba_TrapLog_CompuMethods_rba_TrapLog_oneToOne 1 100 0.0 4.E9 FORMAT "%32.0" ECU_ADDRESS 0x600357FC
 /begin ANNOTATION ANNOTATION_LABEL "Description (coming from AUTOSAR DESC field)" /begin ANNOTATION_TEXT "Callstack from the Core2\r\n" /end ANNOTATION_TEXT /end ANNOTATION
/end MEASUREMENT
/begin MEASUREMENT rba_TrapLog_CallStackCore2_a_u32[0][3] "Callstack from the Core2[0][3]" ULONG RB_RBA_rba_TrapLog_CompuMethods_rba_TrapLog_oneToOne 1 100 0.0 4.E9 FORMAT "%32.0" ECU_ADDRESS 0x60035800
 /begin ANNOTATION ANNOTATION_LABEL "Description (coming from AUTOSAR DESC field)" /begin ANNOTATION_TEXT "Callstack from the Core2\r\n" /end ANNOTATION_TEXT /end ANNOTATION
/end MEASUREMENT
/begin MEASUREMENT rba_TrapLog_CallStackCore2_a_u32[0][4] "Callstack from the Core2[0][4]" ULONG RB_RBA_rba_TrapLog_CompuMethods_rba_TrapLog_oneToOne 1 100 0.0 4.E9 FORMAT "%32.0" ECU_ADDRESS 0x60035804
 /begin ANNOTATION ANNOTATION_LABEL "Description (coming from AUTOSAR DESC field)" /begin ANNOTATION_TEXT "Callstack from the Core2\r\n" /end ANNOTATION_TEXT /end ANNOTATION
/end MEASUREMENT
/begin MEASUREMENT rba_TrapLog_CallStackCore2_a_u32[0][5] "Callstack from the Core2[0][5]" ULONG RB_RBA_rba_TrapLog_CompuMethods_rba_TrapLog_oneToOne 1 100 0.0 4.E9 FORMAT "%32.0" ECU_ADDRESS 0x60035808
 /begin ANNOTATION ANNOTATION_LABEL "Description (coming from AUTOSAR DESC field)" /begin ANNOTATION_TEXT "Callstack from the Core2\r\n" /end ANNOTATION_TEXT /end ANNOTATION
/end MEASUREMENT
/begin MEASUREMENT rba_TrapLog_CallStackCore2_a_u32[0][6] "Callstack from the Core2[0][6]" ULONG RB_RBA_rba_TrapLog_CompuMethods_rba_TrapLog_oneToOne 1 100 0.0 4.E9 FORMAT "%32.0" ECU_ADDRESS 0x6003580C
 /begin ANNOTATION ANNOTATION_LABEL "Description (coming from AUTOSAR DESC field)" /begin ANNOTATION_TEXT "Callstack from the Core2\r\n" /end ANNOTATION_TEXT /end ANNOTATION
/end MEASUREMENT
/begin MEASUREMENT rba_TrapLog_CallStackCore2_a_u32[0][7] "Callstack from the Core2[0][7]" ULONG RB_RBA_rba_TrapLog_CompuMethods_rba_TrapLog_oneToOne 1 100 0.0 4.E9 FORMAT "%32.0" ECU_ADDRESS 0x60035810
 /begin ANNOTATION ANNOTATION_LABEL "Description (coming from AUTOSAR DESC field)" /begin ANNOTATION_TEXT "Callstack from the Core2\r\n" /end ANNOTATION_TEXT /end ANNOTATION
/end MEASUREMENT
/begin MEASUREMENT rba_TrapLog_CallStackCore2_a_u32[1][0] "Callstack from the Core2[1][0]" ULONG RB_RBA_rba_TrapLog_CompuMethods_rba_TrapLog_oneToOne 1 100 0.0 4.E9 FORMAT "%32.0" ECU_ADDRESS 0x60035814
 /begin ANNOTATION ANNOTATION_LABEL "Description (coming from AUTOSAR DESC field)" /begin ANNOTATION_TEXT "Callstack from the Core2\r\n" /end ANNOTATION_TEXT /end ANNOTATION
/end MEASUREMENT
/begin MEASUREMENT rba_TrapLog_CallStackCore2_a_u32[1][1] "Callstack from the Core2[1][1]" ULONG RB_RBA_rba_TrapLog_CompuMethods_rba_TrapLog_oneToOne 1 100 0.0 4.E9 FORMAT "%32.0" ECU_ADDRESS 0x60035818
 /begin ANNOTATION ANNOTATION_LABEL "Description (coming from AUTOSAR DESC field)" /begin ANNOTATION_TEXT "Callstack from the Core2\r\n" /end ANNOTATION_TEXT /end ANNOTATION
/end MEASUREMENT
/begin MEASUREMENT rba_TrapLog_CallStackCore2_a_u32[1][2] "Callstack from the Core2[1][2]" ULONG RB_RBA_rba_TrapLog_CompuMethods_rba_TrapLog_oneToOne 1 100 0.0 4.E9 FORMAT "%32.0" ECU_ADDRESS 0x6003581C
 /begin ANNOTATION ANNOTATION_LABEL "Description (coming from AUTOSAR DESC field)" /begin ANNOTATION_TEXT "Callstack from the Core2\r\n" /end ANNOTATION_TEXT /end ANNOTATION
/end MEASUREMENT
/begin MEASUREMENT rba_TrapLog_CallStackCore2_a_u32[1][3] "Callstack from the Core2[1][3]" ULONG RB_RBA_rba_TrapLog_CompuMethods_rba_TrapLog_oneToOne 1 100 0.0 4.E9 FORMAT "%32.0" ECU_ADDRESS 0x60035820
 /begin ANNOTATION ANNOTATION_LABEL "Description (coming from AUTOSAR DESC field)" /begin ANNOTATION_TEXT "Callstack from the Core2\r\n" /end ANNOTATION_TEXT /end ANNOTATION
/end MEASUREMENT
/begin MEASUREMENT rba_TrapLog_CallStackCore2_a_u32[1][4] "Callstack from the Core2[1][4]" ULONG RB_RBA_rba_TrapLog_CompuMethods_rba_TrapLog_oneToOne 1 100 0.0 4.E9 FORMAT "%32.0" ECU_ADDRESS 0x60035824
 /begin ANNOTATION ANNOTATION_LABEL "Description (coming from AUTOSAR DESC field)" /begin ANNOTATION_TEXT "Callstack from the Core2\r\n" /end ANNOTATION_TEXT /end ANNOTATION
/end MEASUREMENT
/begin MEASUREMENT rba_TrapLog_CallStackCore2_a_u32[1][5] "Callstack from the Core2[1][5]" ULONG RB_RBA_rba_TrapLog_CompuMethods_rba_TrapLog_oneToOne 1 100 0.0 4.E9 FORMAT "%32.0" ECU_ADDRESS 0x60035828
 /begin ANNOTATION ANNOTATION_LABEL "Description (coming from AUTOSAR DESC field)" /begin ANNOTATION_TEXT "Callstack from the Core2\r\n" /end ANNOTATION_TEXT /end ANNOTATION
/end MEASUREMENT
/begin MEASUREMENT rba_TrapLog_CallStackCore2_a_u32[1][6] "Callstack from the Core2[1][6]" ULONG RB_RBA_rba_TrapLog_CompuMethods_rba_TrapLog_oneToOne 1 100 0.0 4.E9 FORMAT "%32.0" ECU_ADDRESS 0x6003582C
 /begin ANNOTATION ANNOTATION_LABEL "Description (coming from AUTOSAR DESC field)" /begin ANNOTATION_TEXT "Callstack from the Core2\r\n" /end ANNOTATION_TEXT /end ANNOTATION
/end MEASUREMENT
/begin MEASUREMENT rba_TrapLog_CallStackCore2_a_u32[1][7] "Callstack from the Core2[1][7]" ULONG RB_RBA_rba_TrapLog_CompuMethods_rba_TrapLog_oneToOne 1 100 0.0 4.E9 FORMAT "%32.0" ECU_ADDRESS 0x60035830
 /begin ANNOTATION ANNOTATION_LABEL "Description (coming from AUTOSAR DESC field)" /begin ANNOTATION_TEXT "Callstack from the Core2\r\n" /end ANNOTATION_TEXT /end ANNOTATION
/end MEASUREMENT
/begin MEASUREMENT rba_TrapLog_CallStackCore2_a_u32[2][0] "Callstack from the Core2[2][0]" ULONG RB_RBA_rba_TrapLog_CompuMethods_rba_TrapLog_oneToOne 1 100 0.0 4.E9 FORMAT "%32.0" ECU_ADDRESS 0x60035834
 /begin ANNOTATION ANNOTATION_LABEL "Description (coming from AUTOSAR DESC field)" /begin ANNOTATION_TEXT "Callstack from the Core2\r\n" /end ANNOTATION_TEXT /end ANNOTATION
/end MEASUREMENT
/begin MEASUREMENT rba_TrapLog_CallStackCore2_a_u32[2][1] "Callstack from the Core2[2][1]" ULONG RB_RBA_rba_TrapLog_CompuMethods_rba_TrapLog_oneToOne 1 100 0.0 4.E9 FORMAT "%32.0" ECU_ADDRESS 0x60035838
 /begin ANNOTATION ANNOTATION_LABEL "Description (coming from AUTOSAR DESC field)" /begin ANNOTATION_TEXT "Callstack from the Core2\r\n" /end ANNOTATION_TEXT /end ANNOTATION
/end MEASUREMENT
/begin MEASUREMENT rba_TrapLog_CallStackCore2_a_u32[2][2] "Callstack from the Core2[2][2]" ULONG RB_RBA_rba_TrapLog_CompuMethods_rba_TrapLog_oneToOne 1 100 0.0 4.E9 FORMAT "%32.0" ECU_ADDRESS 0x6003583C
 /begin ANNOTATION ANNOTATION_LABEL "Description (coming from AUTOSAR DESC field)" /begin ANNOTATION_TEXT "Callstack from the Core2\r\n" /end ANNOTATION_TEXT /end ANNOTATION
/end MEASUREMENT
/begin MEASUREMENT rba_TrapLog_CallStackCore2_a_u32[2][3] "Callstack from the Core2[2][3]" ULONG RB_RBA_rba_TrapLog_CompuMethods_rba_TrapLog_oneToOne 1 100 0.0 4.E9 FORMAT "%32.0" ECU_ADDRESS 0x60035840
 /begin ANNOTATION ANNOTATION_LABEL "Description (coming from AUTOSAR DESC field)" /begin ANNOTATION_TEXT "Callstack from the Core2\r\n" /end ANNOTATION_TEXT /end ANNOTATION
/end MEASUREMENT
/begin MEASUREMENT rba_TrapLog_CallStackCore2_a_u32[2][4] "Callstack from the Core2[2][4]" ULONG RB_RBA_rba_TrapLog_CompuMethods_rba_TrapLog_oneToOne 1 100 0.0 4.E9 FORMAT "%32.0" ECU_ADDRESS 0x60035844
 /begin ANNOTATION ANNOTATION_LABEL "Description (coming from AUTOSAR DESC field)" /begin ANNOTATION_TEXT "Callstack from the Core2\r\n" /end ANNOTATION_TEXT /end ANNOTATION
/end MEASUREMENT
/begin MEASUREMENT rba_TrapLog_CallStackCore2_a_u32[2][5] "Callstack from the Core2[2][5]" ULONG RB_RBA_rba_TrapLog_CompuMethods_rba_TrapLog_oneToOne 1 100 0.0 4.E9 FORMAT "%32.0" ECU_ADDRESS 0x60035848
 /begin ANNOTATION ANNOTATION_LABEL "Description (coming from AUTOSAR DESC field)" /begin ANNOTATION_TEXT "Callstack from the Core2\r\n" /end ANNOTATION_TEXT /end ANNOTATION
/end MEASUREMENT
/begin MEASUREMENT rba_TrapLog_CallStackCore2_a_u32[2][6] "Callstack from the Core2[2][6]" ULONG RB_RBA_rba_TrapLog_CompuMethods_rba_TrapLog_oneToOne 1 100 0.0 4.E9 FORMAT "%32.0" ECU_ADDRESS 0x6003584C
 /begin ANNOTATION ANNOTATION_LABEL "Description (coming from AUTOSAR DESC field)" /begin ANNOTATION_TEXT "Callstack from the Core2\r\n" /end ANNOTATION_TEXT /end ANNOTATION
/end MEASUREMENT
/begin MEASUREMENT rba_TrapLog_CallStackCore2_a_u32[2][7] "Callstack from the Core2[2][7]" ULONG RB_RBA_rba_TrapLog_CompuMethods_rba_TrapLog_oneToOne 1 100 0.0 4.E9 FORMAT "%32.0" ECU_ADDRESS 0x60035850
 /begin ANNOTATION ANNOTATION_LABEL "Description (coming from AUTOSAR DESC field)" /begin ANNOTATION_TEXT "Callstack from the Core2\r\n" /end ANNOTATION_TEXT /end ANNOTATION
/end MEASUREMENT
/begin MEASUREMENT rba_TrapLog_CallStackCore2_a_u32[3][0] "Callstack from the Core2[3][0]" ULONG RB_RBA_rba_TrapLog_CompuMethods_rba_TrapLog_oneToOne 1 100 0.0 4.E9 FORMAT "%32.0" ECU_ADDRESS 0x60035854
 /begin ANNOTATION ANNOTATION_LABEL "Description (coming from AUTOSAR DESC field)" /begin ANNOTATION_TEXT "Callstack from the Core2\r\n" /end ANNOTATION_TEXT /end ANNOTATION
/end MEASUREMENT
/begin MEASUREMENT rba_TrapLog_CallStackCore2_a_u32[3][1] "Callstack from the Core2[3][1]" ULONG RB_RBA_rba_TrapLog_CompuMethods_rba_TrapLog_oneToOne 1 100 0.0 4.E9 FORMAT "%32.0" ECU_ADDRESS 0x60035858
 /begin ANNOTATION ANNOTATION_LABEL "Description (coming from AUTOSAR DESC field)" /begin ANNOTATION_TEXT "Callstack from the Core2\r\n" /end ANNOTATION_TEXT /end ANNOTATION
/end MEASUREMENT
/begin MEASUREMENT rba_TrapLog_CallStackCore2_a_u32[3][2] "Callstack from the Core2[3][2]" ULONG RB_RBA_rba_TrapLog_CompuMethods_rba_TrapLog_oneToOne 1 100 0.0 4.E9 FORMAT "%32.0" ECU_ADDRESS 0x6003585C
 /begin ANNOTATION ANNOTATION_LABEL "Description (coming from AUTOSAR DESC field)" /begin ANNOTATION_TEXT "Callstack from the Core2\r\n" /end ANNOTATION_TEXT /end ANNOTATION
/end MEASUREMENT
/begin MEASUREMENT rba_TrapLog_CallStackCore2_a_u32[3][3] "Callstack from the Core2[3][3]" ULONG RB_RBA_rba_TrapLog_CompuMethods_rba_TrapLog_oneToOne 1 100 0.0 4.E9 FORMAT "%32.0" ECU_ADDRESS 0x60035860
 /begin ANNOTATION ANNOTATION_LABEL "Description (coming from AUTOSAR DESC field)" /begin ANNOTATION_TEXT "Callstack from the Core2\r\n" /end ANNOTATION_TEXT /end ANNOTATION
/end MEASUREMENT
/begin MEASUREMENT rba_TrapLog_CallStackCore2_a_u32[3][4] "Callstack from the Core2[3][4]" ULONG RB_RBA_rba_TrapLog_CompuMethods_rba_TrapLog_oneToOne 1 100 0.0 4.E9 FORMAT "%32.0" ECU_ADDRESS 0x60035864
 /begin ANNOTATION ANNOTATION_LABEL "Description (coming from AUTOSAR DESC field)" /begin ANNOTATION_TEXT "Callstack from the Core2\r\n" /end ANNOTATION_TEXT /end ANNOTATION
/end MEASUREMENT
/begin MEASUREMENT rba_TrapLog_CallStackCore2_a_u32[3][5] "Callstack from the Core2[3][5]" ULONG RB_RBA_rba_TrapLog_CompuMethods_rba_TrapLog_oneToOne 1 100 0.0 4.E9 FORMAT "%32.0" ECU_ADDRESS 0x60035868
 /begin ANNOTATION ANNOTATION_LABEL "Description (coming from AUTOSAR DESC field)" /begin ANNOTATION_TEXT "Callstack from the Core2\r\n" /end ANNOTATION_TEXT /end ANNOTATION
/end MEASUREMENT
/begin MEASUREMENT rba_TrapLog_CallStackCore2_a_u32[3][6] "Callstack from the Core2[3][6]" ULONG RB_RBA_rba_TrapLog_CompuMethods_rba_TrapLog_oneToOne 1 100 0.0 4.E9 FORMAT "%32.0" ECU_ADDRESS 0x6003586C
 /begin ANNOTATION ANNOTATION_LABEL "Description (coming from AUTOSAR DESC field)" /begin ANNOTATION_TEXT "Callstack from the Core2\r\n" /end ANNOTATION_TEXT /end ANNOTATION
/end MEASUREMENT
/begin MEASUREMENT rba_TrapLog_CallStackCore2_a_u32[3][7] "Callstack from the Core2[3][7]" ULONG RB_RBA_rba_TrapLog_CompuMethods_rba_TrapLog_oneToOne 1 100 0.0 4.E9 FORMAT "%32.0" ECU_ADDRESS 0x60035870
 /begin ANNOTATION ANNOTATION_LABEL "Description (coming from AUTOSAR DESC field)" /begin ANNOTATION_TEXT "Callstack from the Core2\r\n" /end ANNOTATION_TEXT /end ANNOTATION
/end MEASUREMENT
/begin MEASUREMENT rba_TrapLog_CallStackCore2_a_u32[4][0] "Callstack from the Core2[4][0]" ULONG RB_RBA_rba_TrapLog_CompuMethods_rba_TrapLog_oneToOne 1 100 0.0 4.E9 FORMAT "%32.0" ECU_ADDRESS 0x60035874
 /begin ANNOTATION ANNOTATION_LABEL "Description (coming from AUTOSAR DESC field)" /begin ANNOTATION_TEXT "Callstack from the Core2\r\n" /end ANNOTATION_TEXT /end ANNOTATION
/end MEASUREMENT
/begin MEASUREMENT rba_TrapLog_CallStackCore2_a_u32[4][1] "Callstack from the Core2[4][1]" ULONG RB_RBA_rba_TrapLog_CompuMethods_rba_TrapLog_oneToOne 1 100 0.0 4.E9 FORMAT "%32.0" ECU_ADDRESS 0x60035878
 /begin ANNOTATION ANNOTATION_LABEL "Description (coming from AUTOSAR DESC field)" /begin ANNOTATION_TEXT "Callstack from the Core2\r\n" /end ANNOTATION_TEXT /end ANNOTATION
/end MEASUREMENT
/begin MEASUREMENT rba_TrapLog_CallStackCore2_a_u32[4][2] "Callstack from the Core2[4][2]" ULONG RB_RBA_rba_TrapLog_CompuMethods_rba_TrapLog_oneToOne 1 100 0.0 4.E9 FORMAT "%32.0" ECU_ADDRESS 0x6003587C
 /begin ANNOTATION ANNOTATION_LABEL "Description (coming from AUTOSAR DESC field)" /begin ANNOTATION_TEXT "Callstack from the Core2\r\n" /end ANNOTATION_TEXT /end ANNOTATION
/end MEASUREMENT
/begin MEASUREMENT rba_TrapLog_CallStackCore2_a_u32[4][3] "Callstack from the Core2[4][3]" ULONG RB_RBA_rba_TrapLog_CompuMethods_rba_TrapLog_oneToOne 1 100 0.0 4.E9 FORMAT "%32.0" ECU_ADDRESS 0x60035880
 /begin ANNOTATION ANNOTATION_LABEL "Description (coming from AUTOSAR DESC field)" /begin ANNOTATION_TEXT "Callstack from the Core2\r\n" /end ANNOTATION_TEXT /end ANNOTATION
/end MEASUREMENT
/begin MEASUREMENT rba_TrapLog_CallStackCore2_a_u32[4][4] "Callstack from the Core2[4][4]" ULONG RB_RBA_rba_TrapLog_CompuMethods_rba_TrapLog_oneToOne 1 100 0.0 4.E9 FORMAT "%32.0" ECU_ADDRESS 0x60035884
 /begin ANNOTATION ANNOTATION_LABEL "Description (coming from AUTOSAR DESC field)" /begin ANNOTATION_TEXT "Callstack from the Core2\r\n" /end ANNOTATION_TEXT /end ANNOTATION
/end MEASUREMENT
/begin MEASUREMENT rba_TrapLog_CallStackCore2_a_u32[4][5] "Callstack from the Core2[4][5]" ULONG RB_RBA_rba_TrapLog_CompuMethods_rba_TrapLog_oneToOne 1 100 0.0 4.E9 FORMAT "%32.0" ECU_ADDRESS 0x60035888
 /begin ANNOTATION ANNOTATION_LABEL "Description (coming from AUTOSAR DESC field)" /begin ANNOTATION_TEXT "Callstack from the Core2\r\n" /end ANNOTATION_TEXT /end ANNOTATION
/end MEASUREMENT
/begin MEASUREMENT rba_TrapLog_CallStackCore2_a_u32[4][6] "Callstack from the Core2[4][6]" ULONG RB_RBA_rba_TrapLog_CompuMethods_rba_TrapLog_oneToOne 1 100 0.0 4.E9 FORMAT "%32.0" ECU_ADDRESS 0x6003588C
 /begin ANNOTATION ANNOTATION_LABEL "Description (coming from AUTOSAR DESC field)" /begin ANNOTATION_TEXT "Callstack from the Core2\r\n" /end ANNOTATION_TEXT /end ANNOTATION
/end MEASUREMENT
/begin MEASUREMENT rba_TrapLog_CallStackCore2_a_u32[4][7] "Callstack from the Core2[4][7]" ULONG RB_RBA_rba_TrapLog_CompuMethods_rba_TrapLog_oneToOne 1 100 0.0 4.E9 FORMAT "%32.0" ECU_ADDRESS 0x60035890
 /begin ANNOTATION ANNOTATION_LABEL "Description (coming from AUTOSAR DESC field)" /begin ANNOTATION_TEXT "Callstack from the Core2\r\n" /end ANNOTATION_TEXT /end ANNOTATION
/end MEASUREMENT
/begin MEASUREMENT rba_TrapLog_CallStackCore2_a_u32[5][0] "Callstack from the Core2[5][0]" ULONG RB_RBA_rba_TrapLog_CompuMethods_rba_TrapLog_oneToOne 1 100 0.0 4.E9 FORMAT "%32.0" ECU_ADDRESS 0x60035894
 /begin ANNOTATION ANNOTATION_LABEL "Description (coming from AUTOSAR DESC field)" /begin ANNOTATION_TEXT "Callstack from the Core2\r\n" /end ANNOTATION_TEXT /end ANNOTATION
/end MEASUREMENT
/begin MEASUREMENT rba_TrapLog_CallStackCore2_a_u32[5][1] "Callstack from the Core2[5][1]" ULONG RB_RBA_rba_TrapLog_CompuMethods_rba_TrapLog_oneToOne 1 100 0.0 4.E9 FORMAT "%32.0" ECU_ADDRESS 0x60035898
 /begin ANNOTATION ANNOTATION_LABEL "Description (coming from AUTOSAR DESC field)" /begin ANNOTATION_TEXT "Callstack from the Core2\r\n" /end ANNOTATION_TEXT /end ANNOTATION
/end MEASUREMENT
/begin MEASUREMENT rba_TrapLog_CallStackCore2_a_u32[5][2] "Callstack from the Core2[5][2]" ULONG RB_RBA_rba_TrapLog_CompuMethods_rba_TrapLog_oneToOne 1 100 0.0 4.E9 FORMAT "%32.0" ECU_ADDRESS 0x6003589C
 /begin ANNOTATION ANNOTATION_LABEL "Description (coming from AUTOSAR DESC field)" /begin ANNOTATION_TEXT "Callstack from the Core2\r\n" /end ANNOTATION_TEXT /end ANNOTATION
/end MEASUREMENT
/begin MEASUREMENT rba_TrapLog_CallStackCore2_a_u32[5][3] "Callstack from the Core2[5][3]" ULONG RB_RBA_rba_TrapLog_CompuMethods_rba_TrapLog_oneToOne 1 100 0.0 4.E9 FORMAT "%32.0" ECU_ADDRESS 0x600358A0
 /begin ANNOTATION ANNOTATION_LABEL "Description (coming from AUTOSAR DESC field)" /begin ANNOTATION_TEXT "Callstack from the Core2\r\n" /end ANNOTATION_TEXT /end ANNOTATION
/end MEASUREMENT
/begin MEASUREMENT rba_TrapLog_CallStackCore2_a_u32[5][4] "Callstack from the Core2[5][4]" ULONG RB_RBA_rba_TrapLog_CompuMethods_rba_TrapLog_oneToOne 1 100 0.0 4.E9 FORMAT "%32.0" ECU_ADDRESS 0x600358A4
 /begin ANNOTATION ANNOTATION_LABEL "Description (coming from AUTOSAR DESC field)" /begin ANNOTATION_TEXT "Callstack from the Core2\r\n" /end ANNOTATION_TEXT /end ANNOTATION
/end MEASUREMENT
/begin MEASUREMENT rba_TrapLog_CallStackCore2_a_u32[5][5] "Callstack from the Core2[5][5]" ULONG RB_RBA_rba_TrapLog_CompuMethods_rba_TrapLog_oneToOne 1 100 0.0 4.E9 FORMAT "%32.0" ECU_ADDRESS 0x600358A8
 /begin ANNOTATION ANNOTATION_LABEL "Description (coming from AUTOSAR DESC field)" /begin ANNOTATION_TEXT "Callstack from the Core2\r\n" /end ANNOTATION_TEXT /end ANNOTATION
/end MEASUREMENT
/begin MEASUREMENT rba_TrapLog_CallStackCore2_a_u32[5][6] "Callstack from the Core2[5][6]" ULONG RB_RBA_rba_TrapLog_CompuMethods_rba_TrapLog_oneToOne 1 100 0.0 4.E9 FORMAT "%32.0" ECU_ADDRESS 0x600358AC
 /begin ANNOTATION ANNOTATION_LABEL "Description (coming from AUTOSAR DESC field)" /begin ANNOTATION_TEXT "Callstack from the Core2\r\n" /end ANNOTATION_TEXT /end ANNOTATION
/end MEASUREMENT
/begin MEASUREMENT rba_TrapLog_CallStackCore2_a_u32[5][7] "Callstack from the Core2[5][7]" ULONG RB_RBA_rba_TrapLog_CompuMethods_rba_TrapLog_oneToOne 1 100 0.0 4.E9 FORMAT "%32.0" ECU_ADDRESS 0x600358B0
 /begin ANNOTATION ANNOTATION_LABEL "Description (coming from AUTOSAR DESC field)" /begin ANNOTATION_TEXT "Callstack from the Core2\r\n" /end ANNOTATION_TEXT /end ANNOTATION
/end MEASUREMENT
/begin MEASUREMENT rba_TrapLog_CallStack_a_u32[0][0] "Callstack from the main core[0][0]" ULONG RB_RBA_rba_TrapLog_CompuMethods_rba_TrapLog_oneToOne 1 100 0.0 4.E9 FORMAT "%32.0" ECU_ADDRESS 0x60035BE4
 /begin ANNOTATION ANNOTATION_LABEL "Description (coming from AUTOSAR DESC field)" /begin ANNOTATION_TEXT "Callstack from the main core or single core trap\r\n" /end ANNOTATION_TEXT /end ANNOTATION
/end MEASUREMENT
/begin MEASUREMENT rba_TrapLog_CallStack_a_u32[0][1] "Callstack from the main core[0][1]" ULONG RB_RBA_rba_TrapLog_CompuMethods_rba_TrapLog_oneToOne 1 100 0.0 4.E9 FORMAT "%32.0" ECU_ADDRESS 0x60035BE8
 /begin ANNOTATION ANNOTATION_LABEL "Description (coming from AUTOSAR DESC field)" /begin ANNOTATION_TEXT "Callstack from the main core or single core trap\r\n" /end ANNOTATION_TEXT /end ANNOTATION
/end MEASUREMENT
/begin MEASUREMENT rba_TrapLog_CallStack_a_u32[0][2] "Callstack from the main core[0][2]" ULONG RB_RBA_rba_TrapLog_CompuMethods_rba_TrapLog_oneToOne 1 100 0.0 4.E9 FORMAT "%32.0" ECU_ADDRESS 0x60035BEC
 /begin ANNOTATION ANNOTATION_LABEL "Description (coming from AUTOSAR DESC field)" /begin ANNOTATION_TEXT "Callstack from the main core or single core trap\r\n" /end ANNOTATION_TEXT /end ANNOTATION
/end MEASUREMENT
/begin MEASUREMENT rba_TrapLog_CallStack_a_u32[0][3] "Callstack from the main core[0][3]" ULONG RB_RBA_rba_TrapLog_CompuMethods_rba_TrapLog_oneToOne 1 100 0.0 4.E9 FORMAT "%32.0" ECU_ADDRESS 0x60035BF0
 /begin ANNOTATION ANNOTATION_LABEL "Description (coming from AUTOSAR DESC field)" /begin ANNOTATION_TEXT "Callstack from the main core or single core trap\r\n" /end ANNOTATION_TEXT /end ANNOTATION
/end MEASUREMENT
/begin MEASUREMENT rba_TrapLog_CallStack_a_u32[0][4] "Callstack from the main core[0][4]" ULONG RB_RBA_rba_TrapLog_CompuMethods_rba_TrapLog_oneToOne 1 100 0.0 4.E9 FORMAT "%32.0" ECU_ADDRESS 0x60035BF4
 /begin ANNOTATION ANNOTATION_LABEL "Description (coming from AUTOSAR DESC field)" /begin ANNOTATION_TEXT "Callstack from the main core or single core trap\r\n" /end ANNOTATION_TEXT /end ANNOTATION
/end MEASUREMENT
/begin MEASUREMENT rba_TrapLog_CallStack_a_u32[0][5] "Callstack from the main core[0][5]" ULONG RB_RBA_rba_TrapLog_CompuMethods_rba_TrapLog_oneToOne 1 100 0.0 4.E9 FORMAT "%32.0" ECU_ADDRESS 0x60035BF8
 /begin ANNOTATION ANNOTATION_LABEL "Description (coming from AUTOSAR DESC field)" /begin ANNOTATION_TEXT "Callstack from the main core or single core trap\r\n" /end ANNOTATION_TEXT /end ANNOTATION
/end MEASUREMENT
/begin MEASUREMENT rba_TrapLog_CallStack_a_u32[0][6] "Callstack from the main core[0][6]" ULONG RB_RBA_rba_TrapLog_CompuMethods_rba_TrapLog_oneToOne 1 100 0.0 4.E9 FORMAT "%32.0" ECU_ADDRESS 0x60035BFC
 /begin ANNOTATION ANNOTATION_LABEL "Description (coming from AUTOSAR DESC field)" /begin ANNOTATION_TEXT "Callstack from the main core or single core trap\r\n" /end ANNOTATION_TEXT /end ANNOTATION
/end MEASUREMENT
/begin MEASUREMENT rba_TrapLog_CallStack_a_u32[0][7] "Callstack from the main core[0][7]" ULONG RB_RBA_rba_TrapLog_CompuMethods_rba_TrapLog_oneToOne 1 100 0.0 4.E9 FORMAT "%32.0" ECU_ADDRESS 0x60035C00
 /begin ANNOTATION ANNOTATION_LABEL "Description (coming from AUTOSAR DESC field)" /begin ANNOTATION_TEXT "Callstack from the main core or single core trap\r\n" /end ANNOTATION_TEXT /end ANNOTATION
/end MEASUREMENT
/begin MEASUREMENT rba_TrapLog_CallStack_a_u32[1][0] "Callstack from the main core[1][0]" ULONG RB_RBA_rba_TrapLog_CompuMethods_rba_TrapLog_oneToOne 1 100 0.0 4.E9 FORMAT "%32.0" ECU_ADDRESS 0x60035C04
 /begin ANNOTATION ANNOTATION_LABEL "Description (coming from AUTOSAR DESC field)" /begin ANNOTATION_TEXT "Callstack from the main core or single core trap\r\n" /end ANNOTATION_TEXT /end ANNOTATION
/end MEASUREMENT
/begin MEASUREMENT rba_TrapLog_CallStack_a_u32[1][1] "Callstack from the main core[1][1]" ULONG RB_RBA_rba_TrapLog_CompuMethods_rba_TrapLog_oneToOne 1 100 0.0 4.E9 FORMAT "%32.0" ECU_ADDRESS 0x60035C08
 /begin ANNOTATION ANNOTATION_LABEL "Description (coming from AUTOSAR DESC field)" /begin ANNOTATION_TEXT "Callstack from the main core or single core trap\r\n" /end ANNOTATION_TEXT /end ANNOTATION
/end MEASUREMENT
/begin MEASUREMENT rba_TrapLog_CallStack_a_u32[1][2] "Callstack from the main core[1][2]" ULONG RB_RBA_rba_TrapLog_CompuMethods_rba_TrapLog_oneToOne 1 100 0.0 4.E9 FORMAT "%32.0" ECU_ADDRESS 0x60035C0C
 /begin ANNOTATION ANNOTATION_LABEL "Description (coming from AUTOSAR DESC field)" /begin ANNOTATION_TEXT "Callstack from the main core or single core trap\r\n" /end ANNOTATION_TEXT /end ANNOTATION
/end MEASUREMENT
/begin MEASUREMENT rba_TrapLog_CallStack_a_u32[1][3] "Callstack from the main core[1][3]" ULONG RB_RBA_rba_TrapLog_CompuMethods_rba_TrapLog_oneToOne 1 100 0.0 4.E9 FORMAT "%32.0" ECU_ADDRESS 0x60035C10
 /begin ANNOTATION ANNOTATION_LABEL "Description (coming from AUTOSAR DESC field)" /begin ANNOTATION_TEXT "Callstack from the main core or single core trap\r\n" /end ANNOTATION_TEXT /end ANNOTATION
/end MEASUREMENT
/begin MEASUREMENT rba_TrapLog_CallStack_a_u32[1][4] "Callstack from the main core[1][4]" ULONG RB_RBA_rba_TrapLog_CompuMethods_rba_TrapLog_oneToOne 1 100 0.0 4.E9 FORMAT "%32.0" ECU_ADDRESS 0x60035C14
 /begin ANNOTATION ANNOTATION_LABEL "Description (coming from AUTOSAR DESC field)" /begin ANNOTATION_TEXT "Callstack from the main core or single core trap\r\n" /end ANNOTATION_TEXT /end ANNOTATION
/end MEASUREMENT
/begin MEASUREMENT rba_TrapLog_CallStack_a_u32[1][5] "Callstack from the main core[1][5]" ULONG RB_RBA_rba_TrapLog_CompuMethods_rba_TrapLog_oneToOne 1 100 0.0 4.E9 FORMAT "%32.0" ECU_ADDRESS 0x60035C18
 /begin ANNOTATION ANNOTATION_LABEL "Description (coming from AUTOSAR DESC field)" /begin ANNOTATION_TEXT "Callstack from the main core or single core trap\r\n" /end ANNOTATION_TEXT /end ANNOTATION
/end MEASUREMENT
/begin MEASUREMENT rba_TrapLog_CallStack_a_u32[1][6] "Callstack from the main core[1][6]" ULONG RB_RBA_rba_TrapLog_CompuMethods_rba_TrapLog_oneToOne 1 100 0.0 4.E9 FORMAT "%32.0" ECU_ADDRESS 0x60035C1C
 /begin ANNOTATION ANNOTATION_LABEL "Description (coming from AUTOSAR DESC field)" /begin ANNOTATION_TEXT "Callstack from the main core or single core trap\r\n" /end ANNOTATION_TEXT /end ANNOTATION
/end MEASUREMENT
/begin MEASUREMENT rba_TrapLog_CallStack_a_u32[1][7] "Callstack from the main core[1][7]" ULONG RB_RBA_rba_TrapLog_CompuMethods_rba_TrapLog_oneToOne 1 100 0.0 4.E9 FORMAT "%32.0" ECU_ADDRESS 0x60035C20
 /begin ANNOTATION ANNOTATION_LABEL "Description (coming from AUTOSAR DESC field)" /begin ANNOTATION_TEXT "Callstack from the main core or single core trap\r\n" /end ANNOTATION_TEXT /end ANNOTATION
/end MEASUREMENT
/begin MEASUREMENT rba_TrapLog_CallStack_a_u32[2][0] "Callstack from the main core[2][0]" ULONG RB_RBA_rba_TrapLog_CompuMethods_rba_TrapLog_oneToOne 1 100 0.0 4.E9 FORMAT "%32.0" ECU_ADDRESS 0x60035C24
 /begin ANNOTATION ANNOTATION_LABEL "Description (coming from AUTOSAR DESC field)" /begin ANNOTATION_TEXT "Callstack from the main core or single core trap\r\n" /end ANNOTATION_TEXT /end ANNOTATION
/end MEASUREMENT
/begin MEASUREMENT rba_TrapLog_CallStack_a_u32[2][1] "Callstack from the main core[2][1]" ULONG RB_RBA_rba_TrapLog_CompuMethods_rba_TrapLog_oneToOne 1 100 0.0 4.E9 FORMAT "%32.0" ECU_ADDRESS 0x60035C28
 /begin ANNOTATION ANNOTATION_LABEL "Description (coming from AUTOSAR DESC field)" /begin ANNOTATION_TEXT "Callstack from the main core or single core trap\r\n" /end ANNOTATION_TEXT /end ANNOTATION
/end MEASUREMENT
/begin MEASUREMENT rba_TrapLog_CallStack_a_u32[2][2] "Callstack from the main core[2][2]" ULONG RB_RBA_rba_TrapLog_CompuMethods_rba_TrapLog_oneToOne 1 100 0.0 4.E9 FORMAT "%32.0" ECU_ADDRESS 0x60035C2C
 /begin ANNOTATION ANNOTATION_LABEL "Description (coming from AUTOSAR DESC field)" /begin ANNOTATION_TEXT "Callstack from the main core or single core trap\r\n" /end ANNOTATION_TEXT /end ANNOTATION
/end MEASUREMENT
/begin MEASUREMENT rba_TrapLog_CallStack_a_u32[2][3] "Callstack from the main core[2][3]" ULONG RB_RBA_rba_TrapLog_CompuMethods_rba_TrapLog_oneToOne 1 100 0.0 4.E9 FORMAT "%32.0" ECU_ADDRESS 0x60035C30
 /begin ANNOTATION ANNOTATION_LABEL "Description (coming from AUTOSAR DESC field)" /begin ANNOTATION_TEXT "Callstack from the main core or single core trap\r\n" /end ANNOTATION_TEXT /end ANNOTATION
/end MEASUREMENT
/begin MEASUREMENT rba_TrapLog_CallStack_a_u32[2][4] "Callstack from the main core[2][4]" ULONG RB_RBA_rba_TrapLog_CompuMethods_rba_TrapLog_oneToOne 1 100 0.0 4.E9 FORMAT "%32.0" ECU_ADDRESS 0x60035C34
 /begin ANNOTATION ANNOTATION_LABEL "Description (coming from AUTOSAR DESC field)" /begin ANNOTATION_TEXT "Callstack from the main core or single core trap\r\n" /end ANNOTATION_TEXT /end ANNOTATION
/end MEASUREMENT
/begin MEASUREMENT rba_TrapLog_CallStack_a_u32[2][5] "Callstack from the main core[2][5]" ULONG RB_RBA_rba_TrapLog_CompuMethods_rba_TrapLog_oneToOne 1 100 0.0 4.E9 FORMAT "%32.0" ECU_ADDRESS 0x60035C38
 /begin ANNOTATION ANNOTATION_LABEL "Description (coming from AUTOSAR DESC field)" /begin ANNOTATION_TEXT "Callstack from the main core or single core trap\r\n" /end ANNOTATION_TEXT /end ANNOTATION
/end MEASUREMENT
/begin MEASUREMENT rba_TrapLog_CallStack_a_u32[2][6] "Callstack from the main core[2][6]" ULONG RB_RBA_rba_TrapLog_CompuMethods_rba_TrapLog_oneToOne 1 100 0.0 4.E9 FORMAT "%32.0" ECU_ADDRESS 0x60035C3C
 /begin ANNOTATION ANNOTATION_LABEL "Description (coming from AUTOSAR DESC field)" /begin ANNOTATION_TEXT "Callstack from the main core or single core trap\r\n" /end ANNOTATION_TEXT /end ANNOTATION
/end MEASUREMENT
/begin MEASUREMENT rba_TrapLog_CallStack_a_u32[2][7] "Callstack from the main core[2][7]" ULONG RB_RBA_rba_TrapLog_CompuMethods_rba_TrapLog_oneToOne 1 100 0.0 4.E9 FORMAT "%32.0" ECU_ADDRESS 0x60035C40
 /begin ANNOTATION ANNOTATION_LABEL "Description (coming from AUTOSAR DESC field)" /begin ANNOTATION_TEXT "Callstack from the main core or single core trap\r\n" /end ANNOTATION_TEXT /end ANNOTATION
/end MEASUREMENT
/begin MEASUREMENT rba_TrapLog_CallStack_a_u32[3][0] "Callstack from the main core[3][0]" ULONG RB_RBA_rba_TrapLog_CompuMethods_rba_TrapLog_oneToOne 1 100 0.0 4.E9 FORMAT "%32.0" ECU_ADDRESS 0x60035C44
 /begin ANNOTATION ANNOTATION_LABEL "Description (coming from AUTOSAR DESC field)" /begin ANNOTATION_TEXT "Callstack from the main core or single core trap\r\n" /end ANNOTATION_TEXT /end ANNOTATION
/end MEASUREMENT
/begin MEASUREMENT rba_TrapLog_CallStack_a_u32[3][1] "Callstack from the main core[3][1]" ULONG RB_RBA_rba_TrapLog_CompuMethods_rba_TrapLog_oneToOne 1 100 0.0 4.E9 FORMAT "%32.0" ECU_ADDRESS 0x60035C48
 /begin ANNOTATION ANNOTATION_LABEL "Description (coming from AUTOSAR DESC field)" /begin ANNOTATION_TEXT "Callstack from the main core or single core trap\r\n" /end ANNOTATION_TEXT /end ANNOTATION
/end MEASUREMENT
/begin MEASUREMENT rba_TrapLog_CallStack_a_u32[3][2] "Callstack from the main core[3][2]" ULONG RB_RBA_rba_TrapLog_CompuMethods_rba_TrapLog_oneToOne 1 100 0.0 4.E9 FORMAT "%32.0" ECU_ADDRESS 0x60035C4C
 /begin ANNOTATION ANNOTATION_LABEL "Description (coming from AUTOSAR DESC field)" /begin ANNOTATION_TEXT "Callstack from the main core or single core trap\r\n" /end ANNOTATION_TEXT /end ANNOTATION
/end MEASUREMENT
/begin MEASUREMENT rba_TrapLog_CallStack_a_u32[3][3] "Callstack from the main core[3][3]" ULONG RB_RBA_rba_TrapLog_CompuMethods_rba_TrapLog_oneToOne 1 100 0.0 4.E9 FORMAT "%32.0" ECU_ADDRESS 0x60035C50
 /begin ANNOTATION ANNOTATION_LABEL "Description (coming from AUTOSAR DESC field)" /begin ANNOTATION_TEXT "Callstack from the main core or single core trap\r\n" /end ANNOTATION_TEXT /end ANNOTATION
/end MEASUREMENT
/begin MEASUREMENT rba_TrapLog_CallStack_a_u32[3][4] "Callstack from the main core[3][4]" ULONG RB_RBA_rba_TrapLog_CompuMethods_rba_TrapLog_oneToOne 1 100 0.0 4.E9 FORMAT "%32.0" ECU_ADDRESS 0x60035C54
 /begin ANNOTATION ANNOTATION_LABEL "Description (coming from AUTOSAR DESC field)" /begin ANNOTATION_TEXT "Callstack from the main core or single core trap\r\n" /end ANNOTATION_TEXT /end ANNOTATION
/end MEASUREMENT
/begin MEASUREMENT rba_TrapLog_CallStack_a_u32[3][5] "Callstack from the main core[3][5]" ULONG RB_RBA_rba_TrapLog_CompuMethods_rba_TrapLog_oneToOne 1 100 0.0 4.E9 FORMAT "%32.0" ECU_ADDRESS 0x60035C58
 /begin ANNOTATION ANNOTATION_LABEL "Description (coming from AUTOSAR DESC field)" /begin ANNOTATION_TEXT "Callstack from the main core or single core trap\r\n" /end ANNOTATION_TEXT /end ANNOTATION
/end MEASUREMENT
/begin MEASUREMENT rba_TrapLog_CallStack_a_u32[3][6] "Callstack from the main core[3][6]" ULONG RB_RBA_rba_TrapLog_CompuMethods_rba_TrapLog_oneToOne 1 100 0.0 4.E9 FORMAT "%32.0" ECU_ADDRESS 0x60035C5C
 /begin ANNOTATION ANNOTATION_LABEL "Description (coming from AUTOSAR DESC field)" /begin ANNOTATION_TEXT "Callstack from the main core or single core trap\r\n" /end ANNOTATION_TEXT /end ANNOTATION
/end MEASUREMENT
/begin MEASUREMENT rba_TrapLog_CallStack_a_u32[3][7] "Callstack from the main core[3][7]" ULONG RB_RBA_rba_TrapLog_CompuMethods_rba_TrapLog_oneToOne 1 100 0.0 4.E9 FORMAT "%32.0" ECU_ADDRESS 0x60035C60
 /begin ANNOTATION ANNOTATION_LABEL "Description (coming from AUTOSAR DESC field)" /begin ANNOTATION_TEXT "Callstack from the main core or single core trap\r\n" /end ANNOTATION_TEXT /end ANNOTATION
/end MEASUREMENT
/begin MEASUREMENT rba_TrapLog_CallStack_a_u32[4][0] "Callstack from the main core[4][0]" ULONG RB_RBA_rba_TrapLog_CompuMethods_rba_TrapLog_oneToOne 1 100 0.0 4.E9 FORMAT "%32.0" ECU_ADDRESS 0x60035C64
 /begin ANNOTATION ANNOTATION_LABEL "Description (coming from AUTOSAR DESC field)" /begin ANNOTATION_TEXT "Callstack from the main core or single core trap\r\n" /end ANNOTATION_TEXT /end ANNOTATION
/end MEASUREMENT
/begin MEASUREMENT rba_TrapLog_CallStack_a_u32[4][1] "Callstack from the main core[4][1]" ULONG RB_RBA_rba_TrapLog_CompuMethods_rba_TrapLog_oneToOne 1 100 0.0 4.E9 FORMAT "%32.0" ECU_ADDRESS 0x60035C68
 /begin ANNOTATION ANNOTATION_LABEL "Description (coming from AUTOSAR DESC field)" /begin ANNOTATION_TEXT "Callstack from the main core or single core trap\r\n" /end ANNOTATION_TEXT /end ANNOTATION
/end MEASUREMENT
/begin MEASUREMENT rba_TrapLog_CallStack_a_u32[4][2] "Callstack from the main core[4][2]" ULONG RB_RBA_rba_TrapLog_CompuMethods_rba_TrapLog_oneToOne 1 100 0.0 4.E9 FORMAT "%32.0" ECU_ADDRESS 0x60035C6C
 /begin ANNOTATION ANNOTATION_LABEL "Description (coming from AUTOSAR DESC field)" /begin ANNOTATION_TEXT "Callstack from the main core or single core trap\r\n" /end ANNOTATION_TEXT /end ANNOTATION
/end MEASUREMENT
/begin MEASUREMENT rba_TrapLog_CallStack_a_u32[4][3] "Callstack from the main core[4][3]" ULONG RB_RBA_rba_TrapLog_CompuMethods_rba_TrapLog_oneToOne 1 100 0.0 4.E9 FORMAT "%32.0" ECU_ADDRESS 0x60035C70
 /begin ANNOTATION ANNOTATION_LABEL "Description (coming from AUTOSAR DESC field)" /begin ANNOTATION_TEXT "Callstack from the main core or single core trap\r\n" /end ANNOTATION_TEXT /end ANNOTATION
/end MEASUREMENT
/begin MEASUREMENT rba_TrapLog_CallStack_a_u32[4][4] "Callstack from the main core[4][4]" ULONG RB_RBA_rba_TrapLog_CompuMethods_rba_TrapLog_oneToOne 1 100 0.0 4.E9 FORMAT "%32.0" ECU_ADDRESS 0x60035C74
 /begin ANNOTATION ANNOTATION_LABEL "Description (coming from AUTOSAR DESC field)" /begin ANNOTATION_TEXT "Callstack from the main core or single core trap\r\n" /end ANNOTATION_TEXT /end ANNOTATION
/end MEASUREMENT
/begin MEASUREMENT rba_TrapLog_CallStack_a_u32[4][5] "Callstack from the main core[4][5]" ULONG RB_RBA_rba_TrapLog_CompuMethods_rba_TrapLog_oneToOne 1 100 0.0 4.E9 FORMAT "%32.0" ECU_ADDRESS 0x60035C78
 /begin ANNOTATION ANNOTATION_LABEL "Description (coming from AUTOSAR DESC field)" /begin ANNOTATION_TEXT "Callstack from the main core or single core trap\r\n" /end ANNOTATION_TEXT /end ANNOTATION
/end MEASUREMENT
/begin MEASUREMENT rba_TrapLog_CallStack_a_u32[4][6] "Callstack from the main core[4][6]" ULONG RB_RBA_rba_TrapLog_CompuMethods_rba_TrapLog_oneToOne 1 100 0.0 4.E9 FORMAT "%32.0" ECU_ADDRESS 0x60035C7C
 /begin ANNOTATION ANNOTATION_LABEL "Description (coming from AUTOSAR DESC field)" /begin ANNOTATION_TEXT "Callstack from the main core or single core trap\r\n" /end ANNOTATION_TEXT /end ANNOTATION
/end MEASUREMENT
/begin MEASUREMENT rba_TrapLog_CallStack_a_u32[4][7] "Callstack from the main core[4][7]" ULONG RB_RBA_rba_TrapLog_CompuMethods_rba_TrapLog_oneToOne 1 100 0.0 4.E9 FORMAT "%32.0" ECU_ADDRESS 0x60035C80
 /begin ANNOTATION ANNOTATION_LABEL "Description (coming from AUTOSAR DESC field)" /begin ANNOTATION_TEXT "Callstack from the main core or single core trap\r\n" /end ANNOTATION_TEXT /end ANNOTATION
/end MEASUREMENT
/begin MEASUREMENT rba_TrapLog_CallStack_a_u32[5][0] "Callstack from the main core[5][0]" ULONG RB_RBA_rba_TrapLog_CompuMethods_rba_TrapLog_oneToOne 1 100 0.0 4.E9 FORMAT "%32.0" ECU_ADDRESS 0x60035C84
 /begin ANNOTATION ANNOTATION_LABEL "Description (coming from AUTOSAR DESC field)" /begin ANNOTATION_TEXT "Callstack from the main core or single core trap\r\n" /end ANNOTATION_TEXT /end ANNOTATION
/end MEASUREMENT
/begin MEASUREMENT rba_TrapLog_CallStack_a_u32[5][1] "Callstack from the main core[5][1]" ULONG RB_RBA_rba_TrapLog_CompuMethods_rba_TrapLog_oneToOne 1 100 0.0 4.E9 FORMAT "%32.0" ECU_ADDRESS 0x60035C88
 /begin ANNOTATION ANNOTATION_LABEL "Description (coming from AUTOSAR DESC field)" /begin ANNOTATION_TEXT "Callstack from the main core or single core trap\r\n" /end ANNOTATION_TEXT /end ANNOTATION
/end MEASUREMENT
/begin MEASUREMENT rba_TrapLog_CallStack_a_u32[5][2] "Callstack from the main core[5][2]" ULONG RB_RBA_rba_TrapLog_CompuMethods_rba_TrapLog_oneToOne 1 100 0.0 4.E9 FORMAT "%32.0" ECU_ADDRESS 0x60035C8C
 /begin ANNOTATION ANNOTATION_LABEL "Description (coming from AUTOSAR DESC field)" /begin ANNOTATION_TEXT "Callstack from the main core or single core trap\r\n" /end ANNOTATION_TEXT /end ANNOTATION
/end MEASUREMENT
/begin MEASUREMENT rba_TrapLog_CallStack_a_u32[5][3] "Callstack from the main core[5][3]" ULONG RB_RBA_rba_TrapLog_CompuMethods_rba_TrapLog_oneToOne 1 100 0.0 4.E9 FORMAT "%32.0" ECU_ADDRESS 0x60035C90
 /begin ANNOTATION ANNOTATION_LABEL "Description (coming from AUTOSAR DESC field)" /begin ANNOTATION_TEXT "Callstack from the main core or single core trap\r\n" /end ANNOTATION_TEXT /end ANNOTATION
/end MEASUREMENT
/begin MEASUREMENT rba_TrapLog_CallStack_a_u32[5][4] "Callstack from the main core[5][4]" ULONG RB_RBA_rba_TrapLog_CompuMethods_rba_TrapLog_oneToOne 1 100 0.0 4.E9 FORMAT "%32.0" ECU_ADDRESS 0x60035C94
 /begin ANNOTATION ANNOTATION_LABEL "Description (coming from AUTOSAR DESC field)" /begin ANNOTATION_TEXT "Callstack from the main core or single core trap\r\n" /end ANNOTATION_TEXT /end ANNOTATION
/end MEASUREMENT
/begin MEASUREMENT rba_TrapLog_CallStack_a_u32[5][5] "Callstack from the main core[5][5]" ULONG RB_RBA_rba_TrapLog_CompuMethods_rba_TrapLog_oneToOne 1 100 0.0 4.E9 FORMAT "%32.0" ECU_ADDRESS 0x60035C98
 /begin ANNOTATION ANNOTATION_LABEL "Description (coming from AUTOSAR DESC field)" /begin ANNOTATION_TEXT "Callstack from the main core or single core trap\r\n" /end ANNOTATION_TEXT /end ANNOTATION
/end MEASUREMENT
/begin MEASUREMENT rba_TrapLog_CallStack_a_u32[5][6] "Callstack from the main core[5][6]" ULONG RB_RBA_rba_TrapLog_CompuMethods_rba_TrapLog_oneToOne 1 100 0.0 4.E9 FORMAT "%32.0" ECU_ADDRESS 0x60035C9C
 /begin ANNOTATION ANNOTATION_LABEL "Description (coming from AUTOSAR DESC field)" /begin ANNOTATION_TEXT "Callstack from the main core or single core trap\r\n" /end ANNOTATION_TEXT /end ANNOTATION
/end MEASUREMENT
/begin MEASUREMENT rba_TrapLog_CallStack_a_u32[5][7] "Callstack from the main core[5][7]" ULONG RB_RBA_rba_TrapLog_CompuMethods_rba_TrapLog_oneToOne 1 100 0.0 4.E9 FORMAT "%32.0" ECU_ADDRESS 0x60035CA0
 /begin ANNOTATION ANNOTATION_LABEL "Description (coming from AUTOSAR DESC field)" /begin ANNOTATION_TEXT "Callstack from the main core or single core trap\r\n" /end ANNOTATION_TEXT /end ANNOTATION
/end MEASUREMENT
/begin MEASUREMENT rba_TrapLog_RegCore1_st[0].COREID_u32 "Saved register list[0]/COREID" ULONG RB_RBA_rba_TrapLog_CompuMethods_rba_TrapLog_oneToOne 1 100 0.0 4.E9 FORMAT "%32.0" ECU_ADDRESS 0x60035AAC /end MEASUREMENT
/begin MEASUREMENT rba_TrapLog_RegCore1_st[1].COREID_u32 "Saved register list[1]/COREID" ULONG RB_RBA_rba_TrapLog_CompuMethods_rba_TrapLog_oneToOne 1 100 0.0 4.E9 FORMAT "%32.0" ECU_ADDRESS 0x60035AE0 /end MEASUREMENT
/begin MEASUREMENT rba_TrapLog_RegCore1_st[2].COREID_u32 "Saved register list[2]/COREID" ULONG RB_RBA_rba_TrapLog_CompuMethods_rba_TrapLog_oneToOne 1 100 0.0 4.E9 FORMAT "%32.0" ECU_ADDRESS 0x60035B14 /end MEASUREMENT
/begin MEASUREMENT rba_TrapLog_RegCore1_st[3].COREID_u32 "Saved register list[3]/COREID" ULONG RB_RBA_rba_TrapLog_CompuMethods_rba_TrapLog_oneToOne 1 100 0.0 4.E9 FORMAT "%32.0" ECU_ADDRESS 0x60035B48 /end MEASUREMENT
/begin MEASUREMENT rba_TrapLog_RegCore1_st[4].COREID_u32 "Saved register list[4]/COREID" ULONG RB_RBA_rba_TrapLog_CompuMethods_rba_TrapLog_oneToOne 1 100 0.0 4.E9 FORMAT "%32.0" ECU_ADDRESS 0x60035B7C /end MEASUREMENT
/begin MEASUREMENT rba_TrapLog_RegCore1_st[5].COREID_u32 "Saved register list[5]/COREID" ULONG RB_RBA_rba_TrapLog_CompuMethods_rba_TrapLog_oneToOne 1 100 0.0 4.E9 FORMAT "%32.0" ECU_ADDRESS 0x60035BB0 /end MEASUREMENT
/begin MEASUREMENT rba_TrapLog_RegCore1_st[0].PSW_u32 "Saved register list[0]/PSW" ULONG RB_RBA_rba_TrapLog_CompuMethods_rba_TrapLog_oneToOne 1 100 0.0 4.E9 FORMAT "%32.0" ECU_ADDRESS 0x60035AB0 /end MEASUREMENT
/begin MEASUREMENT rba_TrapLog_RegCore1_st[1].PSW_u32 "Saved register list[1]/PSW" ULONG RB_RBA_rba_TrapLog_CompuMethods_rba_TrapLog_oneToOne 1 100 0.0 4.E9 FORMAT "%32.0" ECU_ADDRESS 0x60035AE4 /end MEASUREMENT
/begin MEASUREMENT rba_TrapLog_RegCore1_st[2].PSW_u32 "Saved register list[2]/PSW" ULONG RB_RBA_rba_TrapLog_CompuMethods_rba_TrapLog_oneToOne 1 100 0.0 4.E9 FORMAT "%32.0" ECU_ADDRESS 0x60035B18 /end MEASUREMENT
/begin MEASUREMENT rba_TrapLog_RegCore1_st[3].PSW_u32 "Saved register list[3]/PSW" ULONG RB_RBA_rba_TrapLog_CompuMethods_rba_TrapLog_oneToOne 1 100 0.0 4.E9 FORMAT "%32.0" ECU_ADDRESS 0x60035B4C /end MEASUREMENT
/begin MEASUREMENT rba_TrapLog_RegCore1_st[4].PSW_u32 "Saved register list[4]/PSW" ULONG RB_RBA_rba_TrapLog_CompuMethods_rba_TrapLog_oneToOne 1 100 0.0 4.E9 FORMAT "%32.0" ECU_ADDRESS 0x60035B80 /end MEASUREMENT
/begin MEASUREMENT rba_TrapLog_RegCore1_st[5].PSW_u32 "Saved register list[5]/PSW" ULONG RB_RBA_rba_TrapLog_CompuMethods_rba_TrapLog_oneToOne 1 100 0.0 4.E9 FORMAT "%32.0" ECU_ADDRESS 0x60035BB4 /end MEASUREMENT
/begin MEASUREMENT rba_TrapLog_RegCore1_st[0].PCXI_u32 "Saved register list[0]/PCXI" ULONG RB_RBA_rba_TrapLog_CompuMethods_rba_TrapLog_oneToOne 1 100 0.0 4.E9 FORMAT "%32.0" ECU_ADDRESS 0x60035AB4 /end MEASUREMENT
/begin MEASUREMENT rba_TrapLog_RegCore1_st[1].PCXI_u32 "Saved register list[1]/PCXI" ULONG RB_RBA_rba_TrapLog_CompuMethods_rba_TrapLog_oneToOne 1 100 0.0 4.E9 FORMAT "%32.0" ECU_ADDRESS 0x60035AE8 /end MEASUREMENT
/begin MEASUREMENT rba_TrapLog_RegCore1_st[2].PCXI_u32 "Saved register list[2]/PCXI" ULONG RB_RBA_rba_TrapLog_CompuMethods_rba_TrapLog_oneToOne 1 100 0.0 4.E9 FORMAT "%32.0" ECU_ADDRESS 0x60035B1C /end MEASUREMENT
/begin MEASUREMENT rba_TrapLog_RegCore1_st[3].PCXI_u32 "Saved register list[3]/PCXI" ULONG RB_RBA_rba_TrapLog_CompuMethods_rba_TrapLog_oneToOne 1 100 0.0 4.E9 FORMAT "%32.0" ECU_ADDRESS 0x60035B50 /end MEASUREMENT
/begin MEASUREMENT rba_TrapLog_RegCore1_st[4].PCXI_u32 "Saved register list[4]/PCXI" ULONG RB_RBA_rba_TrapLog_CompuMethods_rba_TrapLog_oneToOne 1 100 0.0 4.E9 FORMAT "%32.0" ECU_ADDRESS 0x60035B84 /end MEASUREMENT
/begin MEASUREMENT rba_TrapLog_RegCore1_st[5].PCXI_u32 "Saved register list[5]/PCXI" ULONG RB_RBA_rba_TrapLog_CompuMethods_rba_TrapLog_oneToOne 1 100 0.0 4.E9 FORMAT "%32.0" ECU_ADDRESS 0x60035BB8 /end MEASUREMENT
/begin MEASUREMENT rba_TrapLog_RegCore1_st[0].TRAP_CON_u32 "Saved register list[0]/TRAP_CON" ULONG RB_RBA_rba_TrapLog_CompuMethods_rba_TrapLog_oneToOne 1 100 0.0 4.E9 FORMAT "%32.0" ECU_ADDRESS 0x60035AB8 /end MEASUREMENT
/begin MEASUREMENT rba_TrapLog_RegCore1_st[1].TRAP_CON_u32 "Saved register list[1]/TRAP_CON" ULONG RB_RBA_rba_TrapLog_CompuMethods_rba_TrapLog_oneToOne 1 100 0.0 4.E9 FORMAT "%32.0" ECU_ADDRESS 0x60035AEC /end MEASUREMENT
/begin MEASUREMENT rba_TrapLog_RegCore1_st[2].TRAP_CON_u32 "Saved register list[2]/TRAP_CON" ULONG RB_RBA_rba_TrapLog_CompuMethods_rba_TrapLog_oneToOne 1 100 0.0 4.E9 FORMAT "%32.0" ECU_ADDRESS 0x60035B20 /end MEASUREMENT
/begin MEASUREMENT rba_TrapLog_RegCore1_st[3].TRAP_CON_u32 "Saved register list[3]/TRAP_CON" ULONG RB_RBA_rba_TrapLog_CompuMethods_rba_TrapLog_oneToOne 1 100 0.0 4.E9 FORMAT "%32.0" ECU_ADDRESS 0x60035B54 /end MEASUREMENT
/begin MEASUREMENT rba_TrapLog_RegCore1_st[4].TRAP_CON_u32 "Saved register list[4]/TRAP_CON" ULONG RB_RBA_rba_TrapLog_CompuMethods_rba_TrapLog_oneToOne 1 100 0.0 4.E9 FORMAT "%32.0" ECU_ADDRESS 0x60035B88 /end MEASUREMENT
/begin MEASUREMENT rba_TrapLog_RegCore1_st[5].TRAP_CON_u32 "Saved register list[5]/TRAP_CON" ULONG RB_RBA_rba_TrapLog_CompuMethods_rba_TrapLog_oneToOne 1 100 0.0 4.E9 FORMAT "%32.0" ECU_ADDRESS 0x60035BBC /end MEASUREMENT
/begin MEASUREMENT rba_TrapLog_RegCore1_st[0].TRAP_PC_u32 "Saved register list[0]/TRAP_PC" ULONG RB_RBA_rba_TrapLog_CompuMethods_rba_TrapLog_oneToOne 1 100 0.0 4.E9 FORMAT "%32.0" ECU_ADDRESS 0x60035ABC /end MEASUREMENT
/begin MEASUREMENT rba_TrapLog_RegCore1_st[1].TRAP_PC_u32 "Saved register list[1]/TRAP_PC" ULONG RB_RBA_rba_TrapLog_CompuMethods_rba_TrapLog_oneToOne 1 100 0.0 4.E9 FORMAT "%32.0" ECU_ADDRESS 0x60035AF0 /end MEASUREMENT
/begin MEASUREMENT rba_TrapLog_RegCore1_st[2].TRAP_PC_u32 "Saved register list[2]/TRAP_PC" ULONG RB_RBA_rba_TrapLog_CompuMethods_rba_TrapLog_oneToOne 1 100 0.0 4.E9 FORMAT "%32.0" ECU_ADDRESS 0x60035B24 /end MEASUREMENT
/begin MEASUREMENT rba_TrapLog_RegCore1_st[3].TRAP_PC_u32 "Saved register list[3]/TRAP_PC" ULONG RB_RBA_rba_TrapLog_CompuMethods_rba_TrapLog_oneToOne 1 100 0.0 4.E9 FORMAT "%32.0" ECU_ADDRESS 0x60035B58 /end MEASUREMENT
/begin MEASUREMENT rba_TrapLog_RegCore1_st[4].TRAP_PC_u32 "Saved register list[4]/TRAP_PC" ULONG RB_RBA_rba_TrapLog_CompuMethods_rba_TrapLog_oneToOne 1 100 0.0 4.E9 FORMAT "%32.0" ECU_ADDRESS 0x60035B8C /end MEASUREMENT
/begin MEASUREMENT rba_TrapLog_RegCore1_st[5].TRAP_PC_u32 "Saved register list[5]/TRAP_PC" ULONG RB_RBA_rba_TrapLog_CompuMethods_rba_TrapLog_oneToOne 1 100 0.0 4.E9 FORMAT "%32.0" ECU_ADDRESS 0x60035BC0 /end MEASUREMENT
/begin MEASUREMENT rba_TrapLog_RegCore1_st[0].DMI_STR_u32 "Saved register list[0]/DMI_STR" ULONG RB_RBA_rba_TrapLog_CompuMethods_rba_TrapLog_oneToOne 1 100 0.0 4.E9 FORMAT "%32.0" ECU_ADDRESS 0x60035AC0 /end MEASUREMENT
/begin MEASUREMENT rba_TrapLog_RegCore1_st[1].DMI_STR_u32 "Saved register list[1]/DMI_STR" ULONG RB_RBA_rba_TrapLog_CompuMethods_rba_TrapLog_oneToOne 1 100 0.0 4.E9 FORMAT "%32.0" ECU_ADDRESS 0x60035AF4 /end MEASUREMENT
/begin MEASUREMENT rba_TrapLog_RegCore1_st[2].DMI_STR_u32 "Saved register list[2]/DMI_STR" ULONG RB_RBA_rba_TrapLog_CompuMethods_rba_TrapLog_oneToOne 1 100 0.0 4.E9 FORMAT "%32.0" ECU_ADDRESS 0x60035B28 /end MEASUREMENT
/begin MEASUREMENT rba_TrapLog_RegCore1_st[3].DMI_STR_u32 "Saved register list[3]/DMI_STR" ULONG RB_RBA_rba_TrapLog_CompuMethods_rba_TrapLog_oneToOne 1 100 0.0 4.E9 FORMAT "%32.0" ECU_ADDRESS 0x60035B5C /end MEASUREMENT
/begin MEASUREMENT rba_TrapLog_RegCore1_st[4].DMI_STR_u32 "Saved register list[4]/DMI_STR" ULONG RB_RBA_rba_TrapLog_CompuMethods_rba_TrapLog_oneToOne 1 100 0.0 4.E9 FORMAT "%32.0" ECU_ADDRESS 0x60035B90 /end MEASUREMENT
/begin MEASUREMENT rba_TrapLog_RegCore1_st[5].DMI_STR_u32 "Saved register list[5]/DMI_STR" ULONG RB_RBA_rba_TrapLog_CompuMethods_rba_TrapLog_oneToOne 1 100 0.0 4.E9 FORMAT "%32.0" ECU_ADDRESS 0x60035BC4 /end MEASUREMENT
/begin MEASUREMENT rba_TrapLog_RegCore1_st[0].DMI_ATR_u32 "Saved register list[0]/DMI_ATR" ULONG RB_RBA_rba_TrapLog_CompuMethods_rba_TrapLog_oneToOne 1 100 0.0 4.E9 FORMAT "%32.0" ECU_ADDRESS 0x60035AC4 /end MEASUREMENT
/begin MEASUREMENT rba_TrapLog_RegCore1_st[1].DMI_ATR_u32 "Saved register list[1]/DMI_ATR" ULONG RB_RBA_rba_TrapLog_CompuMethods_rba_TrapLog_oneToOne 1 100 0.0 4.E9 FORMAT "%32.0" ECU_ADDRESS 0x60035AF8 /end MEASUREMENT
/begin MEASUREMENT rba_TrapLog_RegCore1_st[2].DMI_ATR_u32 "Saved register list[2]/DMI_ATR" ULONG RB_RBA_rba_TrapLog_CompuMethods_rba_TrapLog_oneToOne 1 100 0.0 4.E9 FORMAT "%32.0" ECU_ADDRESS 0x60035B2C /end MEASUREMENT
/begin MEASUREMENT rba_TrapLog_RegCore1_st[3].DMI_ATR_u32 "Saved register list[3]/DMI_ATR" ULONG RB_RBA_rba_TrapLog_CompuMethods_rba_TrapLog_oneToOne 1 100 0.0 4.E9 FORMAT "%32.0" ECU_ADDRESS 0x60035B60 /end MEASUREMENT
/begin MEASUREMENT rba_TrapLog_RegCore1_st[4].DMI_ATR_u32 "Saved register list[4]/DMI_ATR" ULONG RB_RBA_rba_TrapLog_CompuMethods_rba_TrapLog_oneToOne 1 100 0.0 4.E9 FORMAT "%32.0" ECU_ADDRESS 0x60035B94 /end MEASUREMENT
/begin MEASUREMENT rba_TrapLog_RegCore1_st[5].DMI_ATR_u32 "Saved register list[5]/DMI_ATR" ULONG RB_RBA_rba_TrapLog_CompuMethods_rba_TrapLog_oneToOne 1 100 0.0 4.E9 FORMAT "%32.0" ECU_ADDRESS 0x60035BC8 /end MEASUREMENT
/begin MEASUREMENT rba_TrapLog_RegCore1_st[0].DMI_EADD_u32 "Saved register list[0]/DMI_EADD" ULONG RB_RBA_rba_TrapLog_CompuMethods_rba_TrapLog_oneToOne 1 100 0.0 4.E9 FORMAT "%32.0" ECU_ADDRESS 0x60035AC8 /end MEASUREMENT
/begin MEASUREMENT rba_TrapLog_RegCore1_st[1].DMI_EADD_u32 "Saved register list[1]/DMI_EADD" ULONG RB_RBA_rba_TrapLog_CompuMethods_rba_TrapLog_oneToOne 1 100 0.0 4.E9 FORMAT "%32.0" ECU_ADDRESS 0x60035AFC /end MEASUREMENT
/begin MEASUREMENT rba_TrapLog_RegCore1_st[2].DMI_EADD_u32 "Saved register list[2]/DMI_EADD" ULONG RB_RBA_rba_TrapLog_CompuMethods_rba_TrapLog_oneToOne 1 100 0.0 4.E9 FORMAT "%32.0" ECU_ADDRESS 0x60035B30 /end MEASUREMENT
/begin MEASUREMENT rba_TrapLog_RegCore1_st[3].DMI_EADD_u32 "Saved register list[3]/DMI_EADD" ULONG RB_RBA_rba_TrapLog_CompuMethods_rba_TrapLog_oneToOne 1 100 0.0 4.E9 FORMAT "%32.0" ECU_ADDRESS 0x60035B64 /end MEASUREMENT
/begin MEASUREMENT rba_TrapLog_RegCore1_st[4].DMI_EADD_u32 "Saved register list[4]/DMI_EADD" ULONG RB_RBA_rba_TrapLog_CompuMethods_rba_TrapLog_oneToOne 1 100 0.0 4.E9 FORMAT "%32.0" ECU_ADDRESS 0x60035B98 /end MEASUREMENT
/begin MEASUREMENT rba_TrapLog_RegCore1_st[5].DMI_EADD_u32 "Saved register list[5]/DMI_EADD" ULONG RB_RBA_rba_TrapLog_CompuMethods_rba_TrapLog_oneToOne 1 100 0.0 4.E9 FORMAT "%32.0" ECU_ADDRESS 0x60035BCC /end MEASUREMENT
/begin MEASUREMENT rba_TrapLog_RegCore1_st[0].DIETR_u32 "Saved register list[0]/DIETR" ULONG RB_RBA_rba_TrapLog_CompuMethods_rba_TrapLog_oneToOne 1 100 0.0 4.E9 FORMAT "%32.0" ECU_ADDRESS 0x60035ACC /end MEASUREMENT
/begin MEASUREMENT rba_TrapLog_RegCore1_st[1].DIETR_u32 "Saved register list[1]/DIETR" ULONG RB_RBA_rba_TrapLog_CompuMethods_rba_TrapLog_oneToOne 1 100 0.0 4.E9 FORMAT "%32.0" ECU_ADDRESS 0x60035B00 /end MEASUREMENT
/begin MEASUREMENT rba_TrapLog_RegCore1_st[2].DIETR_u32 "Saved register list[2]/DIETR" ULONG RB_RBA_rba_TrapLog_CompuMethods_rba_TrapLog_oneToOne 1 100 0.0 4.E9 FORMAT "%32.0" ECU_ADDRESS 0x60035B34 /end MEASUREMENT
/begin MEASUREMENT rba_TrapLog_RegCore1_st[3].DIETR_u32 "Saved register list[3]/DIETR" ULONG RB_RBA_rba_TrapLog_CompuMethods_rba_TrapLog_oneToOne 1 100 0.0 4.E9 FORMAT "%32.0" ECU_ADDRESS 0x60035B68 /end MEASUREMENT
/begin MEASUREMENT rba_TrapLog_RegCore1_st[4].DIETR_u32 "Saved register list[4]/DIETR" ULONG RB_RBA_rba_TrapLog_CompuMethods_rba_TrapLog_oneToOne 1 100 0.0 4.E9 FORMAT "%32.0" ECU_ADDRESS 0x60035B9C /end MEASUREMENT
/begin MEASUREMENT rba_TrapLog_RegCore1_st[5].DIETR_u32 "Saved register list[5]/DIETR" ULONG RB_RBA_rba_TrapLog_CompuMethods_rba_TrapLog_oneToOne 1 100 0.0 4.E9 FORMAT "%32.0" ECU_ADDRESS 0x60035BD0 /end MEASUREMENT
/begin MEASUREMENT rba_TrapLog_RegCore1_st[0].DIEAR_u32 "Saved register list[0]/DIEAR" ULONG RB_RBA_rba_TrapLog_CompuMethods_rba_TrapLog_oneToOne 1 100 0.0 4.E9 FORMAT "%32.0" ECU_ADDRESS 0x60035AD0 /end MEASUREMENT
/begin MEASUREMENT rba_TrapLog_RegCore1_st[1].DIEAR_u32 "Saved register list[1]/DIEAR" ULONG RB_RBA_rba_TrapLog_CompuMethods_rba_TrapLog_oneToOne 1 100 0.0 4.E9 FORMAT "%32.0" ECU_ADDRESS 0x60035B04 /end MEASUREMENT
/begin MEASUREMENT rba_TrapLog_RegCore1_st[2].DIEAR_u32 "Saved register list[2]/DIEAR" ULONG RB_RBA_rba_TrapLog_CompuMethods_rba_TrapLog_oneToOne 1 100 0.0 4.E9 FORMAT "%32.0" ECU_ADDRESS 0x60035B38 /end MEASUREMENT
/begin MEASUREMENT rba_TrapLog_RegCore1_st[3].DIEAR_u32 "Saved register list[3]/DIEAR" ULONG RB_RBA_rba_TrapLog_CompuMethods_rba_TrapLog_oneToOne 1 100 0.0 4.E9 FORMAT "%32.0" ECU_ADDRESS 0x60035B6C /end MEASUREMENT
/begin MEASUREMENT rba_TrapLog_RegCore1_st[4].DIEAR_u32 "Saved register list[4]/DIEAR" ULONG RB_RBA_rba_TrapLog_CompuMethods_rba_TrapLog_oneToOne 1 100 0.0 4.E9 FORMAT "%32.0" ECU_ADDRESS 0x60035BA0 /end MEASUREMENT
/begin MEASUREMENT rba_TrapLog_RegCore1_st[5].DIEAR_u32 "Saved register list[5]/DIEAR" ULONG RB_RBA_rba_TrapLog_CompuMethods_rba_TrapLog_oneToOne 1 100 0.0 4.E9 FORMAT "%32.0" ECU_ADDRESS 0x60035BD4 /end MEASUREMENT
/begin MEASUREMENT rba_TrapLog_RegCore1_st[0].PIETR_u32 "Saved register list[0]/PIETR" ULONG RB_RBA_rba_TrapLog_CompuMethods_rba_TrapLog_oneToOne 1 100 0.0 4.E9 FORMAT "%32.0" ECU_ADDRESS 0x60035AD4 /end MEASUREMENT
/begin MEASUREMENT rba_TrapLog_RegCore1_st[1].PIETR_u32 "Saved register list[1]/PIETR" ULONG RB_RBA_rba_TrapLog_CompuMethods_rba_TrapLog_oneToOne 1 100 0.0 4.E9 FORMAT "%32.0" ECU_ADDRESS 0x60035B08 /end MEASUREMENT
/begin MEASUREMENT rba_TrapLog_RegCore1_st[2].PIETR_u32 "Saved register list[2]/PIETR" ULONG RB_RBA_rba_TrapLog_CompuMethods_rba_TrapLog_oneToOne 1 100 0.0 4.E9 FORMAT "%32.0" ECU_ADDRESS 0x60035B3C /end MEASUREMENT
/begin MEASUREMENT rba_TrapLog_RegCore1_st[3].PIETR_u32 "Saved register list[3]/PIETR" ULONG RB_RBA_rba_TrapLog_CompuMethods_rba_TrapLog_oneToOne 1 100 0.0 4.E9 FORMAT "%32.0" ECU_ADDRESS 0x60035B70 /end MEASUREMENT
/begin MEASUREMENT rba_TrapLog_RegCore1_st[4].PIETR_u32 "Saved register list[4]/PIETR" ULONG RB_RBA_rba_TrapLog_CompuMethods_rba_TrapLog_oneToOne 1 100 0.0 4.E9 FORMAT "%32.0" ECU_ADDRESS 0x60035BA4 /end MEASUREMENT
/begin MEASUREMENT rba_TrapLog_RegCore1_st[5].PIETR_u32 "Saved register list[5]/PIETR" ULONG RB_RBA_rba_TrapLog_CompuMethods_rba_TrapLog_oneToOne 1 100 0.0 4.E9 FORMAT "%32.0" ECU_ADDRESS 0x60035BD8 /end MEASUREMENT
/begin MEASUREMENT rba_TrapLog_RegCore1_st[0].PIEAR_u32 "Saved register list[0]/PIEAR" ULONG RB_RBA_rba_TrapLog_CompuMethods_rba_TrapLog_oneToOne 1 100 0.0 4.E9 FORMAT "%32.0" ECU_ADDRESS 0x60035AD8 /end MEASUREMENT
/begin MEASUREMENT rba_TrapLog_RegCore1_st[1].PIEAR_u32 "Saved register list[1]/PIEAR" ULONG RB_RBA_rba_TrapLog_CompuMethods_rba_TrapLog_oneToOne 1 100 0.0 4.E9 FORMAT "%32.0" ECU_ADDRESS 0x60035B0C /end MEASUREMENT
/begin MEASUREMENT rba_TrapLog_RegCore1_st[2].PIEAR_u32 "Saved register list[2]/PIEAR" ULONG RB_RBA_rba_TrapLog_CompuMethods_rba_TrapLog_oneToOne 1 100 0.0 4.E9 FORMAT "%32.0" ECU_ADDRESS 0x60035B40 /end MEASUREMENT
/begin MEASUREMENT rba_TrapLog_RegCore1_st[3].PIEAR_u32 "Saved register list[3]/PIEAR" ULONG RB_RBA_rba_TrapLog_CompuMethods_rba_TrapLog_oneToOne 1 100 0.0 4.E9 FORMAT "%32.0" ECU_ADDRESS 0x60035B74 /end MEASUREMENT
/begin MEASUREMENT rba_TrapLog_RegCore1_st[4].PIEAR_u32 "Saved register list[4]/PIEAR" ULONG RB_RBA_rba_TrapLog_CompuMethods_rba_TrapLog_oneToOne 1 100 0.0 4.E9 FORMAT "%32.0" ECU_ADDRESS 0x60035BA8 /end MEASUREMENT
/begin MEASUREMENT rba_TrapLog_RegCore1_st[5].PIEAR_u32 "Saved register list[5]/PIEAR" ULONG RB_RBA_rba_TrapLog_CompuMethods_rba_TrapLog_oneToOne 1 100 0.0 4.E9 FORMAT "%32.0" ECU_ADDRESS 0x60035BDC /end MEASUREMENT
/begin MEASUREMENT rba_TrapLog_RegCore1_st[0].SYS_TIME_u32 "Saved register list[0]/SYS_TIME" ULONG RB_RBA_rba_TrapLog_CompuMethods_rba_TrapLog_oneToOne 1 100 0.0 4.E9 FORMAT "%32.0" ECU_ADDRESS 0x60035ADC /end MEASUREMENT
/begin MEASUREMENT rba_TrapLog_RegCore1_st[1].SYS_TIME_u32 "Saved register list[1]/SYS_TIME" ULONG RB_RBA_rba_TrapLog_CompuMethods_rba_TrapLog_oneToOne 1 100 0.0 4.E9 FORMAT "%32.0" ECU_ADDRESS 0x60035B10 /end MEASUREMENT
/begin MEASUREMENT rba_TrapLog_RegCore1_st[2].SYS_TIME_u32 "Saved register list[2]/SYS_TIME" ULONG RB_RBA_rba_TrapLog_CompuMethods_rba_TrapLog_oneToOne 1 100 0.0 4.E9 FORMAT "%32.0" ECU_ADDRESS 0x60035B44 /end MEASUREMENT
/begin MEASUREMENT rba_TrapLog_RegCore1_st[3].SYS_TIME_u32 "Saved register list[3]/SYS_TIME" ULONG RB_RBA_rba_TrapLog_CompuMethods_rba_TrapLog_oneToOne 1 100 0.0 4.E9 FORMAT "%32.0" ECU_ADDRESS 0x60035B78 /end MEASUREMENT
/begin MEASUREMENT rba_TrapLog_RegCore1_st[4].SYS_TIME_u32 "Saved register list[4]/SYS_TIME" ULONG RB_RBA_rba_TrapLog_CompuMethods_rba_TrapLog_oneToOne 1 100 0.0 4.E9 FORMAT "%32.0" ECU_ADDRESS 0x60035BAC /end MEASUREMENT
/begin MEASUREMENT rba_TrapLog_RegCore1_st[5].SYS_TIME_u32 "Saved register list[5]/SYS_TIME" ULONG RB_RBA_rba_TrapLog_CompuMethods_rba_TrapLog_oneToOne 1 100 0.0 4.E9 FORMAT "%32.0" ECU_ADDRESS 0x60035BE0 /end MEASUREMENT
/begin MEASUREMENT rba_TrapLog_RegCore2_st[0].COREID_u32 "Saved register list[0]/COREID" ULONG RB_RBA_rba_TrapLog_CompuMethods_rba_TrapLog_oneToOne 1 100 0.0 4.E9 FORMAT "%32.0" ECU_ADDRESS 0x60035974 /end MEASUREMENT
/begin MEASUREMENT rba_TrapLog_RegCore2_st[1].COREID_u32 "Saved register list[1]/COREID" ULONG RB_RBA_rba_TrapLog_CompuMethods_rba_TrapLog_oneToOne 1 100 0.0 4.E9 FORMAT "%32.0" ECU_ADDRESS 0x600359A8 /end MEASUREMENT
/begin MEASUREMENT rba_TrapLog_RegCore2_st[2].COREID_u32 "Saved register list[2]/COREID" ULONG RB_RBA_rba_TrapLog_CompuMethods_rba_TrapLog_oneToOne 1 100 0.0 4.E9 FORMAT "%32.0" ECU_ADDRESS 0x600359DC /end MEASUREMENT
/begin MEASUREMENT rba_TrapLog_RegCore2_st[3].COREID_u32 "Saved register list[3]/COREID" ULONG RB_RBA_rba_TrapLog_CompuMethods_rba_TrapLog_oneToOne 1 100 0.0 4.E9 FORMAT "%32.0" ECU_ADDRESS 0x60035A10 /end MEASUREMENT
/begin MEASUREMENT rba_TrapLog_RegCore2_st[4].COREID_u32 "Saved register list[4]/COREID" ULONG RB_RBA_rba_TrapLog_CompuMethods_rba_TrapLog_oneToOne 1 100 0.0 4.E9 FORMAT "%32.0" ECU_ADDRESS 0x60035A44 /end MEASUREMENT
/begin MEASUREMENT rba_TrapLog_RegCore2_st[5].COREID_u32 "Saved register list[5]/COREID" ULONG RB_RBA_rba_TrapLog_CompuMethods_rba_TrapLog_oneToOne 1 100 0.0 4.E9 FORMAT "%32.0" ECU_ADDRESS 0x60035A78 /end MEASUREMENT
/begin MEASUREMENT rba_TrapLog_RegCore2_st[0].PSW_u32 "Saved register list[0]/PSW" ULONG RB_RBA_rba_TrapLog_CompuMethods_rba_TrapLog_oneToOne 1 100 0.0 4.E9 FORMAT "%32.0" ECU_ADDRESS 0x60035978 /end MEASUREMENT
/begin MEASUREMENT rba_TrapLog_RegCore2_st[1].PSW_u32 "Saved register list[1]/PSW" ULONG RB_RBA_rba_TrapLog_CompuMethods_rba_TrapLog_oneToOne 1 100 0.0 4.E9 FORMAT "%32.0" ECU_ADDRESS 0x600359AC /end MEASUREMENT
/begin MEASUREMENT rba_TrapLog_RegCore2_st[2].PSW_u32 "Saved register list[2]/PSW" ULONG RB_RBA_rba_TrapLog_CompuMethods_rba_TrapLog_oneToOne 1 100 0.0 4.E9 FORMAT "%32.0" ECU_ADDRESS 0x600359E0 /end MEASUREMENT
/begin MEASUREMENT rba_TrapLog_RegCore2_st[3].PSW_u32 "Saved register list[3]/PSW" ULONG RB_RBA_rba_TrapLog_CompuMethods_rba_TrapLog_oneToOne 1 100 0.0 4.E9 FORMAT "%32.0" ECU_ADDRESS 0x60035A14 /end MEASUREMENT
/begin MEASUREMENT rba_TrapLog_RegCore2_st[4].PSW_u32 "Saved register list[4]/PSW" ULONG RB_RBA_rba_TrapLog_CompuMethods_rba_TrapLog_oneToOne 1 100 0.0 4.E9 FORMAT "%32.0" ECU_ADDRESS 0x60035A48 /end MEASUREMENT
/begin MEASUREMENT rba_TrapLog_RegCore2_st[5].PSW_u32 "Saved register list[5]/PSW" ULONG RB_RBA_rba_TrapLog_CompuMethods_rba_TrapLog_oneToOne 1 100 0.0 4.E9 FORMAT "%32.0" ECU_ADDRESS 0x60035A7C /end MEASUREMENT
/begin MEASUREMENT rba_TrapLog_RegCore2_st[0].PCXI_u32 "Saved register list[0]/PCXI" ULONG RB_RBA_rba_TrapLog_CompuMethods_rba_TrapLog_oneToOne 1 100 0.0 4.E9 FORMAT "%32.0" ECU_ADDRESS 0x6003597C /end MEASUREMENT
/begin MEASUREMENT rba_TrapLog_RegCore2_st[1].PCXI_u32 "Saved register list[1]/PCXI" ULONG RB_RBA_rba_TrapLog_CompuMethods_rba_TrapLog_oneToOne 1 100 0.0 4.E9 FORMAT "%32.0" ECU_ADDRESS 0x600359B0 /end MEASUREMENT
/begin MEASUREMENT rba_TrapLog_RegCore2_st[2].PCXI_u32 "Saved register list[2]/PCXI" ULONG RB_RBA_rba_TrapLog_CompuMethods_rba_TrapLog_oneToOne 1 100 0.0 4.E9 FORMAT "%32.0" ECU_ADDRESS 0x600359E4 /end MEASUREMENT
/begin MEASUREMENT rba_TrapLog_RegCore2_st[3].PCXI_u32 "Saved register list[3]/PCXI" ULONG RB_RBA_rba_TrapLog_CompuMethods_rba_TrapLog_oneToOne 1 100 0.0 4.E9 FORMAT "%32.0" ECU_ADDRESS 0x60035A18 /end MEASUREMENT
/begin MEASUREMENT rba_TrapLog_RegCore2_st[4].PCXI_u32 "Saved register list[4]/PCXI" ULONG RB_RBA_rba_TrapLog_CompuMethods_rba_TrapLog_oneToOne 1 100 0.0 4.E9 FORMAT "%32.0" ECU_ADDRESS 0x60035A4C /end MEASUREMENT
/begin MEASUREMENT rba_TrapLog_RegCore2_st[5].PCXI_u32 "Saved register list[5]/PCXI" ULONG RB_RBA_rba_TrapLog_CompuMethods_rba_TrapLog_oneToOne 1 100 0.0 4.E9 FORMAT "%32.0" ECU_ADDRESS 0x60035A80 /end MEASUREMENT
/begin MEASUREMENT rba_TrapLog_RegCore2_st[0].TRAP_CON_u32 "Saved register list[0]/TRAP_CON" ULONG RB_RBA_rba_TrapLog_CompuMethods_rba_TrapLog_oneToOne 1 100 0.0 4.E9 FORMAT "%32.0" ECU_ADDRESS 0x60035980 /end MEASUREMENT
/begin MEASUREMENT rba_TrapLog_RegCore2_st[1].TRAP_CON_u32 "Saved register list[1]/TRAP_CON" ULONG RB_RBA_rba_TrapLog_CompuMethods_rba_TrapLog_oneToOne 1 100 0.0 4.E9 FORMAT "%32.0" ECU_ADDRESS 0x600359B4 /end MEASUREMENT
/begin MEASUREMENT rba_TrapLog_RegCore2_st[2].TRAP_CON_u32 "Saved register list[2]/TRAP_CON" ULONG RB_RBA_rba_TrapLog_CompuMethods_rba_TrapLog_oneToOne 1 100 0.0 4.E9 FORMAT "%32.0" ECU_ADDRESS 0x600359E8 /end MEASUREMENT
/begin MEASUREMENT rba_TrapLog_RegCore2_st[3].TRAP_CON_u32 "Saved register list[3]/TRAP_CON" ULONG RB_RBA_rba_TrapLog_CompuMethods_rba_TrapLog_oneToOne 1 100 0.0 4.E9 FORMAT "%32.0" ECU_ADDRESS 0x60035A1C /end MEASUREMENT
/begin MEASUREMENT rba_TrapLog_RegCore2_st[4].TRAP_CON_u32 "Saved register list[4]/TRAP_CON" ULONG RB_RBA_rba_TrapLog_CompuMethods_rba_TrapLog_oneToOne 1 100 0.0 4.E9 FORMAT "%32.0" ECU_ADDRESS 0x60035A50 /end MEASUREMENT
/begin MEASUREMENT rba_TrapLog_RegCore2_st[5].TRAP_CON_u32 "Saved register list[5]/TRAP_CON" ULONG RB_RBA_rba_TrapLog_CompuMethods_rba_TrapLog_oneToOne 1 100 0.0 4.E9 FORMAT "%32.0" ECU_ADDRESS 0x60035A84 /end MEASUREMENT
/begin MEASUREMENT rba_TrapLog_RegCore2_st[0].TRAP_PC_u32 "Saved register list[0]/TRAP_PC" ULONG RB_RBA_rba_TrapLog_CompuMethods_rba_TrapLog_oneToOne 1 100 0.0 4.E9 FORMAT "%32.0" ECU_ADDRESS 0x60035984 /end MEASUREMENT
/begin MEASUREMENT rba_TrapLog_RegCore2_st[1].TRAP_PC_u32 "Saved register list[1]/TRAP_PC" ULONG RB_RBA_rba_TrapLog_CompuMethods_rba_TrapLog_oneToOne 1 100 0.0 4.E9 FORMAT "%32.0" ECU_ADDRESS 0x600359B8 /end MEASUREMENT
/begin MEASUREMENT rba_TrapLog_RegCore2_st[2].TRAP_PC_u32 "Saved register list[2]/TRAP_PC" ULONG RB_RBA_rba_TrapLog_CompuMethods_rba_TrapLog_oneToOne 1 100 0.0 4.E9 FORMAT "%32.0" ECU_ADDRESS 0x600359EC /end MEASUREMENT
/begin MEASUREMENT rba_TrapLog_RegCore2_st[3].TRAP_PC_u32 "Saved register list[3]/TRAP_PC" ULONG RB_RBA_rba_TrapLog_CompuMethods_rba_TrapLog_oneToOne 1 100 0.0 4.E9 FORMAT "%32.0" ECU_ADDRESS 0x60035A20 /end MEASUREMENT
/begin MEASUREMENT rba_TrapLog_RegCore2_st[4].TRAP_PC_u32 "Saved register list[4]/TRAP_PC" ULONG RB_RBA_rba_TrapLog_CompuMethods_rba_TrapLog_oneToOne 1 100 0.0 4.E9 FORMAT "%32.0" ECU_ADDRESS 0x60035A54 /end MEASUREMENT
/begin MEASUREMENT rba_TrapLog_RegCore2_st[5].TRAP_PC_u32 "Saved register list[5]/TRAP_PC" ULONG RB_RBA_rba_TrapLog_CompuMethods_rba_TrapLog_oneToOne 1 100 0.0 4.E9 FORMAT "%32.0" ECU_ADDRESS 0x60035A88 /end MEASUREMENT
/begin MEASUREMENT rba_TrapLog_RegCore2_st[0].DMI_STR_u32 "Saved register list[0]/DMI_STR" ULONG RB_RBA_rba_TrapLog_CompuMethods_rba_TrapLog_oneToOne 1 100 0.0 4.E9 FORMAT "%32.0" ECU_ADDRESS 0x60035988 /end MEASUREMENT
/begin MEASUREMENT rba_TrapLog_RegCore2_st[1].DMI_STR_u32 "Saved register list[1]/DMI_STR" ULONG RB_RBA_rba_TrapLog_CompuMethods_rba_TrapLog_oneToOne 1 100 0.0 4.E9 FORMAT "%32.0" ECU_ADDRESS 0x600359BC /end MEASUREMENT
/begin MEASUREMENT rba_TrapLog_RegCore2_st[2].DMI_STR_u32 "Saved register list[2]/DMI_STR" ULONG RB_RBA_rba_TrapLog_CompuMethods_rba_TrapLog_oneToOne 1 100 0.0 4.E9 FORMAT "%32.0" ECU_ADDRESS 0x600359F0 /end MEASUREMENT
/begin MEASUREMENT rba_TrapLog_RegCore2_st[3].DMI_STR_u32 "Saved register list[3]/DMI_STR" ULONG RB_RBA_rba_TrapLog_CompuMethods_rba_TrapLog_oneToOne 1 100 0.0 4.E9 FORMAT "%32.0" ECU_ADDRESS 0x60035A24 /end MEASUREMENT
/begin MEASUREMENT rba_TrapLog_RegCore2_st[4].DMI_STR_u32 "Saved register list[4]/DMI_STR" ULONG RB_RBA_rba_TrapLog_CompuMethods_rba_TrapLog_oneToOne 1 100 0.0 4.E9 FORMAT "%32.0" ECU_ADDRESS 0x60035A58 /end MEASUREMENT
/begin MEASUREMENT rba_TrapLog_RegCore2_st[5].DMI_STR_u32 "Saved register list[5]/DMI_STR" ULONG RB_RBA_rba_TrapLog_CompuMethods_rba_TrapLog_oneToOne 1 100 0.0 4.E9 FORMAT "%32.0" ECU_ADDRESS 0x60035A8C /end MEASUREMENT
/begin MEASUREMENT rba_TrapLog_RegCore2_st[0].DMI_ATR_u32 "Saved register list[0]/DMI_ATR" ULONG RB_RBA_rba_TrapLog_CompuMethods_rba_TrapLog_oneToOne 1 100 0.0 4.E9 FORMAT "%32.0" ECU_ADDRESS 0x6003598C /end MEASUREMENT
/begin MEASUREMENT rba_TrapLog_RegCore2_st[1].DMI_ATR_u32 "Saved register list[1]/DMI_ATR" ULONG RB_RBA_rba_TrapLog_CompuMethods_rba_TrapLog_oneToOne 1 100 0.0 4.E9 FORMAT "%32.0" ECU_ADDRESS 0x600359C0 /end MEASUREMENT
/begin MEASUREMENT rba_TrapLog_RegCore2_st[2].DMI_ATR_u32 "Saved register list[2]/DMI_ATR" ULONG RB_RBA_rba_TrapLog_CompuMethods_rba_TrapLog_oneToOne 1 100 0.0 4.E9 FORMAT "%32.0" ECU_ADDRESS 0x600359F4 /end MEASUREMENT
/begin MEASUREMENT rba_TrapLog_RegCore2_st[3].DMI_ATR_u32 "Saved register list[3]/DMI_ATR" ULONG RB_RBA_rba_TrapLog_CompuMethods_rba_TrapLog_oneToOne 1 100 0.0 4.E9 FORMAT "%32.0" ECU_ADDRESS 0x60035A28 /end MEASUREMENT
/begin MEASUREMENT rba_TrapLog_RegCore2_st[4].DMI_ATR_u32 "Saved register list[4]/DMI_ATR" ULONG RB_RBA_rba_TrapLog_CompuMethods_rba_TrapLog_oneToOne 1 100 0.0 4.E9 FORMAT "%32.0" ECU_ADDRESS 0x60035A5C /end MEASUREMENT
/begin MEASUREMENT rba_TrapLog_RegCore2_st[5].DMI_ATR_u32 "Saved register list[5]/DMI_ATR" ULONG RB_RBA_rba_TrapLog_CompuMethods_rba_TrapLog_oneToOne 1 100 0.0 4.E9 FORMAT "%32.0" ECU_ADDRESS 0x60035A90 /end MEASUREMENT
/begin MEASUREMENT rba_TrapLog_RegCore2_st[0].DMI_EADD_u32 "Saved register list[0]/DMI_EADD" ULONG RB_RBA_rba_TrapLog_CompuMethods_rba_TrapLog_oneToOne 1 100 0.0 4.E9 FORMAT "%32.0" ECU_ADDRESS 0x60035990 /end MEASUREMENT
/begin MEASUREMENT rba_TrapLog_RegCore2_st[1].DMI_EADD_u32 "Saved register list[1]/DMI_EADD" ULONG RB_RBA_rba_TrapLog_CompuMethods_rba_TrapLog_oneToOne 1 100 0.0 4.E9 FORMAT "%32.0" ECU_ADDRESS 0x600359C4 /end MEASUREMENT
/begin MEASUREMENT rba_TrapLog_RegCore2_st[2].DMI_EADD_u32 "Saved register list[2]/DMI_EADD" ULONG RB_RBA_rba_TrapLog_CompuMethods_rba_TrapLog_oneToOne 1 100 0.0 4.E9 FORMAT "%32.0" ECU_ADDRESS 0x600359F8 /end MEASUREMENT
/begin MEASUREMENT rba_TrapLog_RegCore2_st[3].DMI_EADD_u32 "Saved register list[3]/DMI_EADD" ULONG RB_RBA_rba_TrapLog_CompuMethods_rba_TrapLog_oneToOne 1 100 0.0 4.E9 FORMAT "%32.0" ECU_ADDRESS 0x60035A2C /end MEASUREMENT
/begin MEASUREMENT rba_TrapLog_RegCore2_st[4].DMI_EADD_u32 "Saved register list[4]/DMI_EADD" ULONG RB_RBA_rba_TrapLog_CompuMethods_rba_TrapLog_oneToOne 1 100 0.0 4.E9 FORMAT "%32.0" ECU_ADDRESS 0x60035A60 /end MEASUREMENT
/begin MEASUREMENT rba_TrapLog_RegCore2_st[5].DMI_EADD_u32 "Saved register list[5]/DMI_EADD" ULONG RB_RBA_rba_TrapLog_CompuMethods_rba_TrapLog_oneToOne 1 100 0.0 4.E9 FORMAT "%32.0" ECU_ADDRESS 0x60035A94 /end MEASUREMENT
/begin MEASUREMENT rba_TrapLog_RegCore2_st[0].DIETR_u32 "Saved register list[0]/DIETR" ULONG RB_RBA_rba_TrapLog_CompuMethods_rba_TrapLog_oneToOne 1 100 0.0 4.E9 FORMAT "%32.0" ECU_ADDRESS 0x60035994 /end MEASUREMENT
/begin MEASUREMENT rba_TrapLog_RegCore2_st[1].DIETR_u32 "Saved register list[1]/DIETR" ULONG RB_RBA_rba_TrapLog_CompuMethods_rba_TrapLog_oneToOne 1 100 0.0 4.E9 FORMAT "%32.0" ECU_ADDRESS 0x600359C8 /end MEASUREMENT
/begin MEASUREMENT rba_TrapLog_RegCore2_st[2].DIETR_u32 "Saved register list[2]/DIETR" ULONG RB_RBA_rba_TrapLog_CompuMethods_rba_TrapLog_oneToOne 1 100 0.0 4.E9 FORMAT "%32.0" ECU_ADDRESS 0x600359FC /end MEASUREMENT
/begin MEASUREMENT rba_TrapLog_RegCore2_st[3].DIETR_u32 "Saved register list[3]/DIETR" ULONG RB_RBA_rba_TrapLog_CompuMethods_rba_TrapLog_oneToOne 1 100 0.0 4.E9 FORMAT "%32.0" ECU_ADDRESS 0x60035A30 /end MEASUREMENT
/begin MEASUREMENT rba_TrapLog_RegCore2_st[4].DIETR_u32 "Saved register list[4]/DIETR" ULONG RB_RBA_rba_TrapLog_CompuMethods_rba_TrapLog_oneToOne 1 100 0.0 4.E9 FORMAT "%32.0" ECU_ADDRESS 0x60035A64 /end MEASUREMENT
/begin MEASUREMENT rba_TrapLog_RegCore2_st[5].DIETR_u32 "Saved register list[5]/DIETR" ULONG RB_RBA_rba_TrapLog_CompuMethods_rba_TrapLog_oneToOne 1 100 0.0 4.E9 FORMAT "%32.0" ECU_ADDRESS 0x60035A98 /end MEASUREMENT
/begin MEASUREMENT rba_TrapLog_RegCore2_st[0].DIEAR_u32 "Saved register list[0]/DIEAR" ULONG RB_RBA_rba_TrapLog_CompuMethods_rba_TrapLog_oneToOne 1 100 0.0 4.E9 FORMAT "%32.0" ECU_ADDRESS 0x60035998 /end MEASUREMENT
/begin MEASUREMENT rba_TrapLog_RegCore2_st[1].DIEAR_u32 "Saved register list[1]/DIEAR" ULONG RB_RBA_rba_TrapLog_CompuMethods_rba_TrapLog_oneToOne 1 100 0.0 4.E9 FORMAT "%32.0" ECU_ADDRESS 0x600359CC /end MEASUREMENT
/begin MEASUREMENT rba_TrapLog_RegCore2_st[2].DIEAR_u32 "Saved register list[2]/DIEAR" ULONG RB_RBA_rba_TrapLog_CompuMethods_rba_TrapLog_oneToOne 1 100 0.0 4.E9 FORMAT "%32.0" ECU_ADDRESS 0x60035A00 /end MEASUREMENT
/begin MEASUREMENT rba_TrapLog_RegCore2_st[3].DIEAR_u32 "Saved register list[3]/DIEAR" ULONG RB_RBA_rba_TrapLog_CompuMethods_rba_TrapLog_oneToOne 1 100 0.0 4.E9 FORMAT "%32.0" ECU_ADDRESS 0x60035A34 /end MEASUREMENT
/begin MEASUREMENT rba_TrapLog_RegCore2_st[4].DIEAR_u32 "Saved register list[4]/DIEAR" ULONG RB_RBA_rba_TrapLog_CompuMethods_rba_TrapLog_oneToOne 1 100 0.0 4.E9 FORMAT "%32.0" ECU_ADDRESS 0x60035A68 /end MEASUREMENT
/begin MEASUREMENT rba_TrapLog_RegCore2_st[5].DIEAR_u32 "Saved register list[5]/DIEAR" ULONG RB_RBA_rba_TrapLog_CompuMethods_rba_TrapLog_oneToOne 1 100 0.0 4.E9 FORMAT "%32.0" ECU_ADDRESS 0x60035A9C /end MEASUREMENT
/begin MEASUREMENT rba_TrapLog_RegCore2_st[0].PIETR_u32 "Saved register list[0]/PIETR" ULONG RB_RBA_rba_TrapLog_CompuMethods_rba_TrapLog_oneToOne 1 100 0.0 4.E9 FORMAT "%32.0" ECU_ADDRESS 0x6003599C /end MEASUREMENT
/begin MEASUREMENT rba_TrapLog_RegCore2_st[1].PIETR_u32 "Saved register list[1]/PIETR" ULONG RB_RBA_rba_TrapLog_CompuMethods_rba_TrapLog_oneToOne 1 100 0.0 4.E9 FORMAT "%32.0" ECU_ADDRESS 0x600359D0 /end MEASUREMENT
/begin MEASUREMENT rba_TrapLog_RegCore2_st[2].PIETR_u32 "Saved register list[2]/PIETR" ULONG RB_RBA_rba_TrapLog_CompuMethods_rba_TrapLog_oneToOne 1 100 0.0 4.E9 FORMAT "%32.0" ECU_ADDRESS 0x60035A04 /end MEASUREMENT
/begin MEASUREMENT rba_TrapLog_RegCore2_st[3].PIETR_u32 "Saved register list[3]/PIETR" ULONG RB_RBA_rba_TrapLog_CompuMethods_rba_TrapLog_oneToOne 1 100 0.0 4.E9 FORMAT "%32.0" ECU_ADDRESS 0x60035A38 /end MEASUREMENT
/begin MEASUREMENT rba_TrapLog_RegCore2_st[4].PIETR_u32 "Saved register list[4]/PIETR" ULONG RB_RBA_rba_TrapLog_CompuMethods_rba_TrapLog_oneToOne 1 100 0.0 4.E9 FORMAT "%32.0" ECU_ADDRESS 0x60035A6C /end MEASUREMENT
/begin MEASUREMENT rba_TrapLog_RegCore2_st[5].PIETR_u32 "Saved register list[5]/PIETR" ULONG RB_RBA_rba_TrapLog_CompuMethods_rba_TrapLog_oneToOne 1 100 0.0 4.E9 FORMAT "%32.0" ECU_ADDRESS 0x60035AA0 /end MEASUREMENT
/begin MEASUREMENT rba_TrapLog_RegCore2_st[0].PIEAR_u32 "Saved register list[0]/PIEAR" ULONG RB_RBA_rba_TrapLog_CompuMethods_rba_TrapLog_oneToOne 1 100 0.0 4.E9 FORMAT "%32.0" ECU_ADDRESS 0x600359A0 /end MEASUREMENT
/begin MEASUREMENT rba_TrapLog_RegCore2_st[1].PIEAR_u32 "Saved register list[1]/PIEAR" ULONG RB_RBA_rba_TrapLog_CompuMethods_rba_TrapLog_oneToOne 1 100 0.0 4.E9 FORMAT "%32.0" ECU_ADDRESS 0x600359D4 /end MEASUREMENT
/begin MEASUREMENT rba_TrapLog_RegCore2_st[2].PIEAR_u32 "Saved register list[2]/PIEAR" ULONG RB_RBA_rba_TrapLog_CompuMethods_rba_TrapLog_oneToOne 1 100 0.0 4.E9 FORMAT "%32.0" ECU_ADDRESS 0x60035A08 /end MEASUREMENT
/begin MEASUREMENT rba_TrapLog_RegCore2_st[3].PIEAR_u32 "Saved register list[3]/PIEAR" ULONG RB_RBA_rba_TrapLog_CompuMethods_rba_TrapLog_oneToOne 1 100 0.0 4.E9 FORMAT "%32.0" ECU_ADDRESS 0x60035A3C /end MEASUREMENT
/begin MEASUREMENT rba_TrapLog_RegCore2_st[4].PIEAR_u32 "Saved register list[4]/PIEAR" ULONG RB_RBA_rba_TrapLog_CompuMethods_rba_TrapLog_oneToOne 1 100 0.0 4.E9 FORMAT "%32.0" ECU_ADDRESS 0x60035A70 /end MEASUREMENT
/begin MEASUREMENT rba_TrapLog_RegCore2_st[5].PIEAR_u32 "Saved register list[5]/PIEAR" ULONG RB_RBA_rba_TrapLog_CompuMethods_rba_TrapLog_oneToOne 1 100 0.0 4.E9 FORMAT "%32.0" ECU_ADDRESS 0x60035AA4 /end MEASUREMENT
/begin MEASUREMENT rba_TrapLog_RegCore2_st[0].SYS_TIME_u32 "Saved register list[0]/SYS_TIME" ULONG RB_RBA_rba_TrapLog_CompuMethods_rba_TrapLog_oneToOne 1 100 0.0 4.E9 FORMAT "%32.0" ECU_ADDRESS 0x600359A4 /end MEASUREMENT
/begin MEASUREMENT rba_TrapLog_RegCore2_st[1].SYS_TIME_u32 "Saved register list[1]/SYS_TIME" ULONG RB_RBA_rba_TrapLog_CompuMethods_rba_TrapLog_oneToOne 1 100 0.0 4.E9 FORMAT "%32.0" ECU_ADDRESS 0x600359D8 /end MEASUREMENT
/begin MEASUREMENT rba_TrapLog_RegCore2_st[2].SYS_TIME_u32 "Saved register list[2]/SYS_TIME" ULONG RB_RBA_rba_TrapLog_CompuMethods_rba_TrapLog_oneToOne 1 100 0.0 4.E9 FORMAT "%32.0" ECU_ADDRESS 0x60035A0C /end MEASUREMENT
/begin MEASUREMENT rba_TrapLog_RegCore2_st[3].SYS_TIME_u32 "Saved register list[3]/SYS_TIME" ULONG RB_RBA_rba_TrapLog_CompuMethods_rba_TrapLog_oneToOne 1 100 0.0 4.E9 FORMAT "%32.0" ECU_ADDRESS 0x60035A40 /end MEASUREMENT
/begin MEASUREMENT rba_TrapLog_RegCore2_st[4].SYS_TIME_u32 "Saved register list[4]/SYS_TIME" ULONG RB_RBA_rba_TrapLog_CompuMethods_rba_TrapLog_oneToOne 1 100 0.0 4.E9 FORMAT "%32.0" ECU_ADDRESS 0x60035A74 /end MEASUREMENT
/begin MEASUREMENT rba_TrapLog_RegCore2_st[5].SYS_TIME_u32 "Saved register list[5]/SYS_TIME" ULONG RB_RBA_rba_TrapLog_CompuMethods_rba_TrapLog_oneToOne 1 100 0.0 4.E9 FORMAT "%32.0" ECU_ADDRESS 0x60035AA8 /end MEASUREMENT
/begin MEASUREMENT rba_TrapLog_Reg_st[0].COREID_CALIB_TCN_u32 "Saved register list[0]/COREID_CALIB_TCN" ULONG RB_RBA_rba_TrapLog_CompuMethods_rba_TrapLog_oneToOne 1 100 0.0 4.E9 FORMAT "%32.0" ECU_ADDRESS 0x60035CA4 /end MEASUREMENT
/begin MEASUREMENT rba_TrapLog_Reg_st[1].COREID_CALIB_TCN_u32 "Saved register list[1]/COREID_CALIB_TCN" ULONG RB_RBA_rba_TrapLog_CompuMethods_rba_TrapLog_oneToOne 1 100 0.0 4.E9 FORMAT "%32.0" ECU_ADDRESS 0x60035D54 /end MEASUREMENT
/begin MEASUREMENT rba_TrapLog_Reg_st[2].COREID_CALIB_TCN_u32 "Saved register list[2]/COREID_CALIB_TCN" ULONG RB_RBA_rba_TrapLog_CompuMethods_rba_TrapLog_oneToOne 1 100 0.0 4.E9 FORMAT "%32.0" ECU_ADDRESS 0x60035E04 /end MEASUREMENT
/begin MEASUREMENT rba_TrapLog_Reg_st[3].COREID_CALIB_TCN_u32 "Saved register list[3]/COREID_CALIB_TCN" ULONG RB_RBA_rba_TrapLog_CompuMethods_rba_TrapLog_oneToOne 1 100 0.0 4.E9 FORMAT "%32.0" ECU_ADDRESS 0x60035EB4 /end MEASUREMENT
/begin MEASUREMENT rba_TrapLog_Reg_st[4].COREID_CALIB_TCN_u32 "Saved register list[4]/COREID_CALIB_TCN" ULONG RB_RBA_rba_TrapLog_CompuMethods_rba_TrapLog_oneToOne 1 100 0.0 4.E9 FORMAT "%32.0" ECU_ADDRESS 0x60035F64 /end MEASUREMENT
/begin MEASUREMENT rba_TrapLog_Reg_st[5].COREID_CALIB_TCN_u32 "Saved register list[5]/COREID_CALIB_TCN" ULONG RB_RBA_rba_TrapLog_CompuMethods_rba_TrapLog_oneToOne 1 100 0.0 4.E9 FORMAT "%32.0" ECU_ADDRESS 0x60036014 /end MEASUREMENT
/begin MEASUREMENT rba_TrapLog_Reg_st[0].PSW_u32 "Saved register list[0]/PSW" ULONG RB_RBA_rba_TrapLog_CompuMethods_rba_TrapLog_oneToOne 1 100 0.0 4.E9 FORMAT "%32.0" ECU_ADDRESS 0x60035CA8 /end MEASUREMENT
/begin MEASUREMENT rba_TrapLog_Reg_st[1].PSW_u32 "Saved register list[1]/PSW" ULONG RB_RBA_rba_TrapLog_CompuMethods_rba_TrapLog_oneToOne 1 100 0.0 4.E9 FORMAT "%32.0" ECU_ADDRESS 0x60035D58 /end MEASUREMENT
/begin MEASUREMENT rba_TrapLog_Reg_st[2].PSW_u32 "Saved register list[2]/PSW" ULONG RB_RBA_rba_TrapLog_CompuMethods_rba_TrapLog_oneToOne 1 100 0.0 4.E9 FORMAT "%32.0" ECU_ADDRESS 0x60035E08 /end MEASUREMENT
/begin MEASUREMENT rba_TrapLog_Reg_st[3].PSW_u32 "Saved register list[3]/PSW" ULONG RB_RBA_rba_TrapLog_CompuMethods_rba_TrapLog_oneToOne 1 100 0.0 4.E9 FORMAT "%32.0" ECU_ADDRESS 0x60035EB8 /end MEASUREMENT
/begin MEASUREMENT rba_TrapLog_Reg_st[4].PSW_u32 "Saved register list[4]/PSW" ULONG RB_RBA_rba_TrapLog_CompuMethods_rba_TrapLog_oneToOne 1 100 0.0 4.E9 FORMAT "%32.0" ECU_ADDRESS 0x60035F68 /end MEASUREMENT
/begin MEASUREMENT rba_TrapLog_Reg_st[5].PSW_u32 "Saved register list[5]/PSW" ULONG RB_RBA_rba_TrapLog_CompuMethods_rba_TrapLog_oneToOne 1 100 0.0 4.E9 FORMAT "%32.0" ECU_ADDRESS 0x60036018 /end MEASUREMENT
/begin MEASUREMENT rba_TrapLog_Reg_st[0].PCXI_u32 "Saved register list[0]/PCXI" ULONG RB_RBA_rba_TrapLog_CompuMethods_rba_TrapLog_oneToOne 1 100 0.0 4.E9 FORMAT "%32.0" ECU_ADDRESS 0x60035CAC /end MEASUREMENT
/begin MEASUREMENT rba_TrapLog_Reg_st[1].PCXI_u32 "Saved register list[1]/PCXI" ULONG RB_RBA_rba_TrapLog_CompuMethods_rba_TrapLog_oneToOne 1 100 0.0 4.E9 FORMAT "%32.0" ECU_ADDRESS 0x60035D5C /end MEASUREMENT
/begin MEASUREMENT rba_TrapLog_Reg_st[2].PCXI_u32 "Saved register list[2]/PCXI" ULONG RB_RBA_rba_TrapLog_CompuMethods_rba_TrapLog_oneToOne 1 100 0.0 4.E9 FORMAT "%32.0" ECU_ADDRESS 0x60035E0C /end MEASUREMENT
/begin MEASUREMENT rba_TrapLog_Reg_st[3].PCXI_u32 "Saved register list[3]/PCXI" ULONG RB_RBA_rba_TrapLog_CompuMethods_rba_TrapLog_oneToOne 1 100 0.0 4.E9 FORMAT "%32.0" ECU_ADDRESS 0x60035EBC /end MEASUREMENT
/begin MEASUREMENT rba_TrapLog_Reg_st[4].PCXI_u32 "Saved register list[4]/PCXI" ULONG RB_RBA_rba_TrapLog_CompuMethods_rba_TrapLog_oneToOne 1 100 0.0 4.E9 FORMAT "%32.0" ECU_ADDRESS 0x60035F6C /end MEASUREMENT
/begin MEASUREMENT rba_TrapLog_Reg_st[5].PCXI_u32 "Saved register list[5]/PCXI" ULONG RB_RBA_rba_TrapLog_CompuMethods_rba_TrapLog_oneToOne 1 100 0.0 4.E9 FORMAT "%32.0" ECU_ADDRESS 0x6003601C /end MEASUREMENT
/begin MEASUREMENT rba_TrapLog_Reg_st[0].TRAP_CON_u32 "Saved register list[0]/TRAP_CON" ULONG RB_RBA_rba_TrapLog_CompuMethods_rba_TrapLog_oneToOne 1 100 0.0 4.E9 FORMAT "%32.0" ECU_ADDRESS 0x60035CB0 /end MEASUREMENT
/begin MEASUREMENT rba_TrapLog_Reg_st[1].TRAP_CON_u32 "Saved register list[1]/TRAP_CON" ULONG RB_RBA_rba_TrapLog_CompuMethods_rba_TrapLog_oneToOne 1 100 0.0 4.E9 FORMAT "%32.0" ECU_ADDRESS 0x60035D60 /end MEASUREMENT
/begin MEASUREMENT rba_TrapLog_Reg_st[2].TRAP_CON_u32 "Saved register list[2]/TRAP_CON" ULONG RB_RBA_rba_TrapLog_CompuMethods_rba_TrapLog_oneToOne 1 100 0.0 4.E9 FORMAT "%32.0" ECU_ADDRESS 0x60035E10 /end MEASUREMENT
/begin MEASUREMENT rba_TrapLog_Reg_st[3].TRAP_CON_u32 "Saved register list[3]/TRAP_CON" ULONG RB_RBA_rba_TrapLog_CompuMethods_rba_TrapLog_oneToOne 1 100 0.0 4.E9 FORMAT "%32.0" ECU_ADDRESS 0x60035EC0 /end MEASUREMENT
/begin MEASUREMENT rba_TrapLog_Reg_st[4].TRAP_CON_u32 "Saved register list[4]/TRAP_CON" ULONG RB_RBA_rba_TrapLog_CompuMethods_rba_TrapLog_oneToOne 1 100 0.0 4.E9 FORMAT "%32.0" ECU_ADDRESS 0x60035F70 /end MEASUREMENT
/begin MEASUREMENT rba_TrapLog_Reg_st[5].TRAP_CON_u32 "Saved register list[5]/TRAP_CON" ULONG RB_RBA_rba_TrapLog_CompuMethods_rba_TrapLog_oneToOne 1 100 0.0 4.E9 FORMAT "%32.0" ECU_ADDRESS 0x60036020 /end MEASUREMENT
/begin MEASUREMENT rba_TrapLog_Reg_st[0].TRAP_PC_u32 "Saved register list[0]/TRAP_PC" ULONG RB_RBA_rba_TrapLog_CompuMethods_rba_TrapLog_oneToOne 1 100 0.0 4.E9 FORMAT "%32.0" ECU_ADDRESS 0x60035CB4 /end MEASUREMENT
/begin MEASUREMENT rba_TrapLog_Reg_st[1].TRAP_PC_u32 "Saved register list[1]/TRAP_PC" ULONG RB_RBA_rba_TrapLog_CompuMethods_rba_TrapLog_oneToOne 1 100 0.0 4.E9 FORMAT "%32.0" ECU_ADDRESS 0x60035D64 /end MEASUREMENT
/begin MEASUREMENT rba_TrapLog_Reg_st[2].TRAP_PC_u32 "Saved register list[2]/TRAP_PC" ULONG RB_RBA_rba_TrapLog_CompuMethods_rba_TrapLog_oneToOne 1 100 0.0 4.E9 FORMAT "%32.0" ECU_ADDRESS 0x60035E14 /end MEASUREMENT
/begin MEASUREMENT rba_TrapLog_Reg_st[3].TRAP_PC_u32 "Saved register list[3]/TRAP_PC" ULONG RB_RBA_rba_TrapLog_CompuMethods_rba_TrapLog_oneToOne 1 100 0.0 4.E9 FORMAT "%32.0" ECU_ADDRESS 0x60035EC4 /end MEASUREMENT
/begin MEASUREMENT rba_TrapLog_Reg_st[4].TRAP_PC_u32 "Saved register list[4]/TRAP_PC" ULONG RB_RBA_rba_TrapLog_CompuMethods_rba_TrapLog_oneToOne 1 100 0.0 4.E9 FORMAT "%32.0" ECU_ADDRESS 0x60035F74 /end MEASUREMENT
/begin MEASUREMENT rba_TrapLog_Reg_st[5].TRAP_PC_u32 "Saved register list[5]/TRAP_PC" ULONG RB_RBA_rba_TrapLog_CompuMethods_rba_TrapLog_oneToOne 1 100 0.0 4.E9 FORMAT "%32.0" ECU_ADDRESS 0x60036024 /end MEASUREMENT
/begin MEASUREMENT rba_TrapLog_Reg_st[0].DIETR_u32 "Saved register list[0]/DIETR" ULONG RB_RBA_rba_TrapLog_CompuMethods_rba_TrapLog_oneToOne 1 100 0.0 4.E9 FORMAT "%32.0" ECU_ADDRESS 0x60035CB8 /end MEASUREMENT
/begin MEASUREMENT rba_TrapLog_Reg_st[1].DIETR_u32 "Saved register list[1]/DIETR" ULONG RB_RBA_rba_TrapLog_CompuMethods_rba_TrapLog_oneToOne 1 100 0.0 4.E9 FORMAT "%32.0" ECU_ADDRESS 0x60035D68 /end MEASUREMENT
/begin MEASUREMENT rba_TrapLog_Reg_st[2].DIETR_u32 "Saved register list[2]/DIETR" ULONG RB_RBA_rba_TrapLog_CompuMethods_rba_TrapLog_oneToOne 1 100 0.0 4.E9 FORMAT "%32.0" ECU_ADDRESS 0x60035E18 /end MEASUREMENT
/begin MEASUREMENT rba_TrapLog_Reg_st[3].DIETR_u32 "Saved register list[3]/DIETR" ULONG RB_RBA_rba_TrapLog_CompuMethods_rba_TrapLog_oneToOne 1 100 0.0 4.E9 FORMAT "%32.0" ECU_ADDRESS 0x60035EC8 /end MEASUREMENT
/begin MEASUREMENT rba_TrapLog_Reg_st[4].DIETR_u32 "Saved register list[4]/DIETR" ULONG RB_RBA_rba_TrapLog_CompuMethods_rba_TrapLog_oneToOne 1 100 0.0 4.E9 FORMAT "%32.0" ECU_ADDRESS 0x60035F78 /end MEASUREMENT
/begin MEASUREMENT rba_TrapLog_Reg_st[5].DIETR_u32 "Saved register list[5]/DIETR" ULONG RB_RBA_rba_TrapLog_CompuMethods_rba_TrapLog_oneToOne 1 100 0.0 4.E9 FORMAT "%32.0" ECU_ADDRESS 0x60036028 /end MEASUREMENT
/begin MEASUREMENT rba_TrapLog_Reg_st[0].DIEAR_u32 "Saved register list[0]/DIEAR" ULONG RB_RBA_rba_TrapLog_CompuMethods_rba_TrapLog_oneToOne 1 100 0.0 4.E9 FORMAT "%32.0" ECU_ADDRESS 0x60035CBC /end MEASUREMENT
/begin MEASUREMENT rba_TrapLog_Reg_st[1].DIEAR_u32 "Saved register list[1]/DIEAR" ULONG RB_RBA_rba_TrapLog_CompuMethods_rba_TrapLog_oneToOne 1 100 0.0 4.E9 FORMAT "%32.0" ECU_ADDRESS 0x60035D6C /end MEASUREMENT
/begin MEASUREMENT rba_TrapLog_Reg_st[2].DIEAR_u32 "Saved register list[2]/DIEAR" ULONG RB_RBA_rba_TrapLog_CompuMethods_rba_TrapLog_oneToOne 1 100 0.0 4.E9 FORMAT "%32.0" ECU_ADDRESS 0x60035E1C /end MEASUREMENT
/begin MEASUREMENT rba_TrapLog_Reg_st[3].DIEAR_u32 "Saved register list[3]/DIEAR" ULONG RB_RBA_rba_TrapLog_CompuMethods_rba_TrapLog_oneToOne 1 100 0.0 4.E9 FORMAT "%32.0" ECU_ADDRESS 0x60035ECC /end MEASUREMENT
/begin MEASUREMENT rba_TrapLog_Reg_st[4].DIEAR_u32 "Saved register list[4]/DIEAR" ULONG RB_RBA_rba_TrapLog_CompuMethods_rba_TrapLog_oneToOne 1 100 0.0 4.E9 FORMAT "%32.0" ECU_ADDRESS 0x60035F7C /end MEASUREMENT
/begin MEASUREMENT rba_TrapLog_Reg_st[5].DIEAR_u32 "Saved register list[5]/DIEAR" ULONG RB_RBA_rba_TrapLog_CompuMethods_rba_TrapLog_oneToOne 1 100 0.0 4.E9 FORMAT "%32.0" ECU_ADDRESS 0x6003602C /end MEASUREMENT
/begin MEASUREMENT rba_TrapLog_Reg_st[0].PIETR_u32 "Saved register list[0]/PIETR" ULONG RB_RBA_rba_TrapLog_CompuMethods_rba_TrapLog_oneToOne 1 100 0.0 4.E9 FORMAT "%32.0" ECU_ADDRESS 0x60035CC0 /end MEASUREMENT
/begin MEASUREMENT rba_TrapLog_Reg_st[1].PIETR_u32 "Saved register list[1]/PIETR" ULONG RB_RBA_rba_TrapLog_CompuMethods_rba_TrapLog_oneToOne 1 100 0.0 4.E9 FORMAT "%32.0" ECU_ADDRESS 0x60035D70 /end MEASUREMENT
/begin MEASUREMENT rba_TrapLog_Reg_st[2].PIETR_u32 "Saved register list[2]/PIETR" ULONG RB_RBA_rba_TrapLog_CompuMethods_rba_TrapLog_oneToOne 1 100 0.0 4.E9 FORMAT "%32.0" ECU_ADDRESS 0x60035E20 /end MEASUREMENT
/begin MEASUREMENT rba_TrapLog_Reg_st[3].PIETR_u32 "Saved register list[3]/PIETR" ULONG RB_RBA_rba_TrapLog_CompuMethods_rba_TrapLog_oneToOne 1 100 0.0 4.E9 FORMAT "%32.0" ECU_ADDRESS 0x60035ED0 /end MEASUREMENT
/begin MEASUREMENT rba_TrapLog_Reg_st[4].PIETR_u32 "Saved register list[4]/PIETR" ULONG RB_RBA_rba_TrapLog_CompuMethods_rba_TrapLog_oneToOne 1 100 0.0 4.E9 FORMAT "%32.0" ECU_ADDRESS 0x60035F80 /end MEASUREMENT
/begin MEASUREMENT rba_TrapLog_Reg_st[5].PIETR_u32 "Saved register list[5]/PIETR" ULONG RB_RBA_rba_TrapLog_CompuMethods_rba_TrapLog_oneToOne 1 100 0.0 4.E9 FORMAT "%32.0" ECU_ADDRESS 0x60036030 /end MEASUREMENT
/begin MEASUREMENT rba_TrapLog_Reg_st[0].PIEAR_u32 "Saved register list[0]/PIEAR" ULONG RB_RBA_rba_TrapLog_CompuMethods_rba_TrapLog_oneToOne 1 100 0.0 4.E9 FORMAT "%32.0" ECU_ADDRESS 0x60035CC4 /end MEASUREMENT
/begin MEASUREMENT rba_TrapLog_Reg_st[1].PIEAR_u32 "Saved register list[1]/PIEAR" ULONG RB_RBA_rba_TrapLog_CompuMethods_rba_TrapLog_oneToOne 1 100 0.0 4.E9 FORMAT "%32.0" ECU_ADDRESS 0x60035D74 /end MEASUREMENT
/begin MEASUREMENT rba_TrapLog_Reg_st[2].PIEAR_u32 "Saved register list[2]/PIEAR" ULONG RB_RBA_rba_TrapLog_CompuMethods_rba_TrapLog_oneToOne 1 100 0.0 4.E9 FORMAT "%32.0" ECU_ADDRESS 0x60035E24 /end MEASUREMENT
/begin MEASUREMENT rba_TrapLog_Reg_st[3].PIEAR_u32 "Saved register list[3]/PIEAR" ULONG RB_RBA_rba_TrapLog_CompuMethods_rba_TrapLog_oneToOne 1 100 0.0 4.E9 FORMAT "%32.0" ECU_ADDRESS 0x60035ED4 /end MEASUREMENT
/begin MEASUREMENT rba_TrapLog_Reg_st[4].PIEAR_u32 "Saved register list[4]/PIEAR" ULONG RB_RBA_rba_TrapLog_CompuMethods_rba_TrapLog_oneToOne 1 100 0.0 4.E9 FORMAT "%32.0" ECU_ADDRESS 0x60035F84 /end MEASUREMENT
/begin MEASUREMENT rba_TrapLog_Reg_st[5].PIEAR_u32 "Saved register list[5]/PIEAR" ULONG RB_RBA_rba_TrapLog_CompuMethods_rba_TrapLog_oneToOne 1 100 0.0 4.E9 FORMAT "%32.0" ECU_ADDRESS 0x60036034 /end MEASUREMENT
/begin MEASUREMENT rba_TrapLog_Reg_st[0].DMI_STR_u32 "Saved register list[0]/DMI_STR" ULONG RB_RBA_rba_TrapLog_CompuMethods_rba_TrapLog_oneToOne 1 100 0.0 4.E9 FORMAT "%32.0" ECU_ADDRESS 0x60035CC8 /end MEASUREMENT
/begin MEASUREMENT rba_TrapLog_Reg_st[1].DMI_STR_u32 "Saved register list[1]/DMI_STR" ULONG RB_RBA_rba_TrapLog_CompuMethods_rba_TrapLog_oneToOne 1 100 0.0 4.E9 FORMAT "%32.0" ECU_ADDRESS 0x60035D78 /end MEASUREMENT
/begin MEASUREMENT rba_TrapLog_Reg_st[2].DMI_STR_u32 "Saved register list[2]/DMI_STR" ULONG RB_RBA_rba_TrapLog_CompuMethods_rba_TrapLog_oneToOne 1 100 0.0 4.E9 FORMAT "%32.0" ECU_ADDRESS 0x60035E28 /end MEASUREMENT
/begin MEASUREMENT rba_TrapLog_Reg_st[3].DMI_STR_u32 "Saved register list[3]/DMI_STR" ULONG RB_RBA_rba_TrapLog_CompuMethods_rba_TrapLog_oneToOne 1 100 0.0 4.E9 FORMAT "%32.0" ECU_ADDRESS 0x60035ED8 /end MEASUREMENT
/begin MEASUREMENT rba_TrapLog_Reg_st[4].DMI_STR_u32 "Saved register list[4]/DMI_STR" ULONG RB_RBA_rba_TrapLog_CompuMethods_rba_TrapLog_oneToOne 1 100 0.0 4.E9 FORMAT "%32.0" ECU_ADDRESS 0x60035F88 /end MEASUREMENT
/begin MEASUREMENT rba_TrapLog_Reg_st[5].DMI_STR_u32 "Saved register list[5]/DMI_STR" ULONG RB_RBA_rba_TrapLog_CompuMethods_rba_TrapLog_oneToOne 1 100 0.0 4.E9 FORMAT "%32.0" ECU_ADDRESS 0x60036038 /end MEASUREMENT
/begin MEASUREMENT rba_TrapLog_Reg_st[0].DMI_ATR_u32 "Saved register list[0]/DMI_ATR" ULONG RB_RBA_rba_TrapLog_CompuMethods_rba_TrapLog_oneToOne 1 100 0.0 4.E9 FORMAT "%32.0" ECU_ADDRESS 0x60035CCC /end MEASUREMENT
/begin MEASUREMENT rba_TrapLog_Reg_st[1].DMI_ATR_u32 "Saved register list[1]/DMI_ATR" ULONG RB_RBA_rba_TrapLog_CompuMethods_rba_TrapLog_oneToOne 1 100 0.0 4.E9 FORMAT "%32.0" ECU_ADDRESS 0x60035D7C /end MEASUREMENT
/begin MEASUREMENT rba_TrapLog_Reg_st[2].DMI_ATR_u32 "Saved register list[2]/DMI_ATR" ULONG RB_RBA_rba_TrapLog_CompuMethods_rba_TrapLog_oneToOne 1 100 0.0 4.E9 FORMAT "%32.0" ECU_ADDRESS 0x60035E2C /end MEASUREMENT
/begin MEASUREMENT rba_TrapLog_Reg_st[3].DMI_ATR_u32 "Saved register list[3]/DMI_ATR" ULONG RB_RBA_rba_TrapLog_CompuMethods_rba_TrapLog_oneToOne 1 100 0.0 4.E9 FORMAT "%32.0" ECU_ADDRESS 0x60035EDC /end MEASUREMENT
/begin MEASUREMENT rba_TrapLog_Reg_st[4].DMI_ATR_u32 "Saved register list[4]/DMI_ATR" ULONG RB_RBA_rba_TrapLog_CompuMethods_rba_TrapLog_oneToOne 1 100 0.0 4.E9 FORMAT "%32.0" ECU_ADDRESS 0x60035F8C /end MEASUREMENT
/begin MEASUREMENT rba_TrapLog_Reg_st[5].DMI_ATR_u32 "Saved register list[5]/DMI_ATR" ULONG RB_RBA_rba_TrapLog_CompuMethods_rba_TrapLog_oneToOne 1 100 0.0 4.E9 FORMAT "%32.0" ECU_ADDRESS 0x6003603C /end MEASUREMENT
/begin MEASUREMENT rba_TrapLog_Reg_st[0].DMI_EADD_u32 "Saved register list[0]/DMI_EADD" ULONG RB_RBA_rba_TrapLog_CompuMethods_rba_TrapLog_oneToOne 1 100 0.0 4.E9 FORMAT "%32.0" ECU_ADDRESS 0x60035CD0 /end MEASUREMENT
/begin MEASUREMENT rba_TrapLog_Reg_st[1].DMI_EADD_u32 "Saved register list[1]/DMI_EADD" ULONG RB_RBA_rba_TrapLog_CompuMethods_rba_TrapLog_oneToOne 1 100 0.0 4.E9 FORMAT "%32.0" ECU_ADDRESS 0x60035D80 /end MEASUREMENT
/begin MEASUREMENT rba_TrapLog_Reg_st[2].DMI_EADD_u32 "Saved register list[2]/DMI_EADD" ULONG RB_RBA_rba_TrapLog_CompuMethods_rba_TrapLog_oneToOne 1 100 0.0 4.E9 FORMAT "%32.0" ECU_ADDRESS 0x60035E30 /end MEASUREMENT
/begin MEASUREMENT rba_TrapLog_Reg_st[3].DMI_EADD_u32 "Saved register list[3]/DMI_EADD" ULONG RB_RBA_rba_TrapLog_CompuMethods_rba_TrapLog_oneToOne 1 100 0.0 4.E9 FORMAT "%32.0" ECU_ADDRESS 0x60035EE0 /end MEASUREMENT
/begin MEASUREMENT rba_TrapLog_Reg_st[4].DMI_EADD_u32 "Saved register list[4]/DMI_EADD" ULONG RB_RBA_rba_TrapLog_CompuMethods_rba_TrapLog_oneToOne 1 100 0.0 4.E9 FORMAT "%32.0" ECU_ADDRESS 0x60035F90 /end MEASUREMENT
/begin MEASUREMENT rba_TrapLog_Reg_st[5].DMI_EADD_u32 "Saved register list[5]/DMI_EADD" ULONG RB_RBA_rba_TrapLog_CompuMethods_rba_TrapLog_oneToOne 1 100 0.0 4.E9 FORMAT "%32.0" ECU_ADDRESS 0x60036040 /end MEASUREMENT
/begin MEASUREMENT rba_TrapLog_Reg_st[0].DOM0_ERRADDRx_u32 "Saved register list[0]/DOM0_ERRADDRx" ULONG RB_RBA_rba_TrapLog_CompuMethods_rba_TrapLog_oneToOne 1 100 0.0 4.E9 FORMAT "%32.0" ECU_ADDRESS 0x60035CD4 /end MEASUREMENT
/begin MEASUREMENT rba_TrapLog_Reg_st[1].DOM0_ERRADDRx_u32 "Saved register list[1]/DOM0_ERRADDRx" ULONG RB_RBA_rba_TrapLog_CompuMethods_rba_TrapLog_oneToOne 1 100 0.0 4.E9 FORMAT "%32.0" ECU_ADDRESS 0x60035D84 /end MEASUREMENT
/begin MEASUREMENT rba_TrapLog_Reg_st[2].DOM0_ERRADDRx_u32 "Saved register list[2]/DOM0_ERRADDRx" ULONG RB_RBA_rba_TrapLog_CompuMethods_rba_TrapLog_oneToOne 1 100 0.0 4.E9 FORMAT "%32.0" ECU_ADDRESS 0x60035E34 /end MEASUREMENT
/begin MEASUREMENT rba_TrapLog_Reg_st[3].DOM0_ERRADDRx_u32 "Saved register list[3]/DOM0_ERRADDRx" ULONG RB_RBA_rba_TrapLog_CompuMethods_rba_TrapLog_oneToOne 1 100 0.0 4.E9 FORMAT "%32.0" ECU_ADDRESS 0x60035EE4 /end MEASUREMENT
/begin MEASUREMENT rba_TrapLog_Reg_st[4].DOM0_ERRADDRx_u32 "Saved register list[4]/DOM0_ERRADDRx" ULONG RB_RBA_rba_TrapLog_CompuMethods_rba_TrapLog_oneToOne 1 100 0.0 4.E9 FORMAT "%32.0" ECU_ADDRESS 0x60035F94 /end MEASUREMENT
/begin MEASUREMENT rba_TrapLog_Reg_st[5].DOM0_ERRADDRx_u32 "Saved register list[5]/DOM0_ERRADDRx" ULONG RB_RBA_rba_TrapLog_CompuMethods_rba_TrapLog_oneToOne 1 100 0.0 4.E9 FORMAT "%32.0" ECU_ADDRESS 0x60036044 /end MEASUREMENT
/begin MEASUREMENT rba_TrapLog_Reg_st[0].DOM0_ERRx_u32 "Saved register list[0]/DOM0_ERRx" ULONG RB_RBA_rba_TrapLog_CompuMethods_rba_TrapLog_oneToOne 1 100 0.0 4.E9 FORMAT "%32.0" ECU_ADDRESS 0x60035CD8 /end MEASUREMENT
/begin MEASUREMENT rba_TrapLog_Reg_st[1].DOM0_ERRx_u32 "Saved register list[1]/DOM0_ERRx" ULONG RB_RBA_rba_TrapLog_CompuMethods_rba_TrapLog_oneToOne 1 100 0.0 4.E9 FORMAT "%32.0" ECU_ADDRESS 0x60035D88 /end MEASUREMENT
/begin MEASUREMENT rba_TrapLog_Reg_st[2].DOM0_ERRx_u32 "Saved register list[2]/DOM0_ERRx" ULONG RB_RBA_rba_TrapLog_CompuMethods_rba_TrapLog_oneToOne 1 100 0.0 4.E9 FORMAT "%32.0" ECU_ADDRESS 0x60035E38 /end MEASUREMENT
/begin MEASUREMENT rba_TrapLog_Reg_st[3].DOM0_ERRx_u32 "Saved register list[3]/DOM0_ERRx" ULONG RB_RBA_rba_TrapLog_CompuMethods_rba_TrapLog_oneToOne 1 100 0.0 4.E9 FORMAT "%32.0" ECU_ADDRESS 0x60035EE8 /end MEASUREMENT
/begin MEASUREMENT rba_TrapLog_Reg_st[4].DOM0_ERRx_u32 "Saved register list[4]/DOM0_ERRx" ULONG RB_RBA_rba_TrapLog_CompuMethods_rba_TrapLog_oneToOne 1 100 0.0 4.E9 FORMAT "%32.0" ECU_ADDRESS 0x60035F98 /end MEASUREMENT
/begin MEASUREMENT rba_TrapLog_Reg_st[5].DOM0_ERRx_u32 "Saved register list[5]/DOM0_ERRx" ULONG RB_RBA_rba_TrapLog_CompuMethods_rba_TrapLog_oneToOne 1 100 0.0 4.E9 FORMAT "%32.0" ECU_ADDRESS 0x60036048 /end MEASUREMENT
/begin MEASUREMENT rba_TrapLog_Reg_st[0].DOM0_PESTAT_u32 "Saved register list[0]/DOM0_PESTAT" ULONG RB_RBA_rba_TrapLog_CompuMethods_rba_TrapLog_oneToOne 1 100 0.0 4.E9 FORMAT "%32.0" ECU_ADDRESS 0x60035CDC /end MEASUREMENT
/begin MEASUREMENT rba_TrapLog_Reg_st[1].DOM0_PESTAT_u32 "Saved register list[1]/DOM0_PESTAT" ULONG RB_RBA_rba_TrapLog_CompuMethods_rba_TrapLog_oneToOne 1 100 0.0 4.E9 FORMAT "%32.0" ECU_ADDRESS 0x60035D8C /end MEASUREMENT
/begin MEASUREMENT rba_TrapLog_Reg_st[2].DOM0_PESTAT_u32 "Saved register list[2]/DOM0_PESTAT" ULONG RB_RBA_rba_TrapLog_CompuMethods_rba_TrapLog_oneToOne 1 100 0.0 4.E9 FORMAT "%32.0" ECU_ADDRESS 0x60035E3C /end MEASUREMENT
/begin MEASUREMENT rba_TrapLog_Reg_st[3].DOM0_PESTAT_u32 "Saved register list[3]/DOM0_PESTAT" ULONG RB_RBA_rba_TrapLog_CompuMethods_rba_TrapLog_oneToOne 1 100 0.0 4.E9 FORMAT "%32.0" ECU_ADDRESS 0x60035EEC /end MEASUREMENT
/begin MEASUREMENT rba_TrapLog_Reg_st[4].DOM0_PESTAT_u32 "Saved register list[4]/DOM0_PESTAT" ULONG RB_RBA_rba_TrapLog_CompuMethods_rba_TrapLog_oneToOne 1 100 0.0 4.E9 FORMAT "%32.0" ECU_ADDRESS 0x60035F9C /end MEASUREMENT
/begin MEASUREMENT rba_TrapLog_Reg_st[5].DOM0_PESTAT_u32 "Saved register list[5]/DOM0_PESTAT" ULONG RB_RBA_rba_TrapLog_CompuMethods_rba_TrapLog_oneToOne 1 100 0.0 4.E9 FORMAT "%32.0" ECU_ADDRESS 0x6003604C /end MEASUREMENT
/begin MEASUREMENT rba_TrapLog_Reg_st[0].DOM0_TIDSTAT_u32 "Saved register list[0]/DOM0_TIDSTAT" ULONG RB_RBA_rba_TrapLog_CompuMethods_rba_TrapLog_oneToOne 1 100 0.0 4.E9 FORMAT "%32.0" ECU_ADDRESS 0x60035CE0 /end MEASUREMENT
/begin MEASUREMENT rba_TrapLog_Reg_st[1].DOM0_TIDSTAT_u32 "Saved register list[1]/DOM0_TIDSTAT" ULONG RB_RBA_rba_TrapLog_CompuMethods_rba_TrapLog_oneToOne 1 100 0.0 4.E9 FORMAT "%32.0" ECU_ADDRESS 0x60035D90 /end MEASUREMENT
/begin MEASUREMENT rba_TrapLog_Reg_st[2].DOM0_TIDSTAT_u32 "Saved register list[2]/DOM0_TIDSTAT" ULONG RB_RBA_rba_TrapLog_CompuMethods_rba_TrapLog_oneToOne 1 100 0.0 4.E9 FORMAT "%32.0" ECU_ADDRESS 0x60035E40 /end MEASUREMENT
/begin MEASUREMENT rba_TrapLog_Reg_st[3].DOM0_TIDSTAT_u32 "Saved register list[3]/DOM0_TIDSTAT" ULONG RB_RBA_rba_TrapLog_CompuMethods_rba_TrapLog_oneToOne 1 100 0.0 4.E9 FORMAT "%32.0" ECU_ADDRESS 0x60035EF0 /end MEASUREMENT
/begin MEASUREMENT rba_TrapLog_Reg_st[4].DOM0_TIDSTAT_u32 "Saved register list[4]/DOM0_TIDSTAT" ULONG RB_RBA_rba_TrapLog_CompuMethods_rba_TrapLog_oneToOne 1 100 0.0 4.E9 FORMAT "%32.0" ECU_ADDRESS 0x60035FA0 /end MEASUREMENT
/begin MEASUREMENT rba_TrapLog_Reg_st[5].DOM0_TIDSTAT_u32 "Saved register list[5]/DOM0_TIDSTAT" ULONG RB_RBA_rba_TrapLog_CompuMethods_rba_TrapLog_oneToOne 1 100 0.0 4.E9 FORMAT "%32.0" ECU_ADDRESS 0x60036050 /end MEASUREMENT
/begin MEASUREMENT rba_TrapLog_Reg_st[0].PFI0_MBABRECORD0_u32 "Saved register list[0]/PFI0_MBABRECORD0" ULONG RB_RBA_rba_TrapLog_CompuMethods_rba_TrapLog_oneToOne 1 100 0.0 4.E9 FORMAT "%32.0" ECU_ADDRESS 0x60035CE4 /end MEASUREMENT
/begin MEASUREMENT rba_TrapLog_Reg_st[1].PFI0_MBABRECORD0_u32 "Saved register list[1]/PFI0_MBABRECORD0" ULONG RB_RBA_rba_TrapLog_CompuMethods_rba_TrapLog_oneToOne 1 100 0.0 4.E9 FORMAT "%32.0" ECU_ADDRESS 0x60035D94 /end MEASUREMENT
/begin MEASUREMENT rba_TrapLog_Reg_st[2].PFI0_MBABRECORD0_u32 "Saved register list[2]/PFI0_MBABRECORD0" ULONG RB_RBA_rba_TrapLog_CompuMethods_rba_TrapLog_oneToOne 1 100 0.0 4.E9 FORMAT "%32.0" ECU_ADDRESS 0x60035E44 /end MEASUREMENT
/begin MEASUREMENT rba_TrapLog_Reg_st[3].PFI0_MBABRECORD0_u32 "Saved register list[3]/PFI0_MBABRECORD0" ULONG RB_RBA_rba_TrapLog_CompuMethods_rba_TrapLog_oneToOne 1 100 0.0 4.E9 FORMAT "%32.0" ECU_ADDRESS 0x60035EF4 /end MEASUREMENT
/begin MEASUREMENT rba_TrapLog_Reg_st[4].PFI0_MBABRECORD0_u32 "Saved register list[4]/PFI0_MBABRECORD0" ULONG RB_RBA_rba_TrapLog_CompuMethods_rba_TrapLog_oneToOne 1 100 0.0 4.E9 FORMAT "%32.0" ECU_ADDRESS 0x60035FA4 /end MEASUREMENT
/begin MEASUREMENT rba_TrapLog_Reg_st[5].PFI0_MBABRECORD0_u32 "Saved register list[5]/PFI0_MBABRECORD0" ULONG RB_RBA_rba_TrapLog_CompuMethods_rba_TrapLog_oneToOne 1 100 0.0 4.E9 FORMAT "%32.0" ECU_ADDRESS 0x60036054 /end MEASUREMENT
/begin MEASUREMENT rba_TrapLog_Reg_st[0].PFI1_MBABRECORD0_u32 "Saved register list[0]/PFI1_MBABRECORD0" ULONG RB_RBA_rba_TrapLog_CompuMethods_rba_TrapLog_oneToOne 1 100 0.0 4.E9 FORMAT "%32.0" ECU_ADDRESS 0x60035CE8 /end MEASUREMENT
/begin MEASUREMENT rba_TrapLog_Reg_st[1].PFI1_MBABRECORD0_u32 "Saved register list[1]/PFI1_MBABRECORD0" ULONG RB_RBA_rba_TrapLog_CompuMethods_rba_TrapLog_oneToOne 1 100 0.0 4.E9 FORMAT "%32.0" ECU_ADDRESS 0x60035D98 /end MEASUREMENT
/begin MEASUREMENT rba_TrapLog_Reg_st[2].PFI1_MBABRECORD0_u32 "Saved register list[2]/PFI1_MBABRECORD0" ULONG RB_RBA_rba_TrapLog_CompuMethods_rba_TrapLog_oneToOne 1 100 0.0 4.E9 FORMAT "%32.0" ECU_ADDRESS 0x60035E48 /end MEASUREMENT
/begin MEASUREMENT rba_TrapLog_Reg_st[3].PFI1_MBABRECORD0_u32 "Saved register list[3]/PFI1_MBABRECORD0" ULONG RB_RBA_rba_TrapLog_CompuMethods_rba_TrapLog_oneToOne 1 100 0.0 4.E9 FORMAT "%32.0" ECU_ADDRESS 0x60035EF8 /end MEASUREMENT
/begin MEASUREMENT rba_TrapLog_Reg_st[4].PFI1_MBABRECORD0_u32 "Saved register list[4]/PFI1_MBABRECORD0" ULONG RB_RBA_rba_TrapLog_CompuMethods_rba_TrapLog_oneToOne 1 100 0.0 4.E9 FORMAT "%32.0" ECU_ADDRESS 0x60035FA8 /end MEASUREMENT
/begin MEASUREMENT rba_TrapLog_Reg_st[5].PFI1_MBABRECORD0_u32 "Saved register list[5]/PFI1_MBABRECORD0" ULONG RB_RBA_rba_TrapLog_CompuMethods_rba_TrapLog_oneToOne 1 100 0.0 4.E9 FORMAT "%32.0" ECU_ADDRESS 0x60036058 /end MEASUREMENT
/begin MEASUREMENT rba_TrapLog_Reg_st[0].SBCU_ECON_u32 "Saved register list[0]/SBCU_ECON" ULONG RB_RBA_rba_TrapLog_CompuMethods_rba_TrapLog_oneToOne 1 100 0.0 4.E9 FORMAT "%32.0" ECU_ADDRESS 0x60035CEC /end MEASUREMENT
/begin MEASUREMENT rba_TrapLog_Reg_st[1].SBCU_ECON_u32 "Saved register list[1]/SBCU_ECON" ULONG RB_RBA_rba_TrapLog_CompuMethods_rba_TrapLog_oneToOne 1 100 0.0 4.E9 FORMAT "%32.0" ECU_ADDRESS 0x60035D9C /end MEASUREMENT
/begin MEASUREMENT rba_TrapLog_Reg_st[2].SBCU_ECON_u32 "Saved register list[2]/SBCU_ECON" ULONG RB_RBA_rba_TrapLog_CompuMethods_rba_TrapLog_oneToOne 1 100 0.0 4.E9 FORMAT "%32.0" ECU_ADDRESS 0x60035E4C /end MEASUREMENT
/begin MEASUREMENT rba_TrapLog_Reg_st[3].SBCU_ECON_u32 "Saved register list[3]/SBCU_ECON" ULONG RB_RBA_rba_TrapLog_CompuMethods_rba_TrapLog_oneToOne 1 100 0.0 4.E9 FORMAT "%32.0" ECU_ADDRESS 0x60035EFC /end MEASUREMENT
/begin MEASUREMENT rba_TrapLog_Reg_st[4].SBCU_ECON_u32 "Saved register list[4]/SBCU_ECON" ULONG RB_RBA_rba_TrapLog_CompuMethods_rba_TrapLog_oneToOne 1 100 0.0 4.E9 FORMAT "%32.0" ECU_ADDRESS 0x60035FAC /end MEASUREMENT
/begin MEASUREMENT rba_TrapLog_Reg_st[5].SBCU_ECON_u32 "Saved register list[5]/SBCU_ECON" ULONG RB_RBA_rba_TrapLog_CompuMethods_rba_TrapLog_oneToOne 1 100 0.0 4.E9 FORMAT "%32.0" ECU_ADDRESS 0x6003605C /end MEASUREMENT
/begin MEASUREMENT rba_TrapLog_Reg_st[0].SBCU_EDAT_u32 "Saved register list[0]/SBCU_EDAT" ULONG RB_RBA_rba_TrapLog_CompuMethods_rba_TrapLog_oneToOne 1 100 0.0 4.E9 FORMAT "%32.0" ECU_ADDRESS 0x60035CF0 /end MEASUREMENT
/begin MEASUREMENT rba_TrapLog_Reg_st[1].SBCU_EDAT_u32 "Saved register list[1]/SBCU_EDAT" ULONG RB_RBA_rba_TrapLog_CompuMethods_rba_TrapLog_oneToOne 1 100 0.0 4.E9 FORMAT "%32.0" ECU_ADDRESS 0x60035DA0 /end MEASUREMENT
/begin MEASUREMENT rba_TrapLog_Reg_st[2].SBCU_EDAT_u32 "Saved register list[2]/SBCU_EDAT" ULONG RB_RBA_rba_TrapLog_CompuMethods_rba_TrapLog_oneToOne 1 100 0.0 4.E9 FORMAT "%32.0" ECU_ADDRESS 0x60035E50 /end MEASUREMENT
/begin MEASUREMENT rba_TrapLog_Reg_st[3].SBCU_EDAT_u32 "Saved register list[3]/SBCU_EDAT" ULONG RB_RBA_rba_TrapLog_CompuMethods_rba_TrapLog_oneToOne 1 100 0.0 4.E9 FORMAT "%32.0" ECU_ADDRESS 0x60035F00 /end MEASUREMENT
/begin MEASUREMENT rba_TrapLog_Reg_st[4].SBCU_EDAT_u32 "Saved register list[4]/SBCU_EDAT" ULONG RB_RBA_rba_TrapLog_CompuMethods_rba_TrapLog_oneToOne 1 100 0.0 4.E9 FORMAT "%32.0" ECU_ADDRESS 0x60035FB0 /end MEASUREMENT
/begin MEASUREMENT rba_TrapLog_Reg_st[5].SBCU_EDAT_u32 "Saved register list[5]/SBCU_EDAT" ULONG RB_RBA_rba_TrapLog_CompuMethods_rba_TrapLog_oneToOne 1 100 0.0 4.E9 FORMAT "%32.0" ECU_ADDRESS 0x60036060 /end MEASUREMENT
/begin MEASUREMENT rba_TrapLog_Reg_st[0].SBCU_EADD_u32 "Saved register list[0]/SBCU_EADD" ULONG RB_RBA_rba_TrapLog_CompuMethods_rba_TrapLog_oneToOne 1 100 0.0 4.E9 FORMAT "%32.0" ECU_ADDRESS 0x60035CF4 /end MEASUREMENT
/begin MEASUREMENT rba_TrapLog_Reg_st[1].SBCU_EADD_u32 "Saved register list[1]/SBCU_EADD" ULONG RB_RBA_rba_TrapLog_CompuMethods_rba_TrapLog_oneToOne 1 100 0.0 4.E9 FORMAT "%32.0" ECU_ADDRESS 0x60035DA4 /end MEASUREMENT
/begin MEASUREMENT rba_TrapLog_Reg_st[2].SBCU_EADD_u32 "Saved register list[2]/SBCU_EADD" ULONG RB_RBA_rba_TrapLog_CompuMethods_rba_TrapLog_oneToOne 1 100 0.0 4.E9 FORMAT "%32.0" ECU_ADDRESS 0x60035E54 /end MEASUREMENT
/begin MEASUREMENT rba_TrapLog_Reg_st[3].SBCU_EADD_u32 "Saved register list[3]/SBCU_EADD" ULONG RB_RBA_rba_TrapLog_CompuMethods_rba_TrapLog_oneToOne 1 100 0.0 4.E9 FORMAT "%32.0" ECU_ADDRESS 0x60035F04 /end MEASUREMENT
/begin MEASUREMENT rba_TrapLog_Reg_st[4].SBCU_EADD_u32 "Saved register list[4]/SBCU_EADD" ULONG RB_RBA_rba_TrapLog_CompuMethods_rba_TrapLog_oneToOne 1 100 0.0 4.E9 FORMAT "%32.0" ECU_ADDRESS 0x60035FB4 /end MEASUREMENT
/begin MEASUREMENT rba_TrapLog_Reg_st[5].SBCU_EADD_u32 "Saved register list[5]/SBCU_EADD" ULONG RB_RBA_rba_TrapLog_CompuMethods_rba_TrapLog_oneToOne 1 100 0.0 4.E9 FORMAT "%32.0" ECU_ADDRESS 0x60036064 /end MEASUREMENT
/begin MEASUREMENT rba_TrapLog_Reg_st[0].SYS_TIME_u32 "Saved register list[0]/SYS_TIME" ULONG RB_RBA_rba_TrapLog_CompuMethods_rba_TrapLog_oneToOne 1 100 0.0 4.E9 FORMAT "%32.0" ECU_ADDRESS 0x60035CF8 /end MEASUREMENT
/begin MEASUREMENT rba_TrapLog_Reg_st[1].SYS_TIME_u32 "Saved register list[1]/SYS_TIME" ULONG RB_RBA_rba_TrapLog_CompuMethods_rba_TrapLog_oneToOne 1 100 0.0 4.E9 FORMAT "%32.0" ECU_ADDRESS 0x60035DA8 /end MEASUREMENT
/begin MEASUREMENT rba_TrapLog_Reg_st[2].SYS_TIME_u32 "Saved register list[2]/SYS_TIME" ULONG RB_RBA_rba_TrapLog_CompuMethods_rba_TrapLog_oneToOne 1 100 0.0 4.E9 FORMAT "%32.0" ECU_ADDRESS 0x60035E58 /end MEASUREMENT
/begin MEASUREMENT rba_TrapLog_Reg_st[3].SYS_TIME_u32 "Saved register list[3]/SYS_TIME" ULONG RB_RBA_rba_TrapLog_CompuMethods_rba_TrapLog_oneToOne 1 100 0.0 4.E9 FORMAT "%32.0" ECU_ADDRESS 0x60035F08 /end MEASUREMENT
/begin MEASUREMENT rba_TrapLog_Reg_st[4].SYS_TIME_u32 "Saved register list[4]/SYS_TIME" ULONG RB_RBA_rba_TrapLog_CompuMethods_rba_TrapLog_oneToOne 1 100 0.0 4.E9 FORMAT "%32.0" ECU_ADDRESS 0x60035FB8 /end MEASUREMENT
/begin MEASUREMENT rba_TrapLog_Reg_st[5].SYS_TIME_u32 "Saved register list[5]/SYS_TIME" ULONG RB_RBA_rba_TrapLog_CompuMethods_rba_TrapLog_oneToOne 1 100 0.0 4.E9 FORMAT "%32.0" ECU_ADDRESS 0x60036068 /end MEASUREMENT
/begin MEASUREMENT rba_TrapLog_Reg_st[0].CHIP_ID_u32 "Saved register list[0]/CHIP_ID" ULONG RB_RBA_rba_TrapLog_CompuMethods_rba_TrapLog_oneToOne 1 100 0.0 4.E9 FORMAT "%32.0" ECU_ADDRESS 0x60035CFC /end MEASUREMENT
/begin MEASUREMENT rba_TrapLog_Reg_st[1].CHIP_ID_u32 "Saved register list[1]/CHIP_ID" ULONG RB_RBA_rba_TrapLog_CompuMethods_rba_TrapLog_oneToOne 1 100 0.0 4.E9 FORMAT "%32.0" ECU_ADDRESS 0x60035DAC /end MEASUREMENT
/begin MEASUREMENT rba_TrapLog_Reg_st[2].CHIP_ID_u32 "Saved register list[2]/CHIP_ID" ULONG RB_RBA_rba_TrapLog_CompuMethods_rba_TrapLog_oneToOne 1 100 0.0 4.E9 FORMAT "%32.0" ECU_ADDRESS 0x60035E5C /end MEASUREMENT
/begin MEASUREMENT rba_TrapLog_Reg_st[3].CHIP_ID_u32 "Saved register list[3]/CHIP_ID" ULONG RB_RBA_rba_TrapLog_CompuMethods_rba_TrapLog_oneToOne 1 100 0.0 4.E9 FORMAT "%32.0" ECU_ADDRESS 0x60035F0C /end MEASUREMENT
/begin MEASUREMENT rba_TrapLog_Reg_st[4].CHIP_ID_u32 "Saved register list[4]/CHIP_ID" ULONG RB_RBA_rba_TrapLog_CompuMethods_rba_TrapLog_oneToOne 1 100 0.0 4.E9 FORMAT "%32.0" ECU_ADDRESS 0x60035FBC /end MEASUREMENT
/begin MEASUREMENT rba_TrapLog_Reg_st[5].CHIP_ID_u32 "Saved register list[5]/CHIP_ID" ULONG RB_RBA_rba_TrapLog_CompuMethods_rba_TrapLog_oneToOne 1 100 0.0 4.E9 FORMAT "%32.0" ECU_ADDRESS 0x6003606C /end MEASUREMENT
/begin MEASUREMENT rba_TrapLog_Reg_st[0].BCU_ALSTAT0_u32 "Saved register list[0]/BCU_ALSTAT0" ULONG RB_RBA_rba_TrapLog_CompuMethods_rba_TrapLog_oneToOne 1 100 0.0 4.E9 FORMAT "%32.0" ECU_ADDRESS 0x60035D00 /end MEASUREMENT
/begin MEASUREMENT rba_TrapLog_Reg_st[1].BCU_ALSTAT0_u32 "Saved register list[1]/BCU_ALSTAT0" ULONG RB_RBA_rba_TrapLog_CompuMethods_rba_TrapLog_oneToOne 1 100 0.0 4.E9 FORMAT "%32.0" ECU_ADDRESS 0x60035DB0 /end MEASUREMENT
/begin MEASUREMENT rba_TrapLog_Reg_st[2].BCU_ALSTAT0_u32 "Saved register list[2]/BCU_ALSTAT0" ULONG RB_RBA_rba_TrapLog_CompuMethods_rba_TrapLog_oneToOne 1 100 0.0 4.E9 FORMAT "%32.0" ECU_ADDRESS 0x60035E60 /end MEASUREMENT
/begin MEASUREMENT rba_TrapLog_Reg_st[3].BCU_ALSTAT0_u32 "Saved register list[3]/BCU_ALSTAT0" ULONG RB_RBA_rba_TrapLog_CompuMethods_rba_TrapLog_oneToOne 1 100 0.0 4.E9 FORMAT "%32.0" ECU_ADDRESS 0x60035F10 /end MEASUREMENT
/begin MEASUREMENT rba_TrapLog_Reg_st[4].BCU_ALSTAT0_u32 "Saved register list[4]/BCU_ALSTAT0" ULONG RB_RBA_rba_TrapLog_CompuMethods_rba_TrapLog_oneToOne 1 100 0.0 4.E9 FORMAT "%32.0" ECU_ADDRESS 0x60035FC0 /end MEASUREMENT
/begin MEASUREMENT rba_TrapLog_Reg_st[5].BCU_ALSTAT0_u32 "Saved register list[5]/BCU_ALSTAT0" ULONG RB_RBA_rba_TrapLog_CompuMethods_rba_TrapLog_oneToOne 1 100 0.0 4.E9 FORMAT "%32.0" ECU_ADDRESS 0x60036070 /end MEASUREMENT
/begin MEASUREMENT rba_TrapLog_Reg_st[0].BCU_ALSTAT1_u32 "Saved register list[0]/BCU_ALSTAT1" ULONG RB_RBA_rba_TrapLog_CompuMethods_rba_TrapLog_oneToOne 1 100 0.0 4.E9 FORMAT "%32.0" ECU_ADDRESS 0x60035D04 /end MEASUREMENT
/begin MEASUREMENT rba_TrapLog_Reg_st[1].BCU_ALSTAT1_u32 "Saved register list[1]/BCU_ALSTAT1" ULONG RB_RBA_rba_TrapLog_CompuMethods_rba_TrapLog_oneToOne 1 100 0.0 4.E9 FORMAT "%32.0" ECU_ADDRESS 0x60035DB4 /end MEASUREMENT
/begin MEASUREMENT rba_TrapLog_Reg_st[2].BCU_ALSTAT1_u32 "Saved register list[2]/BCU_ALSTAT1" ULONG RB_RBA_rba_TrapLog_CompuMethods_rba_TrapLog_oneToOne 1 100 0.0 4.E9 FORMAT "%32.0" ECU_ADDRESS 0x60035E64 /end MEASUREMENT
/begin MEASUREMENT rba_TrapLog_Reg_st[3].BCU_ALSTAT1_u32 "Saved register list[3]/BCU_ALSTAT1" ULONG RB_RBA_rba_TrapLog_CompuMethods_rba_TrapLog_oneToOne 1 100 0.0 4.E9 FORMAT "%32.0" ECU_ADDRESS 0x60035F14 /end MEASUREMENT
/begin MEASUREMENT rba_TrapLog_Reg_st[4].BCU_ALSTAT1_u32 "Saved register list[4]/BCU_ALSTAT1" ULONG RB_RBA_rba_TrapLog_CompuMethods_rba_TrapLog_oneToOne 1 100 0.0 4.E9 FORMAT "%32.0" ECU_ADDRESS 0x60035FC4 /end MEASUREMENT
/begin MEASUREMENT rba_TrapLog_Reg_st[5].BCU_ALSTAT1_u32 "Saved register list[5]/BCU_ALSTAT1" ULONG RB_RBA_rba_TrapLog_CompuMethods_rba_TrapLog_oneToOne 1 100 0.0 4.E9 FORMAT "%32.0" ECU_ADDRESS 0x60036074 /end MEASUREMENT
/begin MEASUREMENT rba_TrapLog_Reg_st[0].BCU_ALSTAT2_u32 "Saved register list[0]/BCU_ALSTAT2" ULONG RB_RBA_rba_TrapLog_CompuMethods_rba_TrapLog_oneToOne 1 100 0.0 4.E9 FORMAT "%32.0" ECU_ADDRESS 0x60035D08 /end MEASUREMENT
/begin MEASUREMENT rba_TrapLog_Reg_st[1].BCU_ALSTAT2_u32 "Saved register list[1]/BCU_ALSTAT2" ULONG RB_RBA_rba_TrapLog_CompuMethods_rba_TrapLog_oneToOne 1 100 0.0 4.E9 FORMAT "%32.0" ECU_ADDRESS 0x60035DB8 /end MEASUREMENT
/begin MEASUREMENT rba_TrapLog_Reg_st[2].BCU_ALSTAT2_u32 "Saved register list[2]/BCU_ALSTAT2" ULONG RB_RBA_rba_TrapLog_CompuMethods_rba_TrapLog_oneToOne 1 100 0.0 4.E9 FORMAT "%32.0" ECU_ADDRESS 0x60035E68 /end MEASUREMENT
/begin MEASUREMENT rba_TrapLog_Reg_st[3].BCU_ALSTAT2_u32 "Saved register list[3]/BCU_ALSTAT2" ULONG RB_RBA_rba_TrapLog_CompuMethods_rba_TrapLog_oneToOne 1 100 0.0 4.E9 FORMAT "%32.0" ECU_ADDRESS 0x60035F18 /end MEASUREMENT
/begin MEASUREMENT rba_TrapLog_Reg_st[4].BCU_ALSTAT2_u32 "Saved register list[4]/BCU_ALSTAT2" ULONG RB_RBA_rba_TrapLog_CompuMethods_rba_TrapLog_oneToOne 1 100 0.0 4.E9 FORMAT "%32.0" ECU_ADDRESS 0x60035FC8 /end MEASUREMENT
/begin MEASUREMENT rba_TrapLog_Reg_st[5].BCU_ALSTAT2_u32 "Saved register list[5]/BCU_ALSTAT2" ULONG RB_RBA_rba_TrapLog_CompuMethods_rba_TrapLog_oneToOne 1 100 0.0 4.E9 FORMAT "%32.0" ECU_ADDRESS 0x60036078 /end MEASUREMENT
/begin MEASUREMENT rba_TrapLog_Reg_st[0].BCU_ALSTAT3_u32 "Saved register list[0]/BCU_ALSTAT3" ULONG RB_RBA_rba_TrapLog_CompuMethods_rba_TrapLog_oneToOne 1 100 0.0 4.E9 FORMAT "%32.0" ECU_ADDRESS 0x60035D0C /end MEASUREMENT
/begin MEASUREMENT rba_TrapLog_Reg_st[1].BCU_ALSTAT3_u32 "Saved register list[1]/BCU_ALSTAT3" ULONG RB_RBA_rba_TrapLog_CompuMethods_rba_TrapLog_oneToOne 1 100 0.0 4.E9 FORMAT "%32.0" ECU_ADDRESS 0x60035DBC /end MEASUREMENT
/begin MEASUREMENT rba_TrapLog_Reg_st[2].BCU_ALSTAT3_u32 "Saved register list[2]/BCU_ALSTAT3" ULONG RB_RBA_rba_TrapLog_CompuMethods_rba_TrapLog_oneToOne 1 100 0.0 4.E9 FORMAT "%32.0" ECU_ADDRESS 0x60035E6C /end MEASUREMENT
/begin MEASUREMENT rba_TrapLog_Reg_st[3].BCU_ALSTAT3_u32 "Saved register list[3]/BCU_ALSTAT3" ULONG RB_RBA_rba_TrapLog_CompuMethods_rba_TrapLog_oneToOne 1 100 0.0 4.E9 FORMAT "%32.0" ECU_ADDRESS 0x60035F1C /end MEASUREMENT
/begin MEASUREMENT rba_TrapLog_Reg_st[4].BCU_ALSTAT3_u32 "Saved register list[4]/BCU_ALSTAT3" ULONG RB_RBA_rba_TrapLog_CompuMethods_rba_TrapLog_oneToOne 1 100 0.0 4.E9 FORMAT "%32.0" ECU_ADDRESS 0x60035FCC /end MEASUREMENT
/begin MEASUREMENT rba_TrapLog_Reg_st[5].BCU_ALSTAT3_u32 "Saved register list[5]/BCU_ALSTAT3" ULONG RB_RBA_rba_TrapLog_CompuMethods_rba_TrapLog_oneToOne 1 100 0.0 4.E9 FORMAT "%32.0" ECU_ADDRESS 0x6003607C /end MEASUREMENT
/begin MEASUREMENT rba_TrapLog_Reg_st[0].SCU_DTSCSTAT_u32 "Saved register list[0]/SCU_DTSCSTAT" ULONG RB_RBA_rba_TrapLog_CompuMethods_rba_TrapLog_oneToOne 1 100 0.0 4.E9 FORMAT "%32.0" ECU_ADDRESS 0x60035D10 /end MEASUREMENT
/begin MEASUREMENT rba_TrapLog_Reg_st[1].SCU_DTSCSTAT_u32 "Saved register list[1]/SCU_DTSCSTAT" ULONG RB_RBA_rba_TrapLog_CompuMethods_rba_TrapLog_oneToOne 1 100 0.0 4.E9 FORMAT "%32.0" ECU_ADDRESS 0x60035DC0 /end MEASUREMENT
/begin MEASUREMENT rba_TrapLog_Reg_st[2].SCU_DTSCSTAT_u32 "Saved register list[2]/SCU_DTSCSTAT" ULONG RB_RBA_rba_TrapLog_CompuMethods_rba_TrapLog_oneToOne 1 100 0.0 4.E9 FORMAT "%32.0" ECU_ADDRESS 0x60035E70 /end MEASUREMENT
/begin MEASUREMENT rba_TrapLog_Reg_st[3].SCU_DTSCSTAT_u32 "Saved register list[3]/SCU_DTSCSTAT" ULONG RB_RBA_rba_TrapLog_CompuMethods_rba_TrapLog_oneToOne 1 100 0.0 4.E9 FORMAT "%32.0" ECU_ADDRESS 0x60035F20 /end MEASUREMENT
/begin MEASUREMENT rba_TrapLog_Reg_st[4].SCU_DTSCSTAT_u32 "Saved register list[4]/SCU_DTSCSTAT" ULONG RB_RBA_rba_TrapLog_CompuMethods_rba_TrapLog_oneToOne 1 100 0.0 4.E9 FORMAT "%32.0" ECU_ADDRESS 0x60035FD0 /end MEASUREMENT
/begin MEASUREMENT rba_TrapLog_Reg_st[5].SCU_DTSCSTAT_u32 "Saved register list[5]/SCU_DTSCSTAT" ULONG RB_RBA_rba_TrapLog_CompuMethods_rba_TrapLog_oneToOne 1 100 0.0 4.E9 FORMAT "%32.0" ECU_ADDRESS 0x60036080 /end MEASUREMENT
/begin MEASUREMENT rba_TrapLog_Reg_st[0].SCU_DTSCLIM_u32 "Saved register list[0]/SCU_DTSCLIM" ULONG RB_RBA_rba_TrapLog_CompuMethods_rba_TrapLog_oneToOne 1 100 0.0 4.E9 FORMAT "%32.0" ECU_ADDRESS 0x60035D14 /end MEASUREMENT
/begin MEASUREMENT rba_TrapLog_Reg_st[1].SCU_DTSCLIM_u32 "Saved register list[1]/SCU_DTSCLIM" ULONG RB_RBA_rba_TrapLog_CompuMethods_rba_TrapLog_oneToOne 1 100 0.0 4.E9 FORMAT "%32.0" ECU_ADDRESS 0x60035DC4 /end MEASUREMENT
/begin MEASUREMENT rba_TrapLog_Reg_st[2].SCU_DTSCLIM_u32 "Saved register list[2]/SCU_DTSCLIM" ULONG RB_RBA_rba_TrapLog_CompuMethods_rba_TrapLog_oneToOne 1 100 0.0 4.E9 FORMAT "%32.0" ECU_ADDRESS 0x60035E74 /end MEASUREMENT
/begin MEASUREMENT rba_TrapLog_Reg_st[3].SCU_DTSCLIM_u32 "Saved register list[3]/SCU_DTSCLIM" ULONG RB_RBA_rba_TrapLog_CompuMethods_rba_TrapLog_oneToOne 1 100 0.0 4.E9 FORMAT "%32.0" ECU_ADDRESS 0x60035F24 /end MEASUREMENT
/begin MEASUREMENT rba_TrapLog_Reg_st[4].SCU_DTSCLIM_u32 "Saved register list[4]/SCU_DTSCLIM" ULONG RB_RBA_rba_TrapLog_CompuMethods_rba_TrapLog_oneToOne 1 100 0.0 4.E9 FORMAT "%32.0" ECU_ADDRESS 0x60035FD4 /end MEASUREMENT
/begin MEASUREMENT rba_TrapLog_Reg_st[5].SCU_DTSCLIM_u32 "Saved register list[5]/SCU_DTSCLIM" ULONG RB_RBA_rba_TrapLog_CompuMethods_rba_TrapLog_oneToOne 1 100 0.0 4.E9 FORMAT "%32.0" ECU_ADDRESS 0x60036084 /end MEASUREMENT
/begin MEASUREMENT rba_TrapLog_Reg_st[0].PMS_DTSLIM_u32 "Saved register list[0]/PMS_DTSLIM" ULONG RB_RBA_rba_TrapLog_CompuMethods_rba_TrapLog_oneToOne 1 100 0.0 4.E9 FORMAT "%32.0" ECU_ADDRESS 0x60035D18 /end MEASUREMENT
/begin MEASUREMENT rba_TrapLog_Reg_st[1].PMS_DTSLIM_u32 "Saved register list[1]/PMS_DTSLIM" ULONG RB_RBA_rba_TrapLog_CompuMethods_rba_TrapLog_oneToOne 1 100 0.0 4.E9 FORMAT "%32.0" ECU_ADDRESS 0x60035DC8 /end MEASUREMENT
/begin MEASUREMENT rba_TrapLog_Reg_st[2].PMS_DTSLIM_u32 "Saved register list[2]/PMS_DTSLIM" ULONG RB_RBA_rba_TrapLog_CompuMethods_rba_TrapLog_oneToOne 1 100 0.0 4.E9 FORMAT "%32.0" ECU_ADDRESS 0x60035E78 /end MEASUREMENT
/begin MEASUREMENT rba_TrapLog_Reg_st[3].PMS_DTSLIM_u32 "Saved register list[3]/PMS_DTSLIM" ULONG RB_RBA_rba_TrapLog_CompuMethods_rba_TrapLog_oneToOne 1 100 0.0 4.E9 FORMAT "%32.0" ECU_ADDRESS 0x60035F28 /end MEASUREMENT
/begin MEASUREMENT rba_TrapLog_Reg_st[4].PMS_DTSLIM_u32 "Saved register list[4]/PMS_DTSLIM" ULONG RB_RBA_rba_TrapLog_CompuMethods_rba_TrapLog_oneToOne 1 100 0.0 4.E9 FORMAT "%32.0" ECU_ADDRESS 0x60035FD8 /end MEASUREMENT
/begin MEASUREMENT rba_TrapLog_Reg_st[5].PMS_DTSLIM_u32 "Saved register list[5]/PMS_DTSLIM" ULONG RB_RBA_rba_TrapLog_CompuMethods_rba_TrapLog_oneToOne 1 100 0.0 4.E9 FORMAT "%32.0" ECU_ADDRESS 0x60036088 /end MEASUREMENT
/begin MEASUREMENT rba_TrapLog_Reg_st[0].PMS_DTSSTAT_u32 "Saved register list[0]/PMS_DTSSTAT" ULONG RB_RBA_rba_TrapLog_CompuMethods_rba_TrapLog_oneToOne 1 100 0.0 4.E9 FORMAT "%32.0" ECU_ADDRESS 0x60035D1C /end MEASUREMENT
/begin MEASUREMENT rba_TrapLog_Reg_st[1].PMS_DTSSTAT_u32 "Saved register list[1]/PMS_DTSSTAT" ULONG RB_RBA_rba_TrapLog_CompuMethods_rba_TrapLog_oneToOne 1 100 0.0 4.E9 FORMAT "%32.0" ECU_ADDRESS 0x60035DCC /end MEASUREMENT
/begin MEASUREMENT rba_TrapLog_Reg_st[2].PMS_DTSSTAT_u32 "Saved register list[2]/PMS_DTSSTAT" ULONG RB_RBA_rba_TrapLog_CompuMethods_rba_TrapLog_oneToOne 1 100 0.0 4.E9 FORMAT "%32.0" ECU_ADDRESS 0x60035E7C /end MEASUREMENT
/begin MEASUREMENT rba_TrapLog_Reg_st[3].PMS_DTSSTAT_u32 "Saved register list[3]/PMS_DTSSTAT" ULONG RB_RBA_rba_TrapLog_CompuMethods_rba_TrapLog_oneToOne 1 100 0.0 4.E9 FORMAT "%32.0" ECU_ADDRESS 0x60035F2C /end MEASUREMENT
/begin MEASUREMENT rba_TrapLog_Reg_st[4].PMS_DTSSTAT_u32 "Saved register list[4]/PMS_DTSSTAT" ULONG RB_RBA_rba_TrapLog_CompuMethods_rba_TrapLog_oneToOne 1 100 0.0 4.E9 FORMAT "%32.0" ECU_ADDRESS 0x60035FDC /end MEASUREMENT
/begin MEASUREMENT rba_TrapLog_Reg_st[5].PMS_DTSSTAT_u32 "Saved register list[5]/PMS_DTSSTAT" ULONG RB_RBA_rba_TrapLog_CompuMethods_rba_TrapLog_oneToOne 1 100 0.0 4.E9 FORMAT "%32.0" ECU_ADDRESS 0x6003608C /end MEASUREMENT
/begin MEASUREMENT rba_TrapLog_Reg_st[0].DMU_HF_ERRSR_u32 "Saved register list[0]/DMU_HF_ERRSR" ULONG RB_RBA_rba_TrapLog_CompuMethods_rba_TrapLog_oneToOne 1 100 0.0 4.E9 FORMAT "%32.0" ECU_ADDRESS 0x60035D20 /end MEASUREMENT
/begin MEASUREMENT rba_TrapLog_Reg_st[1].DMU_HF_ERRSR_u32 "Saved register list[1]/DMU_HF_ERRSR" ULONG RB_RBA_rba_TrapLog_CompuMethods_rba_TrapLog_oneToOne 1 100 0.0 4.E9 FORMAT "%32.0" ECU_ADDRESS 0x60035DD0 /end MEASUREMENT
/begin MEASUREMENT rba_TrapLog_Reg_st[2].DMU_HF_ERRSR_u32 "Saved register list[2]/DMU_HF_ERRSR" ULONG RB_RBA_rba_TrapLog_CompuMethods_rba_TrapLog_oneToOne 1 100 0.0 4.E9 FORMAT "%32.0" ECU_ADDRESS 0x60035E80 /end MEASUREMENT
/begin MEASUREMENT rba_TrapLog_Reg_st[3].DMU_HF_ERRSR_u32 "Saved register list[3]/DMU_HF_ERRSR" ULONG RB_RBA_rba_TrapLog_CompuMethods_rba_TrapLog_oneToOne 1 100 0.0 4.E9 FORMAT "%32.0" ECU_ADDRESS 0x60035F30 /end MEASUREMENT
/begin MEASUREMENT rba_TrapLog_Reg_st[4].DMU_HF_ERRSR_u32 "Saved register list[4]/DMU_HF_ERRSR" ULONG RB_RBA_rba_TrapLog_CompuMethods_rba_TrapLog_oneToOne 1 100 0.0 4.E9 FORMAT "%32.0" ECU_ADDRESS 0x60035FE0 /end MEASUREMENT
/begin MEASUREMENT rba_TrapLog_Reg_st[5].DMU_HF_ERRSR_u32 "Saved register list[5]/DMU_HF_ERRSR" ULONG RB_RBA_rba_TrapLog_CompuMethods_rba_TrapLog_oneToOne 1 100 0.0 4.E9 FORMAT "%32.0" ECU_ADDRESS 0x60036090 /end MEASUREMENT
/begin MEASUREMENT rba_TrapLog_Reg_st[0].SMU_AG0_u32 "Saved register list[0]/SMU_AG0" ULONG RB_RBA_rba_TrapLog_CompuMethods_rba_TrapLog_oneToOne 1 100 0.0 4.E9 FORMAT "%32.0" ECU_ADDRESS 0x60035D24 /end MEASUREMENT
/begin MEASUREMENT rba_TrapLog_Reg_st[1].SMU_AG0_u32 "Saved register list[1]/SMU_AG0" ULONG RB_RBA_rba_TrapLog_CompuMethods_rba_TrapLog_oneToOne 1 100 0.0 4.E9 FORMAT "%32.0" ECU_ADDRESS 0x60035DD4 /end MEASUREMENT
/begin MEASUREMENT rba_TrapLog_Reg_st[2].SMU_AG0_u32 "Saved register list[2]/SMU_AG0" ULONG RB_RBA_rba_TrapLog_CompuMethods_rba_TrapLog_oneToOne 1 100 0.0 4.E9 FORMAT "%32.0" ECU_ADDRESS 0x60035E84 /end MEASUREMENT
/begin MEASUREMENT rba_TrapLog_Reg_st[3].SMU_AG0_u32 "Saved register list[3]/SMU_AG0" ULONG RB_RBA_rba_TrapLog_CompuMethods_rba_TrapLog_oneToOne 1 100 0.0 4.E9 FORMAT "%32.0" ECU_ADDRESS 0x60035F34 /end MEASUREMENT
/begin MEASUREMENT rba_TrapLog_Reg_st[4].SMU_AG0_u32 "Saved register list[4]/SMU_AG0" ULONG RB_RBA_rba_TrapLog_CompuMethods_rba_TrapLog_oneToOne 1 100 0.0 4.E9 FORMAT "%32.0" ECU_ADDRESS 0x60035FE4 /end MEASUREMENT
/begin MEASUREMENT rba_TrapLog_Reg_st[5].SMU_AG0_u32 "Saved register list[5]/SMU_AG0" ULONG RB_RBA_rba_TrapLog_CompuMethods_rba_TrapLog_oneToOne 1 100 0.0 4.E9 FORMAT "%32.0" ECU_ADDRESS 0x60036094 /end MEASUREMENT
/begin MEASUREMENT rba_TrapLog_Reg_st[0].SMU_AG1_u32 "Saved register list[0]/SMU_AG1" ULONG RB_RBA_rba_TrapLog_CompuMethods_rba_TrapLog_oneToOne 1 100 0.0 4.E9 FORMAT "%32.0" ECU_ADDRESS 0x60035D28 /end MEASUREMENT
/begin MEASUREMENT rba_TrapLog_Reg_st[1].SMU_AG1_u32 "Saved register list[1]/SMU_AG1" ULONG RB_RBA_rba_TrapLog_CompuMethods_rba_TrapLog_oneToOne 1 100 0.0 4.E9 FORMAT "%32.0" ECU_ADDRESS 0x60035DD8 /end MEASUREMENT
/begin MEASUREMENT rba_TrapLog_Reg_st[2].SMU_AG1_u32 "Saved register list[2]/SMU_AG1" ULONG RB_RBA_rba_TrapLog_CompuMethods_rba_TrapLog_oneToOne 1 100 0.0 4.E9 FORMAT "%32.0" ECU_ADDRESS 0x60035E88 /end MEASUREMENT
/begin MEASUREMENT rba_TrapLog_Reg_st[3].SMU_AG1_u32 "Saved register list[3]/SMU_AG1" ULONG RB_RBA_rba_TrapLog_CompuMethods_rba_TrapLog_oneToOne 1 100 0.0 4.E9 FORMAT "%32.0" ECU_ADDRESS 0x60035F38 /end MEASUREMENT
/begin MEASUREMENT rba_TrapLog_Reg_st[4].SMU_AG1_u32 "Saved register list[4]/SMU_AG1" ULONG RB_RBA_rba_TrapLog_CompuMethods_rba_TrapLog_oneToOne 1 100 0.0 4.E9 FORMAT "%32.0" ECU_ADDRESS 0x60035FE8 /end MEASUREMENT
/begin MEASUREMENT rba_TrapLog_Reg_st[5].SMU_AG1_u32 "Saved register list[5]/SMU_AG1" ULONG RB_RBA_rba_TrapLog_CompuMethods_rba_TrapLog_oneToOne 1 100 0.0 4.E9 FORMAT "%32.0" ECU_ADDRESS 0x60036098 /end MEASUREMENT
/begin MEASUREMENT rba_TrapLog_Reg_st[0].SMU_AG2_u32 "Saved register list[0]/SMU_AG2" ULONG RB_RBA_rba_TrapLog_CompuMethods_rba_TrapLog_oneToOne 1 100 0.0 4.E9 FORMAT "%32.0" ECU_ADDRESS 0x60035D2C /end MEASUREMENT
/begin MEASUREMENT rba_TrapLog_Reg_st[1].SMU_AG2_u32 "Saved register list[1]/SMU_AG2" ULONG RB_RBA_rba_TrapLog_CompuMethods_rba_TrapLog_oneToOne 1 100 0.0 4.E9 FORMAT "%32.0" ECU_ADDRESS 0x60035DDC /end MEASUREMENT
/begin MEASUREMENT rba_TrapLog_Reg_st[2].SMU_AG2_u32 "Saved register list[2]/SMU_AG2" ULONG RB_RBA_rba_TrapLog_CompuMethods_rba_TrapLog_oneToOne 1 100 0.0 4.E9 FORMAT "%32.0" ECU_ADDRESS 0x60035E8C /end MEASUREMENT
/begin MEASUREMENT rba_TrapLog_Reg_st[3].SMU_AG2_u32 "Saved register list[3]/SMU_AG2" ULONG RB_RBA_rba_TrapLog_CompuMethods_rba_TrapLog_oneToOne 1 100 0.0 4.E9 FORMAT "%32.0" ECU_ADDRESS 0x60035F3C /end MEASUREMENT
/begin MEASUREMENT rba_TrapLog_Reg_st[4].SMU_AG2_u32 "Saved register list[4]/SMU_AG2" ULONG RB_RBA_rba_TrapLog_CompuMethods_rba_TrapLog_oneToOne 1 100 0.0 4.E9 FORMAT "%32.0" ECU_ADDRESS 0x60035FEC /end MEASUREMENT
/begin MEASUREMENT rba_TrapLog_Reg_st[5].SMU_AG2_u32 "Saved register list[5]/SMU_AG2" ULONG RB_RBA_rba_TrapLog_CompuMethods_rba_TrapLog_oneToOne 1 100 0.0 4.E9 FORMAT "%32.0" ECU_ADDRESS 0x6003609C /end MEASUREMENT
/begin MEASUREMENT rba_TrapLog_Reg_st[0].SMU_AG3_u32 "Saved register list[0]/SMU_AG3" ULONG RB_RBA_rba_TrapLog_CompuMethods_rba_TrapLog_oneToOne 1 100 0.0 4.E9 FORMAT "%32.0" ECU_ADDRESS 0x60035D30 /end MEASUREMENT
/begin MEASUREMENT rba_TrapLog_Reg_st[1].SMU_AG3_u32 "Saved register list[1]/SMU_AG3" ULONG RB_RBA_rba_TrapLog_CompuMethods_rba_TrapLog_oneToOne 1 100 0.0 4.E9 FORMAT "%32.0" ECU_ADDRESS 0x60035DE0 /end MEASUREMENT
/begin MEASUREMENT rba_TrapLog_Reg_st[2].SMU_AG3_u32 "Saved register list[2]/SMU_AG3" ULONG RB_RBA_rba_TrapLog_CompuMethods_rba_TrapLog_oneToOne 1 100 0.0 4.E9 FORMAT "%32.0" ECU_ADDRESS 0x60035E90 /end MEASUREMENT
/begin MEASUREMENT rba_TrapLog_Reg_st[3].SMU_AG3_u32 "Saved register list[3]/SMU_AG3" ULONG RB_RBA_rba_TrapLog_CompuMethods_rba_TrapLog_oneToOne 1 100 0.0 4.E9 FORMAT "%32.0" ECU_ADDRESS 0x60035F40 /end MEASUREMENT
/begin MEASUREMENT rba_TrapLog_Reg_st[4].SMU_AG3_u32 "Saved register list[4]/SMU_AG3" ULONG RB_RBA_rba_TrapLog_CompuMethods_rba_TrapLog_oneToOne 1 100 0.0 4.E9 FORMAT "%32.0" ECU_ADDRESS 0x60035FF0 /end MEASUREMENT
/begin MEASUREMENT rba_TrapLog_Reg_st[5].SMU_AG3_u32 "Saved register list[5]/SMU_AG3" ULONG RB_RBA_rba_TrapLog_CompuMethods_rba_TrapLog_oneToOne 1 100 0.0 4.E9 FORMAT "%32.0" ECU_ADDRESS 0x600360A0 /end MEASUREMENT
/begin MEASUREMENT rba_TrapLog_Reg_st[0].SMU_AG4_u32 "Saved register list[0]/SMU_AG4" ULONG RB_RBA_rba_TrapLog_CompuMethods_rba_TrapLog_oneToOne 1 100 0.0 4.E9 FORMAT "%32.0" ECU_ADDRESS 0x60035D34 /end MEASUREMENT
/begin MEASUREMENT rba_TrapLog_Reg_st[1].SMU_AG4_u32 "Saved register list[1]/SMU_AG4" ULONG RB_RBA_rba_TrapLog_CompuMethods_rba_TrapLog_oneToOne 1 100 0.0 4.E9 FORMAT "%32.0" ECU_ADDRESS 0x60035DE4 /end MEASUREMENT
/begin MEASUREMENT rba_TrapLog_Reg_st[2].SMU_AG4_u32 "Saved register list[2]/SMU_AG4" ULONG RB_RBA_rba_TrapLog_CompuMethods_rba_TrapLog_oneToOne 1 100 0.0 4.E9 FORMAT "%32.0" ECU_ADDRESS 0x60035E94 /end MEASUREMENT
/begin MEASUREMENT rba_TrapLog_Reg_st[3].SMU_AG4_u32 "Saved register list[3]/SMU_AG4" ULONG RB_RBA_rba_TrapLog_CompuMethods_rba_TrapLog_oneToOne 1 100 0.0 4.E9 FORMAT "%32.0" ECU_ADDRESS 0x60035F44 /end MEASUREMENT
/begin MEASUREMENT rba_TrapLog_Reg_st[4].SMU_AG4_u32 "Saved register list[4]/SMU_AG4" ULONG RB_RBA_rba_TrapLog_CompuMethods_rba_TrapLog_oneToOne 1 100 0.0 4.E9 FORMAT "%32.0" ECU_ADDRESS 0x60035FF4 /end MEASUREMENT
/begin MEASUREMENT rba_TrapLog_Reg_st[5].SMU_AG4_u32 "Saved register list[5]/SMU_AG4" ULONG RB_RBA_rba_TrapLog_CompuMethods_rba_TrapLog_oneToOne 1 100 0.0 4.E9 FORMAT "%32.0" ECU_ADDRESS 0x600360A4 /end MEASUREMENT
/begin MEASUREMENT rba_TrapLog_Reg_st[0].SMU_AG5_u32 "Saved register list[0]/SMU_AG5" ULONG RB_RBA_rba_TrapLog_CompuMethods_rba_TrapLog_oneToOne 1 100 0.0 4.E9 FORMAT "%32.0" ECU_ADDRESS 0x60035D38 /end MEASUREMENT
/begin MEASUREMENT rba_TrapLog_Reg_st[1].SMU_AG5_u32 "Saved register list[1]/SMU_AG5" ULONG RB_RBA_rba_TrapLog_CompuMethods_rba_TrapLog_oneToOne 1 100 0.0 4.E9 FORMAT "%32.0" ECU_ADDRESS 0x60035DE8 /end MEASUREMENT
/begin MEASUREMENT rba_TrapLog_Reg_st[2].SMU_AG5_u32 "Saved register list[2]/SMU_AG5" ULONG RB_RBA_rba_TrapLog_CompuMethods_rba_TrapLog_oneToOne 1 100 0.0 4.E9 FORMAT "%32.0" ECU_ADDRESS 0x60035E98 /end MEASUREMENT
/begin MEASUREMENT rba_TrapLog_Reg_st[3].SMU_AG5_u32 "Saved register list[3]/SMU_AG5" ULONG RB_RBA_rba_TrapLog_CompuMethods_rba_TrapLog_oneToOne 1 100 0.0 4.E9 FORMAT "%32.0" ECU_ADDRESS 0x60035F48 /end MEASUREMENT
/begin MEASUREMENT rba_TrapLog_Reg_st[4].SMU_AG5_u32 "Saved register list[4]/SMU_AG5" ULONG RB_RBA_rba_TrapLog_CompuMethods_rba_TrapLog_oneToOne 1 100 0.0 4.E9 FORMAT "%32.0" ECU_ADDRESS 0x60035FF8 /end MEASUREMENT
/begin MEASUREMENT rba_TrapLog_Reg_st[5].SMU_AG5_u32 "Saved register list[5]/SMU_AG5" ULONG RB_RBA_rba_TrapLog_CompuMethods_rba_TrapLog_oneToOne 1 100 0.0 4.E9 FORMAT "%32.0" ECU_ADDRESS 0x600360A8 /end MEASUREMENT
/begin MEASUREMENT rba_TrapLog_Reg_st[0].SMU_AG6_u32 "Saved register list[0]/SMU_AG6" ULONG RB_RBA_rba_TrapLog_CompuMethods_rba_TrapLog_oneToOne 1 100 0.0 4.E9 FORMAT "%32.0" ECU_ADDRESS 0x60035D3C /end MEASUREMENT
/begin MEASUREMENT rba_TrapLog_Reg_st[1].SMU_AG6_u32 "Saved register list[1]/SMU_AG6" ULONG RB_RBA_rba_TrapLog_CompuMethods_rba_TrapLog_oneToOne 1 100 0.0 4.E9 FORMAT "%32.0" ECU_ADDRESS 0x60035DEC /end MEASUREMENT
/begin MEASUREMENT rba_TrapLog_Reg_st[2].SMU_AG6_u32 "Saved register list[2]/SMU_AG6" ULONG RB_RBA_rba_TrapLog_CompuMethods_rba_TrapLog_oneToOne 1 100 0.0 4.E9 FORMAT "%32.0" ECU_ADDRESS 0x60035E9C /end MEASUREMENT
/begin MEASUREMENT rba_TrapLog_Reg_st[3].SMU_AG6_u32 "Saved register list[3]/SMU_AG6" ULONG RB_RBA_rba_TrapLog_CompuMethods_rba_TrapLog_oneToOne 1 100 0.0 4.E9 FORMAT "%32.0" ECU_ADDRESS 0x60035F4C /end MEASUREMENT
/begin MEASUREMENT rba_TrapLog_Reg_st[4].SMU_AG6_u32 "Saved register list[4]/SMU_AG6" ULONG RB_RBA_rba_TrapLog_CompuMethods_rba_TrapLog_oneToOne 1 100 0.0 4.E9 FORMAT "%32.0" ECU_ADDRESS 0x60035FFC /end MEASUREMENT
/begin MEASUREMENT rba_TrapLog_Reg_st[5].SMU_AG6_u32 "Saved register list[5]/SMU_AG6" ULONG RB_RBA_rba_TrapLog_CompuMethods_rba_TrapLog_oneToOne 1 100 0.0 4.E9 FORMAT "%32.0" ECU_ADDRESS 0x600360AC /end MEASUREMENT
/begin MEASUREMENT rba_TrapLog_Reg_st[0].SMU_AG7_u32 "Saved register list[0]/SMU_AG7" ULONG RB_RBA_rba_TrapLog_CompuMethods_rba_TrapLog_oneToOne 1 100 0.0 4.E9 FORMAT "%32.0" ECU_ADDRESS 0x60035D40 /end MEASUREMENT
/begin MEASUREMENT rba_TrapLog_Reg_st[1].SMU_AG7_u32 "Saved register list[1]/SMU_AG7" ULONG RB_RBA_rba_TrapLog_CompuMethods_rba_TrapLog_oneToOne 1 100 0.0 4.E9 FORMAT "%32.0" ECU_ADDRESS 0x60035DF0 /end MEASUREMENT
/begin MEASUREMENT rba_TrapLog_Reg_st[2].SMU_AG7_u32 "Saved register list[2]/SMU_AG7" ULONG RB_RBA_rba_TrapLog_CompuMethods_rba_TrapLog_oneToOne 1 100 0.0 4.E9 FORMAT "%32.0" ECU_ADDRESS 0x60035EA0 /end MEASUREMENT
/begin MEASUREMENT rba_TrapLog_Reg_st[3].SMU_AG7_u32 "Saved register list[3]/SMU_AG7" ULONG RB_RBA_rba_TrapLog_CompuMethods_rba_TrapLog_oneToOne 1 100 0.0 4.E9 FORMAT "%32.0" ECU_ADDRESS 0x60035F50 /end MEASUREMENT
/begin MEASUREMENT rba_TrapLog_Reg_st[4].SMU_AG7_u32 "Saved register list[4]/SMU_AG7" ULONG RB_RBA_rba_TrapLog_CompuMethods_rba_TrapLog_oneToOne 1 100 0.0 4.E9 FORMAT "%32.0" ECU_ADDRESS 0x60036000 /end MEASUREMENT
/begin MEASUREMENT rba_TrapLog_Reg_st[5].SMU_AG7_u32 "Saved register list[5]/SMU_AG7" ULONG RB_RBA_rba_TrapLog_CompuMethods_rba_TrapLog_oneToOne 1 100 0.0 4.E9 FORMAT "%32.0" ECU_ADDRESS 0x600360B0 /end MEASUREMENT
/begin MEASUREMENT rba_TrapLog_Reg_st[0].SMU_AG8_u32 "Saved register list[0]/SMU_AG8" ULONG RB_RBA_rba_TrapLog_CompuMethods_rba_TrapLog_oneToOne 1 100 0.0 4.E9 FORMAT "%32.0" ECU_ADDRESS 0x60035D44 /end MEASUREMENT
/begin MEASUREMENT rba_TrapLog_Reg_st[1].SMU_AG8_u32 "Saved register list[1]/SMU_AG8" ULONG RB_RBA_rba_TrapLog_CompuMethods_rba_TrapLog_oneToOne 1 100 0.0 4.E9 FORMAT "%32.0" ECU_ADDRESS 0x60035DF4 /end MEASUREMENT
/begin MEASUREMENT rba_TrapLog_Reg_st[2].SMU_AG8_u32 "Saved register list[2]/SMU_AG8" ULONG RB_RBA_rba_TrapLog_CompuMethods_rba_TrapLog_oneToOne 1 100 0.0 4.E9 FORMAT "%32.0" ECU_ADDRESS 0x60035EA4 /end MEASUREMENT
/begin MEASUREMENT rba_TrapLog_Reg_st[3].SMU_AG8_u32 "Saved register list[3]/SMU_AG8" ULONG RB_RBA_rba_TrapLog_CompuMethods_rba_TrapLog_oneToOne 1 100 0.0 4.E9 FORMAT "%32.0" ECU_ADDRESS 0x60035F54 /end MEASUREMENT
/begin MEASUREMENT rba_TrapLog_Reg_st[4].SMU_AG8_u32 "Saved register list[4]/SMU_AG8" ULONG RB_RBA_rba_TrapLog_CompuMethods_rba_TrapLog_oneToOne 1 100 0.0 4.E9 FORMAT "%32.0" ECU_ADDRESS 0x60036004 /end MEASUREMENT
/begin MEASUREMENT rba_TrapLog_Reg_st[5].SMU_AG8_u32 "Saved register list[5]/SMU_AG8" ULONG RB_RBA_rba_TrapLog_CompuMethods_rba_TrapLog_oneToOne 1 100 0.0 4.E9 FORMAT "%32.0" ECU_ADDRESS 0x600360B4 /end MEASUREMENT
/begin MEASUREMENT rba_TrapLog_Reg_st[0].SMU_AG9_u32 "Saved register list[0]/SMU_AG9" ULONG RB_RBA_rba_TrapLog_CompuMethods_rba_TrapLog_oneToOne 1 100 0.0 4.E9 FORMAT "%32.0" ECU_ADDRESS 0x60035D48 /end MEASUREMENT
/begin MEASUREMENT rba_TrapLog_Reg_st[1].SMU_AG9_u32 "Saved register list[1]/SMU_AG9" ULONG RB_RBA_rba_TrapLog_CompuMethods_rba_TrapLog_oneToOne 1 100 0.0 4.E9 FORMAT "%32.0" ECU_ADDRESS 0x60035DF8 /end MEASUREMENT
/begin MEASUREMENT rba_TrapLog_Reg_st[2].SMU_AG9_u32 "Saved register list[2]/SMU_AG9" ULONG RB_RBA_rba_TrapLog_CompuMethods_rba_TrapLog_oneToOne 1 100 0.0 4.E9 FORMAT "%32.0" ECU_ADDRESS 0x60035EA8 /end MEASUREMENT
/begin MEASUREMENT rba_TrapLog_Reg_st[3].SMU_AG9_u32 "Saved register list[3]/SMU_AG9" ULONG RB_RBA_rba_TrapLog_CompuMethods_rba_TrapLog_oneToOne 1 100 0.0 4.E9 FORMAT "%32.0" ECU_ADDRESS 0x60035F58 /end MEASUREMENT
/begin MEASUREMENT rba_TrapLog_Reg_st[4].SMU_AG9_u32 "Saved register list[4]/SMU_AG9" ULONG RB_RBA_rba_TrapLog_CompuMethods_rba_TrapLog_oneToOne 1 100 0.0 4.E9 FORMAT "%32.0" ECU_ADDRESS 0x60036008 /end MEASUREMENT
/begin MEASUREMENT rba_TrapLog_Reg_st[5].SMU_AG9_u32 "Saved register list[5]/SMU_AG9" ULONG RB_RBA_rba_TrapLog_CompuMethods_rba_TrapLog_oneToOne 1 100 0.0 4.E9 FORMAT "%32.0" ECU_ADDRESS 0x600360B8 /end MEASUREMENT
/begin MEASUREMENT rba_TrapLog_Reg_st[0].SMU_AG10_u32 "Saved register list[0]/SMU_AG10" ULONG RB_RBA_rba_TrapLog_CompuMethods_rba_TrapLog_oneToOne 1 100 0.0 4.E9 FORMAT "%32.0" ECU_ADDRESS 0x60035D4C /end MEASUREMENT
/begin MEASUREMENT rba_TrapLog_Reg_st[1].SMU_AG10_u32 "Saved register list[1]/SMU_AG10" ULONG RB_RBA_rba_TrapLog_CompuMethods_rba_TrapLog_oneToOne 1 100 0.0 4.E9 FORMAT "%32.0" ECU_ADDRESS 0x60035DFC /end MEASUREMENT
/begin MEASUREMENT rba_TrapLog_Reg_st[2].SMU_AG10_u32 "Saved register list[2]/SMU_AG10" ULONG RB_RBA_rba_TrapLog_CompuMethods_rba_TrapLog_oneToOne 1 100 0.0 4.E9 FORMAT "%32.0" ECU_ADDRESS 0x60035EAC /end MEASUREMENT
/begin MEASUREMENT rba_TrapLog_Reg_st[3].SMU_AG10_u32 "Saved register list[3]/SMU_AG10" ULONG RB_RBA_rba_TrapLog_CompuMethods_rba_TrapLog_oneToOne 1 100 0.0 4.E9 FORMAT "%32.0" ECU_ADDRESS 0x60035F5C /end MEASUREMENT
/begin MEASUREMENT rba_TrapLog_Reg_st[4].SMU_AG10_u32 "Saved register list[4]/SMU_AG10" ULONG RB_RBA_rba_TrapLog_CompuMethods_rba_TrapLog_oneToOne 1 100 0.0 4.E9 FORMAT "%32.0" ECU_ADDRESS 0x6003600C /end MEASUREMENT
/begin MEASUREMENT rba_TrapLog_Reg_st[5].SMU_AG10_u32 "Saved register list[5]/SMU_AG10" ULONG RB_RBA_rba_TrapLog_CompuMethods_rba_TrapLog_oneToOne 1 100 0.0 4.E9 FORMAT "%32.0" ECU_ADDRESS 0x600360BC /end MEASUREMENT
/begin MEASUREMENT rba_TrapLog_Reg_st[0].SMU_AG11_u32 "Saved register list[0]/SMU_AG11" ULONG RB_RBA_rba_TrapLog_CompuMethods_rba_TrapLog_oneToOne 1 100 0.0 4.E9 FORMAT "%32.0" ECU_ADDRESS 0x60035D50 /end MEASUREMENT
/begin MEASUREMENT rba_TrapLog_Reg_st[1].SMU_AG11_u32 "Saved register list[1]/SMU_AG11" ULONG RB_RBA_rba_TrapLog_CompuMethods_rba_TrapLog_oneToOne 1 100 0.0 4.E9 FORMAT "%32.0" ECU_ADDRESS 0x60035E00 /end MEASUREMENT
/begin MEASUREMENT rba_TrapLog_Reg_st[2].SMU_AG11_u32 "Saved register list[2]/SMU_AG11" ULONG RB_RBA_rba_TrapLog_CompuMethods_rba_TrapLog_oneToOne 1 100 0.0 4.E9 FORMAT "%32.0" ECU_ADDRESS 0x60035EB0 /end MEASUREMENT
/begin MEASUREMENT rba_TrapLog_Reg_st[3].SMU_AG11_u32 "Saved register list[3]/SMU_AG11" ULONG RB_RBA_rba_TrapLog_CompuMethods_rba_TrapLog_oneToOne 1 100 0.0 4.E9 FORMAT "%32.0" ECU_ADDRESS 0x60035F60 /end MEASUREMENT
/begin MEASUREMENT rba_TrapLog_Reg_st[4].SMU_AG11_u32 "Saved register list[4]/SMU_AG11" ULONG RB_RBA_rba_TrapLog_CompuMethods_rba_TrapLog_oneToOne 1 100 0.0 4.E9 FORMAT "%32.0" ECU_ADDRESS 0x60036010 /end MEASUREMENT
/begin MEASUREMENT rba_TrapLog_Reg_st[5].SMU_AG11_u32 "Saved register list[5]/SMU_AG11" ULONG RB_RBA_rba_TrapLog_CompuMethods_rba_TrapLog_oneToOne 1 100 0.0 4.E9 FORMAT "%32.0" ECU_ADDRESS 0x600360C0 /end MEASUREMENT
/begin FUNCTION rba_TrapLog "4.3.0  McFunction rba_TrapLog Created by MCFunctionUpdater" /begin DEF_CHARACTERISTIC rba_TrapLog_ResetLog_C /end DEF_CHARACTERISTIC
 /begin LOC_MEASUREMENT rba_TrapLog_CallStackCore1_a_u32[0][0] rba_TrapLog_CallStackCore1_a_u32[0][1] rba_TrapLog_CallStackCore1_a_u32[0][2] rba_TrapLog_CallStackCore1_a_u32[0][3] rba_TrapLog_CallStackCore1_a_u32[0][4] rba_TrapLog_CallStackCore1_a_u32[0][5] rba_TrapLog_CallStackCore1_a_u32[0][6] rba_TrapLog_CallStackCore1_a_u32[0][7] rba_TrapLog_CallStackCore1_a_u32[1][0] rba_TrapLog_CallStackCore1_a_u32[1][1] rba_TrapLog_CallStackCore1_a_u32[1][2] rba_TrapLog_CallStackCore1_a_u32[1][3] rba_TrapLog_CallStackCore1_a_u32[1][4] rba_TrapLog_CallStackCore1_a_u32[1][5] rba_TrapLog_CallStackCore1_a_u32[1][6] rba_TrapLog_CallStackCore1_a_u32[1][7] rba_TrapLog_CallStackCore1_a_u32[2][0] rba_TrapLog_CallStackCore1_a_u32[2][1] rba_TrapLog_CallStackCore1_a_u32[2][2] rba_TrapLog_CallStackCore1_a_u32[2][3] rba_TrapLog_CallStackCore1_a_u32[2][4] rba_TrapLog_CallStackCore1_a_u32[2][5] rba_TrapLog_CallStackCore1_a_u32[2][6] rba_TrapLog_CallStackCore1_a_u32[2][7] rba_TrapLog_CallStackCore1_a_u32[3][0] rba_TrapLog_CallStackCore1_a_u32[3][1] rba_TrapLog_CallStackCore1_a_u32[3][2] rba_TrapLog_CallStackCore1_a_u32[3][3] rba_TrapLog_CallStackCore1_a_u32[3][4] rba_TrapLog_CallStackCore1_a_u32[3][5] rba_TrapLog_CallStackCore1_a_u32[3][6] rba_TrapLog_CallStackCore1_a_u32[3][7] rba_TrapLog_CallStackCore1_a_u32[4][0] rba_TrapLog_CallStackCore1_a_u32[4][1] rba_TrapLog_CallStackCore1_a_u32[4][2] rba_TrapLog_CallStackCore1_a_u32[4][3] rba_TrapLog_CallStackCore1_a_u32[4][4] rba_TrapLog_CallStackCore1_a_u32[4][5] rba_TrapLog_CallStackCore1_a_u32[4][6] rba_TrapLog_CallStackCore1_a_u32[4][7] rba_TrapLog_CallStackCore1_a_u32[5][0] rba_TrapLog_CallStackCore1_a_u32[5][1] rba_TrapLog_CallStackCore1_a_u32[5][2] rba_TrapLog_CallStackCore1_a_u32[5][3] rba_TrapLog_CallStackCore1_a_u32[5][4] rba_TrapLog_CallStackCore1_a_u32[5][5] rba_TrapLog_CallStackCore1_a_u32[5][6] rba_TrapLog_CallStackCore1_a_u32[5][7] rba_TrapLog_CallStackCore2_a_u32[0][0] rba_TrapLog_CallStackCore2_a_u32[0][1] rba_TrapLog_CallStackCore2_a_u32[0][2] rba_TrapLog_CallStackCore2_a_u32[0][3] rba_TrapLog_CallStackCore2_a_u32[0][4] rba_TrapLog_CallStackCore2_a_u32[0][5] rba_TrapLog_CallStackCore2_a_u32[0][6] rba_TrapLog_CallStackCore2_a_u32[0][7] rba_TrapLog_CallStackCore2_a_u32[1][0] rba_TrapLog_CallStackCore2_a_u32[1][1] rba_TrapLog_CallStackCore2_a_u32[1][2] rba_TrapLog_CallStackCore2_a_u32[1][3] rba_TrapLog_CallStackCore2_a_u32[1][4] rba_TrapLog_CallStackCore2_a_u32[1][5] rba_TrapLog_CallStackCore2_a_u32[1][6] rba_TrapLog_CallStackCore2_a_u32[1][7] rba_TrapLog_CallStackCore2_a_u32[2][0] rba_TrapLog_CallStackCore2_a_u32[2][1] rba_TrapLog_CallStackCore2_a_u32[2][2] rba_TrapLog_CallStackCore2_a_u32[2][3] rba_TrapLog_CallStackCore2_a_u32[2][4] rba_TrapLog_CallStackCore2_a_u32[2][5] rba_TrapLog_CallStackCore2_a_u32[2][6] rba_TrapLog_CallStackCore2_a_u32[2][7] rba_TrapLog_CallStackCore2_a_u32[3][0] rba_TrapLog_CallStackCore2_a_u32[3][1] rba_TrapLog_CallStackCore2_a_u32[3][2] rba_TrapLog_CallStackCore2_a_u32[3][3] rba_TrapLog_CallStackCore2_a_u32[3][4] rba_TrapLog_CallStackCore2_a_u32[3][5] rba_TrapLog_CallStackCore2_a_u32[3][6] rba_TrapLog_CallStackCore2_a_u32[3][7] rba_TrapLog_CallStackCore2_a_u32[4][0] rba_TrapLog_CallStackCore2_a_u32[4][1] rba_TrapLog_CallStackCore2_a_u32[4][2] rba_TrapLog_CallStackCore2_a_u32[4][3] rba_TrapLog_CallStackCore2_a_u32[4][4] rba_TrapLog_CallStackCore2_a_u32[4][5] rba_TrapLog_CallStackCore2_a_u32[4][6] rba_TrapLog_CallStackCore2_a_u32[4][7] rba_TrapLog_CallStackCore2_a_u32[5][0] rba_TrapLog_CallStackCore2_a_u32[5][1] rba_TrapLog_CallStackCore2_a_u32[5][2] rba_TrapLog_CallStackCore2_a_u32[5][3] rba_TrapLog_CallStackCore2_a_u32[5][4] rba_TrapLog_CallStackCore2_a_u32[5][5] rba_TrapLog_CallStackCore2_a_u32[5][6] rba_TrapLog_CallStackCore2_a_u32[5][7] rba_TrapLog_CallStack_a_u32[0][0] rba_TrapLog_CallStack_a_u32[0][1] rba_TrapLog_CallStack_a_u32[0][2] rba_TrapLog_CallStack_a_u32[0][3] rba_TrapLog_CallStack_a_u32[0][4] rba_TrapLog_CallStack_a_u32[0][5] rba_TrapLog_CallStack_a_u32[0][6] rba_TrapLog_CallStack_a_u32[0][7] rba_TrapLog_CallStack_a_u32[1][0] rba_TrapLog_CallStack_a_u32[1][1] rba_TrapLog_CallStack_a_u32[1][2] rba_TrapLog_CallStack_a_u32[1][3] rba_TrapLog_CallStack_a_u32[1][4] rba_TrapLog_CallStack_a_u32[1][5] rba_TrapLog_CallStack_a_u32[1][6] rba_TrapLog_CallStack_a_u32[1][7] rba_TrapLog_CallStack_a_u32[2][0] rba_TrapLog_CallStack_a_u32[2][1] rba_TrapLog_CallStack_a_u32[2][2] rba_TrapLog_CallStack_a_u32[2][3] rba_TrapLog_CallStack_a_u32[2][4] rba_TrapLog_CallStack_a_u32[2][5] rba_TrapLog_CallStack_a_u32[2][6] rba_TrapLog_CallStack_a_u32[2][7] rba_TrapLog_CallStack_a_u32[3][0] rba_TrapLog_CallStack_a_u32[3][1] rba_TrapLog_CallStack_a_u32[3][2] rba_TrapLog_CallStack_a_u32[3][3] rba_TrapLog_CallStack_a_u32[3][4] rba_TrapLog_CallStack_a_u32[3][5] rba_TrapLog_CallStack_a_u32[3][6] rba_TrapLog_CallStack_a_u32[3][7] rba_TrapLog_CallStack_a_u32[4][0] rba_TrapLog_CallStack_a_u32[4][1] rba_TrapLog_CallStack_a_u32[4][2] rba_TrapLog_CallStack_a_u32[4][3] rba_TrapLog_CallStack_a_u32[4][4] rba_TrapLog_CallStack_a_u32[4][5] rba_TrapLog_CallStack_a_u32[4][6] rba_TrapLog_CallStack_a_u32[4][7] rba_TrapLog_CallStack_a_u32[5][0] rba_TrapLog_CallStack_a_u32[5][1] rba_TrapLog_CallStack_a_u32[5][2] rba_TrapLog_CallStack_a_u32[5][3] rba_TrapLog_CallStack_a_u32[5][4] rba_TrapLog_CallStack_a_u32[5][5] rba_TrapLog_CallStack_a_u32[5][6] rba_TrapLog_CallStack_a_u32[5][7] rba_TrapLog_RegCore1_st[0].COREID_u32 rba_TrapLog_RegCore1_st[0].DIEAR_u32 rba_TrapLog_RegCore1_st[0].DIETR_u32 rba_TrapLog_RegCore1_st[0].DMI_ATR_u32 rba_TrapLog_RegCore1_st[0].DMI_EADD_u32 rba_TrapLog_RegCore1_st[0].DMI_STR_u32 rba_TrapLog_RegCore1_st[0].PCXI_u32 rba_TrapLog_RegCore1_st[0].PIEAR_u32 rba_TrapLog_RegCore1_st[0].PIETR_u32 rba_TrapLog_RegCore1_st[0].PSW_u32 rba_TrapLog_RegCore1_st[0].SYS_TIME_u32 rba_TrapLog_RegCore1_st[0].TRAP_CON_u32 rba_TrapLog_RegCore1_st[0].TRAP_PC_u32 rba_TrapLog_RegCore1_st[1].COREID_u32 rba_TrapLog_RegCore1_st[1].DIEAR_u32 rba_TrapLog_RegCore1_st[1].DIETR_u32 rba_TrapLog_RegCore1_st[1].DMI_ATR_u32 rba_TrapLog_RegCore1_st[1].DMI_EADD_u32 rba_TrapLog_RegCore1_st[1].DMI_STR_u32 rba_TrapLog_RegCore1_st[1].PCXI_u32 rba_TrapLog_RegCore1_st[1].PIEAR_u32 rba_TrapLog_RegCore1_st[1].PIETR_u32 rba_TrapLog_RegCore1_st[1].PSW_u32 rba_TrapLog_RegCore1_st[1].SYS_TIME_u32 rba_TrapLog_RegCore1_st[1].TRAP_CON_u32 rba_TrapLog_RegCore1_st[1].TRAP_PC_u32 rba_TrapLog_RegCore1_st[2].COREID_u32 rba_TrapLog_RegCore1_st[2].DIEAR_u32 rba_TrapLog_RegCore1_st[2].DIETR_u32 rba_TrapLog_RegCore1_st[2].DMI_ATR_u32 rba_TrapLog_RegCore1_st[2].DMI_EADD_u32 rba_TrapLog_RegCore1_st[2].DMI_STR_u32 rba_TrapLog_RegCore1_st[2].PCXI_u32 rba_TrapLog_RegCore1_st[2].PIEAR_u32 rba_TrapLog_RegCore1_st[2].PIETR_u32 rba_TrapLog_RegCore1_st[2].PSW_u32 rba_TrapLog_RegCore1_st[2].SYS_TIME_u32 rba_TrapLog_RegCore1_st[2].TRAP_CON_u32 rba_TrapLog_RegCore1_st[2].TRAP_PC_u32 rba_TrapLog_RegCore1_st[3].COREID_u32 rba_TrapLog_RegCore1_st[3].DIEAR_u32 rba_TrapLog_RegCore1_st[3].DIETR_u32 rba_TrapLog_RegCore1_st[3].DMI_ATR_u32 rba_TrapLog_RegCore1_st[3].DMI_EADD_u32 rba_TrapLog_RegCore1_st[3].DMI_STR_u32 rba_TrapLog_RegCore1_st[3].PCXI_u32 rba_TrapLog_RegCore1_st[3].PIEAR_u32 rba_TrapLog_RegCore1_st[3].PIETR_u32 rba_TrapLog_RegCore1_st[3].PSW_u32 rba_TrapLog_RegCore1_st[3].SYS_TIME_u32 rba_TrapLog_RegCore1_st[3].TRAP_CON_u32 rba_TrapLog_RegCore1_st[3].TRAP_PC_u32 rba_TrapLog_RegCore1_st[4].COREID_u32 rba_TrapLog_RegCore1_st[4].DIEAR_u32 rba_TrapLog_RegCore1_st[4].DIETR_u32 rba_TrapLog_RegCore1_st[4].DMI_ATR_u32 rba_TrapLog_RegCore1_st[4].DMI_EADD_u32 rba_TrapLog_RegCore1_st[4].DMI_STR_u32 rba_TrapLog_RegCore1_st[4].PCXI_u32 rba_TrapLog_RegCore1_st[4].PIEAR_u32 rba_TrapLog_RegCore1_st[4].PIETR_u32 rba_TrapLog_RegCore1_st[4].PSW_u32 rba_TrapLog_RegCore1_st[4].SYS_TIME_u32 rba_TrapLog_RegCore1_st[4].TRAP_CON_u32 rba_TrapLog_RegCore1_st[4].TRAP_PC_u32 rba_TrapLog_RegCore1_st[5].COREID_u32 rba_TrapLog_RegCore1_st[5].DIEAR_u32 rba_TrapLog_RegCore1_st[5].DIETR_u32 rba_TrapLog_RegCore1_st[5].DMI_ATR_u32 rba_TrapLog_RegCore1_st[5].DMI_EADD_u32 rba_TrapLog_RegCore1_st[5].DMI_STR_u32 rba_TrapLog_RegCore1_st[5].PCXI_u32 rba_TrapLog_RegCore1_st[5].PIEAR_u32 rba_TrapLog_RegCore1_st[5].PIETR_u32 rba_TrapLog_RegCore1_st[5].PSW_u32 rba_TrapLog_RegCore1_st[5].SYS_TIME_u32 rba_TrapLog_RegCore1_st[5].TRAP_CON_u32 rba_TrapLog_RegCore1_st[5].TRAP_PC_u32 rba_TrapLog_RegCore2_st[0].COREID_u32 rba_TrapLog_RegCore2_st[0].DIEAR_u32 rba_TrapLog_RegCore2_st[0].DIETR_u32 rba_TrapLog_RegCore2_st[0].DMI_ATR_u32 rba_TrapLog_RegCore2_st[0].DMI_EADD_u32 rba_TrapLog_RegCore2_st[0].DMI_STR_u32 rba_TrapLog_RegCore2_st[0].PCXI_u32 rba_TrapLog_RegCore2_st[0].PIEAR_u32 rba_TrapLog_RegCore2_st[0].PIETR_u32 rba_TrapLog_RegCore2_st[0].PSW_u32 rba_TrapLog_RegCore2_st[0].SYS_TIME_u32 rba_TrapLog_RegCore2_st[0].TRAP_CON_u32 rba_TrapLog_RegCore2_st[0].TRAP_PC_u32 rba_TrapLog_RegCore2_st[1].COREID_u32 rba_TrapLog_RegCore2_st[1].DIEAR_u32 rba_TrapLog_RegCore2_st[1].DIETR_u32 rba_TrapLog_RegCore2_st[1].DMI_ATR_u32 rba_TrapLog_RegCore2_st[1].DMI_EADD_u32 rba_TrapLog_RegCore2_st[1].DMI_STR_u32 rba_TrapLog_RegCore2_st[1].PCXI_u32 rba_TrapLog_RegCore2_st[1].PIEAR_u32 rba_TrapLog_RegCore2_st[1].PIETR_u32 rba_TrapLog_RegCore2_st[1].PSW_u32 rba_TrapLog_RegCore2_st[1].SYS_TIME_u32 rba_TrapLog_RegCore2_st[1].TRAP_CON_u32 rba_TrapLog_RegCore2_st[1].TRAP_PC_u32 rba_TrapLog_RegCore2_st[2].COREID_u32 rba_TrapLog_RegCore2_st[2].DIEAR_u32 rba_TrapLog_RegCore2_st[2].DIETR_u32 rba_TrapLog_RegCore2_st[2].DMI_ATR_u32 rba_TrapLog_RegCore2_st[2].DMI_EADD_u32 rba_TrapLog_RegCore2_st[2].DMI_STR_u32 rba_TrapLog_RegCore2_st[2].PCXI_u32 rba_TrapLog_RegCore2_st[2].PIEAR_u32 rba_TrapLog_RegCore2_st[2].PIETR_u32 rba_TrapLog_RegCore2_st[2].PSW_u32 rba_TrapLog_RegCore2_st[2].SYS_TIME_u32 rba_TrapLog_RegCore2_st[2].TRAP_CON_u32 rba_TrapLog_RegCore2_st[2].TRAP_PC_u32 rba_TrapLog_RegCore2_st[3].COREID_u32 rba_TrapLog_RegCore2_st[3].DIEAR_u32 rba_TrapLog_RegCore2_st[3].DIETR_u32 rba_TrapLog_RegCore2_st[3].DMI_ATR_u32 rba_TrapLog_RegCore2_st[3].DMI_EADD_u32 rba_TrapLog_RegCore2_st[3].DMI_STR_u32 rba_TrapLog_RegCore2_st[3].PCXI_u32 rba_TrapLog_RegCore2_st[3].PIEAR_u32 rba_TrapLog_RegCore2_st[3].PIETR_u32 rba_TrapLog_RegCore2_st[3].PSW_u32 rba_TrapLog_RegCore2_st[3].SYS_TIME_u32 rba_TrapLog_RegCore2_st[3].TRAP_CON_u32 rba_TrapLog_RegCore2_st[3].TRAP_PC_u32 rba_TrapLog_RegCore2_st[4].COREID_u32 rba_TrapLog_RegCore2_st[4].DIEAR_u32 rba_TrapLog_RegCore2_st[4].DIETR_u32 rba_TrapLog_RegCore2_st[4].DMI_ATR_u32 rba_TrapLog_RegCore2_st[4].DMI_EADD_u32 rba_TrapLog_RegCore2_st[4].DMI_STR_u32 rba_TrapLog_RegCore2_st[4].PCXI_u32 rba_TrapLog_RegCore2_st[4].PIEAR_u32 rba_TrapLog_RegCore2_st[4].PIETR_u32 rba_TrapLog_RegCore2_st[4].PSW_u32 rba_TrapLog_RegCore2_st[4].SYS_TIME_u32 rba_TrapLog_RegCore2_st[4].TRAP_CON_u32 rba_TrapLog_RegCore2_st[4].TRAP_PC_u32 rba_TrapLog_RegCore2_st[5].COREID_u32 rba_TrapLog_RegCore2_st[5].DIEAR_u32 rba_TrapLog_RegCore2_st[5].DIETR_u32 rba_TrapLog_RegCore2_st[5].DMI_ATR_u32 rba_TrapLog_RegCore2_st[5].DMI_EADD_u32 rba_TrapLog_RegCore2_st[5].DMI_STR_u32 rba_TrapLog_RegCore2_st[5].PCXI_u32 rba_TrapLog_RegCore2_st[5].PIEAR_u32 rba_TrapLog_RegCore2_st[5].PIETR_u32 rba_TrapLog_RegCore2_st[5].PSW_u32 rba_TrapLog_RegCore2_st[5].SYS_TIME_u32 rba_TrapLog_RegCore2_st[5].TRAP_CON_u32 rba_TrapLog_RegCore2_st[5].TRAP_PC_u32 rba_TrapLog_Reg_st[0].BCU_ALSTAT0_u32 rba_TrapLog_Reg_st[0].BCU_ALSTAT1_u32 rba_TrapLog_Reg_st[0].BCU_ALSTAT2_u32 rba_TrapLog_Reg_st[0].BCU_ALSTAT3_u32 rba_TrapLog_Reg_st[0].CHIP_ID_u32 rba_TrapLog_Reg_st[0].COREID_CALIB_TCN_u32 rba_TrapLog_Reg_st[0].DIEAR_u32 rba_TrapLog_Reg_st[0].DIETR_u32 rba_TrapLog_Reg_st[0].DMI_ATR_u32 rba_TrapLog_Reg_st[0].DMI_EADD_u32 rba_TrapLog_Reg_st[0].DMI_STR_u32 rba_TrapLog_Reg_st[0].DMU_HF_ERRSR_u32 rba_TrapLog_Reg_st[0].DOM0_ERRADDRx_u32 rba_TrapLog_Reg_st[0].DOM0_ERRx_u32 rba_TrapLog_Reg_st[0].DOM0_PESTAT_u32 rba_TrapLog_Reg_st[0].DOM0_TIDSTAT_u32 rba_TrapLog_Reg_st[0].PCXI_u32 rba_TrapLog_Reg_st[0].PFI0_MBABRECORD0_u32 rba_TrapLog_Reg_st[0].PFI1_MBABRECORD0_u32 rba_TrapLog_Reg_st[0].PIEAR_u32 rba_TrapLog_Reg_st[0].PIETR_u32 rba_TrapLog_Reg_st[0].PMS_DTSLIM_u32 rba_TrapLog_Reg_st[0].PMS_DTSSTAT_u32 rba_TrapLog_Reg_st[0].PSW_u32 rba_TrapLog_Reg_st[0].SBCU_EADD_u32 rba_TrapLog_Reg_st[0].SBCU_ECON_u32 rba_TrapLog_Reg_st[0].SBCU_EDAT_u32 rba_TrapLog_Reg_st[0].SCU_DTSCLIM_u32 rba_TrapLog_Reg_st[0].SCU_DTSCSTAT_u32 rba_TrapLog_Reg_st[0].SMU_AG0_u32 rba_TrapLog_Reg_st[0].SMU_AG10_u32 rba_TrapLog_Reg_st[0].SMU_AG11_u32 rba_TrapLog_Reg_st[0].SMU_AG1_u32 rba_TrapLog_Reg_st[0].SMU_AG2_u32 rba_TrapLog_Reg_st[0].SMU_AG3_u32 rba_TrapLog_Reg_st[0].SMU_AG4_u32 rba_TrapLog_Reg_st[0].SMU_AG5_u32 rba_TrapLog_Reg_st[0].SMU_AG6_u32 rba_TrapLog_Reg_st[0].SMU_AG7_u32 rba_TrapLog_Reg_st[0].SMU_AG8_u32 rba_TrapLog_Reg_st[0].SMU_AG9_u32 rba_TrapLog_Reg_st[0].SYS_TIME_u32 rba_TrapLog_Reg_st[0].TRAP_CON_u32 rba_TrapLog_Reg_st[0].TRAP_PC_u32 rba_TrapLog_Reg_st[1].BCU_ALSTAT0_u32 rba_TrapLog_Reg_st[1].BCU_ALSTAT1_u32 rba_TrapLog_Reg_st[1].BCU_ALSTAT2_u32 rba_TrapLog_Reg_st[1].BCU_ALSTAT3_u32 rba_TrapLog_Reg_st[1].CHIP_ID_u32 rba_TrapLog_Reg_st[1].COREID_CALIB_TCN_u32 rba_TrapLog_Reg_st[1].DIEAR_u32 rba_TrapLog_Reg_st[1].DIETR_u32 rba_TrapLog_Reg_st[1].DMI_ATR_u32 rba_TrapLog_Reg_st[1].DMI_EADD_u32 rba_TrapLog_Reg_st[1].DMI_STR_u32 rba_TrapLog_Reg_st[1].DMU_HF_ERRSR_u32 rba_TrapLog_Reg_st[1].DOM0_ERRADDRx_u32 rba_TrapLog_Reg_st[1].DOM0_ERRx_u32 rba_TrapLog_Reg_st[1].DOM0_PESTAT_u32 rba_TrapLog_Reg_st[1].DOM0_TIDSTAT_u32 rba_TrapLog_Reg_st[1].PCXI_u32 rba_TrapLog_Reg_st[1].PFI0_MBABRECORD0_u32 rba_TrapLog_Reg_st[1].PFI1_MBABRECORD0_u32 rba_TrapLog_Reg_st[1].PIEAR_u32 rba_TrapLog_Reg_st[1].PIETR_u32 rba_TrapLog_Reg_st[1].PMS_DTSLIM_u32 rba_TrapLog_Reg_st[1].PMS_DTSSTAT_u32 rba_TrapLog_Reg_st[1].PSW_u32 rba_TrapLog_Reg_st[1].SBCU_EADD_u32 rba_TrapLog_Reg_st[1].SBCU_ECON_u32 rba_TrapLog_Reg_st[1].SBCU_EDAT_u32 rba_TrapLog_Reg_st[1].SCU_DTSCLIM_u32 rba_TrapLog_Reg_st[1].SCU_DTSCSTAT_u32 rba_TrapLog_Reg_st[1].SMU_AG0_u32 rba_TrapLog_Reg_st[1].SMU_AG10_u32 rba_TrapLog_Reg_st[1].SMU_AG11_u32 rba_TrapLog_Reg_st[1].SMU_AG1_u32 rba_TrapLog_Reg_st[1].SMU_AG2_u32 rba_TrapLog_Reg_st[1].SMU_AG3_u32 rba_TrapLog_Reg_st[1].SMU_AG4_u32 rba_TrapLog_Reg_st[1].SMU_AG5_u32 rba_TrapLog_Reg_st[1].SMU_AG6_u32 rba_TrapLog_Reg_st[1].SMU_AG7_u32 rba_TrapLog_Reg_st[1].SMU_AG8_u32 rba_TrapLog_Reg_st[1].SMU_AG9_u32 rba_TrapLog_Reg_st[1].SYS_TIME_u32 rba_TrapLog_Reg_st[1].TRAP_CON_u32 rba_TrapLog_Reg_st[1].TRAP_PC_u32 rba_TrapLog_Reg_st[2].BCU_ALSTAT0_u32 rba_TrapLog_Reg_st[2].BCU_ALSTAT1_u32 rba_TrapLog_Reg_st[2].BCU_ALSTAT2_u32 rba_TrapLog_Reg_st[2].BCU_ALSTAT3_u32 rba_TrapLog_Reg_st[2].CHIP_ID_u32 rba_TrapLog_Reg_st[2].COREID_CALIB_TCN_u32 rba_TrapLog_Reg_st[2].DIEAR_u32 rba_TrapLog_Reg_st[2].DIETR_u32 rba_TrapLog_Reg_st[2].DMI_ATR_u32 rba_TrapLog_Reg_st[2].DMI_EADD_u32 rba_TrapLog_Reg_st[2].DMI_STR_u32 rba_TrapLog_Reg_st[2].DMU_HF_ERRSR_u32 rba_TrapLog_Reg_st[2].DOM0_ERRADDRx_u32 rba_TrapLog_Reg_st[2].DOM0_ERRx_u32 rba_TrapLog_Reg_st[2].DOM0_PESTAT_u32 rba_TrapLog_Reg_st[2].DOM0_TIDSTAT_u32 rba_TrapLog_Reg_st[2].PCXI_u32 rba_TrapLog_Reg_st[2].PFI0_MBABRECORD0_u32 rba_TrapLog_Reg_st[2].PFI1_MBABRECORD0_u32 rba_TrapLog_Reg_st[2].PIEAR_u32 rba_TrapLog_Reg_st[2].PIETR_u32 rba_TrapLog_Reg_st[2].PMS_DTSLIM_u32 rba_TrapLog_Reg_st[2].PMS_DTSSTAT_u32 rba_TrapLog_Reg_st[2].PSW_u32 rba_TrapLog_Reg_st[2].SBCU_EADD_u32 rba_TrapLog_Reg_st[2].SBCU_ECON_u32 rba_TrapLog_Reg_st[2].SBCU_EDAT_u32 rba_TrapLog_Reg_st[2].SCU_DTSCLIM_u32 rba_TrapLog_Reg_st[2].SCU_DTSCSTAT_u32 rba_TrapLog_Reg_st[2].SMU_AG0_u32 rba_TrapLog_Reg_st[2].SMU_AG10_u32 rba_TrapLog_Reg_st[2].SMU_AG11_u32 rba_TrapLog_Reg_st[2].SMU_AG1_u32 rba_TrapLog_Reg_st[2].SMU_AG2_u32 rba_TrapLog_Reg_st[2].SMU_AG3_u32 rba_TrapLog_Reg_st[2].SMU_AG4_u32 rba_TrapLog_Reg_st[2].SMU_AG5_u32 rba_TrapLog_Reg_st[2].SMU_AG6_u32 rba_TrapLog_Reg_st[2].SMU_AG7_u32 rba_TrapLog_Reg_st[2].SMU_AG8_u32 rba_TrapLog_Reg_st[2].SMU_AG9_u32 rba_TrapLog_Reg_st[2].SYS_TIME_u32 rba_TrapLog_Reg_st[2].TRAP_CON_u32 rba_TrapLog_Reg_st[2].TRAP_PC_u32 rba_TrapLog_Reg_st[3].BCU_ALSTAT0_u32 rba_TrapLog_Reg_st[3].BCU_ALSTAT1_u32 rba_TrapLog_Reg_st[3].BCU_ALSTAT2_u32 rba_TrapLog_Reg_st[3].BCU_ALSTAT3_u32 rba_TrapLog_Reg_st[3].CHIP_ID_u32 rba_TrapLog_Reg_st[3].COREID_CALIB_TCN_u32 rba_TrapLog_Reg_st[3].DIEAR_u32 rba_TrapLog_Reg_st[3].DIETR_u32 rba_TrapLog_Reg_st[3].DMI_ATR_u32 rba_TrapLog_Reg_st[3].DMI_EADD_u32 rba_TrapLog_Reg_st[3].DMI_STR_u32 rba_TrapLog_Reg_st[3].DMU_HF_ERRSR_u32 rba_TrapLog_Reg_st[3].DOM0_ERRADDRx_u32 rba_TrapLog_Reg_st[3].DOM0_ERRx_u32 rba_TrapLog_Reg_st[3].DOM0_PESTAT_u32 rba_TrapLog_Reg_st[3].DOM0_TIDSTAT_u32 rba_TrapLog_Reg_st[3].PCXI_u32 rba_TrapLog_Reg_st[3].PFI0_MBABRECORD0_u32 rba_TrapLog_Reg_st[3].PFI1_MBABRECORD0_u32 rba_TrapLog_Reg_st[3].PIEAR_u32 rba_TrapLog_Reg_st[3].PIETR_u32 rba_TrapLog_Reg_st[3].PMS_DTSLIM_u32 rba_TrapLog_Reg_st[3].PMS_DTSSTAT_u32 rba_TrapLog_Reg_st[3].PSW_u32 rba_TrapLog_Reg_st[3].SBCU_EADD_u32 rba_TrapLog_Reg_st[3].SBCU_ECON_u32 rba_TrapLog_Reg_st[3].SBCU_EDAT_u32 rba_TrapLog_Reg_st[3].SCU_DTSCLIM_u32 rba_TrapLog_Reg_st[3].SCU_DTSCSTAT_u32 rba_TrapLog_Reg_st[3].SMU_AG0_u32 rba_TrapLog_Reg_st[3].SMU_AG10_u32 rba_TrapLog_Reg_st[3].SMU_AG11_u32 rba_TrapLog_Reg_st[3].SMU_AG1_u32 rba_TrapLog_Reg_st[3].SMU_AG2_u32 rba_TrapLog_Reg_st[3].SMU_AG3_u32 rba_TrapLog_Reg_st[3].SMU_AG4_u32 rba_TrapLog_Reg_st[3].SMU_AG5_u32 rba_TrapLog_Reg_st[3].SMU_AG6_u32 rba_TrapLog_Reg_st[3].SMU_AG7_u32 rba_TrapLog_Reg_st[3].SMU_AG8_u32 rba_TrapLog_Reg_st[3].SMU_AG9_u32 rba_TrapLog_Reg_st[3].SYS_TIME_u32 rba_TrapLog_Reg_st[3].TRAP_CON_u32 rba_TrapLog_Reg_st[3].TRAP_PC_u32 rba_TrapLog_Reg_st[4].BCU_ALSTAT0_u32 rba_TrapLog_Reg_st[4].BCU_ALSTAT1_u32 rba_TrapLog_Reg_st[4].BCU_ALSTAT2_u32 rba_TrapLog_Reg_st[4].BCU_ALSTAT3_u32 rba_TrapLog_Reg_st[4].CHIP_ID_u32 rba_TrapLog_Reg_st[4].COREID_CALIB_TCN_u32 rba_TrapLog_Reg_st[4].DIEAR_u32 rba_TrapLog_Reg_st[4].DIETR_u32 rba_TrapLog_Reg_st[4].DMI_ATR_u32 rba_TrapLog_Reg_st[4].DMI_EADD_u32 rba_TrapLog_Reg_st[4].DMI_STR_u32 rba_TrapLog_Reg_st[4].DMU_HF_ERRSR_u32 rba_TrapLog_Reg_st[4].DOM0_ERRADDRx_u32 rba_TrapLog_Reg_st[4].DOM0_ERRx_u32 rba_TrapLog_Reg_st[4].DOM0_PESTAT_u32 rba_TrapLog_Reg_st[4].DOM0_TIDSTAT_u32 rba_TrapLog_Reg_st[4].PCXI_u32 rba_TrapLog_Reg_st[4].PFI0_MBABRECORD0_u32 rba_TrapLog_Reg_st[4].PFI1_MBABRECORD0_u32 rba_TrapLog_Reg_st[4].PIEAR_u32 rba_TrapLog_Reg_st[4].PIETR_u32 rba_TrapLog_Reg_st[4].PMS_DTSLIM_u32 rba_TrapLog_Reg_st[4].PMS_DTSSTAT_u32 rba_TrapLog_Reg_st[4].PSW_u32 rba_TrapLog_Reg_st[4].SBCU_EADD_u32 rba_TrapLog_Reg_st[4].SBCU_ECON_u32 rba_TrapLog_Reg_st[4].SBCU_EDAT_u32 rba_TrapLog_Reg_st[4].SCU_DTSCLIM_u32 rba_TrapLog_Reg_st[4].SCU_DTSCSTAT_u32 rba_TrapLog_Reg_st[4].SMU_AG0_u32 rba_TrapLog_Reg_st[4].SMU_AG10_u32 rba_TrapLog_Reg_st[4].SMU_AG11_u32 rba_TrapLog_Reg_st[4].SMU_AG1_u32 rba_TrapLog_Reg_st[4].SMU_AG2_u32 rba_TrapLog_Reg_st[4].SMU_AG3_u32 rba_TrapLog_Reg_st[4].SMU_AG4_u32 rba_TrapLog_Reg_st[4].SMU_AG5_u32 rba_TrapLog_Reg_st[4].SMU_AG6_u32 rba_TrapLog_Reg_st[4].SMU_AG7_u32 rba_TrapLog_Reg_st[4].SMU_AG8_u32 rba_TrapLog_Reg_st[4].SMU_AG9_u32 rba_TrapLog_Reg_st[4].SYS_TIME_u32 rba_TrapLog_Reg_st[4].TRAP_CON_u32 rba_TrapLog_Reg_st[4].TRAP_PC_u32 rba_TrapLog_Reg_st[5].BCU_ALSTAT0_u32 rba_TrapLog_Reg_st[5].BCU_ALSTAT1_u32 rba_TrapLog_Reg_st[5].BCU_ALSTAT2_u32 rba_TrapLog_Reg_st[5].BCU_ALSTAT3_u32 rba_TrapLog_Reg_st[5].CHIP_ID_u32 rba_TrapLog_Reg_st[5].COREID_CALIB_TCN_u32 rba_TrapLog_Reg_st[5].DIEAR_u32 rba_TrapLog_Reg_st[5].DIETR_u32 rba_TrapLog_Reg_st[5].DMI_ATR_u32 rba_TrapLog_Reg_st[5].DMI_EADD_u32 rba_TrapLog_Reg_st[5].DMI_STR_u32 rba_TrapLog_Reg_st[5].DMU_HF_ERRSR_u32 rba_TrapLog_Reg_st[5].DOM0_ERRADDRx_u32 rba_TrapLog_Reg_st[5].DOM0_ERRx_u32 rba_TrapLog_Reg_st[5].DOM0_PESTAT_u32 rba_TrapLog_Reg_st[5].DOM0_TIDSTAT_u32 rba_TrapLog_Reg_st[5].PCXI_u32 rba_TrapLog_Reg_st[5].PFI0_MBABRECORD0_u32 rba_TrapLog_Reg_st[5].PFI1_MBABRECORD0_u32 rba_TrapLog_Reg_st[5].PIEAR_u32 rba_TrapLog_Reg_st[5].PIETR_u32 rba_TrapLog_Reg_st[5].PMS_DTSLIM_u32 rba_TrapLog_Reg_st[5].PMS_DTSSTAT_u32 rba_TrapLog_Reg_st[5].PSW_u32 rba_TrapLog_Reg_st[5].SBCU_EADD_u32 rba_TrapLog_Reg_st[5].SBCU_ECON_u32 rba_TrapLog_Reg_st[5].SBCU_EDAT_u32 rba_TrapLog_Reg_st[5].SCU_DTSCLIM_u32 rba_TrapLog_Reg_st[5].SCU_DTSCSTAT_u32 rba_TrapLog_Reg_st[5].SMU_AG0_u32 rba_TrapLog_Reg_st[5].SMU_AG10_u32 rba_TrapLog_Reg_st[5].SMU_AG11_u32 rba_TrapLog_Reg_st[5].SMU_AG1_u32 rba_TrapLog_Reg_st[5].SMU_AG2_u32 rba_TrapLog_Reg_st[5].SMU_AG3_u32 rba_TrapLog_Reg_st[5].SMU_AG4_u32 rba_TrapLog_Reg_st[5].SMU_AG5_u32 rba_TrapLog_Reg_st[5].SMU_AG6_u32 rba_TrapLog_Reg_st[5].SMU_AG7_u32 rba_TrapLog_Reg_st[5].SMU_AG8_u32 rba_TrapLog_Reg_st[5].SMU_AG9_u32 rba_TrapLog_Reg_st[5].SYS_TIME_u32 rba_TrapLog_Reg_st[5].TRAP_CON_u32 rba_TrapLog_Reg_st[5].TRAP_PC_u32 /end LOC_MEASUREMENT
 FUNCTION_VERSION "4.3.0" /end FUNCTION
/begin FUNCTION CanSM "11.16.2  McFunction CanSM Created by MCFunctionUpdater"
 /begin LOC_MEASUREMENT CanSM_BORMode_au8 CanSM_BusOffISRPend_ab CanSM_BusOff_Cntr_au8 CanSM_CurrNw_Mode_en CanSM_MutexMode_au8 CanSM_Network_Init_ab CanSM_ReqComM_Mode_en CanSM_TimerConfig_ast[0].cntTick_u16 CanSM_TimerConfig_ast[0].stTimer CanSM_TimerConfig_ast[1].cntTick_u16 CanSM_TimerConfig_ast[1].stTimer CanSM_TimerConfig_ast[2].cntTick_u16 CanSM_TimerConfig_ast[2].stTimer CanSM_currBOR_State_en /end LOC_MEASUREMENT
 FUNCTION_VERSION "11.16.2" /end FUNCTION
/begin FUNCTION CanTp "53.0.0_7.3.0  McFunction CanTp Created by MCFunctionUpdater" /begin LOC_MEASUREMENT CanTp_MainState /end LOC_MEASUREMENT FUNCTION_VERSION "53.0.0_7.3.0" /end FUNCTION
/*********** Start of merged COMPU_METHOD blocks ***********/
/begin COMPU_METHOD RB_RBA_Common_CentralElements_CompuMethods_Identical "The internal value and the physical one are identical. No physical unit available" RAT_FUNC "%10.5" "noUnit" COEFFS 0.0 1.0 0.0 0.0 0.0 1.0 REF_UNIT RB_RBA_Common_CentralElements_Units_NoUnit /end COMPU_METHOD
/begin COMPU_METHOD AUTOSAR_CanSM_CompuMethods_CanSM_NetworkModeStateType_Enum_comp "Computation method for the enum CanSM_NetworkModeStateType" TAB_VERB "%10.5" "noUnit" COMPU_TAB_REF AUTOSAR_CanSM_CompuMethods_CanSM_NetworkModeStateType_Enum_comp REF_UNIT AUTOSAR_CanSM_Units_NoUnit /end COMPU_METHOD
/begin COMPU_METHOD AUTOSAR_CanSM_CompuMethods_CanSM_TimerStateType_Enum_comp "Computation method for the enum CanSM_TimerStateType" TAB_VERB "%10.5" "noUnit" COMPU_TAB_REF AUTOSAR_CanSM_CompuMethods_CanSM_TimerStateType_Enum_comp REF_UNIT AUTOSAR_CanSM_Units_NoUnit /end COMPU_METHOD
/begin COMPU_METHOD AUTOSAR_CanSM_CompuMethods_CanSM_BusOffRecoveryStateType_Enum_comp "Computation method for the enum CanSM_BusOffRecoveryStateType" TAB_VERB "%10.5" "noUnit" COMPU_TAB_REF AUTOSAR_CanSM_CompuMethods_CanSM_BusOffRecoveryStateType_Enum_comp REF_UNIT AUTOSAR_CanSM_Units_NoUnit /end COMPU_METHOD
/begin COMPU_METHOD RB_RBA_rba_TrapLog_CompuMethods_rba_TrapLog_oneToOne "rba_TrapLog computation method" RAT_FUNC "%10.5" "rba_TrapLog_Unit" COEFFS 0.0 1.0 0.0 0.0 0.0 1.0 REF_UNIT RB_RBA_rba_TrapLog_Units_rba_TrapLog_Unit /end COMPU_METHOD
/begin COMPU_METHOD RB_RBA_rba_TrapLog_CompuMethods_rba_TrapLog_ResetLogCompuMethod "CompuMethod used for resetting the logs" TAB_VERB "%10.5" "rba_TrapLog_Unit" COMPU_TAB_REF RB_RBA_rba_TrapLog_CompuMethods_rba_TrapLog_ResetLogCompuMethod REF_UNIT RB_RBA_rba_TrapLog_Units_rba_TrapLog_Unit /end COMPU_METHOD
/begin COMPU_METHOD DefaultIdenticalCompu "" RAT_FUNC "%10.5" "" COEFFS 0.0 1.0 0.0 0.0 0.0 1.0 /end COMPU_METHOD
/*********** Start of merged COMPU_VTAB blocks ***********/
/begin COMPU_VTAB AUTOSAR_CanSM_CompuMethods_CanSM_NetworkModeStateType_Enum_comp "Computation method for the enum CanSM_NetworkModeStateType" TAB_VERB 10 0 "CANSM_BSM_S_NOCOM" 1 "CANSM_BSM_S_SILENTCOM" 2 "CANSM_BSM_S_FULLCOM" 3 "CANSM_BSM_S_NOT_INITIALIZED" 4 "CANSM_BSM_S_PRE_NOCOM" 5 "CANSM_BSM_WUVALIDATION" 6 "CANSM_BSM_S_PRE_FULLCOM" 7 "CANSM_BSM_S_SET_BAUDRATE" 8 "CANSM_BSM_S_SILENTCOM_BOR" 9 "CANSM_BSM_S_TX_TIMEOUT_EXCEPTION" /end COMPU_VTAB
/begin COMPU_VTAB AUTOSAR_CanSM_CompuMethods_CanSM_TimerStateType_Enum_comp "Computation method for the enum CanSM_TimerStateType" TAB_VERB 4 1 "CANSM_TIMER_INIT" 2 "CANSM_TIMER_RUNNING" 3 "CANSM_TIMER_ELAPSED" 4 "CANSM_TIMER_CANCELLED" /end COMPU_VTAB
/begin COMPU_VTAB AUTOSAR_CanSM_CompuMethods_CanSM_BusOffRecoveryStateType_Enum_comp "Computation method for the enum CanSM_BusOffRecoveryStateType" TAB_VERB 6 1 "CANSM_BOR_IDLE" 2 "CANSM_S_BUS_OFF_CHECK" 3 "CANSM_S_NO_BUS_OFF" 4 "CANSM_S_TX_OFF" 5 "CANSM_S_RESTART_CC" 6 "CANSM_S_RESTART_CC_WAIT" /end COMPU_VTAB
/begin COMPU_VTAB RB_RBA_rba_TrapLog_CompuMethods_rba_TrapLog_ResetLogCompuMethod "CompuMethod used for resetting the logs" TAB_VERB 2 0 "Idle State" 1 "Reset the logs" /end COMPU_VTAB
/begin COMPU_METHOD AFS_DRIFTCMPPRSNT_SC_Compu "" TAB_VERB "%6.3" "" COMPU_TAB_REF AFS_DRIFTCMPPRSNT_SC_Compu /end COMPU_METHOD
/begin COMPU_VTAB AFS_DRIFTCMPPRSNT_SC_Compu "" TAB_VERB 2 0 "False" 1 "True" /end COMPU_VTAB
/begin COMPU_METHOD AFS_HFMSNSRPRSNT_SC_Compu "" TAB_VERB "%6.3" "" COMPU_TAB_REF AFS_HFMSNSRPRSNT_SC_Compu /end COMPU_METHOD
/begin COMPU_VTAB AFS_HFMSNSRPRSNT_SC_Compu "" TAB_VERB 2 0 "Disable" 1 "Enable" /end COMPU_VTAB
/begin COMPU_METHOD AFS_PLSCORRNADVENA_SC_Compu "" TAB_VERB "%6.3" "" COMPU_TAB_REF AFS_PLSCORRNADVENA_SC_Compu /end COMPU_METHOD
/begin COMPU_VTAB AFS_PLSCORRNADVENA_SC_Compu "" TAB_VERB 2 0 "Disabled" 1 "Enabled" /end COMPU_VTAB
/begin COMPU_METHOD AFS_PLSTAMPRATCALCN_SC_Compu "" RAT_FUNC "%6.2" "" COEFFS 0 1 0 0 0 1 /end COMPU_METHOD
/begin COMPU_METHOD AFS_PLSTCORRNTYP_SC_Compu "" TAB_VERB "%6.3" "" COMPU_TAB_REF AFS_PLSTCORRNTYP_SC_Compu /end COMPU_METHOD
/begin COMPU_VTAB AFS_PLSTCORRNTYP_SC_Compu "" TAB_VERB 4 0 "Afs_PlstCorrnDisad" 1 "Afs_CnvtnlPlstCorrn" 2 "Afs_AdvPlstCorrn" 3 "Afs_Adv_Cnvtnl_PlstCorrn" /end COMPU_VTAB
/begin COMPU_METHOD AFS_RATYDIAGPRSNT_SC_Compu "" TAB_VERB "%6.3" "" COMPU_TAB_REF AFS_RATYDIAGPRSNT_SC_Compu /end COMPU_METHOD
/begin COMPU_VTAB AFS_RATYDIAGPRSNT_SC_Compu "" TAB_VERB 2 0 "Not_present" 1 "Present" /end COMPU_VTAB
/begin COMPU_METHOD AFS_Rmp "" RAT_FUNC "%6.3" "1/s" COEFFS 0 6.5536 0 0 0 1 /end COMPU_METHOD
/begin COMPU_METHOD AFS_SUBSVALMAPIN_SY_Compu "" TAB_VERB "%6.3" "" COMPU_TAB_REF AFS_SUBSVALMAPIN_SY_Compu /end COMPU_METHOD
/begin COMPU_VTAB AFS_SUBSVALMAPIN_SY_Compu "" TAB_VERB 2 0 "BOOST_PRESSURE" 1 "RAW_INJECTION_QUANTITY" /end COMPU_VTAB
/*********** Start of merged RECORD_LAYOUT blocks ***********/
/begin RECORD_LAYOUT DefaultValueRecordLayout_AUTOSAR_Platform_BaseTypes_uint8 FNC_VALUES 1 UBYTE COLUMN_DIR DIRECT STATIC_RECORD_LAYOUT /end RECORD_LAYOUT
/*********** Start of merged UNIT blocks ***********/
/begin UNIT RB_RBA_Common_CentralElements_Units_NoUnit "No Unit" "noUnit" EXTENDED_SI SI_EXPONENTS 0 0 0 0 0 0 0 /end UNIT
/begin UNIT AUTOSAR_CanSM_Units_NoUnit "No Unit" "noUnit" EXTENDED_SI SI_EXPONENTS 0 0 0 0 0 0 0 /end UNIT
/begin UNIT RB_RBA_rba_TrapLog_Units_rba_TrapLog_Unit "Main unit of the rba_trapLog" "rba_TrapLog_Unit" EXTENDED_SI /end UNIT
/end MODULE
/end PROJECT
