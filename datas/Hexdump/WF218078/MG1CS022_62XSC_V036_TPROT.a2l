ASAP2_VERSION 1 60
/begin PROJECT MG1CS022 "MG1CS022"
/begin HEADER "" VERSION "MG1CS022_62XSC_V036_TPROT" PROJECT_NO MG1CS022 /end HEADER
/begin MODULE DIM ""
/begin MOD_COMMON "" BYTE_ORDER MSB_LAST ALIGNMENT_BYTE 1 ALIGNMENT_WORD 2 ALIGNMENT_LONG 4 ALIGNMENT_INT64 4 ALIGNMENT_FLOAT32_IEEE 4 ALIGNMENT_FLOAT64_IEEE 4 DATA_SIZE 32 /end MOD_COMMON
/begin CHARACTERISTIC CatH_TempSelnCat1B1_I.ExhMgT_idxBrick1Cat_C "class instance for catalyst heating temperature selection for catalyst 1 bank1 / index first brick catalyst 1 for catalyst heating calibration" VALUE 0x80544F1C RB_Val_Wu8 255.0 OneToOne 0.00 255.0 FORMAT "%5.1" /end CHARACTERISTIC
/begin CHARACTERISTIC CatH_TempSelnCat1B1_I.ExhMgT_idxBrick2Cat_C "class instance for catalyst heating temperature selection for catalyst 1 bank1 / index second brick catalyst 1 for catalyst heating calibration" VALUE 0x80544F1D RB_Val_Wu8 255.0 OneToOne 0.00 255.0 FORMAT "%5.1" /end CHARACTERISTIC
/begin CHARACTERISTIC CatH_TempSelnCat1B1_I.ExhMgT_idxBrick3Cat_C "class instance for catalyst heating temperature selection for catalyst 1 bank1 / index third brick catalyst 1 for catalyst heating calibration" VALUE 0x80544F1E RB_Val_Wu8 255.0 OneToOne 0.00 255.0 FORMAT "%5.1" /end CHARACTERISTIC
/begin CHARACTERISTIC CatH_TempSelnCat2B1_I.ExhMgT_idxBrick1Cat_C "class instance for catalyst heating temperature selection for catalyst 2 bank1 / index first brick catalyst 2 for catalyst heating calibration" VALUE 0x80544F24 RB_Val_Wu8 255.0 OneToOne 0.00 255.0 FORMAT "%5.1" /end CHARACTERISTIC
/begin CHARACTERISTIC CatH_TempSelnCat2B1_I.ExhMgT_idxBrick2Cat_C "class instance for catalyst heating temperature selection for catalyst 2 bank1 / index second brick catalyst 2 for catalyst heating calibration" VALUE 0x80544F25 RB_Val_Wu8 255.0 OneToOne 0.00 255.0 FORMAT "%5.1" /end CHARACTERISTIC
/begin CHARACTERISTIC CatH_TempSelnCat2B1_I.ExhMgT_idxBrick3Cat_C "class instance for catalyst heating temperature selection for catalyst 2 bank1 / index third brick catalyst 2 for catalyst heating calibration" VALUE 0x80544F26 RB_Val_Wu8 255.0 OneToOne 0.00 255.0 FORMAT "%5.1" /end CHARACTERISTIC
/begin CHARACTERISTIC DLBTSGANG "Delta lambda component protection, gear-dependent" CURVE 0x80546198 RB_Curve_S16_S16 0.6250000 fak_sw_b8 -0.5000000 0.1250000 FORMAT "%9.7" EXTENDED_LIMITS -8.000000 7.999756
 /begin AXIS_DESCR STD_AXIS gangsist_msg dez 10 -128.0000 127.0000 FORMAT "%8.4" EXTENDED_LIMITS -32768.00 32767.00 DEPOSIT ABSOLUTE /end AXIS_DESCR
/end CHARACTERISTIC
/begin CHARACTERISTIC DLBTSTMOT "Delta lambda component protection, engine temperature dependent" CURVE 0x805461C2 RB_Curve_S16_S16 0.6250000 fak_sw_b8 -0.5000000 0.1250000 FORMAT "%9.7" EXTENDED_LIMITS -8.000000 7.999756
 /begin AXIS_DESCR STD_AXIS CEngDsT_t Temp_Cels 6 -3549.940 3003.560 FORMAT "%8.3" DEPOSIT ABSOLUTE /end AXIS_DESCR
/end CHARACTERISTIC
/begin CHARACTERISTIC DLBTSVFZG "Delta lambda component protection, vehicle speed dependent" CURVE 0x805461DC RB_Curve_S16_S16 0.6250000 fak_sw_b8 -0.5000000 0.1250000 FORMAT "%9.7" EXTENDED_LIMITS -8.000000 7.999756
 /begin AXIS_DESCR STD_AXIS VehV_v Vel 6 -327.6800 327.6700 FORMAT "%8.4" DEPOSIT ABSOLUTE /end AXIS_DESCR
/end CHARACTERISTIC
/begin CHARACTERISTIC DMRTEK "Filter-Constant for the torque reserve for purge control" VALUE 0x80544D10 RB_Val_Wu16 9.999847 k100ms_uw_b10 0.00 9.999847 FORMAT "%8.6" /end CHARACTERISTIC
/begin CHARACTERISTIC DPTELFU "lower threshold for start of diagnose" VALUE 0x80544DAC RB_Val_Ws8 159.4 p_sb_q0p625 -80.00 79.38 FORMAT "%5.2" /end CHARACTERISTIC
/begin CHARACTERISTIC DRLMXBTS "Distance between the desired charge and the relative air charge which implies faster reduction of maximum air charge by component protection" VALUE 0x805461F6 RB_Val_Wu16 1535.977 rel_uw_q0p0234 0.00 1535.977 FORMAT "%8.3" /end CHARACTERISTIC
/begin CHARACTERISTIC DSTGRAD "gradient for conversion voltage -> pressure of tank pressure sensor" VALUE 0x80544DA2 RB_Val_Ws16 127.9980 adb_uw_q0p00195 -64.00000 63.99805 FORMAT "%8.5" /end CHARACTERISTIC
/begin CHARACTERISTIC DSTOFFS "offset for conversion voltage -> pressure of tank pressure sensor" VALUE 0x80544DA4 RB_Val_Wu16 319.9951 spg_q0p00488 0.00 319.9951 FORMAT "%8.4" /end CHARACTERISTIC
/begin CHARACTERISTIC DYNMETKH "dynamic threshold of engine speed for inhibiting diagnosis of engine efficiency for catalyst heating" VALUE 0x80544F28 RB_Val_Wu16 16383.50 EngN 0.00 16383.50 FORMAT "%8.2" EXTENDED_LIMITS 0.00 32767.50 /end CHARACTERISTIC
/begin CHARACTERISTIC DYRLETKH "dynamic threshold of relative air charge for inhibiting diagnosis of engine efficiency for catalyst heating" VALUE 0x80544F2A RB_Val_Wu16 1535.977 rel_uw_q0p0234 0.00 1535.977 FORMAT "%8.3" /end CHARACTERISTIC
/begin CHARACTERISTIC ENDEKHMNLL "threshold release calculation of engine efficiency deviation for diagnosis of ignition during idle" VALUE 0x80544F2C RB_Val_Wu16 1.999969 fak_q3p0518Em5 0.00 1.999969 FORMAT "%8.6" /end CHARACTERISTIC
/begin CHARACTERISTIC ENDEKHMNTL "threshold release calculation of engine efficiency deviation for diagnosis of ignition during part load" VALUE 0x80544F2E RB_Val_Wu16 1.999969 fak_q3p0518Em5 0.00 1.999969 FORMAT "%8.6" /end CHARACTERISTIC
/begin CHARACTERISTIC EvapPSnsrTank_mFlowCpvPhyRngChk_C "threshold integrated CPV-mass flow for physical range check of tank pressure sensor" VALUE 0x80544DAE RB_Val_Wu16 22.75521 m_3p47222Em4_g 0.00 22.75521 FORMAT "%8.5" /end CHARACTERISTIC
/begin CHARACTERISTIC EvapPSnsrTank_stPhyRngChk_C "Code word to configure physical range check of the tank pressure sensor" VALUE 0x80544DB0 RB_Val_Wu8 255.0 dez 0.00 255.0 FORMAT "%5.1" /end CHARACTERISTIC
/begin CHARACTERISTIC EvapPSnsrTank_tiCcvOpenPhyRngChk_C "debouncing time for CCV-opening at tank pressure sensor" VALUE 0x80544DB1 RB_Val_Wu8 25.50 t_q0p1 0.00 25.50 FORMAT "%5.2" /end CHARACTERISTIC
/begin CHARACTERISTIC EvapPSnsrTank_tiFltDetnPhyRngChk_C "debouncing time for fault detection tank pressure sensor (physical range check)" VALUE 0x80544DB2 RB_Val_Wu8 25.50 t_q0p1 0.00 25.50 FORMAT "%5.2" /end CHARACTERISTIC
/begin CHARACTERISTIC EvapPSnsrTank_tiPhyRngChk_C "time constant for low pass filter for physical range check of tank pressure sensor" VALUE 0x80544DB3 RB_Val_Wu8 2.54996 zk10msxs_ub_b2p56 0.01004 2.56000 FORMAT "%7.5" EXTENDED_LIMITS 0.0100392 2.56000 /end CHARACTERISTIC
/begin CHARACTERISTIC EvapPSnsrTank_tiStrtStabnPhyRngChk_C "time period for engine start stabilization for physical range check of tank pressure sensor" VALUE 0x80544DB4 RB_Val_Wu8 25.50 t_q0p1 0.00 25.50 FORMAT "%5.2" /end CHARACTERISTIC
/begin CHARACTERISTIC EvapPSnsrTank_tiVehVEnaPhyRngChk_C "time vehicle speed for enabling physical range check of tank pressure sensor" VALUE 0x80544DB6 RB_Val_Wu16 6553.400 t_q0p1 0.00 6553.400 FORMAT "%8.3" EXTENDED_LIMITS 0.00 6553.500 /end CHARACTERISTIC
/begin CHARACTERISTIC EvapPSnsrTank_tMaxEnvTPhyRngChk_C "maximum ambient temperature for physical range check of tank pressure sensor" VALUE 0x80544DB8 RB_Val_Ws16 6553.500 Temp_Cels -3549.940 3003.560 FORMAT "%8.3" /end CHARACTERISTIC
/begin CHARACTERISTIC EvapPSnsrTank_tMinEnvTPhyRngChk_C "minimum ambient temperature for physical range check of tank pressure sensor" VALUE 0x80544DBA RB_Val_Ws16 6553.500 Temp_Cels -3549.940 3003.560 FORMAT "%8.3" /end CHARACTERISTIC
/begin CHARACTERISTIC EvapPSnsrTank_vMinPhyRngChk_C "minimum velocity for physical range check of the tank pressure sensor" VALUE 0x80544DBC RB_Val_Ws16 655.3500 Vel -327.6800 327.6700 FORMAT "%8.4" /end CHARACTERISTIC
/begin CHARACTERISTIC ExhCo_swtTSelnCatHeatgGpf_C "An application switch to select either Sensor or modelled temperature from exhaust modules" VALUE 0x80544DD4 RB_Val_Wu8 1.00000000000 B_TRUE 0.00 1.00000000000 FORMAT "%13.11" /end CHARACTERISTIC
/begin CHARACTERISTIC ExhMgT_DeltaPredLoadCptProtn_T "Relative air charge gradient because of load dynamic at which component protection is necessary" CURVE 0x80545CF4 RB_Curve_S16_S16 1535.977 rel_sw_q0p0234 -768.0000 767.9766 FORMAT "%8.4"
 /begin AXIS_DESCR STD_AXIS Epm_nEng EngN 16 -16384.00 16383.50 FORMAT "%8.2" DEPOSIT ABSOLUTE /end AXIS_DESCR
/end CHARACTERISTIC
/begin CHARACTERISTIC ExhMgT_effDeltaIdleOperMod_C "delta threshold for engine efficiency for the change of the injection mode during idling for catalyst heating" VALUE 0x80545124 RB_Val_Wu16 1.999969 fak_uw_b2 0.00 1.999969 FORMAT "%8.6" /end CHARACTERISTIC
/begin CHARACTERISTIC ExhMgT_effEngIdleNonCsersMax_M "maximum allowed deviation of ignition efficiency during catalyst haeting during idle (MAX-Errorpath)" MAP 0x80544F30 RB_Map_S16S16_S16 1.999969 fak_q3p0518Em5 -1.000000 0.999969 FORMAT "%8.6" EXTENDED_LIMITS -1.000000 0.9999695
 /begin AXIS_DESCR STD_AXIS CEngDsT_t Temp_Cels 8 -3549.940 3003.560 FORMAT "%8.3" DEPOSIT ABSOLUTE /end AXIS_DESCR
 /begin AXIS_DESCR STD_AXIS NO_INPUT_QUANTITY fak_sw_b4 4 0.00 3.999878 FORMAT "%8.6" EXTENDED_LIMITS -4.000000 3.999878 DEPOSIT ABSOLUTE /end AXIS_DESCR
/end CHARACTERISTIC
/begin CHARACTERISTIC ExhMgT_effEngPtlNonCsersMax_M "maximum allowed deviation of ignition efficiency during catalyst haeting during part load (MAX-Errorpath)" MAP 0x80544F8C RB_Map_S16S16_S16 1.999969 fak_q3p0518Em5 -1.000000 0.999969 FORMAT "%8.6" EXTENDED_LIMITS -1.000000 0.9999695
 /begin AXIS_DESCR STD_AXIS CEngDsT_t Temp_Cels 8 -3549.940 3003.560 FORMAT "%8.3" DEPOSIT ABSOLUTE /end AXIS_DESCR
 /begin AXIS_DESCR STD_AXIS NO_INPUT_QUANTITY fak_sw_b4 4 0.00 3.999878 FORMAT "%8.6" EXTENDED_LIMITS -4.000000 3.999878 DEPOSIT ABSOLUTE /end AXIS_DESCR
/end CHARACTERISTIC
/begin CHARACTERISTIC ExhMgT_effThdIdleOperMod_T "upper hysteresis threshold of the engine efficiency for the change of the injection mode during idling for catalyst heating" CURVE 0x80545126 RB_Curve_S16_U16_Static 1.999969 fak_uw_b2 0.00 1.999969 FORMAT "%8.6"
 /begin AXIS_DESCR STD_AXIS ExhMgT_tEngCatHeatgOperMod Temp_Cels 6 -3549.940 3003.560 FORMAT "%8.3" DEPOSIT ABSOLUTE /end AXIS_DESCR
/end CHARACTERISTIC
/begin CHARACTERISTIC ExhMgT_facBldFillgCptProtnGov_T "curve for the relative regrow of maximum air charge per second" CURVE 0x805461F8 RB_Curve_S16_S16 1.999969 fak_sw_b1 -1.000000 0.999969 FORMAT "%8.6" EXTENDED_LIMITS -1.000000 0.9999695
 /begin AXIS_DESCR STD_AXIS NO_INPUT_QUANTITY temp_q0p1_K 8 -3276.800 3276.700 FORMAT "%8.3" DEPOSIT ABSOLUTE /end AXIS_DESCR
/end CHARACTERISTIC
/begin CHARACTERISTIC ExhMgT_facCorrnTempCatHeatgMax_C "Parameter for maximum factor to calculate temperature correction factor for catalyst heating" VALUE 0x80544E80 RB_Val_Wu16 1.999969 fak_uw_b2 0.00 1.999969 FORMAT "%8.6" /end CHARACTERISTIC
/begin CHARACTERISTIC ExhMgT_facCorrnTempCatHeatgMin_C "Parameter for minimum factor to calculate temperature correction factor for catalyst heating" VALUE 0x80544E82 RB_Val_Wu16 1.999969 fak_uw_b2 0.00 1.999969 FORMAT "%8.6" /end CHARACTERISTIC
/begin CHARACTERISTIC ExhMgT_facCptProtnMisf_T "Curve for the desired air charge reduction factor during exhaust component protection due to misfires that lead to catalyst damage based on engine speed" CURVE 0x8054621A RB_Curve_S16_U16_Static 0.3999939 fak_uw_b2 0.600006 1.000000 FORMAT "%8.6" EXTENDED_LIMITS 0.00 1.999969
 /begin AXIS_DESCR STD_AXIS Epm_nEng EngN 6 -16384.00 16383.50 FORMAT "%8.2" DEPOSIT ABSOLUTE /end AXIS_DESCR
/end CHARACTERISTIC
/begin CHARACTERISTIC ExhMgT_facDeltaLamIntkAirTCptProtn_GM "factor for correction of the Delta lambda component protection dependent on intake air temperature above a nominal charge air temperature" MAP 0x80546234 RB_MapGroup_U16 1.999969 fak_uw_b2 0.00 1.999969 FORMAT "%8.6"
 /begin AXIS_DESCR COM_AXIS Epm_nEng EngN 16 -16384.00 16383.50 FORMAT "%8.2" AXIS_PTS_REF SNM16GKUW /end AXIS_DESCR
 /begin AXIS_DESCR COM_AXIS AirMod_ratChrgAirCyl rel_uw_q0p0234 15 0.00 1535.977 FORMAT "%8.3" AXIS_PTS_REF SRL15GKUW /end AXIS_DESCR
/end CHARACTERISTIC
/begin CHARACTERISTIC ExhMgT_facInvnHeatgDmdHeatgProgs_T "Characteristic Curve for linearisation from factor catalyst heating demand to factor catalyst heating progress" CURVE 0x80544E92 RB_Curve_S16_U16_Static 0.9999847 fak_uw_b1 0.00 0.9999847 FORMAT "%9.7"
 /begin AXIS_DESCR STD_AXIS ExhMgT_facHeatgDmdCat1 Fact 4 -4.000000 3.999878 FORMAT "%8.6" DEPOSIT ABSOLUTE /end AXIS_DESCR
/end CHARACTERISTIC
/begin CHARACTERISTIC ExhMgT_facMaxCatHeatgDmdHSP_C "maximal heating progress till a requirement for operation mode HSP for catalyst heating is set" VALUE 0x80545140 RB_Val_Wu16 0.9999847 fak_uw_b1 0.00 0.9999847 FORMAT "%9.7" /end CHARACTERISTIC
/begin CHARACTERISTIC ExhMgT_facMinCatHeatgDmdHSP_C "minimal heating progress for requirement for operation mode HSP for catalyst heating" VALUE 0x80545142 RB_Val_Wu16 0.9999847 fak_uw_b1 0.00 0.9999847 FORMAT "%9.7" /end CHARACTERISTIC
/begin CHARACTERISTIC ExhMgT_facRatEngSplt_T "Curve weighting factor for the engine load to address the catalyst heating operating point maps" CURVE 0x80545144 RB_Curve_S16_U16_Static 7.999878 fak_uw_b8 0.00 7.999878 FORMAT "%8.6"
 /begin AXIS_DESCR STD_AXIS ExhMgT_tEngCatHeatgOperMod temp_q0p1_o273 6 -3549.940 3003.560 FORMAT "%8.3" DEPOSIT ABSOLUTE /end AXIS_DESCR
/end CHARACTERISTIC
/begin CHARACTERISTIC ExhMgT_facRatLamCptProtnStrt_C "Enrichment, from which lambda-request for component protection is put to lambda coordination" VALUE 0x80546414 RB_Val_Wu16 0.1000977 fak_uw_b16 0.899902 1.000000 FORMAT "%8.6" EXTENDED_LIMITS 0.00 15.99976 /end CHARACTERISTIC
/begin CHARACTERISTIC ExhMgT_facRdcFillgCptProtnFast_T "curve for faster reduction factor for maximum air charge" CURVE 0x80546416 RB_Curve_S16_S16 1.000000 fak_sw_b1 -1.000000 0.00 FORMAT "%8.6" EXTENDED_LIMITS -1.000000 0.9999695
 /begin AXIS_DESCR STD_AXIS NO_INPUT_QUANTITY temp_q0p1_K 8 -3276.800 3276.700 FORMAT "%8.3" DEPOSIT ABSOLUTE /end AXIS_DESCR
/end CHARACTERISTIC
/begin CHARACTERISTIC ExhMgT_facRednCptProtn_T "Relative reduction of maximum air charge per second" CURVE 0x80546438 RB_Curve_S16_S16 1.999969 fak_sw_b1 -1.000000 0.999969 FORMAT "%8.6" EXTENDED_LIMITS -1.000000 0.9999695
 /begin AXIS_DESCR STD_AXIS NO_INPUT_QUANTITY temp_q0p1_K 8 -3276.800 3276.700 FORMAT "%8.3" DEPOSIT ABSOLUTE /end AXIS_DESCR
/end CHARACTERISTIC
/begin CHARACTERISTIC ExhMgT_facThdCatHeatgColdFinshdGpf_C "Threshold for the cooling-off factor catalyst heating to reset the catalyst heating request after cold start and direct switch to GPF heating" VALUE 0x80544EA4 RB_Val_Wu8 1.000000 fak_ub_b2 0.00 1.000000 FORMAT "%8.6" EXTENDED_LIMITS 0.00 1.992188 /end CHARACTERISTIC
/begin CHARACTERISTIC ExhMgT_facThdCatHeatgFinshd_C "Threshold for the cooling-off factor catalyst heating to reset the catalyst heating request" VALUE 0x80544EA5 RB_Val_Wu8 1.000000 fak_ub_b2 0.00 1.000000 FORMAT "%8.6" EXTENDED_LIMITS 0.00 1.992188 /end CHARACTERISTIC
/begin CHARACTERISTIC ExhMgT_facThdEtaCatWrm_C "Threshold for resetting the request for catalyst warming as a function of the engine temperature and the altitude" VALUE 0x80544EA6 RB_Val_Wu8 1.992188 fak_ub_b2 0.00 1.992188 FORMAT "%8.6" /end CHARACTERISTIC
/begin CHARACTERISTIC ExhMgT_facThdEtaColdStrtHeatg_C "Threshold for resetting the request for cold start catalyst heating as a function of the engine temperature and the altitude" VALUE 0x80544EA7 RB_Val_Wu8 1.992188 fak_ub_b2 0.00 1.992188 FORMAT "%8.6" /end CHARACTERISTIC
/begin CHARACTERISTIC ExhMgT_fakWghtSecFuelCptProtn_T "weighting curve for ethanol content in case of component protection" CURVE 0x80545D36 RB_Curve_U16_U16 1.000000 fak_uw_b2 0.00 1.000000 FORMAT "%8.6" EXTENDED_LIMITS 0.00 1.999969
 /begin AXIS_DESCR STD_AXIS fethmnmx_w_msg fak_uw_b2 4 0.00 1.999969 FORMAT "%8.6" DEPOSIT ABSOLUTE /end AXIS_DESCR
/end CHARACTERISTIC
/begin CHARACTERISTIC ExhMgT_IaCorrnCptProtn_M "Ignition angle correction offset" MAP 0x80545D48 RB_Map_S16U16_S16 191.9971 zw_q2p9297Em3_deg_KW -96.00000 95.99707 FORMAT "%8.5"
 /begin AXIS_DESCR STD_AXIS Epm_nEng EngN 16 -16384.00 16383.50 FORMAT "%8.2" DEPOSIT ABSOLUTE /end AXIS_DESCR
 /begin AXIS_DESCR STD_AXIS AirMod_ratChrgAirCyl rel_uw_q0p0234 15 0.00 1535.977 FORMAT "%8.3" DEPOSIT ABSOLUTE /end AXIS_DESCR
/end CHARACTERISTIC
/begin CHARACTERISTIC ExhMgT_IaCorrnSecFuCptProtn_M "Ignition angle correction offset in case of switch over to a second fuel" MAP 0x80545F6A RB_Map_S16U16_S16 191.9971 zw_q2p9297Em3_deg_KW -96.00000 95.99707 FORMAT "%8.5"
 /begin AXIS_DESCR STD_AXIS Epm_nEng EngN 16 -16384.00 16383.50 FORMAT "%8.2" DEPOSIT ABSOLUTE /end AXIS_DESCR
 /begin AXIS_DESCR STD_AXIS AirMod_ratChrgAirCyl rel_uw_q0p0234 15 0.00 1535.977 FORMAT "%8.3" DEPOSIT ABSOLUTE /end AXIS_DESCR
/end CHARACTERISTIC
/begin CHARACTERISTIC ExhMgT_nHysDeltaCatHeatg_C "hysteresis threshold for engine speed for catalyst heating because of a request for catalyst warming with lambda split or caused by regeneration" VALUE 0x8054515E RB_Val_Wu16 16383.50 EngN 0.00 16383.50 FORMAT "%8.2" EXTENDED_LIMITS 0.00 32767.50 /end CHARACTERISTIC
/begin CHARACTERISTIC ExhMgT_nHysDeltaEomCatHeatg_C "engine speed hysteresis for catalyst heating request map" VALUE 0x80545160 RB_Val_Wu16 16383.50 EngN 0.00 16383.50 FORMAT "%8.2" EXTENDED_LIMITS 0.00 32767.50 /end CHARACTERISTIC
/begin CHARACTERISTIC ExhMgT_nrBrickTCat1Avrg_C "number of bricks catalyst 1 to calculate average catalyst temperature for release of catalyst heating" VALUE 0x80544E8C RB_Val_Wu8 255.0 OneToOne 0.00 255.0 FORMAT "%5.1" /end CHARACTERISTIC
/begin CHARACTERISTIC ExhMgT_nrBrickTCat1Max_C "" VALUE 0x80544E8D RB_Val_Wu8 255.0 OneToOne 0.00 255.0 FORMAT "%5.1" /end CHARACTERISTIC
/begin CHARACTERISTIC ExhMgT_nrBrickTCat1Min_C "" VALUE 0x80544E8E RB_Val_Wu8 255.0 OneToOne 0.00 255.0 FORMAT "%5.1" /end CHARACTERISTIC
/begin CHARACTERISTIC ExhMgT_nrBrickTCat2Avrg_C "number of bricks catalyst 2 to calculate average catalyst temperature for release of catalyst heating" VALUE 0x80544E8F RB_Val_Wu8 255.0 OneToOne 0.00 255.0 FORMAT "%5.1" /end CHARACTERISTIC
/begin CHARACTERISTIC ExhMgT_nrBrickTCat2Max_C "" VALUE 0x80544E90 RB_Val_Wu8 255.0 OneToOne 0.00 255.0 FORMAT "%5.1" /end CHARACTERISTIC
/begin CHARACTERISTIC ExhMgT_nrBrickTCat2Min_C "" VALUE 0x80544E91 RB_Val_Wu8 255.0 OneToOne 0.00 255.0 FORMAT "%5.1" /end CHARACTERISTIC
/begin CHARACTERISTIC ExhMgT_nrCatHighPrio_C "Defining the priority for heating the catalysts" VALUE 0x80544EA8 RB_Val_Wu8 255.0 dez 0.00 255.0 FORMAT "%5.1" /end CHARACTERISTIC
/begin CHARACTERISTIC ExhMgT_nrTCat1Seln1_C "Temperature selection between Brick or Min, Max, Average of catalyst 1 for duration of catalyst heating" VALUE 0x80544EA9 RB_Val_Wu8 255.0 dez 0.00 255.0 FORMAT "%5.1" /end CHARACTERISTIC
/begin CHARACTERISTIC ExhMgT_nrTCat1Seln2_C "Temperature selection between Brick or Min, Max, Average of catalyst 1 for release of catalyst heating" VALUE 0x80544EAA RB_Val_Wu8 255.0 dez 0.00 255.0 FORMAT "%5.1" /end CHARACTERISTIC
/begin CHARACTERISTIC ExhMgT_nrTCat2Seln1_C "Temperature selection between Brick or Min, Max, Average of catalyst 2 for duration of catalyst heating" VALUE 0x80544EAB RB_Val_Wu8 255.0 dez 0.00 255.0 FORMAT "%5.1" /end CHARACTERISTIC
/begin CHARACTERISTIC ExhMgT_nrTCat2Seln2_C "Temperature selection between Brick or Min, Max, Average of catalyst 2 for release of catalyst heating" VALUE 0x80544EAC RB_Val_Wu8 255.0 dez 0.00 255.0 FORMAT "%5.1" /end CHARACTERISTIC
/begin CHARACTERISTIC ExhMgT_nrTDesMinCatEngOff_C "Selection of minimal temperature for catalyst heating mode at engine start" VALUE 0x80544EAD RB_Val_Wu8 255.0 dez 0.00 255.0 FORMAT "%5.1" /end CHARACTERISTIC
/begin CHARACTERISTIC ExhMgT_nrTWallArySeldB1_C "choice of wall temperature from array ExhMod_tWallAryB1" VALUE 0x80544DD8 RB_Val_Wu8 11.00 dez 0.00 11.00 FORMAT "%5.2" EXTENDED_LIMITS 0.00 255.0 /end CHARACTERISTIC
/begin CHARACTERISTIC ExhMgT_ratAirChrgHeatgProgsDeltaHSP_C "switch off delay for minimum air charge for hom.split injection for catalyst" VALUE 0x80545162 RB_Val_Wu16 1535.977 rel_uw_q0p0234 0.00 1535.977 FORMAT "%8.3" /end CHARACTERISTIC
/begin CHARACTERISTIC ExhMgT_ratAirChrgHeatgProgsMinHSP_C "Minimum air charge for request of hom.split injection for catalyst heating" VALUE 0x80545164 RB_Val_Wu16 1535.977 rel_uw_q0p0234 0.00 1535.977 FORMAT "%8.3" /end CHARACTERISTIC
/begin CHARACTERISTIC ExhMgT_ratCptProtnLimpCamsft_GM "map for lambda component protection in case of detected camshaft error (bank1)" MAP 0x8054645A RB_MapGroup_U16 1.500000 fak_uw_b16 0.500000 2.000000 FORMAT "%8.6" EXTENDED_LIMITS 0.00 15.99976
 /begin AXIS_DESCR COM_AXIS Epm_nEng EngN 16 -16384.00 16383.50 FORMAT "%8.2" AXIS_PTS_REF SNM16GKUW /end AXIS_DESCR
 /begin AXIS_DESCR COM_AXIS AirMod_ratChrgAirCyl rel_uw_q0p0234 15 0.00 1535.977 FORMAT "%8.3" AXIS_PTS_REF SRL15GKUW /end AXIS_DESCR
/end CHARACTERISTIC
/begin CHARACTERISTIC ExhMgT_ratDeltaLamCptProtnIng_GM "Delta-lambda for component protection due to ignition retardation compared to basic ignition timing" MAP 0x8054663A RB_MapGroup_S16 1.000000 fak_sw_b8 -1.000000 0.00 FORMAT "%8.6" EXTENDED_LIMITS -8.000000 7.999756
 /begin AXIS_DESCR COM_AXIS NO_INPUT_QUANTITY fak_uw_b2 8 0.00 1.999969 FORMAT "%8.6" AXIS_PTS_REF SDETA08UW /end AXIS_DESCR
 /begin AXIS_DESCR COM_AXIS Epm_nEng EngN 16 -16384.00 16383.50 FORMAT "%8.2" AXIS_PTS_REF SNM16GKUW /end AXIS_DESCR
/end CHARACTERISTIC
/begin CHARACTERISTIC ExhMgT_ratDeltaLamIntkAirTCptProtn_T "Delta lambda for component protection based on the intake air temperature above the nominal charge air temperature" CURVE 0x8054673A RB_Curve_S16_S16 0.6250000 fak_sw_b8 -0.5000000 0.1250000 FORMAT "%9.7" EXTENDED_LIMITS -8.000000 7.999756
 /begin AXIS_DESCR STD_AXIS NO_INPUT_QUANTITY temp_q0p1_K 4 -3276.800 3276.700 FORMAT "%8.3" DEPOSIT ABSOLUTE /end AXIS_DESCR
/end CHARACTERISTIC
/begin CHARACTERISTIC ExhMgT_ratHysDeltaCatHeatg_C "hysteresis threshold for actualisation of air charge for catalyst heating because of a request for catalyst warming with lambda split or caused by regeneration" VALUE 0x80545166 RB_Val_Wu16 767.9766 rel_q0p0234 0.00 767.9766 FORMAT "%8.4" EXTENDED_LIMITS 0.00 1535.977 /end CHARACTERISTIC
/begin CHARACTERISTIC ExhMgT_ratHysDeltaEomCatHeatg_C "load hysteresis for catalyst heating request map" VALUE 0x80545168 RB_Val_Wu16 767.9766 rel_q0p0234 0.00 767.9766 FORMAT "%8.4" EXTENDED_LIMITS 0.00 1535.977 /end CHARACTERISTIC
/begin CHARACTERISTIC ExhMgT_ratLamCptProtnLimpCamsft_C "additional enrichment for component protection due to implausible exhaust gas temperature model by camshaft error" VALUE 0x80544DDA RB_Val_Ws16 0.2001953 fak_sw_b8 -0.1000977 0.1000977 FORMAT "%9.7" EXTENDED_LIMITS -8.000000 7.999756 /end CHARACTERISTIC
/begin CHARACTERISTIC ExhMgT_ratLamCptProtnLimpExh_C "additional enrichment for component protection due to implausible exhaust gas temperature model" VALUE 0x80544DDC RB_Val_Ws16 0.2001953 fak_sw_b8 -0.1000977 0.1000977 FORMAT "%9.7" EXTENDED_LIMITS -8.000000 7.999756 /end CHARACTERISTIC
/begin CHARACTERISTIC ExhMgT_ratLamCptProtnLimpUego_C "additional enrichment for component protection due to implausible exhaust gas temperature model by error of oxygen sensor" VALUE 0x80544DDE RB_Val_Ws16 0.2001953 fak_sw_b8 -0.1000977 0.1000977 FORMAT "%9.7" EXTENDED_LIMITS -8.000000 7.999756 /end CHARACTERISTIC
/begin CHARACTERISTIC ExhMgT_ratLamCptProtnMin_GM "Min setpoint value for component protection" MAP 0x8054674C RB_MapGroup_U16 15.99976 fak_uw_b16 0.00 15.99976 FORMAT "%8.5"
 /begin AXIS_DESCR COM_AXIS Epm_nEng EngN 16 -16384.00 16383.50 FORMAT "%8.2" AXIS_PTS_REF SNM16GKUW /end AXIS_DESCR
 /begin AXIS_DESCR COM_AXIS AirMod_ratChrgAirCyl rel_uw_q0p0234 15 0.00 1535.977 FORMAT "%8.3" AXIS_PTS_REF SRL15GKUW /end AXIS_DESCR
/end CHARACTERISTIC
/begin CHARACTERISTIC ExhMgT_ratLamCptProtn_GM "Map for component protection lambda based on engine speed and air charge" MAP 0x8054692C RB_MapGroup_U16 1.500000 fak_uw_b16 0.500000 2.000000 FORMAT "%8.6" EXTENDED_LIMITS 0.00 15.99976
 /begin AXIS_DESCR COM_AXIS Epm_nEng EngN 16 -16384.00 16383.50 FORMAT "%8.2" AXIS_PTS_REF SNM16GKUW /end AXIS_DESCR
 /begin AXIS_DESCR COM_AXIS AirMod_ratChrgAirCyl rel_uw_q0p0234 15 0.00 1535.977 FORMAT "%8.3" AXIS_PTS_REF SRL15GKUW /end AXIS_DESCR
/end CHARACTERISTIC
/begin CHARACTERISTIC ExhMgT_stActvnCptProtnTExh1_C "code word: activation of dynamic temperature threshold" VALUE 0x80544DE0 RB_Val_Wu8 255.0 dez 0.00 255.0 FORMAT "%5.1" /end CHARACTERISTIC
/begin CHARACTERISTIC ExhMgT_stActvnCptProtnTExh_C "code word: activation of component protection because of the exhaust gas temperature" VALUE 0x80544DE1 RB_Val_Wu8 255.0 dez 0.00 255.0 FORMAT "%5.1" /end CHARACTERISTIC
/begin CHARACTERISTIC ExhMgT_stCatHeatgCold3_C "Codeword3: request catalyst heating by cold engine" VALUE 0x80544E84 RB_Val_Wu16 65535.00 OneToOne 0.00 65535.00 FORMAT "%8.2" /end CHARACTERISTIC
/begin CHARACTERISTIC ExhMgT_stCatHeatgUpReq2_C "codeword for the catalyst heating trigger function" VALUE 0x80544EAE RB_Val_Wu16 65535.00 dez 0.00 65535.00 FORMAT "%8.2" /end CHARACTERISTIC
/begin CHARACTERISTIC ExhMgT_stCatHeatgUpReq_C "codeword for the catalyst heating trigger function" VALUE 0x80544EB0 RB_Val_Wu16 65535.00 dez 0.00 65535.00 FORMAT "%8.2" /end CHARACTERISTIC
/begin CHARACTERISTIC ExhMgT_stDiagEtaIaCatHeatg2_C "codeword2 für ExhMgT_DiagEtaIaCatHeatg" VALUE 0x80544FE8 RB_Val_Wu8 255.0 dez 0.00 255.0 FORMAT "%5.1" /end CHARACTERISTIC
/begin CHARACTERISTIC ExhMgT_stDiagEtaIaCatHeatg3_C "codeword3 für ExhMgT_DiagEtaIaCatHeatg" VALUE 0x80544FE9 RB_Val_Wu8 255.0 dez 0.00 255.0 FORMAT "%5.1" /end CHARACTERISTIC
/begin CHARACTERISTIC ExhMgT_stDiagEtaIaCatHeatg_C "codeword für ExhMgT_DiagEtaIaCatHeatg" VALUE 0x80544FEA RB_Val_Wu8 255.0 dez 0.00 255.0 FORMAT "%5.1" /end CHARACTERISTIC
/begin CHARACTERISTIC ExhMgT_stDmdCsersCdnCatHeatg_C "codeword for ExhMgT_DmdCsersCdnCatHeatg" VALUE 0x80545122 RB_Val_Wu8 255.0 dez 0.00 255.0 FORMAT "%5.1" /end CHARACTERISTIC
/begin CHARACTERISTIC ExhMgT_stEomCatHeatg1_C "request operation mode for catalyst heating (desired)" VALUE 0x8054516C RB_Val_Wu32 4294967295.00 OneToOne 0.00 4294967295.00 FORMAT "%13.2" /end CHARACTERISTIC
/begin CHARACTERISTIC ExhMgT_stEomCatHeatg2_C "request operation mode for catalyst heating (alternative)" VALUE 0x80545170 RB_Val_Wu32 4294967295.00 OneToOne 0.00 4294967295.00 FORMAT "%13.2" /end CHARACTERISTIC
/begin CHARACTERISTIC ExhMgT_stEomCatHeatg3_C "request operation mode for catalyst heating (fall-back)" VALUE 0x80545174 RB_Val_Wu32 4294967295.00 OneToOne 0.00 4294967295.00 FORMAT "%13.2" /end CHARACTERISTIC
/begin CHARACTERISTIC ExhMgT_stHeatgModeFacProgsAry_CA "Array factor catalyst heating demand or factor catalyst heating progress" VAL_BLK 0x80544EB2 RB_ValA_Wu8 255.0 OneToOne 0.00 255.0 FORMAT "%5.1" NUMBER 4 /end CHARACTERISTIC
/begin CHARACTERISTIC ExhMgT_stIaDeltaCptProtn_C "code word for the function delta ignition angle component protection" VALUE 0x8054618C RB_Val_Wu8 255.0 dez 0.00 255.0 FORMAT "%5.1" /end CHARACTERISTIC
/begin CHARACTERISTIC ExhMgT_stLamCptProtn_C "Code word ExhMgT_LamCptProtn" VALUE 0x80546B0C RB_Val_Wu16 65535.00 dez 0.00 65535.00 FORMAT "%8.2" /end CHARACTERISTIC
/begin CHARACTERISTIC ExhMgT_stOperModCatHeatg_C "Codeword for the function which requests different operating modes during catalyst heating" VALUE 0x80545178 RB_Val_Wu8 255.0 OneToOne 0.00 255.0 FORMAT "%5.1" /end CHARACTERISTIC
/begin CHARACTERISTIC ExhMgT_stOperModCatWrm_C "operation mode for catalyst warming" VALUE 0x8054517C RB_Val_Wu32 4294967295.00 OneToOne 0.00 4294967295.00 FORMAT "%13.2" /end CHARACTERISTIC
/begin CHARACTERISTIC ExhMgT_stOperModDmd_C "parameter for demand operating mode status" VALUE 0x80544E86 RB_Val_Wu16 65535.00 dez 0.00 65535.00 FORMAT "%8.2" /end CHARACTERISTIC
/begin CHARACTERISTIC ExhMgT_stOperModPrioCatWrm_C "priority of catalyst warming operation mode" VALUE 0x80545180 RB_Val_Wu8 255.0 OneToOne 0.00 255.0 FORMAT "%5.1" /end CHARACTERISTIC
/begin CHARACTERISTIC ExhMgT_stOperModStgCatWrm_M "map for request of an engine operation mode because of a request for catalyst warming depending on engine speed and engine load" MAP 0x80545182 RB_Map_U16U16_U16 65535.00 OneToOne 0.00 65535.00 FORMAT "%8.2"
 /begin AXIS_DESCR STD_AXIS ExhMgT_nCatHeatgOperMod EngN 16 0.00 16383.50 FORMAT "%8.2" EXTENDED_LIMITS 0.00 32767.50 DEPOSIT ABSOLUTE /end AXIS_DESCR
 /begin AXIS_DESCR STD_AXIS ExhMgT_ratCatHeatgOperMod rel_q0p0234 16 0.00 1535.977 FORMAT "%8.3" DEPOSIT ABSOLUTE /end AXIS_DESCR
/end CHARACTERISTIC
/begin CHARACTERISTIC ExhMgT_stPrioCatHeatg1_C "priority operation mode request for desired catalyst heating" VALUE 0x805453C6 RB_Val_Wu8 255.0 OneToOne 0.00 255.0 FORMAT "%5.1" /end CHARACTERISTIC
/begin CHARACTERISTIC ExhMgT_stPrioCatHeatg2_C "priority operation mode request for alternative catalyst heating" VALUE 0x805453C7 RB_Val_Wu8 255.0 OneToOne 0.00 255.0 FORMAT "%5.1" /end CHARACTERISTIC
/begin CHARACTERISTIC ExhMgT_stPrioCatHeatg3_C "prio request operation mode for catalyst heating (fall-back)" VALUE 0x805453C8 RB_Val_Wu8 255.0 OneToOne 0.00 255.0 FORMAT "%5.1" /end CHARACTERISTIC
/begin CHARACTERISTIC ExhMgT_stStgCatHeatgEomMod1_M.idxSt_MAP "map for stage of request operation mode for catalyst heating formode 1 (desired) / Look-Up-Table of the Two-D Hystereses-Look-Up-Table (Uint16)" MAP 0x805453D8 RB_Map_U16U16_U16 65535.00 OneToOne 0.00 65535.00 FORMAT "%8.2"
 /begin AXIS_DESCR STD_AXIS NO_INPUT_QUANTITY EngN 16 0.00 32767.50 FORMAT "%8.2" DEPOSIT ABSOLUTE /end AXIS_DESCR
 /begin AXIS_DESCR STD_AXIS NO_INPUT_QUANTITY rel_q0p0234 16 0.00 1535.977 FORMAT "%8.3" DEPOSIT ABSOLUTE /end AXIS_DESCR
/end CHARACTERISTIC
/begin CHARACTERISTIC ExhMgT_stStgCatHeatgEomMod2_M.idxSt_MAP "map for stage of request operation mode for catalyst heating formode 2 (desired) / Look-Up-Table of the Two-D Hystereses-Look-Up-Table (Uint16)" MAP 0x80545620 RB_Map_U16U16_U16 65535.00 OneToOne 0.00 65535.00 FORMAT "%8.2"
 /begin AXIS_DESCR STD_AXIS NO_INPUT_QUANTITY EngN 16 0.00 32767.50 FORMAT "%8.2" DEPOSIT ABSOLUTE /end AXIS_DESCR
 /begin AXIS_DESCR STD_AXIS NO_INPUT_QUANTITY rel_q0p0234 16 0.00 1535.977 FORMAT "%8.3" DEPOSIT ABSOLUTE /end AXIS_DESCR
/end CHARACTERISTIC
/begin CHARACTERISTIC ExhMgT_stStgCatHeatgEomMod3_M.idxSt_MAP "map for stage of request operation mode for catalyst heating formode 3 (desired) / Look-Up-Table of the Two-D Hystereses-Look-Up-Table (Uint16)" MAP 0x80545868 RB_Map_U16U16_U16 65535.00 OneToOne 0.00 65535.00 FORMAT "%8.2"
 /begin AXIS_DESCR STD_AXIS NO_INPUT_QUANTITY EngN 16 0.00 32767.50 FORMAT "%8.2" DEPOSIT ABSOLUTE /end AXIS_DESCR
 /begin AXIS_DESCR STD_AXIS NO_INPUT_QUANTITY rel_q0p0234 16 0.00 1535.977 FORMAT "%8.3" DEPOSIT ABSOLUTE /end AXIS_DESCR
/end CHARACTERISTIC
/begin CHARACTERISTIC ExhMgT_stStgCatHeatgEomMod4_M.idxSt_MAP "map for stage of request operation mode for catalyst heating formode 4 (desired) / Look-Up-Table of the Two-D Hystereses-Look-Up-Table (Uint16)" MAP 0x80545AB0 RB_Map_U16U16_U16 65535.00 OneToOne 0.00 65535.00 FORMAT "%8.2"
 /begin AXIS_DESCR STD_AXIS NO_INPUT_QUANTITY EngN 16 0.00 32767.50 FORMAT "%8.2" DEPOSIT ABSOLUTE /end AXIS_DESCR
 /begin AXIS_DESCR STD_AXIS NO_INPUT_QUANTITY rel_q0p0234 16 0.00 1535.977 FORMAT "%8.3" DEPOSIT ABSOLUTE /end AXIS_DESCR
/end CHARACTERISTIC
/begin CHARACTERISTIC ExhMgT_stStgHOM_C "stage of request operation mode for catalyst heating for homogenous mode (fall back)" VALUE 0x805453CA RB_Val_Wu16 65535.00 OneToOne 0.00 65535.00 FORMAT "%8.2" /end CHARACTERISTIC
/begin CHARACTERISTIC ExhMgT_stStgHSP_C "stage of request operation mode for catalyst heating for homogenous-split mode (fall back)" VALUE 0x805453CC RB_Val_Wu16 65535.00 OneToOne 0.00 65535.00 FORMAT "%8.2" /end CHARACTERISTIC
/begin CHARACTERISTIC ExhMgT_swtCatHeatg_C "code word for catalyst heating request" VALUE 0x805453CE RB_Val_Wu16 65535.00 dez 0.00 65535.00 FORMAT "%8.2" /end CHARACTERISTIC
/begin CHARACTERISTIC ExhMgT_tCat1CptProtnMax_C "maximal allowed temperature inside catalyst 1 for component protection" VALUE 0x80544DE2 RB_Val_Ws16 6553.500 temp_q0p1_o273 -3549.940 3003.560 FORMAT "%8.3" /end CHARACTERISTIC
/begin CHARACTERISTIC ExhMgT_tCat1MaxCptProtnMax_C "maximal allowed maximum temperature inside catalyst 1 for component protection" VALUE 0x80544DE4 RB_Val_Ws16 6553.500 temp_q0p1_o273 -3549.940 3003.560 FORMAT "%8.3" /end CHARACTERISTIC
/begin CHARACTERISTIC ExhMgT_tCat2CptProtnMax_C "maximal allowed temperature inside catalyst 2 for component protection" VALUE 0x80544DE6 RB_Val_Ws16 6553.500 temp_q0p1_o273 -3549.940 3003.560 FORMAT "%8.3" /end CHARACTERISTIC
/begin CHARACTERISTIC ExhMgT_tCat2MaxCptProtnMax_C "maximal allowed maximum temperature inside catalyst 2 for component protection" VALUE 0x80544DE8 RB_Val_Ws16 6553.500 temp_q0p1_o273 -3549.940 3003.560 FORMAT "%8.3" /end CHARACTERISTIC
/begin CHARACTERISTIC ExhMgT_tCatHeatgMax_C "parameter for maximum temperaure for catalyst heatinng" VALUE 0x80544E88 RB_Val_Ws16 6553.500 Temp_Cels -3549.940 3003.560 FORMAT "%8.3" /end CHARACTERISTIC
/begin CHARACTERISTIC ExhMgT_tDelta2CatHeatgCatHiPrio_C "hysteresis of catalyst temperature2 of the high prio cat which must be reached with catalyst heating" VALUE 0x80544EB6 RB_Val_Wu16 6553.500 Temp_Kelv 0.00 6553.500 FORMAT "%8.3" /end CHARACTERISTIC
/begin CHARACTERISTIC ExhMgT_tDeltaCat1_C "additional delta temperature to the initial threshold catalyst 1" VALUE 0x80544DEA RB_Val_Ws16 6553.500 temp_q0p1_K -3276.800 3276.700 FORMAT "%8.3" /end CHARACTERISTIC
/begin CHARACTERISTIC ExhMgT_tDeltaCat2_C "additional delta temperature to the initial threshold catalyst 2" VALUE 0x80544DEC RB_Val_Ws16 6553.500 temp_q0p1_K -3276.800 3276.700 FORMAT "%8.3" /end CHARACTERISTIC
/begin CHARACTERISTIC ExhMgT_tDeltaCatHeatgCatHiPrio_C "hysteresis of catalyst temperature of the high prio cat which must be reached with catalyst heating" VALUE 0x80544EB8 RB_Val_Ws16 3276.700 Temp_Kelv 0.00 3276.700 FORMAT "%8.3" EXTENDED_LIMITS -3276.800 3276.700 /end CHARACTERISTIC
/begin CHARACTERISTIC ExhMgT_tDeltaCatHeatgCatLoPrio_C "hysteresis of catalyst temperature of the low prio cat which must be reached with catalyst heating" VALUE 0x80544EBA RB_Val_Wu16 6553.500 Temp_Kelv 0.00 6553.500 FORMAT "%8.3" /end CHARACTERISTIC
/begin CHARACTERISTIC ExhMgT_tDeltaEngStopCatCoolgMax_C "Maximum temperature difference of catalyst while cooling at engine stop" VALUE 0x80544EBC RB_Val_Ws16 6553.500 temp_q0p1_K -3276.800 3276.700 FORMAT "%8.3" /end CHARACTERISTIC
/begin CHARACTERISTIC ExhMgT_tDeltaMinCatAge_T "delta temperature depending on catalyst ageing on tDesMIn for catheating demand factor" CURVE 0x80544EBE RB_Curve_U16_S16_Static 6553.500 q0p1_K -3276.800 3276.700 FORMAT "%8.3"
 /begin AXIS_DESCR STD_AXIS ExhMgT_facWghtCatAge fak_uw_b2 4 0.00 1.999969 FORMAT "%8.6" DEPOSIT ABSOLUTE /end AXIS_DESCR
/end CHARACTERISTIC
/begin CHARACTERISTIC ExhMgT_tDeltaMnfB1_T "dynamic delta temperature to the initial threshold manifold" CURVE 0x80544DEE RB_Curve_S16_S16 6553.500 temp_q0p1_K -3276.800 3276.700 FORMAT "%8.3"
 /begin AXIS_DESCR STD_AXIS ExhMgT_tExhMnfFildGrdtB1 temp_q0p1_K 8 -3276.800 3276.700 FORMAT "%8.3" DEPOSIT ABSOLUTE /end AXIS_DESCR
/end CHARACTERISTIC
/begin CHARACTERISTIC ExhMgT_tDeltaMnf_C "additional delta temperature to the initial threshold manifold" VALUE 0x80544E10 RB_Val_Wr32 3000.00000 TempK_float -1500.00000 1500.00000 FORMAT "%10.5" EXTENDED_LIMITS -3.40282347E+038 3.40282347E+038 /end CHARACTERISTIC
/begin CHARACTERISTIC ExhMgT_tDeltaWallActvnCptProtn_C "hysteresis for maximal wall temperature inside exhaust system for deactivation of component protection" VALUE 0x80544E14 RB_Val_Ws16 6553.500 temp_q0p1_K -3276.800 3276.700 FORMAT "%8.3" /end CHARACTERISTIC
/begin CHARACTERISTIC ExhMgT_tDesMinCatDmd_C "minimum desired temperature of catalyst demand" VALUE 0x80544ED0 RB_Val_Ws16 6553.500 Temp_Cels -3549.940 3003.560 FORMAT "%8.3" /end CHARACTERISTIC
/begin CHARACTERISTIC ExhMgT_tDesMinCatEngOff_C "minimum desired temperature of catalyst during engine start" VALUE 0x80544ED2 RB_Val_Ws16 6553.500 Temp_Cels -3549.940 3003.560 FORMAT "%8.3" /end CHARACTERISTIC
/begin CHARACTERISTIC ExhMgT_tDesMinLoPrioCatDmd_C "minimum desired catalyst temperature of the low prio catalyst demand factor" VALUE 0x80544ED4 RB_Val_Ws16 6553.500 Temp_Cels -3549.940 3003.560 FORMAT "%8.3" /end CHARACTERISTIC
/begin CHARACTERISTIC ExhMgT_tDiffActvTi_C "delta temperature threshold in order to reset the dynamic threshold component protection" VALUE 0x80544E16 RB_Val_Ws16 6553.500 temp_q0p1_K -3276.800 3276.700 FORMAT "%8.3" /end CHARACTERISTIC
/begin CHARACTERISTIC ExhMgT_tExhCat1CptProtnDsMax_C "maximal allowed exhaust temperature downstream of catalyst 1 for component protection" VALUE 0x80544E18 RB_Val_Ws16 6553.500 temp_q0p1_o273 -3549.940 3003.560 FORMAT "%8.3" /end CHARACTERISTIC
/begin CHARACTERISTIC ExhMgT_tExhCat1CptProtnUsMax_C "maximal allowed exhaust temperature in front of catalyst 1 for component protection" VALUE 0x80544E1A RB_Val_Ws16 6553.500 temp_q0p1_o273 -3549.940 3003.560 FORMAT "%8.3" /end CHARACTERISTIC
/begin CHARACTERISTIC ExhMgT_tExhCat1UsDelta_C "hysteresis exhaust gas temperature upstream of catalyst1 for predicted component protection at high spark retardation" VALUE 0x8054618E RB_Val_Ws16 3276.700 temp_q0p1_K 0.00 3276.700 FORMAT "%8.3" EXTENDED_LIMITS -3276.800 3276.700 /end CHARACTERISTIC
/begin CHARACTERISTIC ExhMgT_tExhCat1UsHi_C "Threshold exhaust gas temperature upstream of catalyst1 for predicted component protection at high spark retardation" VALUE 0x80546190 RB_Val_Ws16 6553.500 temp_q0p1_o273 -3549.940 3003.560 FORMAT "%8.3" /end CHARACTERISTIC
/begin CHARACTERISTIC ExhMgT_tExhCat2CptProtnDsMax_C "maximal allowed exhaust temperature downstream of catalyst 2 for component protection" VALUE 0x80544E1C RB_Val_Ws16 6553.500 temp_q0p1_o273 -3549.940 3003.560 FORMAT "%8.3" /end CHARACTERISTIC
/begin CHARACTERISTIC ExhMgT_tExhCat2CptProtnUsMax_C "maximal allowed exhaust temperature in front of catalyst 2 for component protection" VALUE 0x80544E1E RB_Val_Ws16 6553.500 temp_q0p1_o273 -3549.940 3003.560 FORMAT "%8.3" /end CHARACTERISTIC
/begin CHARACTERISTIC ExhMgT_tExhDsVlvCptProtnMax_C "Exhaust gas temperature downstream exhaust valve (modeled) for component protection" VALUE 0x80544E20 RB_Val_Ws16 6553.500 temp_q0p1_o273 -3549.940 3003.560 FORMAT "%8.3" /end CHARACTERISTIC
/begin CHARACTERISTIC ExhMgT_tExhFrtPipCptProtnMax_C "maximal allowed Exhaust gas temperature downstream manifold for component protection" VALUE 0x80544E22 RB_Val_Ws16 6553.500 temp_q0p1_o273 -3549.940 3003.560 FORMAT "%8.3" /end CHARACTERISTIC
/begin CHARACTERISTIC ExhMgT_tExhMnfIaDelta_C "hysteresis exhaust gas temperature of manifold for predicted component protection at high spark retardation" VALUE 0x80546192 RB_Val_Ws16 3276.700 temp_q0p1_K 0.00 3276.700 FORMAT "%8.3" EXTENDED_LIMITS -3276.800 3276.700 /end CHARACTERISTIC
/begin CHARACTERISTIC ExhMgT_tExhMnfIa_C "Threshold exhaust gas temperature mainifold for predicted component protection at high spark retardation" VALUE 0x80546194 RB_Val_Ws16 6553.500 temp_q0p1_o273 -3549.940 3003.560 FORMAT "%8.3" /end CHARACTERISTIC
/begin CHARACTERISTIC ExhMgT_tExhMnfMaxDyn_C "Reset temperature value of the dynamic manifold threshold" VALUE 0x80544E24 RB_Val_Ws16 6553.500 temp_q0p1_o273 -3549.940 3003.560 FORMAT "%8.3" /end CHARACTERISTIC
/begin CHARACTERISTIC ExhMgT_tiActvnCptProtn_C "Time constant lambda component protection" VALUE 0x80544E26 RB_Val_Wu16 6553.4999985 zk100msxs_uw_b6553p6 0.1000015 6553.6000000 FORMAT "%12.7" EXTENDED_LIMITS 0.10000152590 6553.6000000 /end CHARACTERISTIC
/begin CHARACTERISTIC ExhMgT_tiAvdSootEgrCptProtn_C "delay time for closing EGR - valve because of component protection to avoid the sooting of the EGR valve" VALUE 0x80546B0E RB_Val_Wu8 2.550 t_q0p01 0.00 2.550 FORMAT "%5.3" /end CHARACTERISTIC
/begin CHARACTERISTIC ExhMgT_tiCat1MaxDec_C "time constant for down-integration of component protection temperature threshold of cat 1" VALUE 0x80544E28 RB_Val_Wu16 6553.4999985 zk100msxs_uw_b6553p6 0.1000015 6553.6000000 FORMAT "%12.7" EXTENDED_LIMITS 0.10000152590 6553.6000000 /end CHARACTERISTIC
/begin CHARACTERISTIC ExhMgT_tiCat1MaxInc_C "time constant for up-integration of component protection temperature threshold of catalyst 1" VALUE 0x80544E2A RB_Val_Wu16 6553.4999985 zk100msxs_uw_b6553p6 0.1000015 6553.6000000 FORMAT "%12.7" EXTENDED_LIMITS 0.10000152590 6553.6000000 /end CHARACTERISTIC
/begin CHARACTERISTIC ExhMgT_tiCat2MaxDec_C "time constant for down-integration of component protection temperature threshold of cat 2" VALUE 0x80544E2C RB_Val_Wu16 6553.4999985 zk100msxs_uw_b6553p6 0.1000015 6553.6000000 FORMAT "%12.7" EXTENDED_LIMITS 0.10000152590 6553.6000000 /end CHARACTERISTIC
/begin CHARACTERISTIC ExhMgT_tiCat2MaxInc_C "time constant for up-integration of component protection temperature threshold of catalyst 2" VALUE 0x80544E2E RB_Val_Wu16 6553.4999985 zk100msxs_uw_b6553p6 0.1000015 6553.6000000 FORMAT "%12.7" EXTENDED_LIMITS 0.10000152590 6553.6000000 /end CHARACTERISTIC
/begin CHARACTERISTIC ExhMgT_tiCatHeatgFacColdFinshGpf_C "Time constant for down ramping of catalyst heating measures by finisching cold start heating with direct switch to GPF heating" VALUE 0x80544ED6 RB_Val_Wu8 25.4996 zk100msxs_ub_b25p5 0.1004 25.6000 FORMAT "%7.4" EXTENDED_LIMITS 0.100392 25.6000 /end CHARACTERISTIC
/begin CHARACTERISTIC ExhMgT_tiCatHeatgFacFinsh_C "Time constant for down ramping of catalyst heating measures by finisching cold start heating" VALUE 0x80544ED7 RB_Val_Wu8 25.4996 zk100msxs_ub_b25p5 0.1004 25.6000 FORMAT "%7.4" EXTENDED_LIMITS 0.100392 25.6000 /end CHARACTERISTIC
/begin CHARACTERISTIC ExhMgT_tiCatHeatgFacGpfRgnRampDown_C "time constant for down ramping of catalyst heating measures by finishing catalyst heating in case of GPF heating" VALUE 0x80544ED8 RB_Val_Wu8 25.4996 zk100msxs_ub_b25p5 0.1004 25.6000 FORMAT "%7.4" EXTENDED_LIMITS 0.100392 25.6000 /end CHARACTERISTIC
/begin CHARACTERISTIC ExhMgT_tiCatHeatgFacGpfRgnRampUp_C "time constant for up ramping of catalyst heating measures by start of catalyst heating in case of GPF heating" VALUE 0x80544ED9 RB_Val_Wu8 25.4996 zk100msxs_ub_b25p5 0.1004 25.6000 FORMAT "%7.4" EXTENDED_LIMITS 0.100392 25.6000 /end CHARACTERISTIC
/begin CHARACTERISTIC ExhMgT_tiCatHeatgFacRampDown_C "time constant for down ramping of catalyst heating measures by finishing catalyst heating" VALUE 0x80544EDA RB_Val_Wu8 25.4996 zk100msxs_ub_b25p5 0.1004 25.6000 FORMAT "%7.4" EXTENDED_LIMITS 0.100392 25.6000 /end CHARACTERISTIC
/begin CHARACTERISTIC ExhMgT_tiCatHeatgFacRampUp_C "time constant for up ramping of catalyst heating measures by start of catalyst heating" VALUE 0x80544EDB RB_Val_Wu8 25.4996 zk100msxs_ub_b25p5 0.1004 25.6000 FORMAT "%7.4" EXTENDED_LIMITS 0.100392 25.6000 /end CHARACTERISTIC
/begin CHARACTERISTIC ExhMgT_tiCatHeatgFacWrmRampDown_C "time constant for down ramping of catalyst heating measures by finishing catalyst heating in case of catalyst warming" VALUE 0x80544EDC RB_Val_Wu8 25.4996 zk100msxs_ub_b25p5 0.1004 25.6000 FORMAT "%7.4" EXTENDED_LIMITS 0.100392 25.6000 /end CHARACTERISTIC
/begin CHARACTERISTIC ExhMgT_tiCatHeatgFacWrmRampUp_C "time constant for up ramping of catalyst heating measures by start of catalyst heating in case of catalyst warming" VALUE 0x80544EDD RB_Val_Wu8 25.4996 zk100msxs_ub_b25p5 0.1004 25.6000 FORMAT "%7.4" EXTENDED_LIMITS 0.100392 25.6000 /end CHARACTERISTIC
/begin CHARACTERISTIC ExhMgT_tiCdnDnyThd_C "maximal Delay time to ramp down the dynamic threshold of the manifold" VALUE 0x80544E30 RB_Val_Wu16 6553.500 t_q0p1 0.00 6553.500 FORMAT "%8.3" /end CHARACTERISTIC
/begin CHARACTERISTIC ExhMgT_tiDeActvnCptProtn_C "Time constant to deactivate lambda component protection" VALUE 0x80544E32 RB_Val_Wu16 6553.4999985 zk100msxs_uw_b6553p6 0.1000015 6553.6000000 FORMAT "%12.7" EXTENDED_LIMITS 0.10000152590 6553.6000000 /end CHARACTERISTIC
/begin CHARACTERISTIC ExhMgT_tiDeltaAvdSootEgrCptProtn_C "Delta time delay for activation of lambda component protection to avoid the sooting of the EGR valve" VALUE 0x80546B0F RB_Val_Wu8 2.550 t_q0p01 0.00 2.550 FORMAT "%5.3" /end CHARACTERISTIC
/begin CHARACTERISTIC ExhMgT_tiDeltaIgnAvdSootEgrCptProtn_C "Delta time delay for activation of lambda component protection to avoid the sooting of the EGR valve, if a preignition is discovered or if the component protection is activated by spark retardation" VALUE 0x80546B10 RB_Val_Wu8 2.550 t_q0p01 0.00 2.550 FORMAT "%5.3" /end CHARACTERISTIC
/begin CHARACTERISTIC ExhMgT_tiDifCdnDyn_C "Reset threshold of the dynamic manifold threshold" VALUE 0x80544E34 RB_Val_Wu16 6553.500 t_q0p1 0.00 6553.500 FORMAT "%8.3" /end CHARACTERISTIC
/begin CHARACTERISTIC ExhMgT_tiDlyActvtRdcAirFillg_C "Time delay after which immediate withdrawal of air charge restriction due to component protection is possible at state of idle" VALUE 0x80546B12 RB_Val_Wu16 5.000000 t_q0p1 0.00 5.000000 FORMAT "%8.6" EXTENDED_LIMITS 0.00 6553.500 /end CHARACTERISTIC
/begin CHARACTERISTIC ExhMgT_tiDlyCatActvCptProtn_C "time delay for activating component protection due to critical exhaust gas temperatures of catalysts" VALUE 0x80544E36 RB_Val_Wu8 25.50 t100msxs_ub_b25p5 0.00 25.50 FORMAT "%5.2" /end CHARACTERISTIC
/begin CHARACTERISTIC ExhMgT_tiDlyCatHeatgCptPrtn_C "Delay time component protection for calculation condition catalyst heating" VALUE 0x80544EDE RB_Val_Wu16 6553.500 t_q0p1 0.00 6553.500 FORMAT "%8.3" /end CHARACTERISTIC
/begin CHARACTERISTIC ExhMgT_tiDlyExhActvCptProtn_C "time delay for activating component protection due to critical exhaust gas temperatures upstream of catalysts" VALUE 0x80544E37 RB_Val_Wu8 25.50 t100msxs_ub_b25p5 0.00 25.50 FORMAT "%5.2" /end CHARACTERISTIC
/begin CHARACTERISTIC ExhMgT_tiDlyRdcAirFillg_C "Time delay from which the air charge no longer reduces in idle speed when there is no more limitation of the rich lambda due to possible component protection at idle" VALUE 0x80546B14 RB_Val_Wu8 25.50 t_q0p1 0.00 25.50 FORMAT "%5.2" /end CHARACTERISTIC
/begin CHARACTERISTIC ExhMgT_tifacRdcAirFillg_C "Delay time after reaching the min-lambda until the start of the limitation of the maximum filling" VALUE 0x80546B15 RB_Val_Wu8 25.50 t_q0p1 0.00 25.50 FORMAT "%5.2" /end CHARACTERISTIC
/begin CHARACTERISTIC ExhMgT_tiFilFuM_C "time constant to filter the injected fuel mass" VALUE 0x805453D0 RB_Val_Wu16 655.3400 t_q0p01 0.0100 655.3500 FORMAT "%8.4" EXTENDED_LIMITS 0.00 655.3500 /end CHARACTERISTIC
/begin CHARACTERISTIC ExhMgT_tiHeatgIdleNonCsersMin_C "minimum necessary time for catalyst heating in due to a cold start during idle for evaluation of ignition efficiency" VALUE 0x80544FEC RB_Val_Wu16 655.3500 t_q0p01 0.00 655.3500 FORMAT "%8.4" /end CHARACTERISTIC
/begin CHARACTERISTIC ExhMgT_tiHeatgPtlNonCsersMin_C "minimum necessary time for catalyst heating in due to a cold start outside idle for evaluation of ignition efficiency" VALUE 0x80544FEE RB_Val_Wu16 655.3500 t_q0p01 0.00 655.3500 FORMAT "%8.4" /end CHARACTERISTIC
/begin CHARACTERISTIC ExhMgT_tiIgnAvdSootEgrCptProtn_C "delay time for closing EGR - valve because of component protection, if a preignition is discovered or if the component protection is activated by spark retardation to avoid the sooting of the EGR valve" VALUE 0x80546B16 RB_Val_Wu8 2.550 t_q0p01 0.00 2.550 FORMAT "%5.3" /end CHARACTERISTIC
/begin CHARACTERISTIC ExhMgT_tiLamMegaKnkUp_C "time constant for ramp up velocity of lambda for mega knock" VALUE 0x80546B18 RB_Val_Wu16 655.34999985 zk10msxs_uw_b655p36 0.01000015 655.36000000 FORMAT "%12.8" EXTENDED_LIMITS 0.010000152590 655.36000000 /end CHARACTERISTIC
/begin CHARACTERISTIC ExhMgT_tiMaxCat1B1_C "duration of the exceedance of the initial threshold catalyst 1" VALUE 0x80544E38 RB_Val_Wu16 6553.500 t_q0p1 0.00 6553.500 FORMAT "%8.3" /end CHARACTERISTIC
/begin CHARACTERISTIC ExhMgT_tiMaxCat2B1_C "duration of the exceedance of the initial threshold catalyst 2" VALUE 0x80544E3A RB_Val_Wu16 6553.500 t_q0p1 0.00 6553.500 FORMAT "%8.3" /end CHARACTERISTIC
/begin CHARACTERISTIC ExhMgT_tiMnfldMaxDec_C "time constant for down-integration of component protection temperature threshold of exhaust manifold" VALUE 0x80544E3C RB_Val_Wu16 6553.4999985 zk100msxs_uw_b6553p6 0.1000015 6553.6000000 FORMAT "%12.7" EXTENDED_LIMITS 0.10000152590 6553.6000000 /end CHARACTERISTIC
/begin CHARACTERISTIC ExhMgT_tiMnfldMaxInc_C "time constant for up-integration of component protection temperature threshold of exhaust manifold" VALUE 0x80544E3E RB_Val_Wu16 6553.4999985 zk100msxs_uw_b6553p6 0.1000015 6553.6000000 FORMAT "%12.7" EXTENDED_LIMITS 0.10000152590 6553.6000000 /end CHARACTERISTIC
/begin CHARACTERISTIC ExhMgT_tiRelsCsersIdle_C "time delay for release of diagnosis in Idle" VALUE 0x80544FF0 RB_Val_Wu16 655.3500 t_q0p01 0.00 655.3500 FORMAT "%8.4" /end CHARACTERISTIC
/begin CHARACTERISTIC ExhMgT_tiRelsCsersPartLoad_C "time delay for release of diagnosis in partload" VALUE 0x80544FF2 RB_Val_Wu16 655.3500 t_q0p01 0.00 655.3500 FORMAT "%8.4" /end CHARACTERISTIC
/begin CHARACTERISTIC ExhMgT_tiRelsNonCsersIdle_C "time delay for release of diagnosis in Idle" VALUE 0x80544FF4 RB_Val_Wu16 655.3500 t_q0p01 0.00 655.3500 FORMAT "%8.4" /end CHARACTERISTIC
/begin CHARACTERISTIC ExhMgT_tiRelsNonCsersPartLoad_C "time delay for release of diagnosis in partload" VALUE 0x80544FF6 RB_Val_Wu16 655.3500 t_q0p01 0.00 655.3500 FORMAT "%8.4" /end CHARACTERISTIC
/begin CHARACTERISTIC ExhMgT_tiTondNonCsers_C "time delay for release of diagnosis for monitoring of degradation engine efficiency during catalyst heating in due of Catalyst warming" VALUE 0x80544FF8 RB_Val_Wu16 655.3500 t_q0p01 0.00 655.3500 FORMAT "%8.4" /end CHARACTERISTIC
/begin CHARACTERISTIC ExhMgT_tiWallActvnCptProtn_C "time delay for activation of component protection in dependence of wall temperature inside of exhaust system" VALUE 0x80544E40 RB_Val_Wu16 100.0000 t_q0p1 0.00 100.0000 FORMAT "%8.4" EXTENDED_LIMITS 0.00 6553.500 /end CHARACTERISTIC
/begin CHARACTERISTIC ExhMgT_tMinCatDelta_C "Exhaust temperature hysteresis for shut-off of component protection because of catalyst temperatures" VALUE 0x80544E42 RB_Val_Ws16 500.0000 temp_q0p1_K 0.00 500.0000 FORMAT "%8.4" EXTENDED_LIMITS -3276.800 3276.700 /end CHARACTERISTIC
/begin CHARACTERISTIC ExhMgT_tMinCatLo_C "Minimum distance to critical limits of temperatures near catalysts from where component protection active" VALUE 0x80544E44 RB_Val_Ws16 500.0000 temp_q0p1_K 0.00 500.0000 FORMAT "%8.4" EXTENDED_LIMITS -3276.800 3276.700 /end CHARACTERISTIC
/begin CHARACTERISTIC ExhMgT_tMinExhDelta_C "Exhaust temperature hysteresis for shut-off of component protection because of gas temperatures" VALUE 0x80544E46 RB_Val_Ws16 500.0000 temp_q0p1_K 0.00 500.0000 FORMAT "%8.4" EXTENDED_LIMITS -3276.800 3276.700 /end CHARACTERISTIC
/begin CHARACTERISTIC ExhMgT_tMinExhLo_C "Minimum distance to critical limits of exhaust gas temperatures upstream of catalysts where component protection active" VALUE 0x80544E48 RB_Val_Ws16 500.0000 temp_q0p1_K 0.00 500.0000 FORMAT "%8.4" EXTENDED_LIMITS -3276.800 3276.700 /end CHARACTERISTIC
/begin CHARACTERISTIC ExhMgT_tOffsCptProtnLimpCamsft_C "Additional distance to critical limits of exhaust temperatures for component protection due to implausible exhaust gas temperature model by error of camshaft" VALUE 0x80544E4A RB_Val_Wu16 500.0000 temp_q0p1 0.00 500.0000 FORMAT "%8.4" EXTENDED_LIMITS 0.00 6553.500 /end CHARACTERISTIC
/begin CHARACTERISTIC ExhMgT_tOffsCptProtnLimpExh_C "Additional distance to critical limits of exhaust temperatures for component protection due to implausible exhaust gas temperature model" VALUE 0x80544E4C RB_Val_Wu16 500.0000 temp_q0p1 0.00 500.0000 FORMAT "%8.4" EXTENDED_LIMITS 0.00 6553.500 /end CHARACTERISTIC
/begin CHARACTERISTIC ExhMgT_tOffsCptProtnLimpUego_C "Additional distance to critical limits of exhaust temperatures for component protection due to implausible exhaust gas temperature model by error of oxygen sensor" VALUE 0x80544E4E RB_Val_Wu16 500.0000 temp_q0p1 0.00 500.0000 FORMAT "%8.4" EXTENDED_LIMITS 0.00 6553.500 /end CHARACTERISTIC
/begin CHARACTERISTIC ExhMgT_tRefIntkAirTCptProtn_GM "group map for nominal charge air temperature for component protection" MAP 0x80546B1A RB_MapGroup_S16 3276.700 Temp_Cels -273.140 3003.560 FORMAT "%8.3" EXTENDED_LIMITS -3549.940 3003.560
 /begin AXIS_DESCR COM_AXIS Epm_nEng EngN 16 -16384.00 16383.50 FORMAT "%8.2" AXIS_PTS_REF SNM16GKUW /end AXIS_DESCR
 /begin AXIS_DESCR COM_AXIS AirMod_ratChrgAirCyl rel_uw_q0p0234 15 0.00 1535.977 FORMAT "%8.3" AXIS_PTS_REF SRL15GKUW /end AXIS_DESCR
/end CHARACTERISTIC
/begin CHARACTERISTIC ExhMgT_tThd2CatHeatgCatHiPrio_T "Temperature threshold2 for catalyst heating for the high prio catalyst" CURVE 0x80544EE0 RB_Curve_U16_S16_Static 6553.500 Temp_Cels -3549.940 3003.560 FORMAT "%8.3"
 /begin AXIS_DESCR STD_AXIS ExhMgT_facWghtCatAge fak_uw_b2 4 0.00 1.999969 FORMAT "%8.6" DEPOSIT ABSOLUTE /end AXIS_DESCR
/end CHARACTERISTIC
/begin CHARACTERISTIC ExhMgT_tThdCatHeatgCatHiPrio_T "Temperature threshold for catalyst heating for the high prio catalyst" CURVE 0x80544EF2 RB_Curve_U16_S16_Static 6553.500 Temp_Cels -3549.940 3003.560 FORMAT "%8.3"
 /begin AXIS_DESCR STD_AXIS ExhMgT_facWghtCatAge fak_uw_b2 4 0.00 1.999969 FORMAT "%8.6" DEPOSIT ABSOLUTE /end AXIS_DESCR
/end CHARACTERISTIC
/begin CHARACTERISTIC ExhMgT_tThdCatHeatgCatLoPrio_T "Temperature threshold for catalyst heating for the low prio catalyst" CURVE 0x80544F04 RB_Curve_U16_S16_Static 6553.500 Temp_Cels -3549.940 3003.560 FORMAT "%8.3"
 /begin AXIS_DESCR STD_AXIS ExhMgT_facWghtCatAge fak_uw_b2 4 0.00 1.999969 FORMAT "%8.6" DEPOSIT ABSOLUTE /end AXIS_DESCR
/end CHARACTERISTIC
/begin CHARACTERISTIC ExhMgT_tWallActvnCptProtnMax_C "maximal wall temperature inside exhaust system for activation of component protection" VALUE 0x80544E50 RB_Val_Ws16 6553.500 Temp_Cels -3549.940 3003.560 FORMAT "%8.3" /end CHARACTERISTIC
/begin CHARACTERISTIC ExhMgT_tWallActvnCptProtnMax_T "curve for maximal wall temperature inside exhaust system for activation of component protection" CURVE 0x80544E52 RB_Curve_U16_S16_Static 6553.500 Temp_Cels -3549.940 3003.560 FORMAT "%8.3"
 /begin AXIS_DESCR STD_AXIS NO_INPUT_QUANTITY vfzg_uw_b512 6 0.00 511.9922 FORMAT "%8.4" DEPOSIT ABSOLUTE /end AXIS_DESCR
/end CHARACTERISTIC
/begin CHARACTERISTIC ExhMgT_tWallMnfCptProtnMax_C "threshold wall temperature manifold for component protection" VALUE 0x80544E6C RB_Val_Ws16 6553.500 temp_q0p1_o273 -3549.940 3003.560 FORMAT "%8.3" /end CHARACTERISTIC
/begin CHARACTERISTIC ExhMgT_tWallMnfldCptProtn_T "maximal allowed temperature at exhaust manifold for component temperature in dependence of wall temperature" CURVE 0x80544E6E RB_Curve_S16_S16 6553.500 temp_q0p1_o273 -3549.940 3003.560 FORMAT "%8.3"
 /begin AXIS_DESCR STD_AXIS NO_INPUT_QUANTITY temp_q0p1_o273 4 -3549.940 3003.560 FORMAT "%8.3" DEPOSIT ABSOLUTE /end AXIS_DESCR
/end CHARACTERISTIC
/begin CHARACTERISTIC ExhMgT_vEnagEffCatHeat "threshold for minimum necessary velocity for enabling of diagnosis of engine efficiency during catalyst heating phase during part load" VALUE 0x80544FFA RB_Val_Ws16 655.3500 Vel -327.6800 327.6700 FORMAT "%8.4" /end CHARACTERISTIC
/begin CHARACTERISTIC FHOETKH "minimum altitude threshold to enable diagnosis of engine efficiency during catalyst heating" VALUE 0x80544FFC RB_Val_Wu16 3.999939 fak_uw_b4 0.00 3.999939 FORMAT "%8.6" /end CHARACTERISTIC
/begin CHARACTERISTIC FRLBTSMN "lower limit of reduction factor for maximum air charge if component protection reaches rich burning limit" VALUE 0x80546CFA RB_Val_Wu16 0.3999634 fak_uw_b2 0.6000061 0.9999695 FORMAT "%9.7" EXTENDED_LIMITS 0.00 1.999969 /end CHARACTERISTIC
/begin CHARACTERISTIC FuPurg_facAdpnVlvLftMax_C "maximum ftead to request large valve lift during high canister load" VALUE 0x80544D12 RB_Val_Ws8 127.5 fak_sb_b64 -64.00 63.50 FORMAT "%5.2" /end CHARACTERISTIC
/begin CHARACTERISTIC FuPurg_facAdpnVlvLftMin_C "minimum ftead to reset request of large valve lift during high canister load" VALUE 0x80544D13 RB_Val_Ws8 127.5 fak_sb_b64 -64.00 63.50 FORMAT "%5.2" /end CHARACTERISTIC
/begin CHARACTERISTIC FuPurg_facDesEngEff_T "characteristic line: reduction of engine efficiency as f(nmot)" CURVE 0x80544D14 RB_Curve_S16_U16_Static 0.9999847 fak_uw_b1 0.00 0.9999847 FORMAT "%9.7"
 /begin AXIS_DESCR STD_AXIS Epm_nEng EngN 5 -16384.00 16383.50 FORMAT "%8.2" DEPOSIT ABSOLUTE /end AXIS_DESCR
/end CHARACTERISTIC
/begin CHARACTERISTIC FuPurg_ratDesTqResvFildPurgCtrlAdpn_M "characteristic map for torque reserve at active purging when te is near TEMIN" MAP 0x80544D2A RB_Map_S16U16_U16 99.99847 rel_uw_b100 0.00 99.99847 FORMAT "%8.5"
 /begin AXIS_DESCR STD_AXIS fteadf_w_msg fak_sw_b64 3 -64.00000 63.99805 FORMAT "%8.5" DEPOSIT ABSOLUTE /end AXIS_DESCR
 /begin AXIS_DESCR STD_AXIS mifal_w_msg rel_uw_b100 5 0.00 99.99847 FORMAT "%8.5" DEPOSIT ABSOLUTE /end AXIS_DESCR
/end CHARACTERISTIC
/begin CHARACTERISTIC FuPurg_ratDesTqResvIntglMFlowHRes_M "characteristic map for torque reserve at learning integral of purge mass flow" MAP 0x80544D5C RB_Map_U8U16_U16 99.99847 rel_uw_b100 0.00 99.99847 FORMAT "%8.5"
 /begin AXIS_DESCR STD_AXIS imsteini_msg m_ub_q0p0444 3 0.00 11.32 FORMAT "%5.2" DEPOSIT ABSOLUTE /end AXIS_DESCR
 /begin AXIS_DESCR STD_AXIS mifal_w_msg rel_uw_b100 5 0.00 99.99847 FORMAT "%8.5" DEPOSIT ABSOLUTE /end AXIS_DESCR
/end CHARACTERISTIC
/begin CHARACTERISTIC FuPurg_ratMaxTqResv_T "max. torque reserve" CURVE 0x80544D8A RB_Curve_U16_U16 99.99847 rel_uw_b100 0.00 99.99847 FORMAT "%8.5"
 /begin AXIS_DESCR STD_AXIS mifal_w_msg rel_uw_b100 5 0.00 99.99847 FORMAT "%8.5" DEPOSIT ABSOLUTE /end AXIS_DESCR
/end CHARACTERISTIC
/begin CHARACTERISTIC FuPurg_stCfgExtReqCoorn_C "Codeword for configuration of external system reaction on high canister load" VALUE 0x80544DA0 RB_Val_Wu8 255.0 dez 0.00 255.0 FORMAT "%5.1" /end CHARACTERISTIC
/begin CHARACTERISTIC KFDETAZWLONE "Ignition angle efficiency correction offset" MAP 0x80546CFC RB_MapGroup_U16 1.999969 fak_uw_b2 0.00 1.999969 FORMAT "%8.6"
 /begin AXIS_DESCR COM_AXIS Epm_nEng EngN 16 -16384.00 16383.50 FORMAT "%8.2" AXIS_PTS_REF SNM16GKUW /end AXIS_DESCR
 /begin AXIS_DESCR COM_AXIS AirMod_ratChrgAirCyl rel_uw_q0p0234 15 0.00 1535.977 FORMAT "%8.3" AXIS_PTS_REF SRL15GKUW /end AXIS_DESCR
/end CHARACTERISTIC
/begin CHARACTERISTIC KFDETAZWLONEAGR "Ignition angle efficiency correction offset at consideration of EGR valve" MAP 0x80546EDC RB_MapGroup_U16 1.999969 fak_uw_b2 0.00 1.999969 FORMAT "%8.6"
 /begin AXIS_DESCR COM_AXIS Epm_nEng EngN 16 -16384.00 16383.50 FORMAT "%8.2" AXIS_PTS_REF SNM16GKUW /end AXIS_DESCR
 /begin AXIS_DESCR COM_AXIS AirMod_ratChrgAirCyl rel_uw_q0p0234 15 0.00 1535.977 FORMAT "%8.3" AXIS_PTS_REF SRL15GKUW /end AXIS_DESCR
/end CHARACTERISTIC
/begin CHARACTERISTIC KFFDLBTS "Factor delta nominal Lambda for component protection" MAP 0x805470BC RB_MapGroup_U16 1.999969 fak_uw_b2 0.00 1.999969 FORMAT "%8.6"
 /begin AXIS_DESCR COM_AXIS Epm_nEng EngN 16 -16384.00 16383.50 FORMAT "%8.2" AXIS_PTS_REF SNM16GKUW /end AXIS_DESCR
 /begin AXIS_DESCR COM_AXIS AirMod_ratChrgAirCyl rel_uw_q0p0234 15 0.00 1535.977 FORMAT "%8.3" AXIS_PTS_REF SRL15GKUW /end AXIS_DESCR
/end CHARACTERISTIC
/begin CHARACTERISTIC KFFDLBTSSFL "Factor delta nominal Lambda for component protection in case of switch over to a second fuel" MAP 0x8054729C RB_MapGroup_U16 1.999969 fak_uw_b2 0.00 1.999969 FORMAT "%8.6"
 /begin AXIS_DESCR COM_AXIS Epm_nEng EngN 16 -16384.00 16383.50 FORMAT "%8.2" AXIS_PTS_REF SNM16GKUW /end AXIS_DESCR
 /begin AXIS_DESCR COM_AXIS AirMod_ratChrgAirCyl rel_uw_q0p0234 15 0.00 1535.977 FORMAT "%8.3" AXIS_PTS_REF SRL15GKUW /end AXIS_DESCR
/end CHARACTERISTIC
/begin CHARACTERISTIC KFLBTSBGSFL "Min setpoint value for component protection in case of switch over to a second fuel" MAP 0x8054747C RB_MapGroup_U16 15.99976 fak_uw_b16 0.00 15.99976 FORMAT "%8.5"
 /begin AXIS_DESCR COM_AXIS Epm_nEng EngN 16 -16384.00 16383.50 FORMAT "%8.2" AXIS_PTS_REF SNM16GKUW /end AXIS_DESCR
 /begin AXIS_DESCR COM_AXIS AirMod_ratChrgAirCyl rel_uw_q0p0234 15 0.00 1535.977 FORMAT "%8.3" AXIS_PTS_REF SRL15GKUW /end AXIS_DESCR
/end CHARACTERISTIC
/begin CHARACTERISTIC KFLBTSDY "enrichment for component protection during dynamic load" MAP 0x8054765C RB_Map_U16S16_U16 1.000000 fak_uw_b16 0.00 1.000000 FORMAT "%8.6" EXTENDED_LIMITS 0.00 15.99976
 /begin AXIS_DESCR STD_AXIS ExhMgT_iaDeltaCptProtn fak_uw_b2 6 0.00 1.999969 FORMAT "%8.6" DEPOSIT ABSOLUTE /end AXIS_DESCR
 /begin AXIS_DESCR STD_AXIS Epm_nEng EngN 6 -16384.00 16383.50 FORMAT "%8.2" DEPOSIT ABSOLUTE /end AXIS_DESCR
/end CHARACTERISTIC
/begin CHARACTERISTIC KFLBTSDYRI "enrichment for component protection during load dynamic (in case of rich engine lambda)" MAP 0x805476C0 RB_Map_U16S16_U16 1.000000 fak_uw_b16 0.00 1.000000 FORMAT "%8.6" EXTENDED_LIMITS 0.00 15.99976
 /begin AXIS_DESCR STD_AXIS ExhMgT_iaDeltaCptProtn fak_uw_b2 6 0.00 1.999969 FORMAT "%8.6" DEPOSIT ABSOLUTE /end AXIS_DESCR
 /begin AXIS_DESCR STD_AXIS Epm_nEng EngN 6 -16384.00 16383.50 FORMAT "%8.2" DEPOSIT ABSOLUTE /end AXIS_DESCR
/end CHARACTERISTIC
/begin CHARACTERISTIC KFLBTSSFL "map for component protection in case of switch over to a second fuel (Bank1)" MAP 0x80547724 RB_MapGroup_U16 1.500000 fak_uw_b16 0.500000 2.000000 FORMAT "%8.6" EXTENDED_LIMITS 0.00 15.99976
 /begin AXIS_DESCR COM_AXIS Epm_nEng EngN 16 -16384.00 16383.50 FORMAT "%8.2" AXIS_PTS_REF SNM16GKUW /end AXIS_DESCR
 /begin AXIS_DESCR COM_AXIS AirMod_ratChrgAirCyl rel_uw_q0p0234 15 0.00 1535.977 FORMAT "%8.3" AXIS_PTS_REF SRL15GKUW /end AXIS_DESCR
/end CHARACTERISTIC
/begin CHARACTERISTIC KFLBTSSFLVS "map for component protection in case of switch over to a second fuel (Bank1) and a high valve lift" MAP 0x80547904 RB_MapGroup_U16 1.500000 fak_uw_b16 0.500000 2.000000 FORMAT "%8.6" EXTENDED_LIMITS 0.00 15.99976
 /begin AXIS_DESCR COM_AXIS Epm_nEng EngN 16 -16384.00 16383.50 FORMAT "%8.2" AXIS_PTS_REF SNM16GKUW /end AXIS_DESCR
 /begin AXIS_DESCR COM_AXIS AirMod_ratChrgAirCyl rel_uw_q0p0234 15 0.00 1535.977 FORMAT "%8.3" AXIS_PTS_REF SRL15GKUW /end AXIS_DESCR
/end CHARACTERISTIC
/begin CHARACTERISTIC KFLBTSVS "Nominal Lambda for component protection with big valve lift" MAP 0x80547AE4 RB_MapGroup_U16 1.500000 fak_uw_b16 0.500000 2.000000 FORMAT "%8.6" EXTENDED_LIMITS 0.00 15.99976
 /begin AXIS_DESCR COM_AXIS Epm_nEng EngN 16 -16384.00 16383.50 FORMAT "%8.2" AXIS_PTS_REF SNM16GKUW /end AXIS_DESCR
 /begin AXIS_DESCR COM_AXIS AirMod_ratChrgAirCyl rel_uw_q0p0234 15 0.00 1535.977 FORMAT "%8.3" AXIS_PTS_REF SRL15GKUW /end AXIS_DESCR
/end CHARACTERISTIC
/begin CHARACTERISTIC KFMXETKHFVLL "diagnosis threshold for maximum allowed deviation of ignition efficiency during catalyst heating during idle (MAX-Errorpath)" MAP 0x80544FFE RB_Map_S16U16_S16 0.9999695 fak_q3p0518Em5 0.00 0.9999695 FORMAT "%9.7" EXTENDED_LIMITS -1.000000 0.9999695
 /begin AXIS_DESCR STD_AXIS ExhMgT_tEngDiagIaCatHeatg Temp_Cels 8 -3549.940 3003.560 FORMAT "%8.3" DEPOSIT ABSOLUTE /end AXIS_DESCR
 /begin AXIS_DESCR STD_AXIS fethmnmx_w_msg fak_uw_b2 6 0.00 1.999969 FORMAT "%8.6" DEPOSIT ABSOLUTE /end AXIS_DESCR
/end CHARACTERISTIC
/begin CHARACTERISTIC KFMXETKHFVTL "diagnosis threshold for maximum allowed deviation of ignition efficiency during catalyst heating during part load (MAX-Errorpath)" MAP 0x8054507E RB_Map_S16U16_S16 0.9999695 fak_q3p0518Em5 0.00 0.9999695 FORMAT "%9.7" EXTENDED_LIMITS -1.000000 0.9999695
 /begin AXIS_DESCR STD_AXIS ExhMgT_tEngDiagIaCatHeatg Temp_Cels 8 -3549.940 3003.560 FORMAT "%8.3" DEPOSIT ABSOLUTE /end AXIS_DESCR
 /begin AXIS_DESCR STD_AXIS fethmnmx_w_msg fak_uw_b2 6 0.00 1.999969 FORMAT "%8.6" DEPOSIT ABSOLUTE /end AXIS_DESCR
/end CHARACTERISTIC
/begin CHARACTERISTIC KLFINTPLZW "line of interpolation factor for enrichment for component protection during load dynamic (in case of rich engine lambda)" CURVE 0x80547CC4 RB_Curve_U16_U8_Static 1.992188 fak_ub_b2 0.00 1.992188 FORMAT "%8.6"
 /begin AXIS_DESCR STD_AXIS lbtsmnsp_w fak_uw_b16 4 0.00 15.99976 FORMAT "%8.5" DEPOSIT ABSOLUTE /end AXIS_DESCR
/end CHARACTERISTIC
/begin CHARACTERISTIC KLRLMDVERL "line for maximum allowed air charge in dependence of resistant torque of the engine for enabling of diagnosis of deviation of ignition efficiency during catalyst haeting during idle" CURVE 0x805450FE RB_Curve_U16_U16 1535.977 rel_uw_q0p0234 0.00 1535.977 FORMAT "%8.3"
 /begin AXIS_DESCR STD_AXIS mdverl_w_msg rel_uw_b100 6 0.00 99.99847 FORMAT "%8.5" DEPOSIT ABSOLUTE /end AXIS_DESCR
/end CHARACTERISTIC
/begin CHARACTERISTIC KLSKLBTSNM "Lambda requirement in case of mega knock detection based on engine speed" CURVE 0x80547CD2 RB_Curve_S16_U16_Static 1.000000 fak_uw_b16 0.00 1.000000 FORMAT "%8.6" EXTENDED_LIMITS 0.00 15.99976
 /begin AXIS_DESCR STD_AXIS Epm_nEng EngN 4 -16384.00 16383.50 FORMAT "%8.2" DEPOSIT ABSOLUTE /end AXIS_DESCR
/end CHARACTERISTIC
/begin CHARACTERISTIC KLZKLBTDY "filter time constant for enrichment for component protection because of load dynamic" CURVE 0x80547CE4 RB_Curve_U16_U16 655.3400 t_q0p01 0.0100 655.3500 FORMAT "%8.4" EXTENDED_LIMITS 0.00 655.3500
 /begin AXIS_DESCR STD_AXIS miwointv_w rel_uw_b100 6 0.00 99.99847 FORMAT "%8.5" DEPOSIT ABSOLUTE /end AXIS_DESCR
/end CHARACTERISTIC
/begin CHARACTERISTIC KLZWDLBTS "filtertime constant for Delta-lambda for component protection due to ignition retardation compared with basic ignition timing" CURVE 0x80547CFE RB_Curve_U16_U16 655.3400 t_q0p01 0.0100 655.3500 FORMAT "%8.4" EXTENDED_LIMITS 0.00 655.3500
 /begin AXIS_DESCR STD_AXIS ml_w_msg m_uw_b6553p5 4 0.00 6553.500 FORMAT "%8.3" DEPOSIT ABSOLUTE /end AXIS_DESCR
/end CHARACTERISTIC
/begin CHARACTERISTIC MNTKHLL "minimum necessary time for catalyst heating in due to a cold start during idle for evaluation of ignition efficiency" VALUE 0x80545118 RB_Val_Wu16 655.3500 t_q0p01 0.00 655.3500 FORMAT "%8.4" /end CHARACTERISTIC
/begin CHARACTERISTIC MNTKHTL "minimum necessary time for catalyst heating in due to a cold start outside idle for evaluation of ignition efficiency" VALUE 0x8054511A RB_Val_Wu16 655.3500 t_q0p01 0.00 655.3500 FORMAT "%8.4" /end CHARACTERISTIC
/begin AXIS_PTS SDETA08UW "Breakpoint distribution component protection over delta efficiency of spark timing" 0x80547D10 NO_INPUT_QUANTITY RB_Axis_U16 1.999969 fak_uw_b2 8 0.00 1.999969 FORMAT "%8.6" DEPOSIT ABSOLUTE /end AXIS_PTS
/begin AXIS_PTS SNM16GKUW "Datapoint distribution mixture control 16 nmot datapoints" 0x80547D22 Epm_nEng RB_Axis_S16 32767.50 EngN 16 -16384.00 16383.50 FORMAT "%8.2" DEPOSIT ABSOLUTE /end AXIS_PTS
/begin AXIS_PTS SRL15GKUW "Datapoint distribution mixture control 15 rl_w datapoints" 0x80547D44 AirMod_ratChrgAirCyl RB_Axis_U16 1535.977 rel_uw_q0p0234 15 0.00 1535.977 FORMAT "%8.3" DEPOSIT ABSOLUTE /end AXIS_PTS
/begin CHARACTERISTIC TankP_pUpprThdPlausDiag_T "Upper threshold for tank pressure for start of diagnosis" CURVE 0x80544DBE RB_Curve_U16_S8_Static 159.4 p_sb_q0p625 -80.00 79.38 FORMAT "%5.2"
 /begin AXIS_DESCR STD_AXIS fstt_w_msg vol_q0p1_l 6 0.00 6553.500 FORMAT "%8.3" DEPOSIT ABSOLUTE /end AXIS_DESCR
/end CHARACTERISTIC
/begin CHARACTERISTIC TDDETAKH "time delay for release of diagnosis for monitoring of degradation engine efficiency during catalyst heating in due of cold start" VALUE 0x8054511C RB_Val_Wu16 655.3500 t_q0p01 0.00 655.3500 FORMAT "%8.4" /end CHARACTERISTIC
/begin CHARACTERISTIC TDDSTPL "Time for plaus error for tank pressure sensor" VALUE 0x80544DD2 RB_Val_Wu16 6553.400 t_q0p1 0.00 6553.400 FORMAT "%8.3" EXTENDED_LIMITS 0.00 6553.500 /end CHARACTERISTIC
/begin CHARACTERISTIC TDDSTW "debouncing time for fault detection tank pressure sensor" VALUE 0x80544DA6 RB_Val_Wu16 6553.500 t_q0p1 0.00 6553.500 FORMAT "%8.3" /end CHARACTERISTIC
/begin CHARACTERISTIC TVLBTSDY "Delay time for enrichment for component protection due to dynamic load" VALUE 0x80546196 RB_Val_Wu16 655.3500 t_q0p01 0.00 655.3500 FORMAT "%8.4" /end CHARACTERISTIC
/begin CHARACTERISTIC UDSTMN "Minimum Tank Pressure Sensor Voltage" VALUE 0x80544DA8 RB_Val_Wu16 319.9951 spg_q0p00488 0.00 319.9951 FORMAT "%8.4" /end CHARACTERISTIC
/begin CHARACTERISTIC UDSTMX "Maximum Tank Pressure Sensor Voltage" VALUE 0x80544DAA RB_Val_Wu16 319.9951 spg_q0p00488 0.00 319.9951 FORMAT "%8.4" /end CHARACTERISTIC
/begin CHARACTERISTIC ZKETKHNM "time constant for filtering of engine speed during diagnosis of engine efficiency for catalyst heating" VALUE 0x8054511E RB_Val_Wu16 655.3400 t_q0p01 0.0100 655.3500 FORMAT "%8.4" EXTENDED_LIMITS 0.00 655.3500 /end CHARACTERISTIC
/begin CHARACTERISTIC ZKETKHRL "time constant for filtering of relative air charge during diagnosis of engine efficiency for catalyst heating" VALUE 0x80545120 RB_Val_Wu16 655.3400 t_q0p01 0.0100 655.3500 FORMAT "%8.4" EXTENDED_LIMITS 0.00 655.3500 /end CHARACTERISTIC
/begin MEASUREMENT bdemodbs_msg "Gasoline Direct Injection desired mode component protection" UBYTE dez 1 100 0.00 255.0 FORMAT "%5.1" ECU_ADDRESS 0x6000EF00 /end MEASUREMENT
/begin MEASUREMENT bdemodkw_msg "GDI desired mode catalyst warming." UBYTE dez 1 100 0.00 255.0 FORMAT "%5.1" ECU_ADDRESS 0x6000EEFF /end MEASUREMENT
/begin MEASUREMENT B_agrofflbts_msg "condition close EGR-valve because of component protection" UBYTE B_TRUE 1 100 0.00 1.00000000000 BIT_MASK 0x1 FORMAT "%13.11" ECU_ADDRESS 0x70000C40 /end MEASUREMENT
/begin MEASUREMENT B_anfhsgkw_msg "Requirement HOS mode throttled for catalyst warming." UBYTE B_TRUE 1 100 0.00 1.00000000000 BIT_MASK 0x1 FORMAT "%13.11" ECU_ADDRESS 0x70000C3E /end MEASUREMENT
/begin MEASUREMENT B_anfscgkw_msg "Requirement stratified mode throttled for catalyst warming." UBYTE B_TRUE 1 100 0.00 1.00000000000 BIT_MASK 0x1 FORMAT "%13.11" ECU_ADDRESS 0x70000C3D /end MEASUREMENT
/begin MEASUREMENT B_bbmrkh_msg "Operation condition for catalyst heating by spark retard (torque reserve)" UBYTE B_TRUE 1 100 0.00 1.00000000000 BIT_MASK 0x1 FORMAT "%13.11" ECU_ADDRESS 0x70000C34 /end MEASUREMENT
/begin MEASUREMENT B_dyetkh_msg "condition for recognized dynamic criteria for inhibiting of diagnosis of engine efficiency deviation during catalyst heating phase" UBYTE B_TRUE 1 100 0.00 1.00000000000 BIT_MASK 0x1 FORMAT "%13.11" ECU_ADDRESS 0x70000BFE /end MEASUREMENT
/begin MEASUREMENT B_edekhlmx_msg "condition for detected error of ignition timing efficiency diagnosis for catalyst heating during cold start (MAX-Errorpath) during idle at the end of catalyst heating" UBYTE B_TRUE 1 100 0.00 1.00000000000 BIT_MASK 0x1 FORMAT "%13.11" ECU_ADDRESS 0x70000BFC /end MEASUREMENT
/begin MEASUREMENT B_edekhtmx_msg "condition for detected error of ignition timing efficiency diagnosis for catalyst heating during cold start (MAX-Errorpath) during part load at the end of catalyst heating" UBYTE B_TRUE 1 100 0.00 1.00000000000 BIT_MASK 0x1 FORMAT "%13.11" ECU_ADDRESS 0x70000BFB /end MEASUREMENT
/begin MEASUREMENT B_ekhllmx "condition for detected error of ignition timing efficiency diagnosis for catalyst heating during cold start (MAX-Errorpath) during idle" UBYTE B_TRUE 1 100 0.00 1.00000000000 BIT_MASK 0x1 FORMAT "%13.11" ECU_ADDRESS 0x7000029A /end MEASUREMENT
/begin MEASUREMENT B_ekhtlmx "condition for detected error of ignition timing efficiency diagnosis for catalyst heating during cold start (MAX-Errorpath) during part load" UBYTE B_TRUE 1 100 0.00 1.00000000000 BIT_MASK 0x1 FORMAT "%13.11" ECU_ADDRESS 0x70000299 /end MEASUREMENT
/begin MEASUREMENT B_endcsst_msg "enable of diagnosis of monitoring for cold start strategy" UBYTE B_TRUE 1 100 0.00 1.00000000000 BIT_MASK 0x1 FORMAT "%13.11" ECU_ADDRESS 0x70000BF0 /end MEASUREMENT
/begin MEASUREMENT B_enetkhll_msg "release calculation of engine efficiency deviation for diagnosis of ignition during idle" UBYTE B_TRUE 1 100 0.00 1.00000000000 BIT_MASK 0x1 FORMAT "%13.11" ECU_ADDRESS 0x70000BEE /end MEASUREMENT
/begin MEASUREMENT B_enetkhtl_msg "release calculation of engine efficiency deviation for diagnosis of ignition during part load" UBYTE B_TRUE 1 100 0.00 1.00000000000 BIT_MASK 0x1 FORMAT "%13.11" ECU_ADDRESS 0x70000BED /end MEASUREMENT
/begin MEASUREMENT B_enetkh_msg "release calculation of engine efficiency deviation for diagnosis of ignition" UBYTE B_TRUE 1 100 0.00 1.00000000000 BIT_MASK 0x1 FORMAT "%13.11" ECU_ADDRESS 0x70000BEF /end MEASUREMENT
/begin MEASUREMENT B_error_old "Old value of the error." UBYTE B_TRUE 1 100 0.00 1.00000000000 BIT_MASK 0x1 FORMAT "%13.11" ECU_ADDRESS 0x60000F7C /end MEASUREMENT
/begin MEASUREMENT B_flbtskat_msg "Condition component protection regarding catalyst temperature" UBYTE B_TRUE 1 100 0.00 1.00000000000 BIT_MASK 0x1 FORMAT "%13.11" ECU_ADDRESS 0x6000EEA0 /end MEASUREMENT
/begin MEASUREMENT B_fuabts_msg "Condition for reducing the max. desired air charge for component protection" UBYTE B_TRUE 1 100 0.00 1.00000000000 BIT_MASK 0x1 FORMAT "%13.11" ECU_ADDRESS 0x70000BB6 /end MEASUREMENT
/begin MEASUREMENT B_khakt_msg "request catalyst heating by cold engine" UBYTE B_TRUE 1 100 0.00 1.00000000000 BIT_MASK 0x1 FORMAT "%13.11" ECU_ADDRESS 0x70000BA1 /end MEASUREMENT
/begin MEASUREMENT B_khakw_msg "request catalyst heating in case of warming catalyst" UBYTE B_TRUE 1 100 0.00 1.00000000000 BIT_MASK 0x1 FORMAT "%13.11" ECU_ADDRESS 0x70000BA0 /end MEASUREMENT
/begin MEASUREMENT B_khan_msg "request of activated catalyst heating in connection with the condition when the engine speed is greated than a minimum threshold" UBYTE B_TRUE 1 100 0.00 1.00000000000 BIT_MASK 0x1 FORMAT "%13.11" ECU_ADDRESS 0x70000B9F /end MEASUREMENT
/begin MEASUREMENT B_khasuhsp_msg "request for catalyst heating for desulphurisation with homogenous spliten zur Entschwefelung mit HSP" UBYTE B_TRUE 1 100 0.00 1.00000000000 BIT_MASK 0x1 FORMAT "%13.11" ECU_ADDRESS 0x70000B9E /end MEASUREMENT
/begin MEASUREMENT B_khat_msg "request of activated catalyst heating (transmitted to CAN)" UBYTE B_TRUE 1 100 0.00 1.00000000000 BIT_MASK 0x1 FORMAT "%13.11" ECU_ADDRESS 0x70000B9D /end MEASUREMENT
/begin MEASUREMENT B_kha_msg "request of activated catalyst heating" UBYTE B_TRUE 1 100 0.00 1.00000000000 BIT_MASK 0x1 FORMAT "%13.11" ECU_ADDRESS 0x70000BA3 /end MEASUREMENT
/begin MEASUREMENT B_kherr_msg "error caused disable condition for bit B_kh" UBYTE B_TRUE 1 100 0.00 1.00000000000 BIT_MASK 0x1 FORMAT "%13.11" ECU_ADDRESS 0x70000B9B /end MEASUREMENT
/begin MEASUREMENT B_khmr_msg "condition catalyst heating with torque reserve" UBYTE B_TRUE 1 100 0.00 1.00000000000 BIT_MASK 0x1 FORMAT "%13.11" ECU_ADDRESS 0x70000B9A /end MEASUREMENT
/begin MEASUREMENT B_kh_msg "condition catalyst heating activated" UBYTE B_TRUE 1 100 0.00 1.00000000000 BIT_MASK 0x1 FORMAT "%13.11" ECU_ADDRESS 0x70000BA4 /end MEASUREMENT
/begin MEASUREMENT B_kw_msg "Condition catalyst warming" UBYTE B_TRUE 1 100 0.00 1.00000000000 BIT_MASK 0x1 FORMAT "%13.11" ECU_ADDRESS 0x70000B93 /end MEASUREMENT
/begin MEASUREMENT B_lambts_msg "lambda for component protection is active" UBYTE B_TRUE 1 100 0.00 1.00000000000 BIT_MASK 0x1 FORMAT "%13.11" ECU_ADDRESS 0x70000B91 /end MEASUREMENT
/begin MEASUREMENT B_laspkt_msg "condition lambda split for catalyst heating in case of a cold start" UBYTE B_TRUE 1 100 0.00 1.00000000000 BIT_MASK 0x1 FORMAT "%13.11" ECU_ADDRESS 0x70000B8B /end MEASUREMENT
/begin MEASUREMENT B_laspkw_msg "condition lambda split for catalyst warming" UBYTE B_TRUE 1 100 0.00 1.00000000000 BIT_MASK 0x1 FORMAT "%13.11" ECU_ADDRESS 0x70000B8A /end MEASUREMENT
/begin MEASUREMENT B_lbtsbg "limitation of desired lambda for component protection" UBYTE B_TRUE 1 100 0.00 1.00000000000 BIT_MASK 0x1 FORMAT "%13.11" ECU_ADDRESS 0x70000B89 /end MEASUREMENT
/begin MEASUREMENT B_stplch_msg "Condition start plaus check of tank pressure sensor" UBYTE B_TRUE 1 100 0.00 1.00000000000 BIT_MASK 0x1 FORMAT "%13.11" ECU_ADDRESS 0x600013BF /end MEASUREMENT
/begin MEASUREMENT B_trkh_msg "Flag for catalyst fast heating" UBYTE B_TRUE 1 100 0.00 1.00000000000 BIT_MASK 0x1 FORMAT "%13.11" ECU_ADDRESS 0x70000B03 /end MEASUREMENT
/begin MEASUREMENT B_trkonz2_msg "condition catalyst heating is realising with thermo reactor concept (Bank2)" UBYTE B_TRUE 1 100 0.00 1.00000000000 BIT_MASK 0x1 FORMAT "%13.11" ECU_ADDRESS 0x70000B02 /end MEASUREMENT
/begin MEASUREMENT B_trkonz_msg "condition catalyst heating is realising with thermo reactor concept" UBYTE B_TRUE 1 100 0.00 1.00000000000 BIT_MASK 0x1 FORMAT "%13.11" ECU_ADDRESS 0x70000B01 /end MEASUREMENT
/begin MEASUREMENT B_zdekhlmx_msg "condition for OK Status of ignition timing efficiency diagnosis for catalyst heating during cold start (MAX-Errorpath) during idle" UBYTE B_TRUE 1 100 0.00 1.00000000000 BIT_MASK 0x1 FORMAT "%13.11" ECU_ADDRESS 0x70000AE8 /end MEASUREMENT
/begin MEASUREMENT B_zdekhtmx_msg "condition for OK Status of ignition timing efficiency diagnosis for catalyst heating during cold start (MAX-Errorpath) during part load" UBYTE B_TRUE 1 100 0.00 1.00000000000 BIT_MASK 0x1 FORMAT "%13.11" ECU_ADDRESS 0x70000AE7 /end MEASUREMENT
/begin MEASUREMENT CatH_TempSelnCat1B1_I.tCatAvrg "class instance for catalyst heating temperature selection for catalyst 1 bank1 / Average temperature catalyst 1" SWORD Temp_Cels 1 100 -3549.940 3003.560 FORMAT "%8.3" ECU_ADDRESS 0x6000700E /end MEASUREMENT
/begin MEASUREMENT CatH_TempSelnCat1B1_I.tCatBrick1 "class instance for catalyst heating temperature selection for catalyst 1 bank1 / Temperature Brick 1 Catalyst 1" SWORD Temp_Cels 1 100 -3549.940 3003.560 FORMAT "%8.3" ECU_ADDRESS 0x60007010 /end MEASUREMENT
/begin MEASUREMENT CatH_TempSelnCat1B1_I.tCatBrick2 "class instance for catalyst heating temperature selection for catalyst 1 bank1 / Temperature Brick 2 Catalyst 1" SWORD Temp_Cels 1 100 -3549.940 3003.560 FORMAT "%8.3" ECU_ADDRESS 0x60007012 /end MEASUREMENT
/begin MEASUREMENT CatH_TempSelnCat1B1_I.tCatBrick3 "class instance for catalyst heating temperature selection for catalyst 1 bank1 / Temperature Brick 3 Catalyst 1" SWORD Temp_Cels 1 100 -3549.940 3003.560 FORMAT "%8.3" ECU_ADDRESS 0x60007014 /end MEASUREMENT
/begin MEASUREMENT CatH_TempSelnCat1B1_I.tCatMax "class instance for catalyst heating temperature selection for catalyst 1 bank1 / Temperature maximum catalyst 1" SWORD Temp_Cels 1 100 -3549.940 3003.560 FORMAT "%8.3" ECU_ADDRESS 0x60007016 /end MEASUREMENT
/begin MEASUREMENT CatH_TempSelnCat1B1_I.tCatMin "class instance for catalyst heating temperature selection for catalyst 1 bank1 / Temperature minimum catalyst 1" SWORD Temp_Cels 1 100 -3549.940 3003.560 FORMAT "%8.3" ECU_ADDRESS 0x60007018 /end MEASUREMENT
/begin MEASUREMENT CatH_TempSelnCat1B1_I.tCatSeln1 "class instance for catalyst heating temperature selection for catalyst 1 bank1 / selected catalyst temperature catalyst 1 for controlling the heating measures (selection1)" SWORD Temp_Cels 1 100 -3549.940 3003.560 FORMAT "%8.3" ECU_ADDRESS 0x6000701A /end MEASUREMENT
/begin MEASUREMENT CatH_TempSelnCat1B1_I.tCatSeln2 "class instance for catalyst heating temperature selection for catalyst 1 bank1 / selected catalyst temperature catalyst 1 for controlling the heating measures (selection2)" SWORD Temp_Cels 1 100 -3549.940 3003.560 FORMAT "%8.3" ECU_ADDRESS 0x6000701C /end MEASUREMENT
/begin MEASUREMENT CatH_TempSelnCat2B1_I.tCatAvrg "class instance for catalyst heating temperature selection for catalyst 2 bank1 / Average temperature catalyst 2" SWORD Temp_Cels 1 100 -3549.940 3003.560 FORMAT "%8.3" ECU_ADDRESS 0x60006FFE /end MEASUREMENT
/begin MEASUREMENT CatH_TempSelnCat2B1_I.tCatBrick1 "class instance for catalyst heating temperature selection for catalyst 2 bank1 / Temperature Brick 1 Catalyst 2" SWORD Temp_Cels 1 100 -3549.940 3003.560 FORMAT "%8.3" ECU_ADDRESS 0x60007000 /end MEASUREMENT
/begin MEASUREMENT CatH_TempSelnCat2B1_I.tCatBrick2 "class instance for catalyst heating temperature selection for catalyst 2 bank1 / Temperature Brick 2 Catalyst 2" SWORD Temp_Cels 1 100 -3549.940 3003.560 FORMAT "%8.3" ECU_ADDRESS 0x60007002 /end MEASUREMENT
/begin MEASUREMENT CatH_TempSelnCat2B1_I.tCatBrick3 "class instance for catalyst heating temperature selection for catalyst 2 bank1 / Temperature Brick 3 Catalyst 2" SWORD Temp_Cels 1 100 -3549.940 3003.560 FORMAT "%8.3" ECU_ADDRESS 0x60007004 /end MEASUREMENT
/begin MEASUREMENT CatH_TempSelnCat2B1_I.tCatMax "class instance for catalyst heating temperature selection for catalyst 2 bank1 / Temperature maximum catalyst 2" SWORD Temp_Cels 1 100 -3549.940 3003.560 FORMAT "%8.3" ECU_ADDRESS 0x60007006 /end MEASUREMENT
/begin MEASUREMENT CatH_TempSelnCat2B1_I.tCatMin "class instance for catalyst heating temperature selection for catalyst 2 bank1 / Temperature minimum catalyst 2" SWORD Temp_Cels 1 100 -3549.940 3003.560 FORMAT "%8.3" ECU_ADDRESS 0x60007008 /end MEASUREMENT
/begin MEASUREMENT CatH_TempSelnCat2B1_I.tCatSeln1 "class instance for catalyst heating temperature selection for catalyst 2 bank1 / selected catalyst temperature catalyst 2 for controlling the heating measures (selection1)" SWORD Temp_Cels 1 100 -3549.940 3003.560 FORMAT "%8.3" ECU_ADDRESS 0x6000700A /end MEASUREMENT
/begin MEASUREMENT CatH_TempSelnCat2B1_I.tCatSeln2 "class instance for catalyst heating temperature selection for catalyst 2 bank1 / selected catalyst temperature catalyst 2 for controlling the heating measures (selection2)" SWORD Temp_Cels 1 100 -3549.940 3003.560 FORMAT "%8.3" ECU_ADDRESS 0x6000700C /end MEASUREMENT
/begin MEASUREMENT detakhls_w "differenz between actuell ignition effciency and desired catalyst heating ignition efficiency during idle" SWORD fak_q3p0518Em5 1 100 -1.000000 0.999969 FORMAT "%8.6" ECU_ADDRESS 0x60006FFC /end MEASUREMENT
/begin MEASUREMENT detakhl_w "differenz between actuell ignition efficiency and desired catalyst heating ignition efficiency (limited) during idle" SWORD fak_q3p0518Em5 1 100 -1.000000 0.999969 FORMAT "%8.6" ECU_ADDRESS 0x60006FFA /end MEASUREMENT
/begin MEASUREMENT detakhts_w "differenz between actuell ignition effciency and desired catalyst heating ignition efficiency during part load" SWORD fak_q3p0518Em5 1 100 -1.000000 0.999969 FORMAT "%8.6" ECU_ADDRESS 0x60006FF8 /end MEASUREMENT
/begin MEASUREMENT detakht_w "differenz between actuell ignition efficiency and desired catalyst heating ignition efficiency (limited) during part load" SWORD fak_q3p0518Em5 1 100 -1.000000 0.999969 FORMAT "%8.6" ECU_ADDRESS 0x60006FF6 /end MEASUREMENT
/begin MEASUREMENT detkhlav_w_msg "mean deviation of actuell ignition effciency and desired catalyst heating ignition efficiency during idle" SWORD fak_q3p0518Em5 1 100 -1.000000 0.999969 FORMAT "%8.6" ECU_ADDRESS 0x60013FF4 /end MEASUREMENT
/begin MEASUREMENT detkhtav_w_msg "mean deviation of actuell ignition effciency and desired catalyst heating ignition efficiency outside idle" SWORD fak_q3p0518Em5 1 100 -1.000000 0.999969 FORMAT "%8.6" ECU_ADDRESS 0x60013FF6 /end MEASUREMENT
/begin MEASUREMENT dlbtszwr_w "Delta-lambda for component protection due to ignition retardation compared with basic ignition timing (raw value)" SWORD fak_sw_b8 1 100 -1.000000 1.000000 FORMAT "%8.6" ECU_ADDRESS 0x60006FC4 /end MEASUREMENT
/begin MEASUREMENT dmrte_w_msg "Torque reserve for purge control" UWORD rel_uw_b100 1 100 0.00 99.99847 FORMAT "%8.5" ECU_ADDRESS 0x60008542 /end MEASUREMENT
/begin MEASUREMENT dtbtgsmx_w_msg "Distance to critical limits of exhaust gas temperatures upstream of catalysts (maximum choice bewteen bench1 and 2)" SWORD temp_q0p0468_K 1 100 -1536.000 1535.953 FORMAT "%8.3" ECU_ADDRESS 0x60014004 /end MEASUREMENT
/begin MEASUREMENT dtbtkamx_w "Distance to critical limits of temperatures near catalysts (minimum choice between bench1 and 2)" SWORD temp_q0p0468_K 1 100 -1536.000 1535.953 FORMAT "%8.3" ECU_ADDRESS 0x60007038 /end MEASUREMENT
/begin MEASUREMENT etakhko_w "desired engine efficiency for catalyst heating" UWORD fak_q3p0518Em5 1 100 0.00 1.999969 FORMAT "%8.6" ECU_ADDRESS 0x60006FF4 /end MEASUREMENT
/begin MEASUREMENT etakhlim_w "desired engine efficiency for catalyst heating by cold start, limited" UWORD fak_uw_b2 1 100 0.00 1.999969 FORMAT "%8.6" ECU_ADDRESS 0x60006FF2 /end MEASUREMENT
/begin MEASUREMENT etazwg_w "Efficiency of basic ignition timing" UWORD fak_uw_b2 1 100 0.00 1.999969 FORMAT "%8.6" ECU_ADDRESS 0x60006FC6 /end MEASUREMENT
/begin MEASUREMENT etkhlmxloc "minimum distance to error threshold (MAX-Errorpath) inside idle (during life cycle)" UBYTE rel_q0p78125 1 100 0.00 199.2 FORMAT "%5.1" ECU_ADDRESS 0x6003908D /end MEASUREMENT
/begin MEASUREMENT etkhlmx_msg "minimum distance to error threshold (MAX-Errorpath) inside idle (during life cycle)" UBYTE rel_q0p78125 1 100 0.00 199.2 FORMAT "%5.1" ECU_ADDRESS 0x60014161 /end MEASUREMENT
/begin MEASUREMENT etkhtmxloc "minimum distance to error threshold (MAX-Errorpath) outside idle (during life cycle)" UBYTE rel_q0p78125 1 100 0.00 199.2 FORMAT "%5.1" ECU_ADDRESS 0x6003908C /end MEASUREMENT
/begin MEASUREMENT etkhtmx_msg "minimum distance to error threshold (MAX-Errorpath) outside idle (during life cycle)" UBYTE rel_q0p78125 1 100 0.00 199.2 FORMAT "%5.1" ECU_ADDRESS 0x60014162 /end MEASUREMENT
/begin MEASUREMENT EvapeLeakDst_msg "distance 0.02inch leak" UWORD km_sw_q1 1 100 0.00 65535.00 FORMAT "%8.2" ECU_ADDRESS 0x60008710 /end MEASUREMENT
/begin MEASUREMENT EvapPSnsrTank_cntrVehVEnaPhyRngChk "counter vehicle speed for enabling physical range check of tank pressure sensor" UWORD t_q0p1 1 100 0.00 6553.400 FORMAT "%8.3" ECU_ADDRESS 0x60000F7A /end MEASUREMENT
/begin MEASUREMENT EvapPSnsrTank_mFlowCpvPhyRngChk "integrated CPV-mass flow for physical range check of tank pressure sensor" UWORD m_3p47222Em4_g 1 100 0.00 22.75521 FORMAT "%8.5" ECU_ADDRESS 0x60000F78 /end MEASUREMENT
/begin MEASUREMENT ExhCo_swtTSelnCatHeatgGpf "An application switch to select either Sensor or modelled temperature from exhaust module" UBYTE B_TRUE 1 100 0.00 1.00000000000 BIT_MASK 0x1 FORMAT "%13.11" ECU_ADDRESS 0x70000988 /end MEASUREMENT
/begin MEASUREMENT ExhMgT_CatHeatg1_I.stOperMod "connection of catalyst heating at operation mode coordinator / Priority-element of the operation mode structure" ULONG OneToOne 1 100 0.00 4294967295.00 FORMAT "%13.2" ECU_ADDRESS 0x70002EE4 /end MEASUREMENT
/begin MEASUREMENT ExhMgT_CatHeatg1_I.stOperModPrio "connection of catalyst heating at operation mode coordinator / Stage-element of the operation mode structure" UBYTE OneToOne 1 100 0.00 255.0 FORMAT "%5.1" ECU_ADDRESS 0x70002EE8 /end MEASUREMENT
/begin MEASUREMENT ExhMgT_CatHeatg1_I.stOperModStg "connection of catalyst heating at operation mode coordinator / Operation-mode element of the operation mode structure" UWORD OneToOne 1 100 0.00 65535.00 FORMAT "%8.2" ECU_ADDRESS 0x70002EEA /end MEASUREMENT
/begin MEASUREMENT ExhMgT_CatHeatg2_I.stOperMod "connection of catalyst heating at operation mode coordinator / Priority-element of the operation mode structure" ULONG OneToOne 1 100 0.00 4294967295.00 FORMAT "%13.2" ECU_ADDRESS 0x70002EDC /end MEASUREMENT
/begin MEASUREMENT ExhMgT_CatHeatg2_I.stOperModPrio "connection of catalyst heating at operation mode coordinator / Stage-element of the operation mode structure" UBYTE OneToOne 1 100 0.00 255.0 FORMAT "%5.1" ECU_ADDRESS 0x70002EE0 /end MEASUREMENT
/begin MEASUREMENT ExhMgT_CatHeatg2_I.stOperModStg "connection of catalyst heating at operation mode coordinator / Operation-mode element of the operation mode structure" UWORD OneToOne 1 100 0.00 65535.00 FORMAT "%8.2" ECU_ADDRESS 0x70002EE2 /end MEASUREMENT
/begin MEASUREMENT ExhMgT_CatHeatg3_I.stOperMod "connection of catalyst heating at operation mode coordinator / Priority-element of the operation mode structure" ULONG OneToOne 1 100 0.00 4294967295.00 FORMAT "%13.2" ECU_ADDRESS 0x70002ED4 /end MEASUREMENT
/begin MEASUREMENT ExhMgT_CatHeatg3_I.stOperModPrio "connection of catalyst heating at operation mode coordinator / Stage-element of the operation mode structure" UBYTE OneToOne 1 100 0.00 255.0 FORMAT "%5.1" ECU_ADDRESS 0x70002ED8 /end MEASUREMENT
/begin MEASUREMENT ExhMgT_CatHeatg3_I.stOperModStg "connection of catalyst heating at operation mode coordinator / Operation-mode element of the operation mode structure" UWORD OneToOne 1 100 0.00 65535.00 FORMAT "%8.2" ECU_ADDRESS 0x70002EDA /end MEASUREMENT
/begin MEASUREMENT ExhMgT_CatHeatgUpReq_ctReIni "Counter for recognizing the re-initialization of variables and parameters" UBYTE dez 1 100 0.00 255.0 FORMAT "%5.1" ECU_ADDRESS 0x6000B0DE /end MEASUREMENT
/begin MEASUREMENT ExhMgT_cntrReiniDiagEtaIaCatHeatg "Counter for recognizing the re-initialization of variables and parameters" UBYTE OneToOne 1 100 0.00 255.0 FORMAT "%5.1" ECU_ADDRESS 0x6000B0D6 /end MEASUREMENT
/begin MEASUREMENT ExhMgT_cntrReiniDmdOperModCatHeatg "Counter for recognizing the re-initialization of variables and parameters" UBYTE OneToOne 1 100 0.00 255.0 FORMAT "%5.1" ECU_ADDRESS 0x6000B0D0 /end MEASUREMENT
/begin MEASUREMENT ExhMgT_cntrReIniIaDeltaCptProtn "local drive cycle counter which is incremented when system state SyC_PostDrive is left" UBYTE OneToOne 1 100 0.00 255.0 FORMAT "%5.1" ECU_ADDRESS 0x6000B0CF /end MEASUREMENT
/begin MEASUREMENT ExhMgT_DmdCsersCdnCatHeatg_ctReIni "local drive cycle counter which is incremented when system state SyC_PostDrive is left" UBYTE dez 1 100 0.00 255.0 FORMAT "%5.1" ECU_ADDRESS 0x6000B0D1 /end MEASUREMENT
/begin MEASUREMENT ExhMgT_effAvrgEngIdleNonCsers "mean deviation of actuell ignition effciency and desired catalyst heating ignition efficiency during idle" SWORD fak_q3p0518Em5 1 100 -1.000000 0.999969 FORMAT "%8.6" ECU_ADDRESS 0x60006FF0 /end MEASUREMENT
/begin MEASUREMENT ExhMgT_effAvrgEngPtlNonCsers "mean deviation of actuell ignition effciency and desired catalyst heating ignition efficiency outside idle" SWORD fak_q3p0518Em5 1 100 -1.000000 0.999969 FORMAT "%8.6" ECU_ADDRESS 0x60006FEE /end MEASUREMENT
/begin MEASUREMENT ExhMgT_effEngIdleNonCsersMax "maximum allowed deviation of ignition efficiency during catalyst haeting during idle (MAX-Errorpath)" SWORD fak_q3p0518Em5 1 100 -1.000000 0.999969 FORMAT "%8.6" ECU_ADDRESS 0x60006FEC /end MEASUREMENT
/begin MEASUREMENT ExhMgT_effEngPtlNonCsersMax "maximum allowed deviation of ignition efficiency during catalyst haeting during part load (MAX-Errorpath)" SWORD fak_q3p0518Em5 1 100 -1.000000 0.999969 FORMAT "%8.6" ECU_ADDRESS 0x60006FEA /end MEASUREMENT
/begin MEASUREMENT ExhMgT_effIntegEngIdleNonCsers "integration of differenz between actuell ignition effciency and desired catalyst heating ignition efficiency during idle" SLONG fak_q3p0518Em7 1 100 -655.360000000 655.359999695 FORMAT "%13.9" ECU_ADDRESS 0x60002AD4 /end MEASUREMENT
/begin MEASUREMENT ExhMgT_effIntegEngPtlNonCsers "integration of differenz between actuell ignition effciency and desired catalyst heating ignition efficiency outside idle" SLONG fak_q3p0518Em7 1 100 -655.360000000 655.359999695 FORMAT "%13.9" ECU_ADDRESS 0x60002AD0 /end MEASUREMENT
/begin MEASUREMENT ExhMgT_facCatHeatgFinshd "terminating factor catalyst heating" UBYTE fak_ub_b1 1 100 0.00 0.9961 ECU_ADDRESS 0x6000EFA0 /end MEASUREMENT
/begin MEASUREMENT ExhMgT_facCatHeatgProgs "relative amount of integrated air mass at catalyst heating" UWORD fak_uw_b1 1 100 0.00 0.9999847 FORMAT "%9.7" ECU_ADDRESS 0x60013EE0 /end MEASUREMENT
/begin MEASUREMENT ExhMgT_facCatHeatgRamp "factor for raising and lowering the heating measures" UBYTE fak_ub_b2 1 100 0.00 1.000000 FORMAT "%8.6" ECU_ADDRESS 0x6000EF9F /end MEASUREMENT
/begin MEASUREMENT ExhMgT_facCorrnMAirCatHeatg "Air mass correction factor for catalyst heating" UWORD fak_uw_b2 1 100 0.00 1.999969 FORMAT "%8.6" ECU_ADDRESS 0x6000870E /end MEASUREMENT
/begin MEASUREMENT ExhMgT_facCorrnTempCatHeatg "factor to calculate temperature correction factor for catalyst heating" UWORD fak_uw_b2 1 100 0.00 1.999969 FORMAT "%8.6" ECU_ADDRESS 0x6000870C /end MEASUREMENT
/begin MEASUREMENT ExhMgT_facCptProtnMisf "factor for reduction of desired air charge in case of catalyst damaged misfires for component protection of exhaust system" UWORD fak_uw_b2 1 100 0.600006 1.000000 FORMAT "%8.6" ECU_ADDRESS 0x6000870A /end MEASUREMENT
/begin MEASUREMENT ExhMgT_facFirstRdcAirFillg "Previous factor for reducing the maximum desired air charge for component protection" UWORD fak_uw_b2 1 100 0.00 1.999969 FORMAT "%8.6" ECU_ADDRESS 0x60008708 /end MEASUREMENT
/begin MEASUREMENT ExhMgT_facHeatgDmdCat "factor for demand of catalyst heating" UWORD fak_uw_b1 1 100 0.00 0.9999847 FORMAT "%9.7" ECU_ADDRESS 0x60008706 /end MEASUREMENT
/begin MEASUREMENT ExhMgT_facHeatgDmdCat1 "heating demand factor of catalyst 1" SWORD Fact 1 100 -4.000000 3.999878 FORMAT "%8.6" ECU_ADDRESS 0x60008988 /end MEASUREMENT
/begin MEASUREMENT ExhMgT_facHeatgDmdCat1B1 "heating demand factor of catalyst1 bank1" SWORD Fact 1 100 -4.000000 3.999878 FORMAT "%8.6" ECU_ADDRESS 0x60008986 /end MEASUREMENT
/begin MEASUREMENT ExhMgT_facHeatgDmdCat2 "heating demand factor of catalyst 2" SWORD Fact 1 100 -4.000000 3.999878 FORMAT "%8.6" ECU_ADDRESS 0x60008984 /end MEASUREMENT
/begin MEASUREMENT ExhMgT_facHeatgDmdCat2B1 "heating demand factor of catalyst2 bank1" SWORD Fact 1 100 -4.000000 3.999878 FORMAT "%8.6" ECU_ADDRESS 0x60008982 /end MEASUREMENT
/begin MEASUREMENT ExhMgT_facHeatgDmdCatLoPrio "heating demand factor of catalyst with low prio" UWORD fak_uw_b1 1 100 0.00 0.9999847 FORMAT "%9.7" ECU_ADDRESS 0x60008704 /end MEASUREMENT
/begin MEASUREMENT ExhMgT_facIntrpnTCat1 "factor for interpolation for dynamic threshold cat 1" UWORD fak_uw_b2 1 100 0.00 1.000000 FORMAT "%8.6" ECU_ADDRESS 0x60007074 /end MEASUREMENT
/begin MEASUREMENT ExhMgT_facIntrpnTCat2 "factor for interpolation for dynamic threshold cat 2" UWORD fak_uw_b2 1 100 0.00 1.000000 FORMAT "%8.6" ECU_ADDRESS 0x60007072 /end MEASUREMENT
/begin MEASUREMENT ExhMgT_facIntrpnTMnf "factor for interpolation for dynamic threshold manifold" UWORD fak_uw_b2 1 100 0.00 1.000000 FORMAT "%8.6" ECU_ADDRESS 0x60007070 /end MEASUREMENT
/begin MEASUREMENT ExhMgT_facLamCptProtnTExh "enabling factor for component protection dependent on modeled exhaust gas temperatures" UWORD fak_uw_b2 1 100 0.00 1.999969 FORMAT "%8.6" ECU_ADDRESS 0x60008702 /end MEASUREMENT
/begin MEASUREMENT ExhMgT_facMinRednCptProtn "dynamic lower limit of reduction factor for maximum air charge component protection" UWORD fak_uw_b2 1 100 0.6000061 0.9999695 FORMAT "%9.7" ECU_ADDRESS 0x60006FB2 /end MEASUREMENT
/begin MEASUREMENT ExhMgT_facRdcAirFillg "demand of the reduction factor for maximum air charge" UWORD fak_uw_b2 1 100 0.00 1.999969 FORMAT "%8.6" ECU_ADDRESS 0x60008700 /end MEASUREMENT
/begin MEASUREMENT ExhMgT_facRdcAirFillgCptProtn "Relative factor of the maximum air charge per second during component protection" SWORD fak_sw_b1 1 100 -1.000000 0.999969 FORMAT "%8.6" ECU_ADDRESS 0x60006FB0 /end MEASUREMENT
/begin MEASUREMENT ExhMgT_facWghtCat1Age "factor for correction of catalyst 1 parameters in dependence of catalyst ageing" UWORD fak_uw_b2 1 100 0.00 1.999969 FORMAT "%8.6" ECU_ADDRESS 0x600086FE /end MEASUREMENT
/begin MEASUREMENT ExhMgT_facWghtCatAge "factor for correction of catalyst parameters in dependence of catalyst ageing" UWORD fak_uw_b2 1 100 0.00 1.999969 FORMAT "%8.6" ECU_ADDRESS 0x600086FC /end MEASUREMENT
/begin MEASUREMENT ExhMgT_fakWghtSecFuelCptProtn "weighting factor for ethanol content in case of component protection" UWORD fak_uw_b2 1 100 0.00 1.000000 FORMAT "%8.6" ECU_ADDRESS 0x60008C46 /end MEASUREMENT
/begin MEASUREMENT ExhMgT_flgActvCptProtn "Condition to activate component protection based on exhaust temperatures" UBYTE B_TRUE 1 100 0.00 1.00000000000 BIT_MASK 0x1 FORMAT "%13.11" ECU_ADDRESS 0x6000EE56 /end MEASUREMENT
/begin MEASUREMENT ExhMgT_flgActvCptProtnTExh "Component protection by exhaust gas temperature model activated" UBYTE B_TRUE 1 100 0.00 1.00000000000 BIT_MASK 0x1 FORMAT "%13.11" ECU_ADDRESS 0x6000EE55 /end MEASUREMENT
/begin MEASUREMENT ExhMgT_flgCatActvCptProtnTExh "Component protection by exhaust gas temperature model of tht catalysts activated" UBYTE B_TRUE 1 100 0.00 1.00000000000 BIT_MASK 0x1 FORMAT "%13.11" ECU_ADDRESS 0x6000EE54 /end MEASUREMENT
/begin MEASUREMENT ExhMgT_flgCatHeatFinshd "cold catalyst heating finished" UBYTE B_TRUE 1 100 0.00 1.00000000000 BIT_MASK 0x1 FORMAT "%13.11" ECU_ADDRESS 0x70000987 /end MEASUREMENT
/begin MEASUREMENT ExhMgT_flgCatHeatgColdStrtAltiRst "condition catalyst heating cold start is reseted due to hight and engine start temperature" UBYTE B_TRUE 1 100 0.00 1.00000000000 BIT_MASK 0x1 FORMAT "%13.11" ECU_ADDRESS 0x700002AB /end MEASUREMENT
/begin MEASUREMENT ExhMgT_flgCatHeatgColdStrtDmd "Demand for cold start catalyst heating without prioritization by the operaton mode coordinator" UBYTE B_TRUE 1 100 0.00 1.00000000000 BIT_MASK 0x1 FORMAT "%13.11" ECU_ADDRESS 0x70000983 /end MEASUREMENT
/begin MEASUREMENT ExhMgT_flgCatHeatgColdStrtLamSplitReq "request catalyst heating by cold engine because of lambda split" UBYTE B_TRUE 1 100 0.00 1.00000000000 BIT_MASK 0x1 FORMAT "%13.11" ECU_ADDRESS 0x70000982 /end MEASUREMENT
/begin MEASUREMENT ExhMgT_flgCatHeatgColdStrtReq "request catalyst heating by cold engine" UBYTE B_TRUE 1 100 0.00 1.00000000000 BIT_MASK 0x1 FORMAT "%13.11" ECU_ADDRESS 0x70000981 /end MEASUREMENT
/begin MEASUREMENT ExhMgT_flgCatHeatgColdStrtRst "resetting the request for cold start catalyst heating" UBYTE B_TRUE 1 100 0.00 1.00000000000 BIT_MASK 0x1 FORMAT "%13.11" ECU_ADDRESS 0x700002AA /end MEASUREMENT
/begin MEASUREMENT ExhMgT_flgCatHeatgColdStrtWoFIdReq "request for catalyst heating due to cold start without consideration of the Fault Identifier release" UBYTE B_TRUE 1 100 0.00 1.00000000000 BIT_MASK 0x1 FORMAT "%13.11" ECU_ADDRESS 0x70000980 /end MEASUREMENT
/begin MEASUREMENT ExhMgT_flgCatHeatgColdWrmReq "Request for catalyst heating due to a cold start or catalyst warming" UBYTE B_TRUE 1 100 0.00 1.00000000000 BIT_MASK 0x1 FORMAT "%13.11" ECU_ADDRESS 0x7000097F /end MEASUREMENT
/begin MEASUREMENT ExhMgT_flgCatHeatgCsers "" UBYTE B_TRUE 1 100 0.00 1.00000000000 BIT_MASK 0x1 FORMAT "%13.11" ECU_ADDRESS 0x6000F12A /end MEASUREMENT
/begin MEASUREMENT ExhMgT_flgCatHeatgCsersReq "CSERS relevant catalyst heating (request)" UBYTE B_TRUE 1 100 0.00 1.00000000000 BIT_MASK 0x1 FORMAT "%13.11" ECU_ADDRESS 0x6000F129 /end MEASUREMENT
/begin MEASUREMENT ExhMgT_flgCatHeatgDmdCond "Condition for operating mode request cold start catalyst heating based on codeword" UBYTE B_TRUE 1 100 0.00 1.00000000000 BIT_MASK 0x1 FORMAT "%13.11" ECU_ADDRESS 0x7000027F /end MEASUREMENT
/begin MEASUREMENT ExhMgT_flgCatHeatgEolTest "request catalyst heating for end of line test" UBYTE B_TRUE 1 100 0.00 1.00000000000 BIT_MASK 0x1 FORMAT "%13.11" ECU_ADDRESS 0x7000097E /end MEASUREMENT
/begin MEASUREMENT ExhMgT_flgCatHeatgFinshdReq "flag for terminating factor catalyst heating" UBYTE B_TRUE 1 100 0.00 1.00000000000 BIT_MASK 0x1 FORMAT "%13.11" ECU_ADDRESS 0x700002A9 /end MEASUREMENT
/begin MEASUREMENT ExhMgT_flgCatHeatgFirstStrt "request catalyst heating in case of first start of combustion engine" UBYTE B_TRUE 1 100 0.00 1.00000000000 BIT_MASK 0x1 FORMAT "%13.11" ECU_ADDRESS 0x7000097D /end MEASUREMENT
/begin MEASUREMENT ExhMgT_flgCatHeatgFirstStrtFinshd "cold catalyst heating in case of first start of combustion engine regular finished" UBYTE B_TRUE 1 100 0.00 1.00000000000 BIT_MASK 0x1 FORMAT "%13.11" ECU_ADDRESS 0x7000097C /end MEASUREMENT
/begin MEASUREMENT ExhMgT_flgCatHeatgFolwStrt "following starts of combustion engine in the same driving cycle would be interpreted as a follow start for catalyst heating" UBYTE B_TRUE 1 100 0.00 1.00000000000 BIT_MASK 0x1 FORMAT "%13.11" ECU_ADDRESS 0x7000097B /end MEASUREMENT
/begin MEASUREMENT ExhMgT_flgCatHeatgFolwStrtWoStop "Triggering of catalyst heating during the driving cycle using the cold start parameterization without the internal combustion engine has to be switched off" UBYTE B_TRUE 1 100 0.00 1.00000000000 BIT_MASK 0x1 FORMAT "%13.11" ECU_ADDRESS 0x7000097A /end MEASUREMENT
/begin MEASUREMENT ExhMgT_flgCatHeatgGpfRgnReq "request of catalyst heating for Gasoline Particulate Filter regeneration" UBYTE B_TRUE 1 100 0.00 1.00000000000 BIT_MASK 0x1 FORMAT "%13.11" ECU_ADDRESS 0x70000979 /end MEASUREMENT
/begin MEASUREMENT ExhMgT_flgCatHeatgNonCsers "Non CSERS relevant catalyst warming is active" UBYTE B_TRUE 1 100 0.00 1.00000000000 BIT_MASK 0x1 FORMAT "%13.11" ECU_ADDRESS 0x6000F128 /end MEASUREMENT
/begin MEASUREMENT ExhMgT_flgCatHeatgNonCsersReq "Non CSERS relevant catalyst heating (request)" UBYTE B_TRUE 1 100 0.00 1.00000000000 BIT_MASK 0x1 FORMAT "%13.11" ECU_ADDRESS 0x6000F127 /end MEASUREMENT
/begin MEASUREMENT ExhMgT_flgCatHeatgRed "condition for active catalyst heating with cold start parameters (reduced duration of catalyst heating)" UBYTE B_TRUE 1 100 0.00 1.00000000000 BIT_MASK 0x1 FORMAT "%13.11" ECU_ADDRESS 0x70000978 /end MEASUREMENT
/begin MEASUREMENT ExhMgT_flgCatHeatgRepStrt "catalyst heating with cold start parameters in case of a repeated start of combustion engine in the same driving cycle" UBYTE B_TRUE 1 100 0.00 1.00000000000 BIT_MASK 0x1 FORMAT "%13.11" ECU_ADDRESS 0x70000977 /end MEASUREMENT
/begin MEASUREMENT ExhMgT_flgCatHeatgReqActv "request catalyst heating in dependence of the current operation mode" UBYTE B_TRUE 1 100 0.00 1.00000000000 BIT_MASK 0x1 FORMAT "%13.11" ECU_ADDRESS 0x70000976 /end MEASUREMENT
/begin MEASUREMENT ExhMgT_flgCatHeatgReqRstSnd "condition catalyst heating terminating send by CAN" UBYTE B_TRUE 1 100 0.00 1.00000000000 BIT_MASK 0x1 FORMAT "%13.11" ECU_ADDRESS 0x70000975 /end MEASUREMENT
/begin MEASUREMENT ExhMgT_flgCatHeatgTWin2 "Condition for 2nd temperature window for catalyst heating" UBYTE B_TRUE 1 100 0.00 1.00000000000 BIT_MASK 0x1 FORMAT "%13.11" ECU_ADDRESS 0x700002A8 /end MEASUREMENT
/begin MEASUREMENT ExhMgT_flgCatHeatgUpActv "Condition for requesting a catalyst heating measure with running combustion engine" UBYTE B_TRUE 1 100 0.00 1.00000000000 BIT_MASK 0x1 FORMAT "%13.11" ECU_ADDRESS 0x70000974 /end MEASUREMENT
/begin MEASUREMENT ExhMgT_flgCatHeatgWrm "catalyst warming" UBYTE B_TRUE 1 100 0.00 1.00000000000 BIT_MASK 0x1 FORMAT "%13.11" ECU_ADDRESS 0x70000973 /end MEASUREMENT
/begin MEASUREMENT ExhMgT_flgCatHeatgWrmAltiRst "condition catalyst warming is reseted due to hight and engine start temperature" UBYTE B_TRUE 1 100 0.00 1.00000000000 BIT_MASK 0x1 FORMAT "%13.11" ECU_ADDRESS 0x700002A7 /end MEASUREMENT
/begin MEASUREMENT ExhMgT_flgCatHeatgWrmDmd "demand for catalyst heating in case of warming catalyst" UBYTE B_TRUE 1 100 0.00 1.00000000000 BIT_MASK 0x1 FORMAT "%13.11" ECU_ADDRESS 0x70000972 /end MEASUREMENT
/begin MEASUREMENT ExhMgT_flgCatHeatgWrmReq "flag for the request of catalyst warming" UBYTE B_TRUE 1 100 0.00 1.00000000000 BIT_MASK 0x1 FORMAT "%13.11" ECU_ADDRESS 0x70000971 /end MEASUREMENT
/begin MEASUREMENT ExhMgT_flgCatHeatgWrmRst "catalyst heating request with running combustion engine (catalyst warming) based on the catalyst temperature is reset" UBYTE B_TRUE 1 100 0.00 1.00000000000 BIT_MASK 0x1 FORMAT "%13.11" ECU_ADDRESS 0x700002A6 /end MEASUREMENT
/begin MEASUREMENT ExhMgT_flgCatHeatgWrmWoFIdReq "request for catalyst warming without consideration of the FId release" UBYTE B_TRUE 1 100 0.00 1.00000000000 BIT_MASK 0x1 FORMAT "%13.11" ECU_ADDRESS 0x70000970 /end MEASUREMENT
/begin MEASUREMENT ExhMgT_flgCatHeatNormFinshd "cold catalyst heating regular finished" UBYTE B_TRUE 1 100 0.00 1.00000000000 BIT_MASK 0x1 FORMAT "%13.11" ECU_ADDRESS 0x70000986 /end MEASUREMENT
/begin MEASUREMENT ExhMgT_flgCatHeatWrmLamSplitReq "request catalyst warming because of lambda split" UBYTE B_TRUE 1 100 0.00 1.00000000000 BIT_MASK 0x1 FORMAT "%13.11" ECU_ADDRESS 0x70000985 /end MEASUREMENT
/begin MEASUREMENT ExhMgT_flgCatHeatWrmReq "request catalyst heating by catalyst warming" UBYTE B_TRUE 1 100 0.00 1.00000000000 BIT_MASK 0x1 FORMAT "%13.11" ECU_ADDRESS 0x70000984 /end MEASUREMENT
/begin MEASUREMENT ExhMgT_flgCntDenumIdleCsers "set condition for specific denominator for Idle CSERS type" UBYTE B_TRUE 1 100 0.00 1.00000000000 BIT_MASK 0x1 FORMAT "%13.11" ECU_ADDRESS 0x70000298 /end MEASUREMENT
/begin MEASUREMENT ExhMgT_flgCntDenumIdleNonCsers "set condition for specific denominator for cold start strategy (Non-CSERS) during idle" UBYTE B_TRUE 1 100 0.00 1.00000000000 BIT_MASK 0x1 FORMAT "%13.11" ECU_ADDRESS 0x70000297 /end MEASUREMENT
/begin MEASUREMENT ExhMgT_flgCntDenumPartLoadCsers "set condition for specific denominator for part load CSERS type" UBYTE B_TRUE 1 100 0.00 1.00000000000 BIT_MASK 0x1 FORMAT "%13.11" ECU_ADDRESS 0x70000296 /end MEASUREMENT
/begin MEASUREMENT ExhMgT_flgCntDenumPartLoadNonCsers "set condition for specific denominator for part load non CSERS type" UBYTE B_TRUE 1 100 0.00 1.00000000000 BIT_MASK 0x1 FORMAT "%13.11" ECU_ADDRESS 0x70000295 /end MEASUREMENT
/begin MEASUREMENT ExhMgT_flgCntDenumSepPartLoadCsers "set condition for specific denominator for part load CSERS type" UBYTE B_TRUE 1 100 0.00 1.00000000000 BIT_MASK 0x1 FORMAT "%13.11" ECU_ADDRESS 0x70000294 /end MEASUREMENT
/begin MEASUREMENT ExhMgT_flgCntDenumSepPartLoadNonCsers "set condition for specific denominator for part load Non CSERS type" UBYTE B_TRUE 1 100 0.00 1.00000000000 BIT_MASK 0x1 FORMAT "%13.11" ECU_ADDRESS 0x70000293 /end MEASUREMENT
/begin MEASUREMENT ExhMgT_flgColdStrtDmdCond "Condition for operating mode request cold start catalyst heating" UBYTE B_TRUE 1 100 0.00 1.00000000000 BIT_MASK 0x1 FORMAT "%13.11" ECU_ADDRESS 0x7000027E /end MEASUREMENT
/begin MEASUREMENT ExhMgT_flgCptnProtnLimpCamsft "Condition: camshaft in default position" UBYTE B_TRUE 1 100 0.00 1.00000000000 BIT_MASK 0x1 FORMAT "%13.11" ECU_ADDRESS 0x7000096E /end MEASUREMENT
/begin MEASUREMENT ExhMgT_flgDiagCsersIdle "CSERS diagnosis at idle" UBYTE B_TRUE 1 100 0.00 1.00000000000 BIT_MASK 0x1 FORMAT "%13.11" ECU_ADDRESS 0x70000292 /end MEASUREMENT
/begin MEASUREMENT ExhMgT_flgDiagCsersPartLoad "CSERS diagnosis at part load" UBYTE B_TRUE 1 100 0.00 1.00000000000 BIT_MASK 0x1 FORMAT "%13.11" ECU_ADDRESS 0x70000291 /end MEASUREMENT
/begin MEASUREMENT ExhMgT_flgDiagIdlePrms "release of diagnosis in idle" UBYTE B_TRUE 1 100 0.00 1.00000000000 BIT_MASK 0x1 FORMAT "%13.11" ECU_ADDRESS 0x70000290 /end MEASUREMENT
/begin MEASUREMENT ExhMgT_flgDiagPartLoadPrms "release of diagnosis in part load" UBYTE B_TRUE 1 100 0.00 1.00000000000 BIT_MASK 0x1 FORMAT "%13.11" ECU_ADDRESS 0x7000028F /end MEASUREMENT
/begin MEASUREMENT ExhMgT_flgEnaDiagIdleNonCsers "release calculation of engine efficiency deviation for diagnosis of ignition during idle" UBYTE B_TRUE 1 100 0.00 1.00000000000 BIT_MASK 0x1 FORMAT "%13.11" ECU_ADDRESS 0x7000028E /end MEASUREMENT
/begin MEASUREMENT ExhMgT_flgEnaDiagPtlNonCsers "release calculation of engine efficiency deviation for diagnosis of ignition during part load" UBYTE B_TRUE 1 100 0.00 1.00000000000 BIT_MASK 0x1 FORMAT "%13.11" ECU_ADDRESS 0x7000028D /end MEASUREMENT
/begin MEASUREMENT ExhMgT_flgEngStopTCatCoolg "request for cold start catalyst heating during startstop condition" UBYTE B_TRUE 1 100 0.00 1.00000000000 BIT_MASK 0x1 FORMAT "%13.11" ECU_ADDRESS 0x700002A5 /end MEASUREMENT
/begin MEASUREMENT ExhMgT_flgEngStrt "first start of combustion in driving cycle" UBYTE B_TRUE 1 100 0.00 1.00000000000 BIT_MASK 0x1 FORMAT "%13.11" ECU_ADDRESS 0x700002A4 /end MEASUREMENT
/begin MEASUREMENT ExhMgT_flgEpmSpdZr "Condition for catalyst heating engine has stopped" UBYTE B_TRUE 1 100 0.00 1.00000000000 BIT_MASK 0x1 FORMAT "%13.11" ECU_ADDRESS 0x700002A3 /end MEASUREMENT
/begin MEASUREMENT ExhMgT_flgErrCamsft "condition for detected camshaft error" UBYTE B_TRUE 1 100 0.00 1.00000000000 BIT_MASK 0x1 FORMAT "%13.11" ECU_ADDRESS 0x6000EE53 /end MEASUREMENT
/begin MEASUREMENT ExhMgT_flgErreffIdleNonCsers "condition for detected error of ignition timing efficiency diagnosis for catalyst heating during cold start (MAX-Errorpath) during idle at the end of catalyst heating" UBYTE B_TRUE 1 100 0.00 1.00000000000 BIT_MASK 0x1 FORMAT "%13.11" ECU_ADDRESS 0x7000028C /end MEASUREMENT
/begin MEASUREMENT ExhMgT_flgErreffIdleNonCsersCurr "condition for detected error of ignition timing efficiency diagnosis for catalyst heating during cold start (MAX-Errorpath) during idle" UBYTE B_TRUE 1 100 0.00 1.00000000000 BIT_MASK 0x1 FORMAT "%13.11" ECU_ADDRESS 0x7000028B /end MEASUREMENT
/begin MEASUREMENT ExhMgT_flgErreffPtlNonCsers "condition for detected error of ignition timing efficiency diagnosis for catalyst heating during cold start (MAX-Errorpath) during part load at the end of catalyst heating" UBYTE B_TRUE 1 100 0.00 1.00000000000 BIT_MASK 0x1 FORMAT "%13.11" ECU_ADDRESS 0x7000028A /end MEASUREMENT
/begin MEASUREMENT ExhMgT_flgErreffPtlNonCsersCurr "condition for detected error of ignition timing efficiency diagnosis for catalyst heating during cold start (MAX-Errorpath) during part load" UBYTE B_TRUE 1 100 0.00 1.00000000000 BIT_MASK 0x1 FORMAT "%13.11" ECU_ADDRESS 0x70000289 /end MEASUREMENT
/begin MEASUREMENT ExhMgT_flgEtaAbvThdCsersIdle "minimum ignition angle efficiency for error detection in idle Csers exceeded" UBYTE B_TRUE 1 100 0.00 1.00000000000 BIT_MASK 0x1 FORMAT "%13.11" ECU_ADDRESS 0x6000B0D5 /end MEASUREMENT
/begin MEASUREMENT ExhMgT_flgEtaAbvThdCsersPartLoad "minimum ignition angle efficiency for error detection in part load Csers exceeded" UBYTE B_TRUE 1 100 0.00 1.00000000000 BIT_MASK 0x1 FORMAT "%13.11" ECU_ADDRESS 0x6000B0D4 /end MEASUREMENT
/begin MEASUREMENT ExhMgT_flgEtaAbvThdNonCsersIdle "minimum ignition angle efficiency for error detection in idle NonCsers exceeded" UBYTE B_TRUE 1 100 0.00 1.00000000000 BIT_MASK 0x1 FORMAT "%13.11" ECU_ADDRESS 0x6000B0D3 /end MEASUREMENT
/begin MEASUREMENT ExhMgT_flgEtaAbvThdNonCsersPartLoad "minimum ignition angle efficiency for error detection in part load NonCsers exceeded" UBYTE B_TRUE 1 100 0.00 1.00000000000 BIT_MASK 0x1 FORMAT "%13.11" ECU_ADDRESS 0x6000B0D2 /end MEASUREMENT
/begin MEASUREMENT ExhMgT_flgEvlnBlwThdIdle "Deviation of desired ignition angle efficiency in idle below threshold (CSERS)" UBYTE B_TRUE 1 100 0.00 1.00000000000 BIT_MASK 0x1 FORMAT "%13.11" ECU_ADDRESS 0x70000288 /end MEASUREMENT
/begin MEASUREMENT ExhMgT_flgEvlnBlwThdIdleNonCsers "Deviation of desired ignition angle efficiency in idle below threshold (NonCSERS)" UBYTE B_TRUE 1 100 0.00 1.00000000000 BIT_MASK 0x1 FORMAT "%13.11" ECU_ADDRESS 0x70000287 /end MEASUREMENT
/begin MEASUREMENT ExhMgT_flgEvlnBlwThdPartLoad "Deviation of desired ignition angle efficiency in part load below threshold (CSERS)" UBYTE B_TRUE 1 100 0.00 1.00000000000 BIT_MASK 0x1 FORMAT "%13.11" ECU_ADDRESS 0x70000286 /end MEASUREMENT
/begin MEASUREMENT ExhMgT_flgEvlnBlwThdPartLoadNonCsers "Deviation of desired ignition angle efficiency in part load below threshold (NonCSERS)" UBYTE B_TRUE 1 100 0.00 1.00000000000 BIT_MASK 0x1 FORMAT "%13.11" ECU_ADDRESS 0x70000285 /end MEASUREMENT
/begin MEASUREMENT ExhMgT_flgExhActvCptProtnTExh "component protection by exhaust gas temperature model of the manifold activated" UBYTE B_TRUE 1 100 0.00 1.00000000000 BIT_MASK 0x1 FORMAT "%13.11" ECU_ADDRESS 0x6000B0EC /end MEASUREMENT
/begin MEASUREMENT ExhMgT_flgFCMClrEtaCatHeatg "FCM-Clear requested because of diagnosis of engine efficiency during catalyst heating" UBYTE B_TRUE 1 100 0.00 1.00000000000 BIT_MASK 0x1 FORMAT "%13.11" ECU_ADDRESS 0x70000284 /end MEASUREMENT
/begin MEASUREMENT ExhMgT_flgFirstCatHeatg "Condition first catalyst heating in driving cycle" UBYTE B_TRUE 1 100 0.00 1.00000000000 BIT_MASK 0x1 FORMAT "%13.11" ECU_ADDRESS 0x700002A2 /end MEASUREMENT
/begin MEASUREMENT ExhMgT_flgHSPCatHeatg "condition for requirement HSP for catalyst heating" UBYTE B_TRUE 1 100 0.00 1.00000000000 BIT_MASK 0x1 FORMAT "%13.11" ECU_ADDRESS 0x7000027D /end MEASUREMENT
/begin MEASUREMENT ExhMgT_flgIaDeltaCorrn "flag for consideration of the correction of delta ignition angle efficiency" UBYTE B_TRUE 1 100 0.00 1.00000000000 BIT_MASK 0x1 FORMAT "%13.11" ECU_ADDRESS 0x7000096C /end MEASUREMENT
/begin MEASUREMENT ExhMgT_flgIaIgnDeltaCptProtn "Actualization of Delta ignition angle efficiency for component protection" UBYTE B_TRUE 1 100 0.00 1.00000000000 BIT_MASK 0x1 FORMAT "%13.11" ECU_ADDRESS 0x7000096B /end MEASUREMENT
/begin MEASUREMENT ExhMgT_flgIaIgnDeltaLoadCat1 "Component protection by spark retardation activated by the temperature of the catalyst" UBYTE B_TRUE 1 100 0.00 1.00000000000 BIT_MASK 0x1 FORMAT "%13.11" ECU_ADDRESS 0x7000096A /end MEASUREMENT
/begin MEASUREMENT ExhMgT_flgIaIgnDeltaLoadCptProtn "Component protection by spark retardation activated" UBYTE B_TRUE 1 100 0.00 1.00000000000 BIT_MASK 0x1 FORMAT "%13.11" ECU_ADDRESS 0x70000969 /end MEASUREMENT
/begin MEASUREMENT ExhMgT_flgIaIgnDeltaLoadMnf "Component protection by spark retardation activated by the temperature of the manifold" UBYTE B_TRUE 1 100 0.00 1.00000000000 BIT_MASK 0x1 FORMAT "%13.11" ECU_ADDRESS 0x70000968 /end MEASUREMENT
/begin MEASUREMENT ExhMgT_flgIaIng "activation of component protection because of load dynamic" UBYTE B_TRUE 1 100 0.00 1.00000000000 BIT_MASK 0x1 FORMAT "%13.11" ECU_ADDRESS 0x70000967 /end MEASUREMENT
/begin MEASUREMENT ExhMgT_flgLamMegaKnkDetn "Condition for fuel enrichment demand at mega knock detection" UBYTE B_TRUE 1 100 0.00 1.00000000000 BIT_MASK 0x1 FORMAT "%13.11" ECU_ADDRESS 0x7000027A /end MEASUREMENT
/begin MEASUREMENT ExhMgT_flgLimpCptProtn "Limp home of lambda for component protection because of failling of sensors of actors bench 1" UBYTE B_TRUE 1 100 0.00 1.00000000000 BIT_MASK 0x1 FORMAT "%13.11" ECU_ADDRESS 0x6000EE51 /end MEASUREMENT
/begin MEASUREMENT ExhMgT_flgNoCatHeatgDmd "There is no requirement for heating" UBYTE B_TRUE 1 100 0.00 1.00000000000 BIT_MASK 0x1 FORMAT "%13.11" ECU_ADDRESS 0x70000966 /end MEASUREMENT
/begin MEASUREMENT ExhMgT_flgObdCarbCsers26 "Central switch for old or new Carb Csers legislation MY26" UBYTE B_TRUE 1 100 0.00 1.00000000000 BIT_MASK 0x1 FORMAT "%13.11" ECU_ADDRESS 0x6000F126 /end MEASUREMENT
/begin MEASUREMENT ExhMgT_flgOffTemp "Condition for additional distance to critical limits of exhaust temperatures for component protection" UBYTE B_TRUE 1 100 0.00 1.00000000000 BIT_MASK 0x1 FORMAT "%13.11" ECU_ADDRESS 0x6000B0EB /end MEASUREMENT
/begin MEASUREMENT ExhMgT_flgOperModWrmDmdCond "Condition for operating mode request for catalyst warming based on codeword" UBYTE B_TRUE 1 100 0.00 1.00000000000 BIT_MASK 0x1 FORMAT "%13.11" ECU_ADDRESS 0x7000027C /end MEASUREMENT
/begin MEASUREMENT ExhMgT_flgOverTCat1Max "temperature of the catalyst 1 is higher as initial threshold" UBYTE B_TRUE 1 100 0.00 1.00000000000 BIT_MASK 0x1 FORMAT "%13.11" ECU_ADDRESS 0x6000B0EA /end MEASUREMENT
/begin MEASUREMENT ExhMgT_flgOverTCat2Max "temperature of the catalyst 2 is higher as initial threshold" UBYTE B_TRUE 1 100 0.00 1.00000000000 BIT_MASK 0x1 FORMAT "%13.11" ECU_ADDRESS 0x6000B0E9 /end MEASUREMENT
/begin MEASUREMENT ExhMgT_flgOverTMnflMax "temperature of the manifold is higher as initial threshold" UBYTE B_TRUE 1 100 0.00 1.00000000000 BIT_MASK 0x1 FORMAT "%13.11" ECU_ADDRESS 0x6000B0E8 /end MEASUREMENT
/begin MEASUREMENT ExhMgT_flgRdcAirFillg "activation of the limitation of the rich lambda for component protection" UBYTE B_TRUE 1 100 0.00 1.00000000000 BIT_MASK 0x1 FORMAT "%13.11" ECU_ADDRESS 0x70000279 /end MEASUREMENT
/begin MEASUREMENT ExhMgT_flgRelsIaThdIdle "Release of idle diagnosis based on desired ignition angle efficiency threshold" UBYTE B_TRUE 1 100 0.00 1.00000000000 BIT_MASK 0x1 FORMAT "%13.11" ECU_ADDRESS 0x70000283 /end MEASUREMENT
/begin MEASUREMENT ExhMgT_flgRelsIaThdPartLoad "Release of part load diagnosis based on desired ignition angle efficiency threshold" UBYTE B_TRUE 1 100 0.00 1.00000000000 BIT_MASK 0x1 FORMAT "%13.11" ECU_ADDRESS 0x70000282 /end MEASUREMENT
/begin MEASUREMENT ExhMgT_flgReqHosThd "condition for request of GDI mode HOS throttled" UBYTE B_TRUE 1 100 0.00 1.00000000000 BIT_MASK 0x1 FORMAT "%13.11" ECU_ADDRESS 0x70000962 /end MEASUREMENT
/begin MEASUREMENT ExhMgT_flgReqLamSplitTMin "Condition for the reduction of the efficiency degradation due to the temperature reached in the catalyst for requesting Lambda Split" UBYTE B_TRUE 1 100 0.00 1.00000000000 BIT_MASK 0x1 FORMAT "%13.11" ECU_ADDRESS 0x70000961 /end MEASUREMENT
/begin MEASUREMENT ExhMgT_flgRstFacRdcAirFillg "Reset of the reduction factor for maximum air charge component protection" UBYTE B_TRUE 1 100 0.00 1.00000000000 BIT_MASK 0x1 FORMAT "%13.11" ECU_ADDRESS 0x70000278 /end MEASUREMENT
/begin MEASUREMENT ExhMgT_flgSpclLft "Outlet or Intake valve lift for charge determination not equals standard lift" UBYTE B_TRUE 1 100 0.00 1.00000000000 BIT_MASK 0x1 FORMAT "%13.11" ECU_ADDRESS 0x70000277 /end MEASUREMENT
/begin MEASUREMENT ExhMgT_flgStCatHeatgOldUpd "Old state of catalyst heating can be updated" UBYTE B_TRUE 1 100 0.00 1.00000000000 BIT_MASK 0x1 FORMAT "%13.11" ECU_ADDRESS 0x700002A1 /end MEASUREMENT
/begin MEASUREMENT ExhMgT_flgStTMdlIninCat1 "Status of the temperature model intialisation of Catalyst 1" UBYTE B_TRUE 1 100 0.00 1.00000000000 BIT_MASK 0x1 FORMAT "%13.11" ECU_ADDRESS 0x6000B0DD /end MEASUREMENT
/begin MEASUREMENT ExhMgT_flgStTMdlIninCat2 "Status of the temperature model intialisation of Catalyst 2" UBYTE B_TRUE 1 100 0.00 1.00000000000 BIT_MASK 0x1 FORMAT "%13.11" ECU_ADDRESS 0x6000B0DC /end MEASUREMENT
/begin MEASUREMENT ExhMgT_flgTBlwLowrThd2HiPrio "Catalyst temperature of the higher priority catalyst is lower than the light off temperature threshold2" UBYTE B_TRUE 1 100 0.00 1.00000000000 BIT_MASK 0x1 FORMAT "%13.11" ECU_ADDRESS 0x700002A0 /end MEASUREMENT
/begin MEASUREMENT ExhMgT_flgTBlwLowrThdHiPrio "Catalyst temperature of the higher priority catalyst is lower than the light off temperature threshold" UBYTE B_TRUE 1 100 0.00 1.00000000000 BIT_MASK 0x1 FORMAT "%13.11" ECU_ADDRESS 0x7000029F /end MEASUREMENT
/begin MEASUREMENT ExhMgT_flgtExhMnfMaxB1 "activation of ramping down of the dynamic manifold threshold" UBYTE B_TRUE 1 100 0.00 1.00000000000 BIT_MASK 0x1 FORMAT "%13.11" ECU_ADDRESS 0x6000B0E7 /end MEASUREMENT
/begin MEASUREMENT ExhMgT_flgThdCatLo "activation of component protection related to the catalyst temperature based on the system value" UBYTE B_TRUE 1 100 0.00 1.00000000000 BIT_MASK 0x1 FORMAT "%13.11" ECU_ADDRESS 0x6000B0E6 /end MEASUREMENT
/begin MEASUREMENT ExhMgT_flgThdExhLo "activation of component protection related to the gas temperature based on the system value" UBYTE B_TRUE 1 100 0.00 1.00000000000 BIT_MASK 0x1 FORMAT "%13.11" ECU_ADDRESS 0x6000B0E5 /end MEASUREMENT
/begin MEASUREMENT ExhMgT_flgTiCdnDynThd "activation of ramping down of the dynamic manifold threshold related to the time" UBYTE B_TRUE 1 100 0.00 1.00000000000 BIT_MASK 0x1 FORMAT "%13.11" ECU_ADDRESS 0x6000B0E4 /end MEASUREMENT
/begin MEASUREMENT ExhMgT_flgTiCdnDynThdRst "Reset of of ramping down of the dynamic manifold threshold related to the time" UBYTE B_TRUE 1 100 0.00 1.00000000000 BIT_MASK 0x1 FORMAT "%13.11" ECU_ADDRESS 0x6000B0E3 /end MEASUREMENT
/begin MEASUREMENT ExhMgT_flgTiCdnDynThdSet "Aktivierung des Abrampens der dynamischen Krümmertemperaturschwelle bezogen auf Zeitfaktor" UBYTE B_TRUE 1 100 0.00 1.00000000000 BIT_MASK 0x1 FORMAT "%13.11" ECU_ADDRESS 0x6000B0E2 /end MEASUREMENT
/begin MEASUREMENT ExhMgT_flgTiOverMaxCat1 "duration of the exceedance of the initial threshold catalyst 1 is finished" UBYTE B_TRUE 1 100 0.00 1.00000000000 BIT_MASK 0x1 FORMAT "%13.11" ECU_ADDRESS 0x6000B0E1 /end MEASUREMENT
/begin MEASUREMENT ExhMgT_flgTiOverMaxCat2 "duration of the exceedance of the initial threshold catalyst 2 is finished" UBYTE B_TRUE 1 100 0.00 1.00000000000 BIT_MASK 0x1 FORMAT "%13.11" ECU_ADDRESS 0x6000B0E0 /end MEASUREMENT
/begin MEASUREMENT ExhMgT_flgTLightOffOnceRea "Condition light off temperature at least once reached" UBYTE B_TRUE 1 100 0.00 1.00000000000 BIT_MASK 0x1 FORMAT "%13.11" ECU_ADDRESS 0x7000029E /end MEASUREMENT
/begin MEASUREMENT ExhMgT_flgTstdeffIdleNonCsers "condition for OK Status of ignition timing efficiency diagnosis for catalyst heating during cold start (MAX-Errorpath) during idle" UBYTE B_TRUE 1 100 0.00 1.00000000000 BIT_MASK 0x1 FORMAT "%13.11" ECU_ADDRESS 0x70000281 /end MEASUREMENT
/begin MEASUREMENT ExhMgT_flgTstdeffPtlNonCsers "condition for OK Status of ignition timing efficiency diagnosis for catalyst heating during cold start (MAX-Errorpath) during part load" UBYTE B_TRUE 1 100 0.00 1.00000000000 BIT_MASK 0x1 FORMAT "%13.11" ECU_ADDRESS 0x70000280 /end MEASUREMENT
/begin MEASUREMENT ExhMgT_flgTUpprThd2HiPrio "Catalyst temperature of the higher priority catalyst is greater than the setpoint2 plus the hysteresis threshold" UBYTE B_TRUE 1 100 0.00 1.00000000000 BIT_MASK 0x1 FORMAT "%13.11" ECU_ADDRESS 0x7000029D /end MEASUREMENT
/begin MEASUREMENT ExhMgT_flgTUpprThdHiPrio "Catalyst temperature of the higher priority catalyst is greater than the setpoint plus the hysteresis threshold" UBYTE B_TRUE 1 100 0.00 1.00000000000 BIT_MASK 0x1 FORMAT "%13.11" ECU_ADDRESS 0x7000029C /end MEASUREMENT
/begin MEASUREMENT ExhMgT_flgTUpprThdLoPrio "Catalyst temperature of the lower priority catalyst is greater than the setpoint plus the hysteresis threshold" UBYTE B_TRUE 1 100 0.00 1.00000000000 BIT_MASK 0x1 FORMAT "%13.11" ECU_ADDRESS 0x7000029B /end MEASUREMENT
/begin MEASUREMENT ExhMgT_flgTWallActvnCptProtn "condition of activation of component protection in dependence of wall temperature inside of exhaust system" UBYTE B_TRUE 1 100 0.00 1.00000000000 BIT_MASK 0x1 FORMAT "%13.11" ECU_ADDRESS 0x6000EE4E /end MEASUREMENT
/begin MEASUREMENT ExhMgT_flgWrmDmdCond "Condition for operating mode request catalyst warming" UBYTE B_TRUE 1 100 0.00 1.00000000000 BIT_MASK 0x1 FORMAT "%13.11" ECU_ADDRESS 0x7000027B /end MEASUREMENT
/begin MEASUREMENT ExhMgT_IaCptProtn "primary ignition angle component protection" SWORD zw_q2p9297Em3_deg_KW 1 100 -96.00000 95.99707 FORMAT "%8.5" ECU_ADDRESS 0x60009154 /end MEASUREMENT
/begin MEASUREMENT ExhMgT_iaDeltaCptProtn "Delta ignition angle efficiency for component protection" UWORD fak_uw_b2 1 100 0.00 1.999969 FORMAT "%8.6" ECU_ADDRESS 0x60008C44 /end MEASUREMENT
/begin MEASUREMENT ExhMgT_iaDeltaCptProtnCorr "Breakpoint distribution component protection over delta efficiency of spark timing" UWORD fak_uw_b2 1 100 0.00 1.999969 FORMAT "%8.6" ECU_ADDRESS 0x600086FA /end MEASUREMENT
/begin MEASUREMENT ExhMgT_nCatHeatgOperMod "engine speed for catalyst heating because of a request for catalyst warming with lambda split or because of regeneration" UWORD EngN 1 100 0.00 16383.50 FORMAT "%8.2" ECU_ADDRESS 0x60006FD6 /end MEASUREMENT
/begin MEASUREMENT ExhMgT_nEngDiffDiagCsers "difference of currect and filtered engine speed" SWORD EngN 1 100 -16384.00 16383.50 FORMAT "%8.2" ECU_ADDRESS 0x60006FE8 /end MEASUREMENT
/begin MEASUREMENT ExhMgT_nEngFildDiagCsers "filtered engine speed for release of CSERS diagnosis" UWORD EngN 1 100 0.00 16383.50 FORMAT "%8.2" ECU_ADDRESS 0x60006FE6 /end MEASUREMENT
/begin MEASUREMENT ExhMgT_nrColdStrt "number of engine starts" UBYTE dez 1 100 0.00 255.0 FORMAT "%5.1" ECU_ADDRESS 0x6000B0DF /end MEASUREMENT
/begin MEASUREMENT ExhMgT_numCatHeatg "number catalyst heating in case of a first start of combustion chamber" UBYTE dez 1 100 0.00 255.0 FORMAT "%5.1" ECU_ADDRESS 0x6000EF9A /end MEASUREMENT
/begin MEASUREMENT ExhMgT_ratCatHeatgOperMod "air charge for catalyst heating because of a request for catalyst warming with lambda split or caused by regeneration" UWORD rel_q0p0234 1 100 0.00 1535.977 FORMAT "%8.3" ECU_ADDRESS 0x60006FD4 /end MEASUREMENT
/begin MEASUREMENT ExhMgT_ratChrgAirDiffDiagCsers "difference of currect and filtered air charge" SWORD rel_uw_q0p0234 1 100 -768.0000 767.9766 FORMAT "%8.4" ECU_ADDRESS 0x60006FE4 /end MEASUREMENT
/begin MEASUREMENT ExhMgT_ratChrgAirFildDiagCsers "filtered air charge for release of CSERS diagnosis" UWORD rel_uw_q0p0234 1 100 0.00 1535.977 FORMAT "%8.3" ECU_ADDRESS 0x60006FE2 /end MEASUREMENT
/begin MEASUREMENT ExhMgT_ratDeltaLamCptProtn "Delta lambda component protection due to ignition angle, speed, gear information, motor temperature, intake air temperature, the soot mass, and the ash mass in a particulate filter" SWORD fak_sw_b8 1 100 -8.000000 7.999756 FORMAT "%8.6" ECU_ADDRESS 0x60006FC2 /end MEASUREMENT
/begin MEASUREMENT ExhMgT_ratDeltaLamCptProtnIgn "Delta-lambda for component protection due to ignition retardation compared with basic ignition timing" SWORD fak_sw_b8 1 100 -8.000000 7.999756 FORMAT "%8.6" ECU_ADDRESS 0x60006FC0 /end MEASUREMENT
/begin MEASUREMENT ExhMgT_ratDeltaLamCptProtnTot1 "Delta Lambda component protection due to ignition angle, speed, gear information, motor temperature, and an error of a relevant input variable (Bank 1)" SWORD fak_sw_b8 1 100 -8.000000 7.999756 FORMAT "%8.6" ECU_ADDRESS 0x60008980 /end MEASUREMENT
/begin MEASUREMENT ExhMgT_ratDeltaLamLimp "additional enrichment for component protection in case of a not valid entry value" SWORD fak_sw_b8 1 100 -8.000000 7.999756 FORMAT "%8.6" ECU_ADDRESS 0x6000897C /end MEASUREMENT
/begin MEASUREMENT ExhMgT_rateffEngIdleNonCsersMax "minimum distance to error threshold (MAX-Errorpath) inside idle (during life cycle)" UBYTE rel_q0p78125 1 100 0.00 199.2 FORMAT "%5.1" ECU_ADDRESS 0x6000F43D /end MEASUREMENT
/begin MEASUREMENT ExhMgT_rateffEngIdleNonCsersMaxLoc "minimum distance to error threshold (MAX-Errorpath) inside idle (during life cycle)" UBYTE rel_q0p78125 1 100 0.00 199.2 FORMAT "%5.1" ECU_ADDRESS 0x6003908B /end MEASUREMENT
/begin MEASUREMENT ExhMgT_rateffEngPtlNonCsersMax "minimum distance to error threshold (MAX-Errorpath) outside idle (during life cycle)" UBYTE rel_q0p78125 1 100 0.00 199.2 FORMAT "%5.1" ECU_ADDRESS 0x6000F43C /end MEASUREMENT
/begin MEASUREMENT ExhMgT_rateffEngPtlNonCsersMaxLoc "minimum distance to error threshold (MAX-Errorpath) outside idle (during life cycle)" UBYTE rel_q0p78125 1 100 0.00 199.2 FORMAT "%5.1" ECU_ADDRESS 0x6003908A /end MEASUREMENT
/begin MEASUREMENT ExhMgT_ratEngLoadDmdOperMod "relative engine load for catalyst heating" UWORD rel_q0p0234 1 100 0.00 1535.977 FORMAT "%8.3" ECU_ADDRESS 0x60006FD2 /end MEASUREMENT
/begin MEASUREMENT ExhMgT_ratFuMSeln "Relative fuel mass" UWORD rel_uw_b3072 1 100 0.00 3071.953 FORMAT "%8.3" ECU_ADDRESS 0x60006FD0 /end MEASUREMENT
/begin MEASUREMENT ExhMgT_ratLamAgKnkCtrl "enrichment by component protection because of current operation point and average ignition retarding by knock control" UWORD fak_uw_b16 1 100 0.00 1.000000 FORMAT "%8.6" ECU_ADDRESS 0x60006FBE /end MEASUREMENT
/begin MEASUREMENT ExhMgT_ratLamCptProtnIgn "Lambda for component protection because of incomplete combustion due to redarded ignition timing" UWORD fak_uw_b16 1 100 0.00 15.99976 FORMAT "%8.5" ECU_ADDRESS 0x60006FBC /end MEASUREMENT
/begin MEASUREMENT ExhMgT_ratLamMinCptProtnB1 "minimum lambda for component protection bank 1" UWORD fak_uw_b16 1 100 0.00 15.99976 FORMAT "%8.5" ECU_ADDRESS 0x60006FAE /end MEASUREMENT
/begin MEASUREMENT ExhMgT_ratLamPreIgnCtlCptProtn "korrigierte vorgesteuerte Lambda, das mit dem temperaturabhängigen Interpolationsfaktor angepasst wurde" UWORD fak_uw_b16 1 100 0.500000 2.000000 FORMAT "%8.6" ECU_ADDRESS 0x600086F4 /end MEASUREMENT
/begin MEASUREMENT ExhMgT_stCatHeatg "catalyst heating status" UBYTE dez 1 100 0.00 1.000 FORMAT "%5.3" ECU_ADDRESS 0x6000B0DB /end MEASUREMENT
/begin MEASUREMENT ExhMgT_stCatHeatgMode "catalyst heating mode" UBYTE dez 1 100 0.00 3.000 FORMAT "%5.3" ECU_ADDRESS 0x6000EF99 /end MEASUREMENT
/begin MEASUREMENT ExhMgT_stCatHeatgReqOld "Old state of catalyst heating request" UBYTE dez 1 100 0.00 1.000 FORMAT "%5.3" ECU_ADDRESS 0x6000B0DA /end MEASUREMENT
/begin MEASUREMENT ExhMgT_stEquPrioCat "Catalysts have the same priority with regard to heating" UBYTE dez 1 100 0.00 1.000 FORMAT "%5.3" ECU_ADDRESS 0x6000B0D9 /end MEASUREMENT
/begin MEASUREMENT ExhMgT_stIdleDetnCptProtn "idle speed condition status from component protection" UBYTE B_TRUE 1 100 0.00 1.00000000000 BIT_MASK 0x1 FORMAT "%13.11" ECU_ADDRESS 0x6000B0CE /end MEASUREMENT
/begin MEASUREMENT ExhMgT_stOperModDmd "request of an operation state of the power train to the hybrid coordinator" UWORD dez 1 100 0.00 65535.00 FORMAT "%8.2" ECU_ADDRESS 0x600086F2 /end MEASUREMENT
/begin MEASUREMENT ExhMgT_stOperModStgCatWrm "engine operation state for catalyst heating because of a request for catalyst warming" UWORD OneToOne 1 100 0.00 65535.00 FORMAT "%8.2" ECU_ADDRESS 0x60006FCE /end MEASUREMENT
/begin MEASUREMENT ExhMgT_stStgCatHeatgEomMod1_M.idxDistbnXOld "map for stage of request operation mode for catalyst heating formode 1 (desired) / Old X-Axis-position-index of the Two-D Hystereses-Look-Up-Table (Uint16)" UBYTE OneToOne 1 100 0.00 255.0 FORMAT "%5.1" ECU_ADDRESS 0x70002EC8 /end MEASUREMENT
/begin MEASUREMENT ExhMgT_stStgCatHeatgEomMod1_M.idxDistbnYOld "map for stage of request operation mode for catalyst heating formode 1 (desired) / Old Y-Axis-position-index of the Two-D Hystereses-Look-Up-Table (Uint16)" UBYTE OneToOne 1 100 0.00 255.0 FORMAT "%5.1" ECU_ADDRESS 0x70002EC9 /end MEASUREMENT
/begin MEASUREMENT ExhMgT_stStgCatHeatgEomMod2_M.idxDistbnXOld "map for stage of request operation mode for catalyst heating formode 2 (desired) / Old X-Axis-position-index of the Two-D Hystereses-Look-Up-Table (Uint16)" UBYTE OneToOne 1 100 0.00 255.0 FORMAT "%5.1" ECU_ADDRESS 0x70002EC6 /end MEASUREMENT
/begin MEASUREMENT ExhMgT_stStgCatHeatgEomMod2_M.idxDistbnYOld "map for stage of request operation mode for catalyst heating formode 2 (desired) / Old Y-Axis-position-index of the Two-D Hystereses-Look-Up-Table (Uint16)" UBYTE OneToOne 1 100 0.00 255.0 FORMAT "%5.1" ECU_ADDRESS 0x70002EC7 /end MEASUREMENT
/begin MEASUREMENT ExhMgT_stStgCatHeatgEomMod3_M.idxDistbnXOld "map for stage of request operation mode for catalyst heating formode 3 (desired) / Old X-Axis-position-index of the Two-D Hystereses-Look-Up-Table (Uint16)" UBYTE OneToOne 1 100 0.00 255.0 FORMAT "%5.1" ECU_ADDRESS 0x70002EC4 /end MEASUREMENT
/begin MEASUREMENT ExhMgT_stStgCatHeatgEomMod3_M.idxDistbnYOld "map for stage of request operation mode for catalyst heating formode 3 (desired) / Old Y-Axis-position-index of the Two-D Hystereses-Look-Up-Table (Uint16)" UBYTE OneToOne 1 100 0.00 255.0 FORMAT "%5.1" ECU_ADDRESS 0x70002EC5 /end MEASUREMENT
/begin MEASUREMENT ExhMgT_stStgCatHeatgEomMod4_M.idxDistbnXOld "map for stage of request operation mode for catalyst heating formode 4 (desired) / Old X-Axis-position-index of the Two-D Hystereses-Look-Up-Table (Uint16)" UBYTE OneToOne 1 100 0.00 255.0 FORMAT "%5.1" ECU_ADDRESS 0x70002EC2 /end MEASUREMENT
/begin MEASUREMENT ExhMgT_stStgCatHeatgEomMod4_M.idxDistbnYOld "map for stage of request operation mode for catalyst heating formode 4 (desired) / Old Y-Axis-position-index of the Two-D Hystereses-Look-Up-Table (Uint16)" UBYTE OneToOne 1 100 0.00 255.0 FORMAT "%5.1" ECU_ADDRESS 0x70002EC3 /end MEASUREMENT
/begin MEASUREMENT ExhMgT_stTHiPrioCat "catalyst heating status of catalyst with higher priority" UBYTE dez 1 100 0.00 2.000 FORMAT "%5.3" ECU_ADDRESS 0x6000B0D8 /end MEASUREMENT
/begin MEASUREMENT ExhMgT_stTLoPrioCat "catalyst heating status of catalyst with lower priority" UBYTE dez 1 100 0.00 2.000 FORMAT "%5.3" ECU_ADDRESS 0x6000B0D7 /end MEASUREMENT
/begin MEASUREMENT ExhMgT_tCat1B1 "Temperature in catalyst 1 Bank 1" SWORD temp_q0p1_o273 1 100 -3549.940 3003.560 FORMAT "%8.3" ECU_ADDRESS 0x60008978 /end MEASUREMENT
/begin MEASUREMENT ExhMgT_tCat1B1Min "Minimum temperature catalyst 1 bank 1" SWORD Temp_Cels 1 100 -3549.940 3003.560 FORMAT "%8.3" ECU_ADDRESS 0x60008976 /end MEASUREMENT
/begin MEASUREMENT ExhMgT_tCat1CptProtnMax "maximal allowed temperature inside catalyst 1 for component protection" SWORD temp_q0p1_o273 1 100 -3549.940 3003.560 FORMAT "%8.3" ECU_ADDRESS 0x60008974 /end MEASUREMENT
/begin MEASUREMENT ExhMgT_tCat1MaxB1 "maximum temperature inside catalyst 1 for component protection bench 1" SWORD temp_q0p1_o273 1 100 -3549.940 3003.560 FORMAT "%8.3" ECU_ADDRESS 0x6000896E /end MEASUREMENT
/begin MEASUREMENT ExhMgT_tCat1MaxCptProtnMax "maximal allowed maximum temperature inside catalyst 1 for component protection" SWORD temp_q0p1_o273 1 100 -3549.940 3003.560 FORMAT "%8.3" ECU_ADDRESS 0x6000706E /end MEASUREMENT
/begin MEASUREMENT ExhMgT_tCat1MaxCptProtnMaxThd "maximal allowed maximum temperature inside catalyst 1 for component protection" SWORD temp_q0p1_o273 1 100 -3549.940 3003.560 FORMAT "%8.3" ECU_ADDRESS 0x6000896C /end MEASUREMENT
/begin MEASUREMENT ExhMgT_tCat1Min "minimum temperature inside of first upstream catalyst (max.choice between bank1 and bank2)" SWORD Temp_Cels 1 100 -3549.940 3003.560 FORMAT "%8.3" ECU_ADDRESS 0x60013EEC /end MEASUREMENT
/begin MEASUREMENT ExhMgT_tCat1Seln1 "selected catalyst temperature catalyst 1 for controlling the heating measures (first selection)" SWORD Temp_Cels 1 100 -3549.940 3003.560 FORMAT "%8.3" ECU_ADDRESS 0x60008966 /end MEASUREMENT
/begin MEASUREMENT ExhMgT_tCat1Seln1B1 "selection1 catalyst temperature cat1 in the dependence of the catalyst heating requirement" SWORD Temp_Cels 1 100 -3549.940 3003.560 FORMAT "%8.3" ECU_ADDRESS 0x60008964 /end MEASUREMENT
/begin MEASUREMENT ExhMgT_tCat1Seln2 "selected catalyst temperature catalyst 1 for controlling the heating measures (second selection)" SWORD Temp_Cels 1 100 -3549.940 3003.560 FORMAT "%8.3" ECU_ADDRESS 0x60008962 /end MEASUREMENT
/begin MEASUREMENT ExhMgT_tCat1SelnStrt "selected catalyst temperature in the dependence of a catalyst heating requirement is triggered" SWORD Temp_Cels 1 100 -3549.940 3003.560 FORMAT "%8.3" ECU_ADDRESS 0x60008960 /end MEASUREMENT
/begin MEASUREMENT ExhMgT_tCat2B1Min "Minimum temperature catalyst 2 bank 1" SWORD Temp_Cels 1 100 -3549.940 3003.560 FORMAT "%8.3" ECU_ADDRESS 0x6000895C /end MEASUREMENT
/begin MEASUREMENT ExhMgT_tCat2CptProtnMax "maximal allowed temperature inside catalyst 2 for component protection" SWORD temp_q0p1_o273 1 100 -3549.940 3003.560 FORMAT "%8.3" ECU_ADDRESS 0x6000706C /end MEASUREMENT
/begin MEASUREMENT ExhMgT_tCat2MaxB1 "maximum temperature inside catalyst 2 for component protection bench 1" SWORD temp_q0p1_o273 1 100 -3549.940 3003.560 FORMAT "%8.3" ECU_ADDRESS 0x6000706A /end MEASUREMENT
/begin MEASUREMENT ExhMgT_tCat2MaxMaxThd "maximal allowed maximum temperature inside catalyst 2 for component protection" SWORD temp_q0p1_o273 1 100 -3549.940 3003.560 FORMAT "%8.3" ECU_ADDRESS 0x60007068 /end MEASUREMENT
/begin MEASUREMENT ExhMgT_tCat2Seln1 "selected catalyst temperature catalyst 2 for controlling the heating measures (first selection)" SWORD Temp_Cels 1 100 -3549.940 3003.560 FORMAT "%8.3" ECU_ADDRESS 0x60008952 /end MEASUREMENT
/begin MEASUREMENT ExhMgT_tCat2Seln1B1 "selection1 catalyst temperature cat2 in the dependence of the catalyst heating requirement" SWORD Temp_Cels 1 100 -3549.940 3003.560 FORMAT "%8.3" ECU_ADDRESS 0x60008950 /end MEASUREMENT
/begin MEASUREMENT ExhMgT_tCat2Seln2 "selected catalyst temperature catalyst 2 for controlling the heating measures (second selection)" SWORD Temp_Cels 1 100 -3549.940 3003.560 FORMAT "%8.3" ECU_ADDRESS 0x6000894E /end MEASUREMENT
/begin MEASUREMENT ExhMgT_tCatColdStrt "catalyst temperature for release of catalyst heating in case of a first start" SWORD Temp_Cels 1 100 -3549.940 3003.560 FORMAT "%8.3" ECU_ADDRESS 0x6000894C /end MEASUREMENT
/begin MEASUREMENT ExhMgT_tCatHeatgTCatSelnActn "Catalyst temperature in the dependence of the heating measures are controlled" SWORD temp_q0p1_K 1 100 -3276.800 3276.700 FORMAT "%8.3" ECU_ADDRESS 0x6000894A /end MEASUREMENT
/begin MEASUREMENT ExhMgT_tCatHeatgWrmThd "threshold of catalyst temperature due to of catalyst warming from which the heating request is reset" SWORD Temp_Cels 1 100 -3549.940 3003.560 FORMAT "%8.3" ECU_ADDRESS 0x60008948 /end MEASUREMENT
/begin MEASUREMENT ExhMgT_tCatHiPrioEngRunStop "Catalyst temperature in dependence of the heating measure during start stop condition" SWORD Temp_Cels 1 100 -3549.940 3003.560 FORMAT "%8.3" ECU_ADDRESS 0x60007036 /end MEASUREMENT
/begin MEASUREMENT ExhMgT_tCatHiPrioSeln1 "selection of catalyst temperature of the high prio catalyst" SWORD Temp_Cels 1 100 -3549.940 3003.560 FORMAT "%8.3" ECU_ADDRESS 0x60007034 /end MEASUREMENT
/begin MEASUREMENT ExhMgT_tCatLoPrioSeln1 "selection of catalyst temperature of the low prio catalyst" SWORD Temp_Cels 1 100 -3549.940 3003.560 FORMAT "%8.3" ECU_ADDRESS 0x60007032 /end MEASUREMENT
/begin MEASUREMENT ExhMgT_tCatThdMin "minimum catalyst threshold component protection" SWORD temp_q0p1_o273 1 100 -3549.940 3003.560 FORMAT "%8.3" ECU_ADDRESS 0x60007066 /end MEASUREMENT
/begin MEASUREMENT ExhMgT_tDeltaEngStopCatCoolg "Temperature difference of cat temperatrue while cooling at engine stop" SWORD temp_q0p1_K 1 100 -3276.800 3276.700 FORMAT "%8.3" ECU_ADDRESS 0x60007030 /end MEASUREMENT
/begin MEASUREMENT ExhMgT_tDesCat1 "Desired temperature for catalyst 1" SWORD Temp_Cels 1 100 -3549.940 3003.560 FORMAT "%8.3" ECU_ADDRESS 0x60008946 /end MEASUREMENT
/begin MEASUREMENT ExhMgT_tDesCat2 "Desired temperature for catalyst 2" SWORD Temp_Cels 1 100 -3549.940 3003.560 FORMAT "%8.3" ECU_ADDRESS 0x60008944 /end MEASUREMENT
/begin MEASUREMENT ExhMgT_tDesMinCatHiPrio "minimum desired catalyst temperature of the high prio catalyst" SWORD Temp_Cels 1 100 -3549.940 3003.560 FORMAT "%8.3" ECU_ADDRESS 0x6000702E /end MEASUREMENT
/begin MEASUREMENT ExhMgT_tDesMinCatLoPrio "minimum desired catalyst temperature of the low prio catalyst" SWORD Temp_Cels 1 100 -3549.940 3003.560 FORMAT "%8.3" ECU_ADDRESS 0x6000702C /end MEASUREMENT
/begin MEASUREMENT ExhMgT_tDifCat1B1 "Distance to critical temperature threshold for catalyst 1 bank 1" SWORD temp_q0p1_K 1 100 -3276.800 3276.700 FORMAT "%8.3" ECU_ADDRESS 0x60008942 /end MEASUREMENT
/begin MEASUREMENT ExhMgT_tDifCat1MaxB1 "Distance of the maximum temperature of cat 1 to maximum allowed temperature threshold for catalyst 1 Bank 1" SWORD temp_q0p1_K 1 100 -3276.800 3276.700 FORMAT "%8.3" ECU_ADDRESS 0x60008940 /end MEASUREMENT
/begin MEASUREMENT ExhMgT_tDifCatHeatgDmd "Temperature difference catalyst between upper temperature threshold and acutal temperature for catalyst heating demand" SWORD temp_q0p1_K 1 100 -3276.800 3276.700 FORMAT "%8.3" ECU_ADDRESS 0x6000702A /end MEASUREMENT
/begin MEASUREMENT ExhMgT_tDifCatHiPrioCatStrt "Difference between the set point of the catalyst temperature and the catalyst temperature at the start of catalyst heating" SWORD temp_q0p1_K 1 100 -3276.800 3276.700 FORMAT "%8.3" ECU_ADDRESS 0x60007028 /end MEASUREMENT
/begin MEASUREMENT ExhMgT_tDifCatSelnCatStrt "Difference between the current catalyst temperature and the catalyst temperature at the start of catalyst heating" SWORD temp_q0p1_K 1 100 -3276.800 3276.700 FORMAT "%8.3" ECU_ADDRESS 0x60007026 /end MEASUREMENT
/begin MEASUREMENT ExhMgT_tDifCatThd "temperature value for activation of component protection related to the catalyst temperature based on the system value" SWORD temp_q0p1_o273 1 100 -3549.940 3003.560 FORMAT "%8.3" ECU_ADDRESS 0x60007064 /end MEASUREMENT
/begin MEASUREMENT ExhMgT_tDifExhMnfB1 "Distance to the maximum allowed temeprature threshold for exhaust manifold Bank 1" SWORD temp_q0p1_K 1 100 -3276.800 3276.700 FORMAT "%8.3" ECU_ADDRESS 0x6000893E /end MEASUREMENT
/begin MEASUREMENT ExhMgT_tDifExhThd "temperature value for activation of component protection related to the gas temperature based on the system value" SWORD temp_q0p1_o273 1 100 -3549.940 3003.560 FORMAT "%8.3" ECU_ADDRESS 0x60007062 /end MEASUREMENT
/begin MEASUREMENT ExhMgT_tDiffTCatHeatgFolwStrt "temperature difference between the current catalyst temperature and the temperature threshold for request of catalyst heating cold start parameters (no first start)" SWORD temp_q0p1_K 1 100 -3276.800 3276.700 FORMAT "%8.3" ECU_ADDRESS 0x6000893C /end MEASUREMENT
/begin MEASUREMENT ExhMgT_tDifThdCatHeatgDmd "Temperature difference catalyst between upper temperature threshold and lightoff temperature for catalyst heating demand" SWORD temp_q0p1_K 1 100 -3276.800 3276.700 FORMAT "%8.3" ECU_ADDRESS 0x60007024 /end MEASUREMENT
/begin MEASUREMENT ExhMgT_tEngCatHeatgOperMod "engine temperature for catalyst heating operation mode" SWORD Temp_Cels 1 100 -3549.940 3003.560 FORMAT "%8.3" ECU_ADDRESS 0x60006FCC /end MEASUREMENT
/begin MEASUREMENT ExhMgT_tEngDiagIaCatHeatg "engine temperature" SWORD Temp_Cels 1 100 -3549.940 3003.560 FORMAT "%8.3" ECU_ADDRESS 0x60006FE0 /end MEASUREMENT
/begin MEASUREMENT ExhMgT_tEngDmdOperMod "current temperature of the cooling water or the cylinder head" SWORD Temp_Cels 1 100 -3549.940 3003.560 FORMAT "%8.3" ECU_ADDRESS 0x60006FCA /end MEASUREMENT
/begin MEASUREMENT ExhMgT_tEngStrtDmdOperMod "temperature of the cooling water or the cylinder head by start of catalyst heating" SWORD Temp_Cels 1 100 -3549.940 3003.560 FORMAT "%8.3" ECU_ADDRESS 0x60006FC8 /end MEASUREMENT
/begin MEASUREMENT ExhMgT_tExhCat1CptProtnUsMax "maximal allowed exhaust temperature in front of catalyst 1 for component protection" SWORD temp_q0p1_o273 1 100 -3549.940 3003.560 FORMAT "%8.3" ECU_ADDRESS 0x60007060 /end MEASUREMENT
/begin MEASUREMENT ExhMgT_tExhCat2CptProtnUsMax "maximal allowed exhaust temperature in front of catalyst 2 for component protection" SWORD temp_q0p1_o273 1 100 -3549.940 3003.560 FORMAT "%8.3" ECU_ADDRESS 0x6000705E /end MEASUREMENT
/begin MEASUREMENT ExhMgT_tExhDsVlvB1 "Exhaust gas temperature downstream exhaust valve, modelled, for component protection" SWORD temp_q0p1_o273 1 100 -3549.940 3003.560 FORMAT "%8.3" ECU_ADDRESS 0x6000893A /end MEASUREMENT
/begin MEASUREMENT ExhMgT_tExhDsVlvCptProtnMax "Exhaust gas temperature downstream exhaust valve (modeled) for component protection" SWORD temp_q0p1_o273 1 100 -3549.940 3003.560 FORMAT "%8.3" ECU_ADDRESS 0x6000705C /end MEASUREMENT
/begin MEASUREMENT ExhMgT_tExhFrtPipCptProtnMax "maximal allowed Exhaust gas temperature downstream manifold for component protection" SWORD temp_q0p1_o273 1 100 -3549.940 3003.560 FORMAT "%8.3" ECU_ADDRESS 0x6000705A /end MEASUREMENT
/begin MEASUREMENT ExhMgT_tExhMnfB1 "Exhaust gas temperature manifold for component protection" SWORD temp_q0p1_o273 1 100 -3549.940 3003.560 FORMAT "%8.3" ECU_ADDRESS 0x60008936 /end MEASUREMENT
/begin MEASUREMENT ExhMgT_tExhMnfMaxB1 "maximal allowed Exhaustgas temperature manifold for component temperature bench 1" SWORD temp_q0p1_o273 1 100 -3549.940 3003.560 FORMAT "%8.3" ECU_ADDRESS 0x6000892E /end MEASUREMENT
/begin MEASUREMENT ExhMgT_tExhMnfMaxThd "maximal allowed Exhaustgas temperature manifold for component temperature" SWORD temp_q0p1_o273 1 100 -3549.940 3003.560 FORMAT "%8.3" ECU_ADDRESS 0x60007058 /end MEASUREMENT
/begin MEASUREMENT ExhMgT_tExhThdMin "minimum exhaust gas threshold component protection" SWORD temp_q0p1_o273 1 100 -3549.940 3003.560 FORMAT "%8.3" ECU_ADDRESS 0x60007056 /end MEASUREMENT
/begin MEASUREMENT ExhMgT_tiCatHeatgFolwStrtDiff "Time from start-up of catalyst heating due to a repeated catalyst heating in the current driving cycle with cold start parameters" UWORD t_q0p1 1 100 0.00 6553.500 FORMAT "%8.3" ECU_ADDRESS 0x600086F0 /end MEASUREMENT
/begin MEASUREMENT ExhMgT_tiCdnDnyThd "Delay time for ramping down the dynamic threshold of the manifold" UWORD t_q0p1 1 100 0.00 6553.500 FORMAT "%8.3" ECU_ADDRESS 0x60007054 /end MEASUREMENT
/begin MEASUREMENT ExhMgT_tiDifCdnDyn "Time, in which the manifold temperature is below the reset threshold" UWORD t_q0p1 1 100 0.00 6553.500 FORMAT "%8.3" ECU_ADDRESS 0x60007052 /end MEASUREMENT
/begin MEASUREMENT ExhMgT_tiHeatgIdleNonCsers "current time for catalyst heating during cold start during idle" UWORD t_q0p01 1 100 0.00 655.3500 FORMAT "%8.4" ECU_ADDRESS 0x60006FDE /end MEASUREMENT
/begin MEASUREMENT ExhMgT_tiHeatgPtlNonCsers "current time for catalyst heating during cold start outside idle" UWORD t_q0p01 1 100 0.00 655.3500 FORMAT "%8.4" ECU_ADDRESS 0x60006FDC /end MEASUREMENT
/begin MEASUREMENT ExhMgT_tIntglCatSelnCatStrt "integrated difference between the current catalyst temperature and the catalyst temperature at the start of catalyst heating" UWORD temp_q0p1_K 1 100 0.00 3276.700 FORMAT "%8.3" ECU_ADDRESS 0x60007022 /end MEASUREMENT
/begin MEASUREMENT ExhMgT_tMinCat1B1 "minmal delta exhaust temperature for 1.catalyst for activation of component protection (bench1)" SWORD temp_q0p1_K 1 100 -3276.800 3276.700 FORMAT "%8.3" ECU_ADDRESS 0x60007050 /end MEASUREMENT
/begin MEASUREMENT ExhMgT_tMinCat2B1 "minmal delta exhaust temperature for 2.catalyst for activation of component protection (bench1)" SWORD temp_q0p1_K 1 100 -3276.800 3276.700 FORMAT "%8.3" ECU_ADDRESS 0x6000704E /end MEASUREMENT
/begin MEASUREMENT ExhMgT_tMinCatB1 "minmal delta exhaust temperature of all catalyst for activation of component protection (bench1)" SWORD temp_q0p1_K 1 100 -3276.800 3276.700 FORMAT "%8.3" ECU_ADDRESS 0x6000892C /end MEASUREMENT
/begin MEASUREMENT ExhMgT_tMinCatB1B2 "minmal delta exhaust temperature of all catalyst for activation of component protection (bench1 and bench2)" SWORD temp_q0p1_K 1 100 -3276.800 3276.700 FORMAT "%8.3" ECU_ADDRESS 0x60013EEE /end MEASUREMENT
/begin MEASUREMENT ExhMgT_tMinCatDelta "Exhaust temperature hysteresis for shut-off of component protection because of catalyst temperatures" SWORD temp_q0p1_K 1 100 -3276.800 3276.700 FORMAT "%8.3" ECU_ADDRESS 0x6000892A /end MEASUREMENT
/begin MEASUREMENT ExhMgT_tMinCatDeltaCorrd "Exhaust temperature hysteresis for shut-off of component protection because of catalyst temperatures" SWORD temp_q0p1_K 1 100 0.00 1500.000 FORMAT "%8.3" ECU_ADDRESS 0x6000704C /end MEASUREMENT
/begin MEASUREMENT ExhMgT_tMinCatLo "Minimum distance to critical limits of temperatures near catalysts from where component protection active" SWORD temp_q0p1_K 1 100 0.00 500.0000 FORMAT "%8.4" ECU_ADDRESS 0x60008928 /end MEASUREMENT
/begin MEASUREMENT ExhMgT_tMinCatLoCorrd "System threshold plus safety distance for component protection related to catalyst temperature" SWORD temp_q0p1_K 1 100 -3276.800 3276.700 FORMAT "%8.3" ECU_ADDRESS 0x6000704A /end MEASUREMENT
/begin MEASUREMENT ExhMgT_tMinExhB1 "Distance to critical limits of exhaust gas temperatures upstream of catalysts (maximum choice between bench1)" SWORD temp_q0p1_K 1 100 -3276.800 3276.700 FORMAT "%8.3" ECU_ADDRESS 0x60013EF0 /end MEASUREMENT
/begin MEASUREMENT ExhMgT_tMinExhB1B2 "Distance to critical limits of exhaust gas temperatures upstream of catalysts (maximum choice between bench1 and 2)" SWORD temp_q0p1_K 1 100 -3276.800 3276.700 FORMAT "%8.3" ECU_ADDRESS 0x60013EF2 /end MEASUREMENT
/begin MEASUREMENT ExhMgT_tMinExhDelta "Exhaust temperature hysteresis for shut-off of component protection because of gas temperatures" SWORD temp_q0p1_K 1 100 -3276.800 3276.700 FORMAT "%8.3" ECU_ADDRESS 0x60008926 /end MEASUREMENT
/begin MEASUREMENT ExhMgT_tMinExhDeltaCorrd "Exhaust temperature hysteresis for shut-off of component protection because of exhaust gas temperature" SWORD temp_q0p1_K 1 100 0.00 1500.000 FORMAT "%8.3" ECU_ADDRESS 0x60007048 /end MEASUREMENT
/begin MEASUREMENT ExhMgT_tMinExhLo "Minimum distance to critical limits of exhaust gas temperatures upstream of catalysts where component protection active" SWORD temp_q0p1_K 1 100 0.00 500.0000 FORMAT "%8.4" ECU_ADDRESS 0x60008924 /end MEASUREMENT
/begin MEASUREMENT ExhMgT_tMinExhLoCorrd "System threshold plus safety distance for component protection related to exhaust gas" SWORD temp_q0p1_K 1 100 -3276.800 3276.700 FORMAT "%8.3" ECU_ADDRESS 0x60007046 /end MEASUREMENT
/begin MEASUREMENT ExhMgT_tMinTExhCptProtnB1 "minimum difference of exhaust temperature of manifold and of all catalysts from the respective critical threshold of bank 1" SWORD temp_q0p1_K 1 100 -3276.800 3276.700 FORMAT "%8.3" ECU_ADDRESS 0x60013EF4 /end MEASUREMENT
/begin MEASUREMENT ExhMgT_tMinTExhCptProtnGlb "minimum difference of exhaust temperature of manifold and of all catalysts from the respective critical threshold" SWORD temp_q0p1_K 1 100 -3276.800 3276.700 FORMAT "%8.3" ECU_ADDRESS 0x60008922 /end MEASUREMENT
/begin MEASUREMENT ExhMgT_tMinThd "local minimal temperature threshold per exhaust unit" SWORD temp_q0p1_o273 1 100 -3549.940 3003.560 FORMAT "%8.3" ECU_ADDRESS 0x60007044 /end MEASUREMENT
/begin MEASUREMENT ExhMgT_tMinTWallCptProtnB1 "distance of the mat temperature from critical temperatures of components, bench 1" SWORD temp_q0p1_K 1 100 -3276.800 3276.700 FORMAT "%8.3" ECU_ADDRESS 0x6000891C /end MEASUREMENT
/begin MEASUREMENT ExhMgT_tOffsCptPrtnLimpB1 "additional distance to critical limits of exhaust temperatures for component protection, bench 1" SWORD temp_q0p1_K 1 100 0.00 3276.700 FORMAT "%8.3" ECU_ADDRESS 0x60013EF6 /end MEASUREMENT
/begin MEASUREMENT ExhMgT_tRstDynThd "temperature threshold in order to reset the dynamic threshold component protection" SWORD temp_q0p1_o273 1 100 -3549.940 3003.560 FORMAT "%8.3" ECU_ADDRESS 0x60007042 /end MEASUREMENT
/begin MEASUREMENT ExhMgT_tThdCatHeatg "Temperature threshold for catalyst heating" SWORD Temp_Cels 1 100 -3549.940 3003.560 FORMAT "%8.3" ECU_ADDRESS 0x6000891A /end MEASUREMENT
/begin MEASUREMENT ExhMgT_tThdCatHeatgCatHiPrio "selection of temperature threshould for high prio catalyst heating" SWORD Temp_Cels 1 100 -3549.940 3003.560 FORMAT "%8.3" ECU_ADDRESS 0x60007020 /end MEASUREMENT
/begin MEASUREMENT ExhMgT_tUpprThd2HiPrio "catalyst temperature2 of the high priority catalyst which must be reached with catalyst heating" SWORD Temp_Cels 1 100 -3549.940 3003.560 FORMAT "%8.3" ECU_ADDRESS 0x60008918 /end MEASUREMENT
/begin MEASUREMENT ExhMgT_tUpprThdCatHeatgHiPrio "selection of temperature threshould for high prio catalyst heating" SWORD Temp_Cels 1 100 -3549.940 3003.560 FORMAT "%8.3" ECU_ADDRESS 0x6000701E /end MEASUREMENT
/begin MEASUREMENT ExhMgT_tUpprThdDiagEtaIa "catalyst temperature threshold for diagnosis of ignition timing efficiency" SWORD Temp_Cels 1 100 -3549.940 3003.560 FORMAT "%8.3" ECU_ADDRESS 0x60008916 /end MEASUREMENT
/begin MEASUREMENT ExhMgT_tUpprThdHiPrio "catalyst temperature of the high priority catalyst which must be reached with catalyst heating" SWORD Temp_Cels 1 100 -3549.940 3003.560 FORMAT "%8.3" ECU_ADDRESS 0x60008914 /end MEASUREMENT
/begin MEASUREMENT ExhMgT_tUpprThdLoPrio "catalyst temperature of the low priority catalyst which must be reached with catalyst heating" SWORD Temp_Cels 1 100 -3549.940 3003.560 FORMAT "%8.3" ECU_ADDRESS 0x60008912 /end MEASUREMENT
/begin MEASUREMENT ExhMgT_tWallAryMin "maximal wall temperature inside exhaust system for activation of component protection" SWORD Temp_Cels 1 100 -3549.940 3003.560 FORMAT "%8.3" ECU_ADDRESS 0x60007040 /end MEASUREMENT
/begin MEASUREMENT ExhMgT_tWallCptProtnB1 "Wall temperature for calculating the maximum allowed temperature in the manifold for component protection, Bank 1" SWORD temp_q0p1_o273 1 100 -3549.940 3003.560 FORMAT "%8.3" ECU_ADDRESS 0x6000703E /end MEASUREMENT
/begin MEASUREMENT ExhMgT_tWallMnfldCptProtn "maximal allowed temperature at exhaust manifold for component temperature in dependence of wall temperature" SWORD temp_q0p1_o273 1 100 -3549.940 3003.560 FORMAT "%8.3" ECU_ADDRESS 0x6000703C /end MEASUREMENT
/begin MEASUREMENT ExhMgT_tWallMnfldCptProtnSnsr "maximal allowed temperature at exhaust manifold for component temperature" SWORD temp_q0p1_o273 1 100 -3549.940 3003.560 FORMAT "%8.3" ECU_ADDRESS 0x6000703A /end MEASUREMENT
/begin MEASUREMENT ExhMgT_WrmSustReq_I.stOperMod "connection of catalyst heating because of a request for catalyst warming with lambda split at operation mode coordinator / Priority-element of the operation mode structure" ULONG OneToOne 1 100 0.00 4294967295.00 FORMAT "%13.2" ECU_ADDRESS 0x70002ECC /end MEASUREMENT
/begin MEASUREMENT ExhMgT_WrmSustReq_I.stOperModPrio "connection of catalyst heating because of a request for catalyst warming with lambda split at operation mode coordinator / Stage-element of the operation mode structure" UBYTE OneToOne 1 100 0.00 255.0 FORMAT "%5.1" ECU_ADDRESS 0x70002ED0 /end MEASUREMENT
/begin MEASUREMENT ExhMgT_WrmSustReq_I.stOperModStg "connection of catalyst heating because of a request for catalyst warming with lambda split at operation mode coordinator / Operation-mode element of the operation mode structure" UWORD OneToOne 1 100 0.00 65535.00 FORMAT "%8.2" ECU_ADDRESS 0x70002ED2 /end MEASUREMENT
/begin MEASUREMENT fanfkw_w_msg "factor for weighting catalyst heating request for catalysator warming" UWORD fak_uw_b2 1 100 0.00 1.999969 FORMAT "%8.6" ECU_ADDRESS 0x6000853C /end MEASUREMENT
/begin MEASUREMENT fkhab_msg "terminating factor catalyst heating" UBYTE fak_ub_b1 1 100 0.00 0.9961 ECU_ADDRESS 0x60014165 /end MEASUREMENT
/begin MEASUREMENT FPCtl_flgReIniTECOOR100ms "Re-Initialisation necessary for TECOOR 100ms" UBYTE B_TRUE 1 100 0.00 1.00000000000 BIT_MASK 0x1 FORMAT "%13.11" ECU_ADDRESS 0x700002AD /end MEASUREMENT
/begin MEASUREMENT FPCtl_flgReIniTECOOR20ms "Re-Initialisation necessary for TECOOR 20ms" UBYTE B_TRUE 1 100 0.00 1.00000000000 BIT_MASK 0x1 FORMAT "%13.11" ECU_ADDRESS 0x700002AC /end MEASUREMENT
/begin MEASUREMENT frlmxbts_w_msg "reduction factor for maximum air charge if component protection reaches rich or lean burning limit" UWORD fak_uw_b2 1 100 0.00 1.999969 FORMAT "%8.6" ECU_ADDRESS 0x60014014 /end MEASUREMENT
/begin MEASUREMENT FuPurg_flgReqVlvFullLftIntk "Condition request intake valve with large lift during fuel purge with high canister load" UBYTE B_TRUE 1 100 0.00 1.00000000000 BIT_MASK 0x1 FORMAT "%13.11" ECU_ADDRESS 0x7000092F /end MEASUREMENT
/begin MEASUREMENT FuPurg_ratDesTqResvWoCorrnHRes "Torque reserve for purge control without correction of engine efficiency" UWORD rel_uw_b100 1 100 0.00 99.99847 FORMAT "%8.5" ECU_ADDRESS 0x600085FE /end MEASUREMENT
/begin MEASUREMENT idetakhl_w "integration of differenz between actuell ignition effciency and desired catalyst heating ignition efficiency during idle" SLONG fak_q3p0518Em7 1 100 -655.360000000 655.359999695 FORMAT "%13.9" ECU_ADDRESS 0x60002ACC /end MEASUREMENT
/begin MEASUREMENT idetakht_w "integration of differenz between actuell ignition effciency and desired catalyst heating ignition efficiency outside idle" SLONG fak_q3p0518Em7 1 100 -655.360000000 655.359999695 FORMAT "%13.9" ECU_ADDRESS 0x60002AC8 /end MEASUREMENT
/begin MEASUREMENT imlpr_w_msg "relative amount of integrated air mass at catalyst heating (word)" UWORD fak_uw_b1 1 100 0.00 0.9999847 FORMAT "%9.7" ECU_ADDRESS 0x60014018 /end MEASUREMENT
/begin MEASUREMENT InjSys_trqResvCP "Torque reserve for purge control" SWORD md_q0p1 1 100 -3276.800 3276.700 FORMAT "%8.3" ECU_ADDRESS 0x60008820 /end MEASUREMENT
/begin MEASUREMENT lambs_w_msg "lambda for component protection (precontrol)" UWORD fak_uw_b16 1 100 0.00 15.99976 FORMAT "%8.5" ECU_ADDRESS 0x60008516 /end MEASUREMENT
/begin MEASUREMENT lambts_w_msg "lambda for component protection" UWORD fak_uw_b16 1 100 0.00 15.99976 FORMAT "%8.5" ECU_ADDRESS 0x60008B04 /end MEASUREMENT
/begin MEASUREMENT lbtarsv_w "Set point lambda corrected with delta lambda of exhaust temperature control" UWORD fak_uw_b16 1 100 0.00 15.99976 FORMAT "%8.5" ECU_ADDRESS 0x60006FAC /end MEASUREMENT
/begin MEASUREMENT lbtsaw_w "Selected lambda component protection (bank 1)" UWORD fak_uw_b16 1 100 0.500000 2.000000 FORMAT "%8.6" ECU_ADDRESS 0x60008510 /end MEASUREMENT
/begin MEASUREMENT lbtsbgmn_w "min. allowed engine lambda for component protection (Limitation)" UWORD fak_uw_b16 1 100 0.00 15.99976 FORMAT "%8.5" ECU_ADDRESS 0x6000850E /end MEASUREMENT
/begin MEASUREMENT lbtsbgmn_w_msg "min. allowed engine lambda for component protection (Limitation)" UWORD fak_uw_b16 1 100 0.00 15.99976 FORMAT "%8.5" ECU_ADDRESS 0x6000850C /end MEASUREMENT
/begin MEASUREMENT lbtsffv_w "Lambda component protection with fuel ethanol (bank1)" UWORD fak_uw_b16 1 100 0.500000 2.000000 FORMAT "%8.6" ECU_ADDRESS 0x60006FAA /end MEASUREMENT
/begin MEASUREMENT lbtsgs_w "Lambda component protection with fuel gasoline (bank1)" UWORD fak_uw_b16 1 100 0.500000 2.000000 FORMAT "%8.6" ECU_ADDRESS 0x60006FA8 /end MEASUREMENT
/begin MEASUREMENT lbtsmnsp_w "Minimum lambda for component protection out of stationary map and at a high load and low gear (steep slope climbing) (bank1 and bank 2)" UWORD fak_uw_b16 1 100 0.00 15.99976 FORMAT "%8.5" ECU_ADDRESS 0x60006FBA /end MEASUREMENT
/begin MEASUREMENT lbtsskf_w "lambda component protection in case of mega-knock detection" UWORD fak_uw_b16 1 100 0.00 1.000000 FORMAT "%8.6" ECU_ADDRESS 0x60006FB8 /end MEASUREMENT
/begin MEASUREMENT lbtsskrmin_w "minimum of lambda for component protection in case of so-called super knock and precontrol component protection" UWORD fak_uw_b16 1 100 0.00 1.000000 FORMAT "%8.6" ECU_ADDRESS 0x60006FB6 /end MEASUREMENT
/begin MEASUREMENT lbtsskr_w_msg "lambda for component protection in case of so-called super knock" UWORD fak_uw_b16 1 100 0.00 15.99976 FORMAT "%8.5" ECU_ADDRESS 0x60008AF6 /end MEASUREMENT
/begin MEASUREMENT miwointv_w "Set point torque without interventions on crankshaft torque level" UWORD rel_uw_b100 1 100 0.00 99.99847 FORMAT "%8.5" ECU_ADDRESS 0x60006FB4 /end MEASUREMENT
/begin MEASUREMENT mxetkhll_w_msg "maximum allowed deviation of ignition efficiency during catalyst heating during idle (MAX-Errorpath)" SWORD fak_q3p0518Em5 1 100 -1.000000 0.999969 FORMAT "%8.6" ECU_ADDRESS 0x6001402E /end MEASUREMENT
/begin MEASUREMENT mxetkhtl_w_msg "maximum allowed deviation of ignition efficiency during catalyst heating during part load (MAX-Errorpath)" SWORD fak_q3p0518Em5 1 100 -1.000000 0.999969 FORMAT "%8.6" ECU_ADDRESS 0x60014030 /end MEASUREMENT
/begin MEASUREMENT pteker_msg "tank pressure (from ADC), extended range" SBYTE p_sb_q0p625 1 100 -80.00 79.38 FORMAT "%5.2" ECU_ADDRESS 0x60001517 /end MEASUREMENT
/begin MEASUREMENT pteker_w_msg "tank pressure (from ADC), extended range" SWORD p_sw_q0p00244 1 100 -80.00000 79.99756 FORMAT "%8.5" ECU_ADDRESS 0x6000162A /end MEASUREMENT
/begin MEASUREMENT ptek_msg "tank pressure (from ADC)" SBYTE p_q0p3125 1 100 -40.00 39.69 FORMAT "%5.2" ECU_ADDRESS 0x60001518 /end MEASUREMENT
/begin MEASUREMENT ptek_w_msg "tank pressure (16 Bit)" SWORD p_q0p00122 1 100 -40.00000 39.99878 FORMAT "%8.5" ECU_ADDRESS 0x6000162C /end MEASUREMENT
/begin MEASUREMENT TankP_flgClr "Flag for checking the DSM_clear in tank pressure sensor module" UBYTE B_TRUE 1 100 0.00 1.00000000000 BIT_MASK 0x1 FORMAT "%13.11" ECU_ADDRESS 0x60000F77 /end MEASUREMENT
/begin MEASUREMENT TankP_pDifTankFildMaxThd "Maximum threshold forfiltered tank pressure difference" SBYTE p_sb_q0p625 1 100 -80.00 79.38 FORMAT "%5.2" ECU_ADDRESS 0x60000F76 /end MEASUREMENT
/begin MEASUREMENT TankP_pTankExtdFild "Filtered tank pressure (extended range)" SBYTE p_sb_q0p625 1 100 -80.00 79.38 FORMAT "%5.2" ECU_ADDRESS 0x60001424 /end MEASUREMENT
/begin MEASUREMENT tkhidle_w "current time for catalyst heating during cold start during idle" UWORD t_q0p01 1 100 0.00 655.3500 FORMAT "%8.4" ECU_ADDRESS 0x60006FDA /end MEASUREMENT
/begin MEASUREMENT tkhpload_w "current time for catalyst heating during cold start outside idle" UWORD t_q0p01 1 100 0.00 655.3500 FORMAT "%8.4" ECU_ADDRESS 0x60006FD8 /end MEASUREMENT
/begin MEASUREMENT tptedbo_w "counter for upper threshold during plaus check (Word)" UWORD t_q0p1 1 100 0.00 6553.400 FORMAT "%8.3" ECU_ADDRESS 0x60000F74 /end MEASUREMENT
/begin MEASUREMENT tptedbu_w "Zähler für untere Grenzwertüberschreitung der Plausprüfung (Word)" UWORD t_q0p1 1 100 0.00 6553.400 FORMAT "%8.3" ECU_ADDRESS 0x60000F72 /end MEASUREMENT
/begin MEASUREMENT wistr_w_msg "Relative heating progress for catalyst by exhaust gas since cranking" UWORD fak_uw_b1 1 100 0.00 0.9999847 FORMAT "%9.7" ECU_ADDRESS 0x600084AA /end MEASUREMENT
/begin FUNCTION EvapDiagToCoornEng "30301.0.0 Communication function evaporative diagnosis to coordination engine"
 /begin DEF_CHARACTERISTIC DMRTEK FuPurg_facAdpnVlvLftMax_C FuPurg_facAdpnVlvLftMin_C FuPurg_facDesEngEff_T FuPurg_ratDesTqResvFildPurgCtrlAdpn_M FuPurg_ratDesTqResvIntglMFlowHRes_M FuPurg_ratMaxTqResv_T FuPurg_stCfgExtReqCoorn_C /end DEF_CHARACTERISTIC
 /begin IN_MEASUREMENT B_nswo1_msg B_tei_msg B_te_msg Epm_nEng fmi2trq_w_msg fteadf_msg fteadf_w_msg imsteini_msg mifal_w_msg SyC_stSub /end IN_MEASUREMENT
 /begin OUT_MEASUREMENT dmrte_w_msg FuPurg_flgReqVlvFullLftIntk InjSys_trqResvCP /end OUT_MEASUREMENT
 /begin LOC_MEASUREMENT FPCtl_flgReIniTECOOR100ms FPCtl_flgReIniTECOOR20ms FuPurg_ratDesTqResvWoCorrnHRes /end LOC_MEASUREMENT
 FUNCTION_VERSION "30301.0.0" /end FUNCTION
/begin FUNCTION EvapDiagToDiagSrv "30301.3.0 Adapter from evaporative diagnosis to diagnosis service" /begin IN_MEASUREMENT B_cdeonv_msg B_dsteonvfcl_msg Dsteonv_msg GlbDa_lTotDst /end IN_MEASUREMENT /begin OUT_MEASUREMENT EvapeLeakDst_msg /end OUT_MEASUREMENT FUNCTION_VERSION "30301.3.0" /end FUNCTION
/begin FUNCTION EvapPSnsrTank_Dd "30312.2.0 Evaporation Sensor Pressure Tank - Device Driver" /begin DEF_CHARACTERISTIC DSTGRAD DSTOFFS TDDSTW UDSTMN UDSTMX /end DEF_CHARACTERISTIC /begin IN_MEASUREMENT B_cddst_msg EngStrt_bStrt SyC_stSub udst_w_msg /end IN_MEASUREMENT /begin OUT_MEASUREMENT pteker_msg pteker_w_msg ptek_msg ptek_w_msg /end OUT_MEASUREMENT /begin LOC_MEASUREMENT B_error_old /end LOC_MEASUREMENT FUNCTION_VERSION "30312.2.0" /end FUNCTION
/begin FUNCTION EvapPSnsrTank_Vd "30211.2.0 Evaporation Sensor Pressure Tank - Virtual Device"
 /begin DEF_CHARACTERISTIC DPTELFU EvapPSnsrTank_mFlowCpvPhyRngChk_C EvapPSnsrTank_stPhyRngChk_C EvapPSnsrTank_tiCcvOpenPhyRngChk_C EvapPSnsrTank_tiFltDetnPhyRngChk_C EvapPSnsrTank_tiPhyRngChk_C EvapPSnsrTank_tiStrtStabnPhyRngChk_C EvapPSnsrTank_tiVehVEnaPhyRngChk_C EvapPSnsrTank_tMaxEnvTPhyRngChk_C EvapPSnsrTank_tMinEnvTPhyRngChk_C EvapPSnsrTank_vMinPhyRngChk_C TankP_pUpprThdPlausDiag_T TDDSTPL /end DEF_CHARACTERISTIC
 /begin REF_CHARACTERISTIC HPUTEDU /end REF_CHARACTERISTIC
 /begin IN_MEASUREMENT B_cddst_msg B_fstdmn_msg B_fstdmx_msg B_fsttg_msg B_fsttldv_msg B_llr_msg B_tldcvs_msg EngStrt_bStrt EnvT_t fstt_w_msg mstedte_w_msg PEnv_p pteker_msg SyC_stSub VehV_v /end IN_MEASUREMENT
 /begin OUT_MEASUREMENT B_stplch_msg /end OUT_MEASUREMENT
 /begin LOC_MEASUREMENT EvapPSnsrTank_cntrVehVEnaPhyRngChk EvapPSnsrTank_mFlowCpvPhyRngChk TankP_flgClr TankP_pDifTankFildMaxThd TankP_pTankExtdFild tptedbo_w tptedbu_w /end LOC_MEASUREMENT
 FUNCTION_VERSION "30211.2.0" /end FUNCTION
/begin FUNCTION ExhCo_Adpr "1.0.0     Adapter function for Exhaust modules" /begin DEF_CHARACTERISTIC ExhCo_swtTSelnCatHeatgGpf_C /end DEF_CHARACTERISTIC /begin OUT_MEASUREMENT ExhCo_swtTSelnCatHeatgGpf /end OUT_MEASUREMENT FUNCTION_VERSION "1.0.0" /end FUNCTION
/begin FUNCTION ExhMgT_ActvnCptProtnTExh "1.17.1    activation of component protection because of the exhaust temperature"
 /begin DEF_CHARACTERISTIC ExhMgT_nrTWallArySeldB1_C ExhMgT_ratLamCptProtnLimpCamsft_C ExhMgT_ratLamCptProtnLimpExh_C ExhMgT_ratLamCptProtnLimpUego_C ExhMgT_stActvnCptProtnTExh1_C ExhMgT_stActvnCptProtnTExh_C ExhMgT_tCat1CptProtnMax_C ExhMgT_tCat1MaxCptProtnMax_C ExhMgT_tCat2CptProtnMax_C ExhMgT_tCat2MaxCptProtnMax_C ExhMgT_tDeltaCat1_C ExhMgT_tDeltaCat2_C ExhMgT_tDeltaMnfB1_T ExhMgT_tDeltaMnf_C ExhMgT_tDeltaWallActvnCptProtn_C ExhMgT_tDiffActvTi_C ExhMgT_tExhCat1CptProtnDsMax_C ExhMgT_tExhCat1CptProtnUsMax_C ExhMgT_tExhCat2CptProtnDsMax_C ExhMgT_tExhCat2CptProtnUsMax_C ExhMgT_tExhDsVlvCptProtnMax_C ExhMgT_tExhFrtPipCptProtnMax_C ExhMgT_tExhMnfMaxDyn_C ExhMgT_tiActvnCptProtn_C ExhMgT_tiCat1MaxDec_C ExhMgT_tiCat1MaxInc_C ExhMgT_tiCat2MaxDec_C ExhMgT_tiCat2MaxInc_C ExhMgT_tiCdnDnyThd_C ExhMgT_tiDeActvnCptProtn_C ExhMgT_tiDifCdnDyn_C ExhMgT_tiDlyCatActvCptProtn_C ExhMgT_tiDlyExhActvCptProtn_C ExhMgT_tiMaxCat1B1_C ExhMgT_tiMaxCat2B1_C ExhMgT_tiMnfldMaxDec_C ExhMgT_tiMnfldMaxInc_C ExhMgT_tiWallActvnCptProtn_C ExhMgT_tMinCatDelta_C ExhMgT_tMinCatLo_C ExhMgT_tMinExhDelta_C ExhMgT_tMinExhLo_C ExhMgT_tOffsCptProtnLimpCamsft_C ExhMgT_tOffsCptProtnLimpExh_C ExhMgT_tOffsCptProtnLimpUego_C ExhMgT_tWallActvnCptProtnMax_C ExhMgT_tWallActvnCptProtnMax_T ExhMgT_tWallMnfCptProtnMax_C ExhMgT_tWallMnfldCptProtn_T /end DEF_CHARACTERISTIC
 /begin IN_MEASUREMENT EngStrt_bStrtEnd ExhMgT_tCat1FildB1 ExhMgT_tCat1MaxFildB1 ExhMgT_tExhDsVlvFildB1 ExhMgT_tExhMnfFildB1 ExhMgT_tExhMnfFildGrdtB1 ExhMod_tCat1B1 ExhMod_tCat1MaxB1 ExhMod_tCat2B1 ExhMod_tCat2MaxB1 ExhMod_tExhCat1DsB1 ExhMod_tExhCat1UsB1 ExhMod_tExhCat2DsB1 ExhMod_tExhCat2UsB1 ExhMod_tExhDsVlvB1 ExhMod_tExhFrtPipB1 ExhMod_tExhMnfB1 ExhMod_tWallAryB1 ExhMod_tWallMnfB1 SyC_stSub VehV_v /end IN_MEASUREMENT
 /begin OUT_MEASUREMENT B_flbtskat_msg dtbtgsmx_w_msg dtbtkamx_w ExhMgT_facLamCptProtnTExh ExhMgT_flgActvCptProtn ExhMgT_flgActvCptProtnTExh ExhMgT_flgCatActvCptProtnTExh ExhMgT_flgErrCamsft ExhMgT_flgLimpCptProtn ExhMgT_flgTWallActvnCptProtn ExhMgT_ratDeltaLamLimp ExhMgT_tCat1B1 ExhMgT_tCat1CptProtnMax ExhMgT_tCat1MaxB1 ExhMgT_tCat1MaxCptProtnMaxThd ExhMgT_tDifCat1B1 ExhMgT_tDifCat1MaxB1 ExhMgT_tDifExhMnfB1 ExhMgT_tExhDsVlvB1 ExhMgT_tExhMnfB1 ExhMgT_tExhMnfMaxB1 ExhMgT_tMinCatB1 ExhMgT_tMinCatB1B2 ExhMgT_tMinCatDelta ExhMgT_tMinCatLo ExhMgT_tMinExhB1 ExhMgT_tMinExhB1B2 ExhMgT_tMinExhDelta ExhMgT_tMinExhLo ExhMgT_tMinTExhCptProtnB1 ExhMgT_tMinTExhCptProtnGlb ExhMgT_tMinTWallCptProtnB1 ExhMgT_tOffsCptPrtnLimpB1 /end OUT_MEASUREMENT
 /begin LOC_MEASUREMENT ExhMgT_facIntrpnTCat1 ExhMgT_facIntrpnTCat2 ExhMgT_facIntrpnTMnf ExhMgT_flgExhActvCptProtnTExh ExhMgT_flgOffTemp ExhMgT_flgOverTCat1Max ExhMgT_flgOverTCat2Max ExhMgT_flgOverTMnflMax ExhMgT_flgtExhMnfMaxB1 ExhMgT_flgThdCatLo ExhMgT_flgThdExhLo ExhMgT_flgTiCdnDynThd ExhMgT_flgTiCdnDynThdRst ExhMgT_flgTiCdnDynThdSet ExhMgT_flgTiOverMaxCat1 ExhMgT_flgTiOverMaxCat2 ExhMgT_tCat1MaxCptProtnMax ExhMgT_tCat2CptProtnMax ExhMgT_tCat2MaxB1 ExhMgT_tCat2MaxMaxThd ExhMgT_tCatThdMin ExhMgT_tDifCatThd ExhMgT_tDifExhThd ExhMgT_tExhCat1CptProtnUsMax ExhMgT_tExhCat2CptProtnUsMax ExhMgT_tExhDsVlvCptProtnMax ExhMgT_tExhFrtPipCptProtnMax ExhMgT_tExhMnfMaxThd ExhMgT_tExhThdMin ExhMgT_tiCdnDnyThd ExhMgT_tiDifCdnDyn ExhMgT_tMinCat1B1 ExhMgT_tMinCat2B1 ExhMgT_tMinCatDeltaCorrd ExhMgT_tMinCatLoCorrd ExhMgT_tMinExhDeltaCorrd ExhMgT_tMinExhLoCorrd ExhMgT_tMinThd ExhMgT_tRstDynThd ExhMgT_tWallAryMin ExhMgT_tWallCptProtnB1 ExhMgT_tWallMnfldCptProtn ExhMgT_tWallMnfldCptProtnSnsr /end LOC_MEASUREMENT
 FUNCTION_VERSION "1.17.1" /end FUNCTION
/begin FUNCTION ExhMgT_CatHeatgUpIf "2.10.0    interface function operating conditions for catalyst heating request"
 /begin DEF_CHARACTERISTIC ExhMgT_facCorrnTempCatHeatgMax_C ExhMgT_facCorrnTempCatHeatgMin_C ExhMgT_stCatHeatgCold3_C ExhMgT_stOperModDmd_C ExhMgT_tCatHeatgMax_C /end DEF_CHARACTERISTIC
 /begin IN_MEASUREMENT EngStrt_bStrtEnd Epm_stSpd ExhMgT_facCatHeatgFinshd ExhMgT_facCatHeatgProgs ExhMgT_facHeatgDmdCat ExhMgT_flgCatHeatgColdStrtReq ExhMgT_flgCatHeatgReqActv ExhMgT_flgCatHeatgUpActv ExhMgT_flgCatHeatgWrmReq ExhMgT_flgNoCatHeatgDmd ExhMgT_tCat1B1Min ExhMgT_tCat1Seln1 ExhMgT_tThdCatHeatg SyC_stSub /end IN_MEASUREMENT
 /begin OUT_MEASUREMENT bdemodkw_msg B_anfhsgkw_msg B_anfscgkw_msg B_bbmrkh_msg B_khakt_msg B_khakw_msg B_khan_msg B_khasuhsp_msg B_khat_msg B_kha_msg B_kherr_msg B_khmr_msg B_kh_msg B_kw_msg B_laspkt_msg B_laspkw_msg B_trkh_msg B_trkonz2_msg B_trkonz_msg ExhMgT_facCorrnMAirCatHeatg ExhMgT_facCorrnTempCatHeatg ExhMgT_flgCatHeatFinshd ExhMgT_flgCatHeatgColdStrtLamSplitReq ExhMgT_flgCatHeatgEolTest ExhMgT_flgCatHeatgFirstStrt ExhMgT_flgCatHeatgFirstStrtFinshd ExhMgT_flgCatHeatgFolwStrt ExhMgT_flgCatHeatgFolwStrtWoStop ExhMgT_flgCatHeatgRed ExhMgT_flgCatHeatgRepStrt ExhMgT_flgCatHeatgReqRstSnd ExhMgT_flgCatHeatgWrm ExhMgT_flgCatHeatNormFinshd ExhMgT_flgCatHeatWrmLamSplitReq ExhMgT_flgCatHeatWrmReq ExhMgT_flgReqHosThd ExhMgT_flgReqLamSplitTMin ExhMgT_numCatHeatg ExhMgT_stOperModDmd ExhMgT_tCat1Min ExhMgT_tCat1SelnStrt ExhMgT_tCatHeatgWrmThd ExhMgT_tDiffTCatHeatgFolwStrt ExhMgT_tiCatHeatgFolwStrtDiff fanfkw_w_msg fkhab_msg imlpr_w_msg wistr_w_msg /end OUT_MEASUREMENT
 /begin LOC_MEASUREMENT ExhMgT_nrColdStrt /end LOC_MEASUREMENT
 FUNCTION_VERSION "2.10.0" /end FUNCTION
/begin FUNCTION ExhMgT_CatHeatgUpReq "1.29.0    operating conditions for catalyst heating request"
 /begin DEF_CHARACTERISTIC ExhMgT_nrBrickTCat1Avrg_C ExhMgT_nrBrickTCat1Max_C ExhMgT_nrBrickTCat1Min_C ExhMgT_nrBrickTCat2Avrg_C ExhMgT_nrBrickTCat2Max_C ExhMgT_nrBrickTCat2Min_C CatH_TempSelnCat1B1_I.ExhMgT_idxBrick1Cat_C CatH_TempSelnCat1B1_I.ExhMgT_idxBrick2Cat_C CatH_TempSelnCat1B1_I.ExhMgT_idxBrick3Cat_C CatH_TempSelnCat2B1_I.ExhMgT_idxBrick1Cat_C CatH_TempSelnCat2B1_I.ExhMgT_idxBrick2Cat_C CatH_TempSelnCat2B1_I.ExhMgT_idxBrick3Cat_C ExhMgT_facInvnHeatgDmdHeatgProgs_T ExhMgT_facThdCatHeatgColdFinshdGpf_C ExhMgT_facThdCatHeatgFinshd_C ExhMgT_facThdEtaCatWrm_C ExhMgT_facThdEtaColdStrtHeatg_C ExhMgT_nrCatHighPrio_C ExhMgT_nrTCat1Seln1_C ExhMgT_nrTCat1Seln2_C ExhMgT_nrTCat2Seln1_C ExhMgT_nrTCat2Seln2_C ExhMgT_nrTDesMinCatEngOff_C ExhMgT_stCatHeatgUpReq2_C ExhMgT_stCatHeatgUpReq_C ExhMgT_stHeatgModeFacProgsAry_CA ExhMgT_tDelta2CatHeatgCatHiPrio_C ExhMgT_tDeltaCatHeatgCatHiPrio_C ExhMgT_tDeltaCatHeatgCatLoPrio_C ExhMgT_tDeltaEngStopCatCoolgMax_C ExhMgT_tDeltaMinCatAge_T ExhMgT_tDesMinCatDmd_C ExhMgT_tDesMinCatEngOff_C ExhMgT_tDesMinLoPrioCatDmd_C ExhMgT_tiCatHeatgFacColdFinshGpf_C ExhMgT_tiCatHeatgFacFinsh_C ExhMgT_tiCatHeatgFacGpfRgnRampDown_C ExhMgT_tiCatHeatgFacGpfRgnRampUp_C ExhMgT_tiCatHeatgFacRampDown_C ExhMgT_tiCatHeatgFacRampUp_C ExhMgT_tiCatHeatgFacWrmRampDown_C ExhMgT_tiCatHeatgFacWrmRampUp_C ExhMgT_tiDlyCatHeatgCptPrtn_C ExhMgT_tThd2CatHeatgCatHiPrio_T ExhMgT_tThdCatHeatgCatHiPrio_T ExhMgT_tThdCatHeatgCatLoPrio_T /end DEF_CHARACTERISTIC
 /begin IN_MEASUREMENT EngStrt_bStrtEnd Epm_stSpd ExhMgT_facEtaCatWrmAltiT ExhMgT_facEtaColdStrtHeatgAltiT ExhMgT_flgActvCptProtn ExhMgT_flgCatHeatgEolTest ExhMod_flgStTMdlIninCat1B1 ExhMod_flgStTMdlIninCat2B1 ExhMod_ratO2StorgCatB1_a ExhMod_ratO2StrCat1MinBnk ExhMod_tCatBrickAryB1 SyC_ctPostDrvLeave SyC_stSub /end IN_MEASUREMENT
 /begin OUT_MEASUREMENT ExhMgT_facCatHeatgFinshd ExhMgT_facCatHeatgProgs ExhMgT_facCatHeatgRamp ExhMgT_facHeatgDmdCat ExhMgT_facHeatgDmdCat1 ExhMgT_facHeatgDmdCat1B1 ExhMgT_facHeatgDmdCat2 ExhMgT_facHeatgDmdCat2B1 ExhMgT_facHeatgDmdCatLoPrio ExhMgT_facWghtCat1Age ExhMgT_facWghtCatAge ExhMgT_flgCatHeatgColdStrtDmd ExhMgT_flgCatHeatgColdStrtReq ExhMgT_flgCatHeatgColdStrtWoFIdReq ExhMgT_flgCatHeatgColdWrmReq ExhMgT_flgCatHeatgGpfRgnReq ExhMgT_flgCatHeatgReqActv ExhMgT_flgCatHeatgUpActv ExhMgT_flgCatHeatgWrmDmd ExhMgT_flgCatHeatgWrmReq ExhMgT_flgCatHeatgWrmWoFIdReq ExhMgT_flgNoCatHeatgDmd ExhMgT_stCatHeatgMode ExhMgT_tCat1B1Min ExhMgT_tCat1Seln1 ExhMgT_tCat1Seln1B1 ExhMgT_tCat1Seln2 ExhMgT_tCat2B1Min ExhMgT_tCat2Seln1 ExhMgT_tCat2Seln1B1 ExhMgT_tCat2Seln2 ExhMgT_tCatColdStrt ExhMgT_tCatHeatgTCatSelnActn ExhMgT_tDesCat1 ExhMgT_tDesCat2 ExhMgT_tThdCatHeatg ExhMgT_tUpprThd2HiPrio ExhMgT_tUpprThdDiagEtaIa ExhMgT_tUpprThdHiPrio ExhMgT_tUpprThdLoPrio /end OUT_MEASUREMENT
 /begin LOC_MEASUREMENT CatH_TempSelnCat1B1_I.tCatAvrg CatH_TempSelnCat1B1_I.tCatBrick1 CatH_TempSelnCat1B1_I.tCatBrick2 CatH_TempSelnCat1B1_I.tCatBrick3 CatH_TempSelnCat1B1_I.tCatMax CatH_TempSelnCat1B1_I.tCatMin CatH_TempSelnCat1B1_I.tCatSeln1 CatH_TempSelnCat1B1_I.tCatSeln2 CatH_TempSelnCat2B1_I.tCatAvrg CatH_TempSelnCat2B1_I.tCatBrick1 CatH_TempSelnCat2B1_I.tCatBrick2 CatH_TempSelnCat2B1_I.tCatBrick3 CatH_TempSelnCat2B1_I.tCatMax CatH_TempSelnCat2B1_I.tCatMin CatH_TempSelnCat2B1_I.tCatSeln1 CatH_TempSelnCat2B1_I.tCatSeln2 ExhMgT_CatHeatgUpReq_ctReIni ExhMgT_flgCatHeatgColdStrtAltiRst ExhMgT_flgCatHeatgColdStrtRst ExhMgT_flgCatHeatgFinshdReq ExhMgT_flgCatHeatgTWin2 ExhMgT_flgCatHeatgWrmAltiRst ExhMgT_flgCatHeatgWrmRst ExhMgT_flgEngStopTCatCoolg ExhMgT_flgEngStrt ExhMgT_flgEpmSpdZr ExhMgT_flgFirstCatHeatg ExhMgT_flgStCatHeatgOldUpd ExhMgT_flgStTMdlIninCat1 ExhMgT_flgStTMdlIninCat2 ExhMgT_flgTBlwLowrThd2HiPrio ExhMgT_flgTBlwLowrThdHiPrio ExhMgT_flgTLightOffOnceRea ExhMgT_flgTUpprThd2HiPrio ExhMgT_flgTUpprThdHiPrio ExhMgT_flgTUpprThdLoPrio ExhMgT_stCatHeatg ExhMgT_stCatHeatgReqOld ExhMgT_stEquPrioCat ExhMgT_stTHiPrioCat ExhMgT_stTLoPrioCat ExhMgT_tCatHiPrioEngRunStop ExhMgT_tCatHiPrioSeln1 ExhMgT_tCatLoPrioSeln1 ExhMgT_tDeltaEngStopCatCoolg ExhMgT_tDesMinCatHiPrio ExhMgT_tDesMinCatLoPrio ExhMgT_tDifCatHeatgDmd ExhMgT_tDifCatHiPrioCatStrt ExhMgT_tDifCatSelnCatStrt ExhMgT_tDifThdCatHeatgDmd ExhMgT_tIntglCatSelnCatStrt ExhMgT_tThdCatHeatgCatHiPrio ExhMgT_tUpprThdCatHeatgHiPrio /end LOC_MEASUREMENT
 FUNCTION_VERSION "1.29.0" /end FUNCTION
/begin FUNCTION ExhMgT_DiagEtaIaCatHeatg "3.2.0     diagnosis of ignition timing efficiency during catalyst heating"
 /begin DEF_CHARACTERISTIC DYNMETKH DYRLETKH ENDEKHMNLL ENDEKHMNTL ExhMgT_effEngIdleNonCsersMax_M ExhMgT_effEngPtlNonCsersMax_M ExhMgT_stDiagEtaIaCatHeatg2_C ExhMgT_stDiagEtaIaCatHeatg3_C ExhMgT_stDiagEtaIaCatHeatg_C ExhMgT_tiHeatgIdleNonCsersMin_C ExhMgT_tiHeatgPtlNonCsersMin_C ExhMgT_tiRelsCsersIdle_C ExhMgT_tiRelsCsersPartLoad_C ExhMgT_tiRelsNonCsersIdle_C ExhMgT_tiRelsNonCsersPartLoad_C ExhMgT_tiTondNonCsers_C ExhMgT_vEnagEffCatHeat FHOETKH KFMXETKHFVLL KFMXETKHFVTL KLRLMDVERL MNTKHLL MNTKHTL TDDETAKH ZKETKHNM ZKETKHRL /end DEF_CHARACTERISTIC
 /begin IN_MEASUREMENT AirMod_ratChrgAirCyl B_ll_msg B_sa_msg CEngDsT_t Eep_EnvRamInvld Epm_nEng Epm_stSpd etakhdia_w_msg etazwist_w_msg ExhMgT_flgCatHeatgCsers ExhMgT_flgCatHeatgNonCsers fethmnmx_w_msg fmi2trq_w_msg fwsanfdlut_msg mdverl_w_msg mimaxud_w_msg PEnv_facCorrAlti PthSet_trqInrFlt SyC_ctPostDrvLeave SyC_stSub VehV_v /end IN_MEASUREMENT
 /begin OUT_MEASUREMENT B_dyetkh_msg B_edekhlmx_msg B_edekhtmx_msg B_endcsst_msg B_enetkhll_msg B_enetkhtl_msg B_enetkh_msg B_zdekhlmx_msg B_zdekhtmx_msg detkhlav_w_msg detkhtav_w_msg etkhlmx_msg etkhtmx_msg ExhMgT_rateffEngIdleNonCsersMax ExhMgT_rateffEngPtlNonCsersMax mxetkhll_w_msg mxetkhtl_w_msg /end OUT_MEASUREMENT
 /begin LOC_MEASUREMENT B_ekhllmx B_ekhtlmx detakhls_w detakhl_w detakhts_w detakht_w etakhko_w etakhlim_w etkhlmxloc etkhtmxloc ExhMgT_cntrReiniDiagEtaIaCatHeatg ExhMgT_effAvrgEngIdleNonCsers ExhMgT_effAvrgEngPtlNonCsers ExhMgT_effEngIdleNonCsersMax ExhMgT_effEngPtlNonCsersMax ExhMgT_effIntegEngIdleNonCsers ExhMgT_effIntegEngPtlNonCsers ExhMgT_flgCntDenumIdleCsers ExhMgT_flgCntDenumIdleNonCsers ExhMgT_flgCntDenumPartLoadCsers ExhMgT_flgCntDenumPartLoadNonCsers ExhMgT_flgCntDenumSepPartLoadCsers ExhMgT_flgCntDenumSepPartLoadNonCsers ExhMgT_flgDiagCsersIdle ExhMgT_flgDiagCsersPartLoad ExhMgT_flgDiagIdlePrms ExhMgT_flgDiagPartLoadPrms ExhMgT_flgEnaDiagIdleNonCsers ExhMgT_flgEnaDiagPtlNonCsers ExhMgT_flgErreffIdleNonCsers ExhMgT_flgErreffIdleNonCsersCurr ExhMgT_flgErreffPtlNonCsers ExhMgT_flgErreffPtlNonCsersCurr ExhMgT_flgEtaAbvThdCsersIdle ExhMgT_flgEtaAbvThdCsersPartLoad ExhMgT_flgEtaAbvThdNonCsersIdle ExhMgT_flgEtaAbvThdNonCsersPartLoad ExhMgT_flgEvlnBlwThdIdle ExhMgT_flgEvlnBlwThdIdleNonCsers ExhMgT_flgEvlnBlwThdPartLoad ExhMgT_flgEvlnBlwThdPartLoadNonCsers ExhMgT_flgFCMClrEtaCatHeatg ExhMgT_flgRelsIaThdIdle ExhMgT_flgRelsIaThdPartLoad ExhMgT_flgTstdeffIdleNonCsers ExhMgT_flgTstdeffPtlNonCsers ExhMgT_nEngDiffDiagCsers ExhMgT_nEngFildDiagCsers ExhMgT_ratChrgAirDiffDiagCsers ExhMgT_ratChrgAirFildDiagCsers ExhMgT_rateffEngIdleNonCsersMaxLoc ExhMgT_rateffEngPtlNonCsersMaxLoc ExhMgT_tEngDiagIaCatHeatg ExhMgT_tiHeatgIdleNonCsers ExhMgT_tiHeatgPtlNonCsers idetakhl_w idetakht_w tkhidle_w tkhpload_w /end LOC_MEASUREMENT
 FUNCTION_VERSION "3.2.0" /end FUNCTION
/begin FUNCTION ExhMgT_DmdCsersCdnCatHeatg "5.1.0     calculation of conditions if diagnoses are CSERS relevant" /begin DEF_CHARACTERISTIC ExhMgT_stDmdCsersCdnCatHeatg_C /end DEF_CHARACTERISTIC
 /begin IN_MEASUREMENT ExhMgT_flgCatHeatgColdStrtReq ExhMgT_flgCatHeatgFirstStrt ExhMgT_flgCatHeatgRepStrt ExhMgT_flgCatHeatgUpActv ExhMgT_flgCatHeatgWrmReq SyC_ctPostDrvLeave SyC_stSub /end IN_MEASUREMENT
 /begin OUT_MEASUREMENT ExhMgT_flgCatHeatgCsers ExhMgT_flgCatHeatgCsersReq ExhMgT_flgCatHeatgNonCsers ExhMgT_flgCatHeatgNonCsersReq ExhMgT_flgObdCarbCsers26 /end OUT_MEASUREMENT
 /begin LOC_MEASUREMENT ExhMgT_DmdCsersCdnCatHeatg_ctReIni /end LOC_MEASUREMENT
 FUNCTION_VERSION "5.1.0" /end FUNCTION
/begin FUNCTION ExhMgT_DmdOperModCatHeatg "6.13.0    Demand of Operation Mode for Catalyst Heating"
 /begin DEF_CHARACTERISTIC ExhMgT_effDeltaIdleOperMod_C ExhMgT_effThdIdleOperMod_T ExhMgT_facMaxCatHeatgDmdHSP_C ExhMgT_facMinCatHeatgDmdHSP_C ExhMgT_facRatEngSplt_T ExhMgT_nHysDeltaCatHeatg_C ExhMgT_nHysDeltaEomCatHeatg_C ExhMgT_ratAirChrgHeatgProgsDeltaHSP_C ExhMgT_ratAirChrgHeatgProgsMinHSP_C ExhMgT_ratHysDeltaCatHeatg_C ExhMgT_ratHysDeltaEomCatHeatg_C ExhMgT_stEomCatHeatg1_C ExhMgT_stEomCatHeatg2_C ExhMgT_stEomCatHeatg3_C ExhMgT_stOperModCatHeatg_C ExhMgT_stOperModCatWrm_C ExhMgT_stOperModPrioCatWrm_C ExhMgT_stOperModStgCatWrm_M ExhMgT_stPrioCatHeatg1_C ExhMgT_stPrioCatHeatg2_C ExhMgT_stPrioCatHeatg3_C ExhMgT_stStgCatHeatgEomMod1_M.idxSt_MAP ExhMgT_stStgCatHeatgEomMod2_M.idxSt_MAP ExhMgT_stStgCatHeatgEomMod3_M.idxSt_MAP ExhMgT_stStgCatHeatgEomMod4_M.idxSt_MAP ExhMgT_stStgHOM_C ExhMgT_stStgHSP_C ExhMgT_swtCatHeatg_C ExhMgT_tiFilFuM_C /end DEF_CHARACTERISTIC
 /begin IN_MEASUREMENT AirMod_ratChrgAirCyl CEngDsT_t CoEOM_percEngLoad Epm_nEng Epm_stSpd etakhkt_w_msg ExhMgT_facHeatgDmdCat ExhMgT_flgCatHeatgColdStrtReq ExhMgT_flgCatHeatgColdStrtWoFIdReq ExhMgT_flgCatHeatgUpActv ExhMgT_flgCatHeatgWrmReq ExhMgT_flgCatHeatgWrmWoFIdReq ExhMgT_tEngCatHeatgFild InjSys_ratFuM rl_w_msg SyC_ctPostDrvLeave SyC_stSub /end IN_MEASUREMENT
 /begin OUT_MEASUREMENT ExhMgT_CatHeatg1_I.stOperMod ExhMgT_CatHeatg1_I.stOperModPrio ExhMgT_CatHeatg1_I.stOperModStg ExhMgT_CatHeatg2_I.stOperMod ExhMgT_CatHeatg2_I.stOperModPrio ExhMgT_CatHeatg2_I.stOperModStg ExhMgT_CatHeatg3_I.stOperMod ExhMgT_CatHeatg3_I.stOperModPrio ExhMgT_CatHeatg3_I.stOperModStg ExhMgT_WrmSustReq_I.stOperMod ExhMgT_WrmSustReq_I.stOperModPrio ExhMgT_WrmSustReq_I.stOperModStg /end OUT_MEASUREMENT
 /begin LOC_MEASUREMENT ExhMgT_cntrReiniDmdOperModCatHeatg ExhMgT_flgCatHeatgDmdCond ExhMgT_flgColdStrtDmdCond ExhMgT_flgHSPCatHeatg ExhMgT_flgOperModWrmDmdCond ExhMgT_flgWrmDmdCond ExhMgT_nCatHeatgOperMod ExhMgT_ratCatHeatgOperMod ExhMgT_ratEngLoadDmdOperMod ExhMgT_ratFuMSeln ExhMgT_stOperModStgCatWrm ExhMgT_stStgCatHeatgEomMod1_M.idxDistbnXOld ExhMgT_stStgCatHeatgEomMod1_M.idxDistbnYOld ExhMgT_stStgCatHeatgEomMod2_M.idxDistbnXOld ExhMgT_stStgCatHeatgEomMod2_M.idxDistbnYOld ExhMgT_stStgCatHeatgEomMod3_M.idxDistbnXOld ExhMgT_stStgCatHeatgEomMod3_M.idxDistbnYOld ExhMgT_stStgCatHeatgEomMod4_M.idxDistbnXOld ExhMgT_stStgCatHeatgEomMod4_M.idxDistbnYOld ExhMgT_tEngCatHeatgOperMod ExhMgT_tEngDmdOperMod ExhMgT_tEngStrtDmdOperMod /end LOC_MEASUREMENT
 FUNCTION_VERSION "6.13.0" /end FUNCTION
/begin FUNCTION ExhMgT_IaDeltaCptProtn "1.7.0_1.1.0Calculation of Delta Ignition Angle for component protection"
 /begin DEF_CHARACTERISTIC ExhMgT_DeltaPredLoadCptProtn_T ExhMgT_fakWghtSecFuelCptProtn_T ExhMgT_IaCorrnCptProtn_M ExhMgT_IaCorrnSecFuCptProtn_M ExhMgT_stIaDeltaCptProtn_C ExhMgT_tExhCat1UsDelta_C ExhMgT_tExhCat1UsHi_C ExhMgT_tExhMnfIaDelta_C ExhMgT_tExhMnfIa_C TVLBTSDY /end DEF_CHARACTERISTIC
 /begin IN_MEASUREMENT AirMod_ratChrgAirCyl B_ethadap_msg B_ethhte_msg B_sa_msg Clth_st drlp_w_msg EngStrt_bStrtEnd Epm_nEng etazwist_w_msg ExhMgT_flgActvCptProtnTExh ExhMod_effIgnAgAvrgB1 ExhMod_tExhCat1UsB1 ExhMod_tExhMnfB1 fethmnmx_w_msg Gbx_bTSCIntv IgCtl_iaPrimMinCptProtnIntv Ign_iaPr_s8 SyC_ctPostDrvLeave SyC_stSub zwopt_w_msg /end IN_MEASUREMENT
 /begin OUT_MEASUREMENT ExhMgT_fakWghtSecFuelCptProtn ExhMgT_flgIaDeltaCorrn ExhMgT_flgIaIgnDeltaCptProtn ExhMgT_flgIaIgnDeltaLoadCptProtn ExhMgT_iaDeltaCptProtn /end OUT_MEASUREMENT
 /begin LOC_MEASUREMENT etazwg_w ExhMgT_cntrReIniIaDeltaCptProtn ExhMgT_flgIaIgnDeltaLoadCat1 ExhMgT_flgIaIgnDeltaLoadMnf ExhMgT_flgIaIng ExhMgT_IaCptProtn /end LOC_MEASUREMENT
 FUNCTION_VERSION "1.7.0_1.1.0" /end FUNCTION
/begin FUNCTION ExhMgT_LamCptProtn "20.2.1    Calculation of lambda for component protection"
 /begin DEF_CHARACTERISTIC DLBTSGANG DLBTSTMOT DLBTSVFZG DRLMXBTS ExhMgT_facBldFillgCptProtnGov_T ExhMgT_facCptProtnMisf_T ExhMgT_facDeltaLamIntkAirTCptProtn_GM ExhMgT_facRatLamCptProtnStrt_C ExhMgT_facRdcFillgCptProtnFast_T ExhMgT_facRednCptProtn_T ExhMgT_ratCptProtnLimpCamsft_GM ExhMgT_ratDeltaLamCptProtnIng_GM ExhMgT_ratDeltaLamIntkAirTCptProtn_T ExhMgT_ratLamCptProtnMin_GM ExhMgT_ratLamCptProtn_GM ExhMgT_stLamCptProtn_C ExhMgT_tiAvdSootEgrCptProtn_C ExhMgT_tiDeltaAvdSootEgrCptProtn_C ExhMgT_tiDeltaIgnAvdSootEgrCptProtn_C ExhMgT_tiDlyActvtRdcAirFillg_C ExhMgT_tiDlyRdcAirFillg_C ExhMgT_tifacRdcAirFillg_C ExhMgT_tiIgnAvdSootEgrCptProtn_C ExhMgT_tiLamMegaKnkUp_C ExhMgT_tRefIntkAirTCptProtn_GM FRLBTSMN KFDETAZWLONE KFDETAZWLONEAGR KFFDLBTS KFFDLBTSSFL KFLBTSBGSFL KFLBTSDY KFLBTSDYRI KFLBTSSFL KFLBTSSFLVS KFLBTSVS KLFINTPLZW KLSKLBTSNM KLZKLBTDY KLZWDLBTS SDETA08UW SNM16GKUW SRL15GKUW /end DEF_CHARACTERISTIC
 /begin REF_CHARACTERISTIC CWEVMZVE /end REF_CHARACTERISTIC
 /begin IN_MEASUREMENT AirMod_ratChrgAirCyl B_agrbb_msg B_agrvo_msg B_atr_msg B_bevab_msg B_ethadap_msg B_ethhte_msg B_lalgf_msg B_ll_msg CEngDsT_t dlamatr_w_msg EngStrt_bStrtEnd Epm_nEng etazwb_w_msg etazwmn_w_msg ExhMgT_facLamCptProtnTExh ExhMgT_fakWghtSecFuelCptProtn ExhMgT_flgActvCptProtnTExh ExhMgT_flgErrCamsft ExhMgT_flgIaDeltaCorrn ExhMgT_flgIaIgnDeltaCptProtn ExhMgT_flgIaIgnDeltaLoadCptProtn ExhMgT_iaDeltaCptProtn ExhMgT_ratDeltaLamLimp ExhMgT_tMinTExhCptProtnGlb ftrq2mi_w_msg fwnwe_msg gangsist_msg GEVCtl_flgStdLftChrgDetrmIntk IKCtl_flgReqEnchmt IKCtl_flgReqInjTiCyl IKCtl_numReqInjTi IntkAirT_tThrVlvUs MisfDet_stCatDmgFcoCyl ml_w_msg PT_trqCrSWoIntv rlsol_w_msg SyC_stSub VehV_v /end IN_MEASUREMENT
 /begin OUT_MEASUREMENT bdemodbs_msg B_agrofflbts_msg B_fuabts_msg B_lambts_msg ExhMgT_facCptProtnMisf ExhMgT_facRdcAirFillg ExhMgT_flgCptnProtnLimpCamsft ExhMgT_ratLamPreIgnCtlCptProtn frlmxbts_w_msg lambs_w_msg lambts_w_msg lbtsbgmn_w_msg lbtsskr_w_msg /end OUT_MEASUREMENT
 /begin LOC_MEASUREMENT B_lbtsbg dlbtszwr_w ExhMgT_facFirstRdcAirFillg ExhMgT_facMinRednCptProtn ExhMgT_facRdcAirFillgCptProtn ExhMgT_flgLamMegaKnkDetn ExhMgT_flgRdcAirFillg ExhMgT_flgRstFacRdcAirFillg ExhMgT_flgSpclLft ExhMgT_iaDeltaCptProtnCorr ExhMgT_ratDeltaLamCptProtn ExhMgT_ratDeltaLamCptProtnIgn ExhMgT_ratDeltaLamCptProtnTot1 ExhMgT_ratLamAgKnkCtrl ExhMgT_ratLamCptProtnIgn ExhMgT_ratLamMinCptProtnB1 ExhMgT_stIdleDetnCptProtn lbtarsv_w lbtsaw_w lbtsbgmn_w lbtsffv_w lbtsgs_w lbtsmnsp_w lbtsskf_w lbtsskrmin_w miwointv_w /end LOC_MEASUREMENT
 FUNCTION_VERSION "20.2.1" /end FUNCTION
/begin COMPU_METHOD adb_uw_q0p00195 "" RAT_FUNC "%6.4" "hPa/V" COEFFS 0 65536 0 0 0 128 /end COMPU_METHOD
/begin COMPU_METHOD B_TRUE "" TAB_VERB "%6.3" "" COMPU_TAB_REF B_TRUE /end COMPU_METHOD
/begin COMPU_VTAB B_TRUE "" TAB_VERB 2 0 "FALSE" 1 "TRUE" /end COMPU_VTAB
/begin COMPU_METHOD dez "" RAT_FUNC "%6.2" "" COEFFS 0 1 0 0 0 1 /end COMPU_METHOD
/begin COMPU_METHOD EngN "" RAT_FUNC "%6.3" "rpm" COEFFS 0 2 0 0 0 1 /end COMPU_METHOD
/begin COMPU_METHOD Fact "" RAT_FUNC "%6.5" "-" COEFFS 0 8192 0 0 0 1 /end COMPU_METHOD
/begin COMPU_METHOD fak_q3p0518Em5 "" RAT_FUNC "%7.6" "" COEFFS 0 32768 0 0 0 1 /end COMPU_METHOD
/begin COMPU_METHOD fak_q3p0518Em7 "" RAT_FUNC "%9.8" "" COEFFS 0 65536 0 0 0 0.02 /end COMPU_METHOD
/begin COMPU_METHOD fak_sb_b64 "" RAT_FUNC "%6.3" "-" COEFFS 0 256 0 0 0 128 /end COMPU_METHOD
/begin COMPU_METHOD fak_sw_b1 "" RAT_FUNC "%7.6" "-" COEFFS 0 65536 0 0 0 2 /end COMPU_METHOD
/begin COMPU_METHOD fak_sw_b4 "" RAT_FUNC "%6.5" "-" COEFFS 0 65536 0 0 0 8 /end COMPU_METHOD
/begin COMPU_METHOD fak_sw_b64 "" RAT_FUNC "%6.4" "-" COEFFS 0 65536 0 0 0 128 /end COMPU_METHOD
/begin COMPU_METHOD fak_sw_b8 "" RAT_FUNC "%6.5" "-" COEFFS 0 65536 0 0 0 16 /end COMPU_METHOD
/begin COMPU_METHOD fak_ub_b1 "" RAT_FUNC "%6.4" "-" COEFFS 0 256 0 0 0 1 /end COMPU_METHOD
/begin COMPU_METHOD fak_ub_b2 "" RAT_FUNC "%8.5" "-" COEFFS 0 256 0 0 0 2 /end COMPU_METHOD
/begin COMPU_METHOD fak_uw_b1 "" RAT_FUNC "%7.6" "-" COEFFS 0 65536 0 0 0 1 /end COMPU_METHOD
/begin COMPU_METHOD fak_uw_b16 "" RAT_FUNC "%6.5" "-" COEFFS 0 65536 0 0 0 16 /end COMPU_METHOD
/begin COMPU_METHOD fak_uw_b2 "" RAT_FUNC "%7.6" "-" COEFFS 0 65536 0 0 0 2 /end COMPU_METHOD
/begin COMPU_METHOD fak_uw_b4 "" RAT_FUNC "%7.6" "-" COEFFS 0 65536 0 0 0 4 /end COMPU_METHOD
/begin COMPU_METHOD fak_uw_b8 "" RAT_FUNC "%6.5" "-" COEFFS 0 65536 0 0 0 8 /end COMPU_METHOD
/begin COMPU_METHOD k100ms_uw_b10 "" RAT_FUNC "%6.5" "1/s" COEFFS 0 65536 0 0 0 10 /end COMPU_METHOD
/begin COMPU_METHOD km_sw_q1 "" RAT_FUNC "%6.2" "" COEFFS 0 1 0 0 0 1 /end COMPU_METHOD
/begin COMPU_METHOD LAMCOORNEXHTINT_SC_Compu "" TAB_VERB "%6.3" "" COMPU_TAB_REF LAMCOORNEXHTINT_SC_Compu /end COMPU_METHOD
/begin COMPU_VTAB LAMCOORNEXHTINT_SC_Compu "" TAB_VERB 2 0 "False" 1 "True" /end COMPU_VTAB
/begin COMPU_METHOD LAMCORENGTEMP_SY_Compu "" TAB_VERB "%6.3" "" COMPU_TAB_REF LAMCORENGTEMP_SY_Compu /end COMPU_METHOD
/begin COMPU_VTAB LAMCORENGTEMP_SY_Compu "" TAB_VERB 2 0 "False" 1 "True" /end COMPU_VTAB
/begin COMPU_METHOD LAMCTRLCONTNSHEGO_SC_Compu "" TAB_VERB "%6.3" "" COMPU_TAB_REF LAMCTRLCONTNSHEGO_SC_Compu /end COMPU_METHOD
/begin COMPU_VTAB LAMCTRLCONTNSHEGO_SC_Compu "" TAB_VERB 2 0 "False" 1 "True" /end COMPU_VTAB
/begin COMPU_METHOD LAMCTRL_GAINCHGENGT_SC_Compu "" TAB_VERB "%6.3" "" COMPU_TAB_REF LAMCTRL_GAINCHGENGT_SC_Compu /end COMPU_METHOD
/begin COMPU_VTAB LAMCTRL_GAINCHGENGT_SC_Compu "" TAB_VERB 2 0 "False" 1 "True" /end COMPU_VTAB
/begin COMPU_METHOD LAMCTRL_GAINCHGTIAFTSTRT_SC_Compu "" TAB_VERB "%6.3" "" COMPU_TAB_REF LAMCTRL_GAINCHGTIAFTSTRT_SC_Compu /end COMPU_METHOD
/begin COMPU_VTAB LAMCTRL_GAINCHGTIAFTSTRT_SC_Compu "" TAB_VERB 2 0 "False" 1 "True" /end COMPU_VTAB
/begin COMPU_METHOD LASP_SY_Compu "" TAB_VERB "%6.3" "" COMPU_TAB_REF LASP_SY_Compu /end COMPU_METHOD
/begin COMPU_VTAB LASP_SY_Compu "" TAB_VERB 2 0 "Lambda-Split no active" 1 "Lambda-Split active" /end COMPU_VTAB
/begin COMPU_METHOD LDCOM_SC_Compu "" TAB_VERB "%6.3" "" COMPU_TAB_REF LDCOM_SC_Compu /end COMPU_METHOD
/begin COMPU_VTAB LDCOM_SC_Compu "" TAB_VERB 2 0 "False" 1 "True" /end COMPU_VTAB
/begin COMPU_METHOD LengthFine "" RAT_FUNC "%6.5" "m" COEFFS 0 1000 0 0 0 1 /end COMPU_METHOD
/begin COMPU_METHOD LengthKm "" RAT_FUNC "%6.1" "Km" COEFFS 0 0.05 0 0 0 1 /end COMPU_METHOD
/begin COMPU_METHOD LengthMm "" RAT_FUNC "%6.2" "mm" COEFFS 0 1 0 0 0 1 /end COMPU_METHOD
/begin COMPU_METHOD Len_Km_q0p00001_COMPU "" RAT_FUNC "%8.7" "Km" COEFFS 0 100000 0 0 0 1 /end COMPU_METHOD
/begin COMPU_METHOD len_q0p0007629_m "" RAT_FUNC "%6.5" "m" COEFFS 0 65536 0 0 0 50 /end COMPU_METHOD
/begin COMPU_METHOD LGTASNSR_SC_Compu "" TAB_VERB "%6.3" "" COMPU_TAB_REF LGTASNSR_SC_Compu /end COMPU_METHOD
/begin COMPU_VTAB LGTASNSR_SC_Compu "" TAB_VERB 2 0 "False" 1 "True" /end COMPU_VTAB
/begin COMPU_METHOD LICTRLAVL_SC_Compu "" TAB_VERB "%6.3" "" COMPU_TAB_REF LICTRLAVL_SC_Compu /end COMPU_METHOD
/begin COMPU_VTAB LICTRLAVL_SC_Compu "" TAB_VERB 2 0 "False" 1 "True" /end COMPU_VTAB
/begin COMPU_METHOD LIGOV_CHGEAR_SY_Compu "" TAB_VERB "%6.3" "" COMPU_TAB_REF LIGOV_CHGEAR_SY_Compu /end COMPU_METHOD
/begin COMPU_VTAB LIGOV_CHGEAR_SY_Compu "" TAB_VERB 2 0 "False" 1 "True" /end COMPU_VTAB
/begin COMPU_METHOD LIGOV_CHSTRT_SY_Compu "" TAB_VERB "%6.3" "" COMPU_TAB_REF LIGOV_CHSTRT_SY_Compu /end COMPU_METHOD
/begin COMPU_VTAB LIGOV_CHSTRT_SY_Compu "" TAB_VERB 2 0 "False" 1 "True" /end COMPU_VTAB
/begin COMPU_METHOD LIGOV_HDC_SY_Compu "" TAB_VERB "%6.3" "" COMPU_TAB_REF LIGOV_HDC_SY_Compu /end COMPU_METHOD
/begin COMPU_VTAB LIGOV_HDC_SY_Compu "" TAB_VERB 2 0 "False" 1 "True" /end COMPU_VTAB
/begin COMPU_METHOD LIGOV_NUMIPAR_SY_Compu "" RAT_FUNC "%6.2" "" COEFFS 0 1 0 0 0 1 /end COMPU_METHOD
/begin COMPU_METHOD LIGOV_NUMPARCNVSIZE_SC_Compu "" RAT_FUNC "%6.2" "" COEFFS 0 1 0 0 0 1 /end COMPU_METHOD
/begin COMPU_METHOD LIGOV_NUMPPAR_SY_Compu "" RAT_FUNC "%6.2" "" COEFFS 0 1 0 0 0 1 /end COMPU_METHOD
/begin COMPU_METHOD LIGOV_PRECTLD_SY_Compu "" TAB_VERB "%6.3" "" COMPU_TAB_REF LIGOV_PRECTLD_SY_Compu /end COMPU_METHOD
/begin COMPU_VTAB LIGOV_PRECTLD_SY_Compu "" TAB_VERB 2 0 "False" 1 "True" /end COMPU_VTAB
/begin COMPU_METHOD LIGOV_SEPPRECTL_SY_Compu "" TAB_VERB "%6.3" "" COMPU_TAB_REF LIGOV_SEPPRECTL_SY_Compu /end COMPU_METHOD
/begin COMPU_VTAB LIGOV_SEPPRECTL_SY_Compu "" TAB_VERB 2 0 "False" 1 "True" /end COMPU_VTAB
/begin COMPU_METHOD LIMENGTEMP_SY_Compu "" TAB_VERB "%6.3" "" COMPU_TAB_REF LIMENGTEMP_SY_Compu /end COMPU_METHOD
/begin COMPU_VTAB LIMENGTEMP_SY_Compu "" TAB_VERB 2 0 "False" 1 "True" /end COMPU_VTAB
/begin COMPU_METHOD LIMEXHTEMP_SY_Compu "" TAB_VERB "%6.3" "" COMPU_TAB_REF LIMEXHTEMP_SY_Compu /end COMPU_METHOD
/begin COMPU_VTAB LIMEXHTEMP_SY_Compu "" TAB_VERB 2 0 "False" 1 "True" /end COMPU_VTAB
/begin COMPU_METHOD LIMMAXCHRGICINGTHRPCV_SC_Compu "" TAB_VERB "%6.3" "" COMPU_TAB_REF LIMMAXCHRGICINGTHRPCV_SC_Compu /end COMPU_METHOD
/begin COMPU_VTAB LIMMAXCHRGICINGTHRPCV_SC_Compu "" TAB_VERB 2 0 "False" 1 "True" /end COMPU_VTAB
/begin COMPU_METHOD LIMNMNFLDT_SC_Compu "" TAB_VERB "%6.3" "" COMPU_TAB_REF LIMNMNFLDT_SC_Compu /end COMPU_METHOD
/begin COMPU_VTAB LIMNMNFLDT_SC_Compu "" TAB_VERB 2 0 "False" 1 "True" /end COMPU_VTAB
/begin COMPU_METHOD LINIPCORETYPE_SC_Compu "" TAB_VERB "%6.3" "" COMPU_TAB_REF LINIPCORETYPE_SC_Compu /end COMPU_METHOD
/begin COMPU_VTAB LINIPCORETYPE_SC_Compu "" TAB_VERB 2 0 "0" 1 "1" /end COMPU_VTAB
/begin COMPU_METHOD LIN_SY_Compu "" TAB_VERB "%6.3" "" COMPU_TAB_REF LIN_SY_Compu /end COMPU_METHOD
/begin COMPU_VTAB LIN_SY_Compu "" TAB_VERB 2 0 "False" 1 "True" /end COMPU_VTAB
/begin COMPU_METHOD LIVC_SC_Compu "" TAB_VERB "%6.3" "" COMPU_TAB_REF LIVC_SC_Compu /end COMPU_METHOD
/begin COMPU_VTAB LIVC_SC_Compu "" TAB_VERB 2 0 "no_LIVC" 1 "LIVC" /end COMPU_VTAB
/begin COMPU_METHOD LLKE_SY_Compu "" TAB_VERB "%6.3" "" COMPU_TAB_REF LLKE_SY_Compu /end COMPU_METHOD
/begin COMPU_VTAB LLKE_SY_Compu "" TAB_VERB 2 0 "0" 1 "1" /end COMPU_VTAB
/begin COMPU_METHOD LLRNSNF_FZNSMGASIZE_SY_Compu "" RAT_FUNC "%6.2" "" COEFFS 0 1 0 0 0 1 /end COMPU_METHOD
/begin COMPU_METHOD LLZWAZ_SY_Compu "" TAB_VERB "%6.3" "" COMPU_TAB_REF LLZWAZ_SY_Compu /end COMPU_METHOD
/begin COMPU_VTAB LLZWAZ_SY_Compu "" TAB_VERB 2 0 "False" 1 "True" /end COMPU_VTAB
/begin COMPU_METHOD LNCHCTRL_SC_Compu "" TAB_VERB "%6.3" "" COMPU_TAB_REF LNCHCTRL_SC_Compu /end COMPU_METHOD
/begin COMPU_VTAB LNCHCTRL_SC_Compu "" TAB_VERB 2 0 "False" 1 "True" /end COMPU_VTAB
/begin COMPU_METHOD md_q0p1 "" RAT_FUNC "%6.3" "Nm" COEFFS 0 10 0 0 0 1 /end COMPU_METHOD
/begin COMPU_METHOD m_3p47222Em4_g "" RAT_FUNC "%6.5" "g" COEFFS 0 2880 0 0 0 1 /end COMPU_METHOD
/begin COMPU_METHOD m_ub_q0p0444 "" RAT_FUNC "%6.4" "g" COEFFS 0 1 0 0 0 0.0444 /end COMPU_METHOD
/begin COMPU_METHOD m_uw_b6553p5 "" RAT_FUNC "%6.3" "kg/h" COEFFS 0 1 0 0 0 0.1 /end COMPU_METHOD
/begin COMPU_METHOD OneToOne "" RAT_FUNC "%6.2" "-" COEFFS 0 1 0 0 0 1 /end COMPU_METHOD
/begin COMPU_METHOD p_q0p00122 "" RAT_FUNC "%6.4" "hPa" COEFFS 0 65536 0 0 0 80 /end COMPU_METHOD
/begin COMPU_METHOD p_q0p3125 "" RAT_FUNC "%6.3" "hPa" COEFFS 0 256 0 0 0 80 /end COMPU_METHOD
/begin COMPU_METHOD p_sb_q0p625 "" RAT_FUNC "%6.3" "hPa" COEFFS 0 128 0 0 0 80 /end COMPU_METHOD
/begin COMPU_METHOD p_sw_q0p00244 "" RAT_FUNC "%6.4" "hPa" COEFFS 0 32768 0 0 0 80 /end COMPU_METHOD
/begin COMPU_METHOD q0p1_K "" RAT_FUNC "%6.3" "K" COEFFS 0 100 0 0 0 10 /end COMPU_METHOD
/begin COMPU_METHOD rel_q0p0234 "" RAT_FUNC "%6.4" "%" COEFFS 0 128 0 0 0 3 /end COMPU_METHOD
/begin COMPU_METHOD rel_q0p78125 "" RAT_FUNC "%6.3" "%" COEFFS 0 256 0 0 0 200 /end COMPU_METHOD
/begin COMPU_METHOD rel_sw_q0p0234 "" RAT_FUNC "%6.4" "%/seg" COEFFS 0 32 0 0 0 0.75 /end COMPU_METHOD
/begin COMPU_METHOD rel_uw_b100 "" RAT_FUNC "%6.4" "%" COEFFS 0 65536 0 0 0 100 /end COMPU_METHOD
/begin COMPU_METHOD rel_uw_b3072 "" RAT_FUNC "%6.4" "%" COEFFS 0 65536 0 0 0 3072 /end COMPU_METHOD
/begin COMPU_METHOD rel_uw_q0p0234 "" RAT_FUNC "%6.4" "%" COEFFS 0 32 0 0 0 0.75 /end COMPU_METHOD
/begin COMPU_METHOD spg_q0p00488 "" RAT_FUNC "%6.4" "V" COEFFS 0 1024 0 0 0 5 /end COMPU_METHOD
/begin COMPU_METHOD t100msxs_ub_b25p5 "" RAT_FUNC "%6.3" "s" COEFFS 0 1 0 0 0 0.1 /end COMPU_METHOD
/begin COMPU_METHOD TempK_float "" RAT_FUNC "%6.2" "K" COEFFS 0 1 0 0 0 1 /end COMPU_METHOD
/begin COMPU_METHOD Temp_Cels "" RAT_FUNC "%6.1" "deg C" COEFFS 0 10 2731.4 0 0 1 /end COMPU_METHOD
/begin COMPU_METHOD Temp_Kelv "" RAT_FUNC "%6.3" "K" COEFFS 0 10 0 0 0 1 /end COMPU_METHOD
/begin COMPU_METHOD temp_q0p0468_K "" RAT_FUNC "%6.4" "Grad K" COEFFS 0 256 0 0 0 12 /end COMPU_METHOD
/begin COMPU_METHOD temp_q0p1 "" RAT_FUNC "%6.3" "Grad C" COEFFS 0 10 0 0 0 1 /end COMPU_METHOD
/begin COMPU_METHOD temp_q0p1_K "" RAT_FUNC "%6.3" "K" COEFFS 0 10 0 0 0 1 /end COMPU_METHOD
/begin COMPU_METHOD temp_q0p1_o273 "" RAT_FUNC "%6.1" "Grad C" COEFFS 0 10 2731.4 0 0 1 /end COMPU_METHOD
/begin COMPU_METHOD t_q0p01 "" RAT_FUNC "%6.4" "s" COEFFS 0 100 0 0 0 1 /end COMPU_METHOD
/begin COMPU_METHOD t_q0p1 "" RAT_FUNC "%6.3" "s" COEFFS 0 10 0 0 0 1 /end COMPU_METHOD
/begin COMPU_METHOD Vel "" RAT_FUNC "%6.4" "km/h" COEFFS 0 100 0 0 0 1 /end COMPU_METHOD
/begin COMPU_METHOD vfzg_uw_b512 "" RAT_FUNC "%6.4" "km/h" COEFFS 0 65536 0 0 0 512 /end COMPU_METHOD
/begin COMPU_METHOD vol_q0p1_l "" RAT_FUNC "%6.3" "l" COEFFS 0 1 0 0 0 0.1 /end COMPU_METHOD
/begin COMPU_METHOD zk100msxs_ub_b25p5 "" RAT_FUNC "%6.3" "s" COEFFS 0 0 256 0 10 0 /end COMPU_METHOD
/begin COMPU_METHOD zk100msxs_uw_b6553p6 "" RAT_FUNC "%6.1" "s" COEFFS 0 0 65536 0 10 0 /end COMPU_METHOD
/begin COMPU_METHOD zk10msxs_ub_b2p56 "" RAT_FUNC "%6.4" "s" COEFFS 0 0 256 0 100 0 /end COMPU_METHOD
/begin COMPU_METHOD zk10msxs_uw_b655p36 "" RAT_FUNC "%6.2" "s" COEFFS 0 0 65536 0 100 0 /end COMPU_METHOD
/begin COMPU_METHOD zw_q2p9297Em3_deg_KW "" RAT_FUNC "%6.4" "deg KW" COEFFS 0 1024 0 0 0 3 /end COMPU_METHOD
/begin RECORD_LAYOUT RB_Axis_S16 NO_AXIS_PTS_X 1 SWORD AXIS_PTS_X 2 SWORD INDEX_INCR DIRECT /end RECORD_LAYOUT
/begin RECORD_LAYOUT RB_Axis_U16 NO_AXIS_PTS_X 1 UWORD AXIS_PTS_X 2 UWORD INDEX_INCR DIRECT /end RECORD_LAYOUT
/begin RECORD_LAYOUT RB_Curve_S16_S16 NO_AXIS_PTS_X 1 SWORD AXIS_PTS_X 2 SWORD INDEX_INCR DIRECT FNC_VALUES 3 SWORD COLUMN_DIR DIRECT /end RECORD_LAYOUT
/begin RECORD_LAYOUT RB_Curve_S16_U16_Static NO_AXIS_PTS_X 1 SWORD AXIS_PTS_X 2 SWORD INDEX_INCR DIRECT FNC_VALUES 3 UWORD COLUMN_DIR DIRECT STATIC_RECORD_LAYOUT /end RECORD_LAYOUT
/begin RECORD_LAYOUT RB_Curve_U16_S16_Static NO_AXIS_PTS_X 1 UWORD AXIS_PTS_X 2 UWORD INDEX_INCR DIRECT FNC_VALUES 3 SWORD COLUMN_DIR DIRECT STATIC_RECORD_LAYOUT /end RECORD_LAYOUT
/begin RECORD_LAYOUT RB_Curve_U16_S8_Static NO_AXIS_PTS_X 1 UWORD AXIS_PTS_X 2 UWORD INDEX_INCR DIRECT FNC_VALUES 3 SBYTE COLUMN_DIR DIRECT STATIC_RECORD_LAYOUT /end RECORD_LAYOUT
/begin RECORD_LAYOUT RB_Curve_U16_U16 NO_AXIS_PTS_X 1 UWORD AXIS_PTS_X 2 UWORD INDEX_INCR DIRECT FNC_VALUES 3 UWORD COLUMN_DIR DIRECT /end RECORD_LAYOUT
/begin RECORD_LAYOUT RB_Curve_U16_U8_Static NO_AXIS_PTS_X 1 UWORD AXIS_PTS_X 2 UWORD INDEX_INCR DIRECT FNC_VALUES 3 UBYTE COLUMN_DIR DIRECT STATIC_RECORD_LAYOUT /end RECORD_LAYOUT
/begin RECORD_LAYOUT RB_MapGroup_S16 FNC_VALUES 1 SWORD COLUMN_DIR DIRECT /end RECORD_LAYOUT
/begin RECORD_LAYOUT RB_MapGroup_U16 FNC_VALUES 1 UWORD COLUMN_DIR DIRECT /end RECORD_LAYOUT
/begin RECORD_LAYOUT RB_Map_S16S16_S16 NO_AXIS_PTS_X 1 SWORD NO_AXIS_PTS_Y 2 SWORD AXIS_PTS_X 3 SWORD INDEX_INCR DIRECT AXIS_PTS_Y 4 SWORD INDEX_INCR DIRECT FNC_VALUES 5 SWORD COLUMN_DIR DIRECT /end RECORD_LAYOUT
/begin RECORD_LAYOUT RB_Map_S16U16_S16 NO_AXIS_PTS_X 1 SWORD NO_AXIS_PTS_Y 2 SWORD AXIS_PTS_X 3 SWORD INDEX_INCR DIRECT AXIS_PTS_Y 4 UWORD INDEX_INCR DIRECT FNC_VALUES 5 SWORD ROW_DIR DIRECT /end RECORD_LAYOUT
/begin RECORD_LAYOUT RB_Map_S16U16_U16 NO_AXIS_PTS_X 1 SWORD NO_AXIS_PTS_Y 2 SWORD AXIS_PTS_X 3 SWORD INDEX_INCR DIRECT AXIS_PTS_Y 4 UWORD INDEX_INCR DIRECT FNC_VALUES 5 UWORD ROW_DIR DIRECT /end RECORD_LAYOUT
/begin RECORD_LAYOUT RB_Map_U16S16_U16 NO_AXIS_PTS_X 1 UWORD NO_AXIS_PTS_Y 2 UWORD AXIS_PTS_X 3 UWORD INDEX_INCR DIRECT AXIS_PTS_Y 4 SWORD INDEX_INCR DIRECT FNC_VALUES 5 UWORD COLUMN_DIR DIRECT /end RECORD_LAYOUT
/begin RECORD_LAYOUT RB_Map_U16U16_U16 NO_AXIS_PTS_X 1 UWORD NO_AXIS_PTS_Y 2 UWORD AXIS_PTS_X 3 UWORD INDEX_INCR DIRECT AXIS_PTS_Y 4 UWORD INDEX_INCR DIRECT FNC_VALUES 5 UWORD COLUMN_DIR DIRECT /end RECORD_LAYOUT
/begin RECORD_LAYOUT RB_Map_U8U16_U16 NO_AXIS_PTS_X 1 UBYTE NO_AXIS_PTS_Y 2 UBYTE AXIS_PTS_X 3 UBYTE INDEX_INCR DIRECT AXIS_PTS_Y 4 UWORD INDEX_INCR DIRECT FNC_VALUES 5 UWORD ROW_DIR DIRECT /end RECORD_LAYOUT
/begin RECORD_LAYOUT RB_ValA_Wu8 FNC_VALUES 1 UBYTE COLUMN_DIR DIRECT /end RECORD_LAYOUT
/begin RECORD_LAYOUT RB_Val_Wr32 FNC_VALUES 1 FLOAT32_IEEE COLUMN_DIR DIRECT /end RECORD_LAYOUT
/begin RECORD_LAYOUT RB_Val_Ws16 FNC_VALUES 1 SWORD COLUMN_DIR DIRECT /end RECORD_LAYOUT
/begin RECORD_LAYOUT RB_Val_Ws8 FNC_VALUES 1 SBYTE COLUMN_DIR DIRECT /end RECORD_LAYOUT
/begin RECORD_LAYOUT RB_Val_Wu16 FNC_VALUES 1 UWORD COLUMN_DIR DIRECT /end RECORD_LAYOUT
/begin RECORD_LAYOUT RB_Val_Wu32 FNC_VALUES 1 ULONG COLUMN_DIR DIRECT /end RECORD_LAYOUT
/begin RECORD_LAYOUT RB_Val_Wu8 FNC_VALUES 1 UBYTE COLUMN_DIR DIRECT /end RECORD_LAYOUT
/end MODULE
/end PROJECT
