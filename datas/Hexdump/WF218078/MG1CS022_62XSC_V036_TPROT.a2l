ASAP2_VERSION 1 60
/begin PROJECT MG1CS022 "MG1CS022"
/begin HEADER "" VERSION "MG1CS022_62XSC_V036_TPROT" PROJECT_NO MG1CS022 /end HEADER
/begin MODULE DIM ""
/begin MOD_COMMON "" BYTE_ORDER MSB_LAST ALIGNMENT_BYTE 1 ALIGNMENT_WORD 2 ALIGNMENT_LONG 4 ALIGNMENT_INT64 4 ALIGNMENT_FLOAT32_IEEE 4 ALIGNMENT_FLOAT64_IEEE 4 DATA_SIZE 32 /end MOD_COMMON
/begin CHARACTERISTIC CrCtl_facACCECOnAAppUp3_CUR "Acceleration factor for changing APP limitation number for ECON to 4 from 3 (for Acceleration , ECON sw ON, and during ACC)" CURVE 0x805349D0 RB_Cur_Xs16Ws16 0.9960938 Fact_CrCtl 0.00 0.9960938 FORMAT "%9.7" EXTENDED_LIMITS -128.0000 127.9961
 /begin AXIS_DESCR STD_AXIS CrCtl_tiDRAccnControl_mp Time_ms_100ms 6 -3276800. 3276700. FORMAT "%8.0" DEPOSIT ABSOLUTE /end AXIS_DESCR
/end CHARACTERISTIC
/begin CHARACTERISTIC CrCtl_facACCECOnAAppUp4_CUR "Acceleration factor for changing APP limitation number for ECON to 5 from 4 (for Acceleration , ECON sw ON, and during ACC)" CURVE 0x805349EA RB_Cur_Xs16Ws16 0.9960938 Fact_CrCtl 0.00 0.9960938 FORMAT "%9.7" EXTENDED_LIMITS -128.0000 127.9961
 /begin AXIS_DESCR STD_AXIS CrCtl_tiDRAccnControl_mp Time_ms_100ms 6 -3276800. 3276700. FORMAT "%8.0" DEPOSIT ABSOLUTE /end AXIS_DESCR
/end CHARACTERISTIC
/begin CHARACTERISTIC CrCtl_facACCECOnAAppUp5_CUR "Slope for changing APP limitation number for ECON to 1 from 2 (for ECON sw OFF)" CURVE 0x80534A04 RB_Cur_Xs16Ws16 0.9960938 Fact_CrCtl 0.00 0.9960938 FORMAT "%9.7" EXTENDED_LIMITS -128.0000 127.9961
 /begin AXIS_DESCR STD_AXIS CrCtl_tiDRAccnControl_mp Time_ms_100ms 6 -3276800. 3276700. FORMAT "%8.0" DEPOSIT ABSOLUTE /end AXIS_DESCR
/end CHARACTERISTIC
/begin CHARACTERISTIC CrCtl_facACCECOnAFbUp2_CUR "Acceleration factor for changing APP limitation number for ECON to 3 from 2 (for FB, ECON sw ON, and during ACC)" CURVE 0x80534A1E RB_Cur_Xs16Ws16 0.9960938 Fact_CrCtl 0.00 0.9960938 FORMAT "%9.7" EXTENDED_LIMITS -128.0000 127.9961
 /begin AXIS_DESCR STD_AXIS CrCtl_vSpdVar_mp Vel_CrCtl 6 -128.0000 127.9961 FORMAT "%8.4" DEPOSIT ABSOLUTE /end AXIS_DESCR
/end CHARACTERISTIC
/begin CHARACTERISTIC CrCtl_facACCECOnAFbUp3_CUR "Acceleration factor for changing APP limitation number for ECON to 4 from 3 (for FB, ECON sw ON, and during ACC)" CURVE 0x80534A38 RB_Cur_Xs16Ws16 0.9960938 Fact_CrCtl 0.00 0.9960938 FORMAT "%9.7" EXTENDED_LIMITS -128.0000 127.9961
 /begin AXIS_DESCR STD_AXIS CrCtl_vSpdVar_mp Vel_CrCtl 6 -128.0000 127.9961 FORMAT "%8.4" DEPOSIT ABSOLUTE /end AXIS_DESCR
/end CHARACTERISTIC
/begin CHARACTERISTIC CrCtl_facACCECOnAFbUp4_CUR "Acceleration factor for changing APP limitation number for ECON to 5 from 4 (for FB, ECON sw ON, and during ACC)" CURVE 0x80534A52 RB_Cur_Xs16Ws16 0.9960938 Fact_CrCtl 0.00 0.9960938 FORMAT "%9.7" EXTENDED_LIMITS -128.0000 127.9961
 /begin AXIS_DESCR STD_AXIS CrCtl_vSpdVar_mp Vel_CrCtl 6 -128.0000 127.9961 FORMAT "%8.4" DEPOSIT ABSOLUTE /end AXIS_DESCR
/end CHARACTERISTIC
/begin CHARACTERISTIC CrCtl_facACCECOnAFbUp5_CUR "Acceleration factor for changing APP limitation number for ECON to 2 from 1 (for Acceleration and ECON sw OFF)" CURVE 0x80534A6C RB_Cur_Xs16Ws16 0.9960938 Fact_CrCtl 0.00 0.9960938 FORMAT "%9.7" EXTENDED_LIMITS -128.0000 127.9961
 /begin AXIS_DESCR STD_AXIS CrCtl_vSpdVar_mp Vel_CrCtl 6 -128.0000 127.9961 FORMAT "%8.4" DEPOSIT ABSOLUTE /end AXIS_DESCR
/end CHARACTERISTIC
/begin CHARACTERISTIC CrCtl_facACCECOnAResUp2_MAP "Acceleration factor for changing APP limitation number for ECON to 3 from 2 (for Resume, ECON sw ON, and during ACC)" MAP 0x80534A86 Map_Xs16Ys16Ws16 0.9960938 Fact_CrCtl 0.00 0.9960938 FORMAT "%9.7" EXTENDED_LIMITS -128.0000 127.9961
 /begin AXIS_DESCR STD_AXIS CrCtl_tiDRAccnControl_mp Time_ms_100ms 6 -3276800. 3276700. FORMAT "%8.0" DEPOSIT ABSOLUTE /end AXIS_DESCR
 /begin AXIS_DESCR STD_AXIS CrCtl_vSpdVar_mp Vel_CrCtl 6 -128.0000 127.9961 FORMAT "%8.4" DEPOSIT ABSOLUTE /end AXIS_DESCR
/end CHARACTERISTIC
/begin CHARACTERISTIC CrCtl_facACCECOnAResUp3_MAP "Acceleration factor for changing APP limitation number for ECON to 4 from 3 (for Resume, ECON sw ON, and during ACC)" MAP 0x80534AEA Map_Xs16Ys16Ws16 0.9960938 Fact_CrCtl 0.00 0.9960938 FORMAT "%9.7" EXTENDED_LIMITS -128.0000 127.9961
 /begin AXIS_DESCR STD_AXIS CrCtl_tiDRAccnControl_mp Time_ms_100ms 6 -3276800. 3276700. FORMAT "%8.0" DEPOSIT ABSOLUTE /end AXIS_DESCR
 /begin AXIS_DESCR STD_AXIS CrCtl_vSpdVar_mp Vel_CrCtl 6 -128.0000 127.9961 FORMAT "%8.4" DEPOSIT ABSOLUTE /end AXIS_DESCR
/end CHARACTERISTIC
/begin CHARACTERISTIC CrCtl_facACCECOnAResUp4_MAP "Acceleration factor for changing APP limitation number for ECON to 5 from 4 (for Resume, ECON sw ON, and during ACC)" MAP 0x80534B4E Map_Xs16Ys16Ws16 0.9960938 Fact_CrCtl 0.00 0.9960938 FORMAT "%9.7" EXTENDED_LIMITS -128.0000 127.9961
 /begin AXIS_DESCR STD_AXIS CrCtl_tiDRAccnControl_mp Time_ms_100ms 6 -3276800. 3276700. FORMAT "%8.0" DEPOSIT ABSOLUTE /end AXIS_DESCR
 /begin AXIS_DESCR STD_AXIS CrCtl_vSpdVar_mp Vel_CrCtl 6 -128.0000 127.9961 FORMAT "%8.4" DEPOSIT ABSOLUTE /end AXIS_DESCR
/end CHARACTERISTIC
/begin CHARACTERISTIC CrCtl_facACCECOnAResUp5_MAP "Acceleration factor for changing APP limitation number for ECON to 2 from 1 (for FB and ECON sw OFF)" MAP 0x80534BB2 Map_Xs16Ys16Ws16 0.9960938 Fact_CrCtl 0.00 0.9960938 FORMAT "%9.7" EXTENDED_LIMITS -128.0000 127.9961
 /begin AXIS_DESCR STD_AXIS CrCtl_tiDRAccnControl_mp Time_ms_100ms 6 -3276800. 3276700. FORMAT "%8.0" DEPOSIT ABSOLUTE /end AXIS_DESCR
 /begin AXIS_DESCR STD_AXIS CrCtl_vSpdVar_mp Vel_CrCtl 6 -128.0000 127.9961 FORMAT "%8.4" DEPOSIT ABSOLUTE /end AXIS_DESCR
/end CHARACTERISTIC
/begin CHARACTERISTIC CrCtl_facAccnRed12_GCUR "Curve for Reduing factor of acceleration contorol value" CURVE 0x80534C16 CurG_Ws16 511.9844 Fact_CrCtl2 0.00 511.9844 FORMAT "%8.4" EXTENDED_LIMITS -512.0000 511.9844
 /begin AXIS_DESCR COM_AXIS CrCtl_vVehUpByte Vel_CrCtl1 12 0.00 255.0000 FORMAT "%8.4" EXTENDED_LIMITS -32768.00 32767.00 AXIS_PTS_REF CrCtl_vAccnCont_AX /end AXIS_DESCR
/end CHARACTERISTIC
/begin CHARACTERISTIC CrCtl_facACtrlECDecelCls_GCUR "Correct value of APP in top gear for ECON" CURVE 0x80534C2E CurG_Ws16 1023.984 Fact_CrCtl2 -512.0000 511.9844 FORMAT "%8.4"
 /begin AXIS_DESCR COM_AXIS CrCtl_vVehUpByte Vel_CrCtl1 6 0.00 255.0000 FORMAT "%8.4" EXTENDED_LIMITS -32768.00 32767.00 AXIS_PTS_REF CrCtl_vAccnCont_AXIS /end AXIS_DESCR
/end CHARACTERISTIC
/begin CHARACTERISTIC CrCtl_facACtrlECDecelOpn_GCUR "Curve for reducing factor of acceleration contorol value for ECON (close)" CURVE 0x80534C3A CurG_Ws16 1023.984 Fact_CrCtl2 -512.0000 511.9844 FORMAT "%8.4"
 /begin AXIS_DESCR COM_AXIS CrCtl_vVehUpByte Vel_CrCtl1 6 0.00 255.0000 FORMAT "%8.4" EXTENDED_LIMITS -32768.00 32767.00 AXIS_PTS_REF CrCtl_vAccnCont_AXIS /end AXIS_DESCR
/end CHARACTERISTIC
/begin CHARACTERISTIC CrCtl_facAPPRedRevi_GCUR "Curve for factor of APP reduce revisions value for Clutch out" CURVE 0x80534C46 CurG_Ws16 511.9844 Fact_CrCtl2 0.00 511.9844 FORMAT "%8.4" EXTENDED_LIMITS -512.0000 511.9844
 /begin AXIS_DESCR COM_AXIS CrCUI_nFlt EngNCrCtl 6 0.00 32767.00 FORMAT "%8.2" EXTENDED_LIMITS -32768.00 32767.00 AXIS_PTS_REF CrCtl_nFlt_AXIS /end AXIS_DESCR
/end CHARACTERISTIC
/begin AXIS_PTS CrCtl_facAPPReviX_AXIS "Number of X-Axispoints for CrCtl_facAPPRevi_GMAP." 0x80534C52 CrCtl_rReq_mp Axis_Xs16 163.8350 APPCrCtl1 12 0.00 163.8350 FORMAT "%8.4" EXTENDED_LIMITS -163.8400 163.8350 DEPOSIT ABSOLUTE /end AXIS_PTS
/begin AXIS_PTS CrCtl_facAPPReviY_AXIS "Number of Y-axispoints for CrCtl_facAPPRevi_GMAP." 0x80534C6C CrCtl_vVehUpByte Axis_Xs16 255.0000 Vel_CrCtl1 6 0.00 255.0000 FORMAT "%8.4" EXTENDED_LIMITS -32768.00 32767.00 DEPOSIT ABSOLUTE /end AXIS_PTS
/begin CHARACTERISTIC CrCtl_facCmftAccnRed12_GCUR "Curve for Reducing factor of acceleration control value for Comfort mode" CURVE 0x80534C7A CurG_Ws16 511.9844 Fact_CrCtl2 0.00 511.9844 FORMAT "%8.4" EXTENDED_LIMITS -512.0000 511.9844
 /begin AXIS_DESCR COM_AXIS CrCtl_vVehUpByte Vel_CrCtl1 12 0.00 255.0000 FORMAT "%8.4" EXTENDED_LIMITS -32768.00 32767.00 AXIS_PTS_REF CrCtl_vAccnCont_AX /end AXIS_DESCR
/end CHARACTERISTIC
/begin CHARACTERISTIC CrCtl_facCmftFdbkAccnVal0_C "Acceleration feed back factor value under Gear no.0 for Comfort mode" VALUE 0x80534C92 Val_Ws16 255.9922 Fact1 0.00 255.9922 FORMAT "%8.4" EXTENDED_LIMITS -256.0000 255.9922 /end CHARACTERISTIC
/begin CHARACTERISTIC CrCtl_facCmftFdbkAccnVal1_C "Acceleration feed back factor value under Gear no.1 for Comfort mode" VALUE 0x80534C94 Val_Ws16 255.9922 Fact1 0.00 255.9922 FORMAT "%8.4" EXTENDED_LIMITS -256.0000 255.9922 /end CHARACTERISTIC
/begin CHARACTERISTIC CrCtl_facCmftFdbkAccnVal2_C "Acceleration feed back factor value under Gear no.2 for Comfort mode" VALUE 0x80534C96 Val_Ws16 255.9922 Fact1 0.00 255.9922 FORMAT "%8.4" EXTENDED_LIMITS -256.0000 255.9922 /end CHARACTERISTIC
/begin CHARACTERISTIC CrCtl_facCmftFdbkAccnVal3_C "Acceleration feed back factor value under Gear no.3 for Comfort mode" VALUE 0x80534C98 Val_Ws16 255.9922 Fact1 0.00 255.9922 FORMAT "%8.4" EXTENDED_LIMITS -256.0000 255.9922 /end CHARACTERISTIC
/begin CHARACTERISTIC CrCtl_facCmftFdbkAccnVal4_C "Acceleration feed back factor value under Gear no.4 for Comfort mode" VALUE 0x80534C9A Val_Ws16 255.9922 Fact1 0.00 255.9922 FORMAT "%8.4" EXTENDED_LIMITS -256.0000 255.9922 /end CHARACTERISTIC
/begin CHARACTERISTIC CrCtl_facCmftFdbkDReviVal0_C "Feed Back D factor revision value for Comfort mode under Gear no.0" VALUE 0x80534C9C Val_Ws16 255.9922 Fact1 0.00 255.9922 FORMAT "%8.4" EXTENDED_LIMITS -256.0000 255.9922 /end CHARACTERISTIC
/begin CHARACTERISTIC CrCtl_facCmftFdbkDReviVal1_C "Feed Back D factor revision value for Comfort mode under Gear no.1" VALUE 0x80534C9E Val_Ws16 255.9922 Fact1 0.00 255.9922 FORMAT "%8.4" EXTENDED_LIMITS -256.0000 255.9922 /end CHARACTERISTIC
/begin CHARACTERISTIC CrCtl_facCmftFdbkDReviVal2_C "Feed Back D factor revision value for Comfort mode under Gear no.2" VALUE 0x80534CA0 Val_Ws16 255.9922 Fact1 0.00 255.9922 FORMAT "%8.4" EXTENDED_LIMITS -256.0000 255.9922 /end CHARACTERISTIC
/begin CHARACTERISTIC CrCtl_facCmftFdbkDReviVal3_C "Feed Back D factor revision value for Comfort mode under Gear no.3" VALUE 0x80534CA2 Val_Ws16 255.9922 Fact1 0.00 255.9922 FORMAT "%8.4" EXTENDED_LIMITS -256.0000 255.9922 /end CHARACTERISTIC
/begin CHARACTERISTIC CrCtl_facCmftFdbkDReviVal4_C "Feed Back D factor revision value for Comfort mode under Gear no.4" VALUE 0x80534CA4 Val_Ws16 255.9922 Fact1 0.00 255.9922 FORMAT "%8.4" EXTENDED_LIMITS -256.0000 255.9922 /end CHARACTERISTIC
/begin CHARACTERISTIC CrCtl_facCmftFdbkPReviVal0_C "Feed Back P factor revision value for Comfort mode under Gear no.0" VALUE 0x80534CA6 Val_Ws16 255.9922 Fact1 0.00 255.9922 FORMAT "%8.4" EXTENDED_LIMITS -256.0000 255.9922 /end CHARACTERISTIC
/begin CHARACTERISTIC CrCtl_facCmftFdbkPReviVal1_C "Feed Back P factor revision value for Comfort mode under Gear no.1" VALUE 0x80534CA8 Val_Ws16 255.9922 Fact1 0.00 255.9922 FORMAT "%8.4" EXTENDED_LIMITS -256.0000 255.9922 /end CHARACTERISTIC
/begin CHARACTERISTIC CrCtl_facCmftFdbkPReviVal2_C "Feed Back P factor revision value for Comfort mode under Gear no.2" VALUE 0x80534CAA Val_Ws16 255.9922 Fact1 0.00 255.9922 FORMAT "%8.4" EXTENDED_LIMITS -256.0000 255.9922 /end CHARACTERISTIC
/begin CHARACTERISTIC CrCtl_facCmftFdbkPReviVal3_C "Feed Back P factor revision value for Comfort mode under Gear no.3" VALUE 0x80534CAC Val_Ws16 255.9922 Fact1 0.00 255.9922 FORMAT "%8.4" EXTENDED_LIMITS -256.0000 255.9922 /end CHARACTERISTIC
/begin CHARACTERISTIC CrCtl_facCmftFdbkPReviVal4_C "Feed Back P factor revision value for Comfort mode under Gear no.4" VALUE 0x80534CAE Val_Ws16 255.9922 Fact1 0.00 255.9922 FORMAT "%8.4" EXTENDED_LIMITS -256.0000 255.9922 /end CHARACTERISTIC
/begin CHARACTERISTIC CrCtl_facContTapInitRevi_C "factor of continuation Tap initial revision request value" VALUE 0x80534CB0 Val_Ws16 0.4960938 Fact_CrCtl 0.00 0.4960938 FORMAT "%9.7" EXTENDED_LIMITS -128.0000 127.9961 /end CHARACTERISTIC
/begin CHARACTERISTIC CrCtl_facDecnRevi12_GCUR "Curve for deceleration revision factor value" CURVE 0x80534CB2 CurG_Ws16 511.9844 Fact_CrCtl2 0.00 511.9844 FORMAT "%8.4" EXTENDED_LIMITS -512.0000 511.9844
 /begin AXIS_DESCR COM_AXIS CrCtl_vDesUpByte_mp Vel_CrCtl1 12 0.00 255.0000 FORMAT "%8.4" EXTENDED_LIMITS -32768.00 32767.00 AXIS_PTS_REF CrCtl_vFdbkArea_AX /end AXIS_DESCR
/end CHARACTERISTIC
/begin CHARACTERISTIC CrCtl_facDiffCoeffDR1ACCEL_CUR "Accel differential coeffecient for DR1 judgement at CC_ACCEL" CURVE 0x80534CCA RB_Cur_Xs16Ws16 0.9960938 Fact_CrCtl 0.00 0.9960938 FORMAT "%9.7" EXTENDED_LIMITS -128.0000 127.9961
 /begin AXIS_DESCR STD_AXIS CrCtl_tiDRAccnControl_mp Time_ms_100ms 6 -3276800. 3276700. FORMAT "%8.0" DEPOSIT ABSOLUTE /end AXIS_DESCR
/end CHARACTERISTIC
/begin CHARACTERISTIC CrCtl_facDiffCoeffDR1FB_CUR "Accel differential coeffecient for DR1 judgement at CC_F/B" CURVE 0x80534CE4 RB_Cur_Xs16Ws16 0.9960938 Fact_CrCtl 0.00 0.9960938 FORMAT "%9.7" EXTENDED_LIMITS -128.0000 127.9961
 /begin AXIS_DESCR STD_AXIS CrCtl_vSpdDvtRgl_mp Vel_CrCtl 6 -128.0000 127.9961 FORMAT "%8.4" DEPOSIT ABSOLUTE /end AXIS_DESCR
/end CHARACTERISTIC
/begin CHARACTERISTIC CrCtl_facDiffCoeffDR1Resume_MAP "Accel differential coeffecient data for DR1 judgement at CC_RESUME" MAP 0x80534CFE Map_Xs16Ys16Ws16 0.9960938 Fact_CrCtl 0.00 0.9960938 FORMAT "%9.7" EXTENDED_LIMITS -128.0000 127.9961
 /begin AXIS_DESCR STD_AXIS CrCtl_tiDRAccnControl_mp Time_ms_100ms 6 0.00 3276700. FORMAT "%8.0" EXTENDED_LIMITS -3276800. 3276700. DEPOSIT ABSOLUTE /end AXIS_DESCR
 /begin AXIS_DESCR STD_AXIS CrCtl_vSpdDvtRgl_mp Vel_CrCtl 6 -128.0000 127.9961 FORMAT "%8.4" DEPOSIT ABSOLUTE /end AXIS_DESCR
/end CHARACTERISTIC
/begin CHARACTERISTIC CrCtl_facDiffCoeffDR2ACCEL_CUR "Accel differential coeffecient for DR2 judgement at CC_ACCEL" CURVE 0x80534D62 RB_Cur_Xs16Ws16 0.9960938 Fact_CrCtl 0.00 0.9960938 FORMAT "%9.7" EXTENDED_LIMITS -128.0000 127.9961
 /begin AXIS_DESCR STD_AXIS CrCtl_tiDRAccnControl_mp Time_ms_100ms 6 -3276800. 3276700. FORMAT "%8.0" DEPOSIT ABSOLUTE /end AXIS_DESCR
/end CHARACTERISTIC
/begin CHARACTERISTIC CrCtl_facDiffCoeffDR2FB_CUR "Accel differential coeffecient for DR2 judgement at CC_F/B" CURVE 0x80534D7C RB_Cur_Xs16Ws16 0.9960938 Fact_CrCtl 0.00 0.9960938 FORMAT "%9.7" EXTENDED_LIMITS -128.0000 127.9961
 /begin AXIS_DESCR STD_AXIS CrCtl_vSpdDvtRgl_mp Vel_CrCtl 6 -128.0000 127.9961 FORMAT "%8.4" DEPOSIT ABSOLUTE /end AXIS_DESCR
/end CHARACTERISTIC
/begin CHARACTERISTIC CrCtl_facDiffCoeffDR2Resume_MAP "Accel defferential coeffecient data for DR2 judgement at CC_RESUME" MAP 0x80534D96 Map_Xs16Ys16Ws16 255.9961 Fact_CrCtl -128.0000 127.9961 FORMAT "%8.4"
 /begin AXIS_DESCR STD_AXIS CrCtl_tiDRAccnControl_mp Time_ms_100ms 6 -3276800. 3276700. FORMAT "%8.0" DEPOSIT ABSOLUTE /end AXIS_DESCR
 /begin AXIS_DESCR STD_AXIS CrCtl_vSpdDvtRgl_mp Vel_CrCtl 6 -128.0000 127.9961 FORMAT "%8.4" DEPOSIT ABSOLUTE /end AXIS_DESCR
/end CHARACTERISTIC
/begin CHARACTERISTIC CrCtl_facDiffCoeffDR3ACCEL_CUR "Accel defferential coeffecient for DR3 judgement at CC_ACCEL" CURVE 0x80534DFA RB_Cur_Xs16Ws16 0.9960938 Fact_CrCtl 0.00 0.9960938 FORMAT "%9.7" EXTENDED_LIMITS -128.0000 127.9961
 /begin AXIS_DESCR STD_AXIS CrCtl_tiDRAccnControl_mp Time_ms_100ms 6 0.00 3276700. FORMAT "%8.0" EXTENDED_LIMITS -3276800. 3276700. DEPOSIT ABSOLUTE /end AXIS_DESCR
/end CHARACTERISTIC
/begin CHARACTERISTIC CrCtl_facDiffCoeffDR3FB_CUR "Accel defferential coeffecient for DR3 judgement at CC_ACCEL" CURVE 0x80534E14 RB_Cur_Xs16Ws16 0.9960938 Fact_CrCtl 0.00 0.9960938 FORMAT "%9.7" EXTENDED_LIMITS -128.0000 127.9961
 /begin AXIS_DESCR STD_AXIS CrCtl_vSpdDvtRgl_mp Vel_CrCtl 6 -128.0000 127.9961 FORMAT "%8.4" DEPOSIT ABSOLUTE /end AXIS_DESCR
/end CHARACTERISTIC
/begin CHARACTERISTIC CrCtl_facDiffCoeffDR3Resume_MAP "Accel defferential coeffecient data for DR3 judgement at CC_RESUME" MAP 0x80534E2E Map_Xs16Ys16Ws16 255.9961 Fact_CrCtl -128.0000 127.9961 FORMAT "%8.4"
 /begin AXIS_DESCR STD_AXIS CrCtl_tiDRAccnControl_mp Time_ms_100ms 6 -3276800. 3276700. FORMAT "%8.0" DEPOSIT ABSOLUTE /end AXIS_DESCR
 /begin AXIS_DESCR STD_AXIS CrCtl_vSpdDvtRgl_mp Vel_CrCtl 6 -128.0000 127.9961 FORMAT "%8.4" DEPOSIT ABSOLUTE /end AXIS_DESCR
/end CHARACTERISTIC
/begin CHARACTERISTIC CrCtl_facDiffCoeffDR4ACCEL_CUR "Accel differential coeffecient data for DR4 judgement at CC_ACCEL" CURVE 0x80534E92 RB_Cur_Xs16Ws16 0.9960938 Fact_CrCtl 0.00 0.9960938 FORMAT "%9.7" EXTENDED_LIMITS -128.0000 127.9961
 /begin AXIS_DESCR STD_AXIS CrCtl_tiDRAccnControl_mp Time_ms_100ms 6 0.00 3276700. FORMAT "%8.0" EXTENDED_LIMITS -3276800. 3276700. DEPOSIT ABSOLUTE /end AXIS_DESCR
/end CHARACTERISTIC
/begin CHARACTERISTIC CrCtl_facDiffCoeffDR4FB_CUR "Accel differential coeffecient data for DR4 judgement at CC_FB" CURVE 0x80534EAC RB_Cur_Xs16Ws16 0.9960938 Fact_CrCtl 0.00 0.9960938 FORMAT "%9.7" EXTENDED_LIMITS -128.0000 127.9961
 /begin AXIS_DESCR STD_AXIS CrCtl_vSpdDvtRgl_mp Vel_CrCtl 6 -128.0000 127.9961 FORMAT "%8.4" DEPOSIT ABSOLUTE /end AXIS_DESCR
/end CHARACTERISTIC
/begin CHARACTERISTIC CrCtl_facDiffCoeffDR4Resume_MAP "Accel differential coeffecient data for DR4 judgement at CC_RESUME" MAP 0x80534EC6 Map_Xs16Ys16Ws16 0.9960938 Fact_CrCtl 0.00 0.9960938 FORMAT "%9.7" EXTENDED_LIMITS -128.0000 127.9961
 /begin AXIS_DESCR STD_AXIS CrCtl_tiDRAccnControl_mp Time_ms_100ms 6 0.00 3276700. FORMAT "%8.0" EXTENDED_LIMITS -3276800. 3276700. DEPOSIT ABSOLUTE /end AXIS_DESCR
 /begin AXIS_DESCR STD_AXIS CrCtl_vSpdDvtRgl_mp Vel_CrCtl 6 -128.0000 127.9961 FORMAT "%8.4" DEPOSIT ABSOLUTE /end AXIS_DESCR
/end CHARACTERISTIC
/begin CHARACTERISTIC CrCtl_facDiffCoeffDR5ACCEL_CUR "Accel differential coeffecient data for DR5 judgement at CC_ACCEL" CURVE 0x80534F2A RB_Cur_Xs16Ws16 0.9960938 Fact_CrCtl 0.00 0.9960938 FORMAT "%9.7" EXTENDED_LIMITS -128.0000 127.9961
 /begin AXIS_DESCR STD_AXIS CrCtl_tiDRAccnControl_mp Time_ms_100ms 6 0.00 3276700. FORMAT "%8.0" EXTENDED_LIMITS -3276800. 3276700. DEPOSIT ABSOLUTE /end AXIS_DESCR
/end CHARACTERISTIC
/begin CHARACTERISTIC CrCtl_facDiffCoeffDR5FB_CUR "Accel differential coeffecient data for DR5 judgement at CC_FB" CURVE 0x80534F44 RB_Cur_Xs16Ws16 0.9960938 Fact_CrCtl 0.00 0.9960938 FORMAT "%9.7" EXTENDED_LIMITS -128.0000 127.9961
 /begin AXIS_DESCR STD_AXIS CrCtl_vSpdDvtRgl_mp Vel_CrCtl 6 -128.0000 127.9961 FORMAT "%8.4" DEPOSIT ABSOLUTE /end AXIS_DESCR
/end CHARACTERISTIC
/begin CHARACTERISTIC CrCtl_facDiffCoeffDR5Resume_MAP "Accel differential coeffecient data for DR5 judgement at CC_RESUME" MAP 0x80534F5E Map_Xs16Ys16Ws16 0.9960938 Fact_CrCtl 0.00 0.9960938 FORMAT "%9.7" EXTENDED_LIMITS -128.0000 127.9961
 /begin AXIS_DESCR STD_AXIS CrCtl_tiDRAccnControl_mp Time_ms_100ms 6 0.00 3276700. FORMAT "%8.0" EXTENDED_LIMITS -3276800. 3276700. DEPOSIT ABSOLUTE /end AXIS_DESCR
 /begin AXIS_DESCR STD_AXIS CrCtl_vSpdDvtRgl_mp Vel_CrCtl 6 -128.0000 127.9961 FORMAT "%8.4" DEPOSIT ABSOLUTE /end AXIS_DESCR
/end CHARACTERISTIC
/begin CHARACTERISTIC CrCtl_facDiffCoeffDR6ACCEL_CUR "Accel differential coeffecient data for DR6 judgement at CC_ACCEL" CURVE 0x80534FC2 RB_Cur_Xs16Ws16 0.9960938 Fact_CrCtl 0.00 0.9960938 FORMAT "%9.7" EXTENDED_LIMITS -128.0000 127.9961
 /begin AXIS_DESCR STD_AXIS CrCtl_tiDRAccnControl_mp Time_ms_100ms 6 0.00 3276700. FORMAT "%8.0" EXTENDED_LIMITS -3276800. 3276700. DEPOSIT ABSOLUTE /end AXIS_DESCR
/end CHARACTERISTIC
/begin CHARACTERISTIC CrCtl_facDiffCoeffDR6FB_CUR "Accel differential coeffecient data for DR6 judgement at CC_FB" CURVE 0x80534FDC RB_Cur_Xs16Ws16 0.9960938 Fact_CrCtl 0.00 0.9960938 FORMAT "%9.7" EXTENDED_LIMITS -128.0000 127.9961
 /begin AXIS_DESCR STD_AXIS CrCtl_vSpdDvtRgl_mp Vel_CrCtl 6 -128.0000 127.9961 FORMAT "%8.4" DEPOSIT ABSOLUTE /end AXIS_DESCR
/end CHARACTERISTIC
/begin CHARACTERISTIC CrCtl_facDiffCoeffDR6Resume_MAP "Accel differential coeffecient data for DR6 judgement at CC_RESUME" MAP 0x80534FF6 Map_Xs16Ys16Ws16 0.9960938 Fact_CrCtl 0.00 0.9960938 FORMAT "%9.7" EXTENDED_LIMITS -128.0000 127.9961
 /begin AXIS_DESCR STD_AXIS CrCtl_tiDRAccnControl_mp Time_ms_100ms 6 0.00 3276700. FORMAT "%8.0" EXTENDED_LIMITS -3276800. 3276700. DEPOSIT ABSOLUTE /end AXIS_DESCR
 /begin AXIS_DESCR STD_AXIS CrCtl_vSpdDvtRgl_mp Vel_CrCtl 6 -128.0000 127.9961 FORMAT "%8.4" DEPOSIT ABSOLUTE /end AXIS_DESCR
/end CHARACTERISTIC
/begin CHARACTERISTIC CrCtl_facDiffCoeffDR7ACCEL_CUR "Accel differential coeffecient data for DR7 judgement at CC_ACCEL" CURVE 0x8053505A RB_Cur_Xs16Ws16 0.9960938 Fact_CrCtl 0.00 0.9960938 FORMAT "%9.7" EXTENDED_LIMITS -128.0000 127.9961
 /begin AXIS_DESCR STD_AXIS CrCtl_tiDRAccnControl_mp Time_ms_100ms 6 0.00 3276700. FORMAT "%8.0" EXTENDED_LIMITS -3276800. 3276700. DEPOSIT ABSOLUTE /end AXIS_DESCR
/end CHARACTERISTIC
/begin CHARACTERISTIC CrCtl_facDiffCoeffDR7FB_CUR "Accel differential coeffecient data for DR7 judgement at CC_FB" CURVE 0x80535074 RB_Cur_Xs16Ws16 0.9960938 Fact_CrCtl 0.00 0.9960938 FORMAT "%9.7" EXTENDED_LIMITS -128.0000 127.9961
 /begin AXIS_DESCR STD_AXIS CrCtl_vSpdDvtRgl_mp Vel_CrCtl 6 -128.0000 127.9961 FORMAT "%8.4" DEPOSIT ABSOLUTE /end AXIS_DESCR
/end CHARACTERISTIC
/begin CHARACTERISTIC CrCtl_facDiffCoeffDR7Resume_MAP "Accel differential coeffecient data for DR7 judgement at CC_RESUME" MAP 0x8053508E Map_Xs16Ys16Ws16 0.9960938 Fact_CrCtl 0.00 0.9960938 FORMAT "%9.7" EXTENDED_LIMITS -128.0000 127.9961
 /begin AXIS_DESCR STD_AXIS CrCtl_tiDRAccnControl_mp Time_ms_100ms 6 0.00 3276700. FORMAT "%8.0" EXTENDED_LIMITS -3276800. 3276700. DEPOSIT ABSOLUTE /end AXIS_DESCR
 /begin AXIS_DESCR STD_AXIS CrCtl_vSpdDvtRgl_mp Vel_CrCtl 6 -128.0000 127.9961 FORMAT "%8.4" DEPOSIT ABSOLUTE /end AXIS_DESCR
/end CHARACTERISTIC
/begin CHARACTERISTIC CrCtl_facEC1LGAppDiffCls_GMAP "Correct value of APP in 1 level lower gear for ECON and close side" MAP 0x805350F2 MapG_Ws16 511.9922 Fact1 -256.0000 255.9922 FORMAT "%8.4"
 /begin AXIS_DESCR COM_AXIS CrCtl_rReq_mp APPCrCtl1 12 0.00 163.8350 FORMAT "%8.4" EXTENDED_LIMITS -163.8400 163.8350 AXIS_PTS_REF CrCtl_facAPPReviX_AXIS /end AXIS_DESCR
 /begin AXIS_DESCR COM_AXIS CrCtl_vVehUpByte Vel_CrCtl1 6 0.00 255.0000 FORMAT "%8.4" EXTENDED_LIMITS -32768.00 32767.00 AXIS_PTS_REF CrCtl_facAPPReviY_AXIS /end AXIS_DESCR
/end CHARACTERISTIC
/begin CHARACTERISTIC CrCtl_facEC1LGAppDiff_GMAP "Correct value of APP in 1 level lower gear for ECON for open" MAP 0x80535182 MapG_Ws16 511.9922 Fact1 -256.0000 255.9922 FORMAT "%8.4"
 /begin AXIS_DESCR COM_AXIS CrCtl_rReq_mp APPCrCtl1 12 0.00 163.8350 FORMAT "%8.4" EXTENDED_LIMITS -163.8400 163.8350 AXIS_PTS_REF CrCtl_facAPPReviX_AXIS /end AXIS_DESCR
 /begin AXIS_DESCR COM_AXIS CrCtl_vVehUpByte Vel_CrCtl1 6 0.00 255.0000 FORMAT "%8.4" EXTENDED_LIMITS -32768.00 32767.00 AXIS_PTS_REF CrCtl_facAPPReviY_AXIS /end AXIS_DESCR
/end CHARACTERISTIC
/begin CHARACTERISTIC CrCtl_facEC2LGAppDiffCls_GMAP "Correct value of APP in 2 level lower gear for ECON and close side" MAP 0x80535212 MapG_Ws16 511.9922 Fact1 -256.0000 255.9922 FORMAT "%8.4"
 /begin AXIS_DESCR COM_AXIS CrCtl_rReq_mp APPCrCtl1 12 0.00 163.8350 FORMAT "%8.4" EXTENDED_LIMITS -163.8400 163.8350 AXIS_PTS_REF CrCtl_facAPPReviX_AXIS /end AXIS_DESCR
 /begin AXIS_DESCR COM_AXIS CrCtl_vVehUpByte Vel_CrCtl1 6 0.00 255.0000 FORMAT "%8.4" EXTENDED_LIMITS -32768.00 32767.00 AXIS_PTS_REF CrCtl_facAPPReviY_AXIS /end AXIS_DESCR
/end CHARACTERISTIC
/begin CHARACTERISTIC CrCtl_facEC2LGAppDiff_GMAP "Correct value of APP in 2 level lower gear for ECON for open side" MAP 0x805352A2 MapG_Ws16 511.9922 Fact1 -256.0000 255.9922 FORMAT "%8.4"
 /begin AXIS_DESCR COM_AXIS CrCtl_rReq_mp APPCrCtl1 12 0.00 163.8350 FORMAT "%8.4" EXTENDED_LIMITS -163.8400 163.8350 AXIS_PTS_REF CrCtl_facAPPReviX_AXIS /end AXIS_DESCR
 /begin AXIS_DESCR COM_AXIS CrCtl_vVehUpByte Vel_CrCtl1 6 0.00 255.0000 FORMAT "%8.4" EXTENDED_LIMITS -32768.00 32767.00 AXIS_PTS_REF CrCtl_facAPPReviY_AXIS /end AXIS_DESCR
/end CHARACTERISTIC
/begin CHARACTERISTIC CrCtl_facEC3LGAppDiffCls_GMAP "Correct value of APP in 3 level lower gear for ECON and close side" MAP 0x80535332 MapG_Ws16 511.9922 Fact1 -256.0000 255.9922 FORMAT "%8.4"
 /begin AXIS_DESCR COM_AXIS CrCtl_rReq_mp APPCrCtl1 12 0.00 163.8350 FORMAT "%8.4" EXTENDED_LIMITS -163.8400 163.8350 AXIS_PTS_REF CrCtl_facAPPReviX_AXIS /end AXIS_DESCR
 /begin AXIS_DESCR COM_AXIS CrCtl_vVehUpByte Vel_CrCtl1 6 0.00 255.0000 FORMAT "%8.4" EXTENDED_LIMITS -32768.00 32767.00 AXIS_PTS_REF CrCtl_facAPPReviY_AXIS /end AXIS_DESCR
/end CHARACTERISTIC
/begin CHARACTERISTIC CrCtl_facEC3LGAppDiff_GMAP "Correct value of APP in 3 level lower gear for ECON for open side" MAP 0x805353C2 MapG_Ws16 511.9922 Fact1 -256.0000 255.9922 FORMAT "%8.4"
 /begin AXIS_DESCR COM_AXIS CrCtl_rReq_mp APPCrCtl1 12 0.00 163.8350 FORMAT "%8.4" EXTENDED_LIMITS -163.8400 163.8350 AXIS_PTS_REF CrCtl_facAPPReviX_AXIS /end AXIS_DESCR
 /begin AXIS_DESCR COM_AXIS CrCtl_vVehUpByte Vel_CrCtl1 6 0.00 255.0000 FORMAT "%8.4" EXTENDED_LIMITS -32768.00 32767.00 AXIS_PTS_REF CrCtl_facAPPReviY_AXIS /end AXIS_DESCR
/end CHARACTERISTIC
/begin CHARACTERISTIC CrCtl_facEC4LGAppDiffCls_GMAP "Correct value of APP in 4 level lower gear for ECON and close side" MAP 0x80535452 MapG_Ws16 511.9922 Fact1 -256.0000 255.9922 FORMAT "%8.4"
 /begin AXIS_DESCR COM_AXIS CrCtl_rReq_mp APPCrCtl1 12 0.00 163.8350 FORMAT "%8.4" EXTENDED_LIMITS -163.8400 163.8350 AXIS_PTS_REF CrCtl_facAPPReviX_AXIS /end AXIS_DESCR
 /begin AXIS_DESCR COM_AXIS CrCtl_vVehUpByte Vel_CrCtl1 6 0.00 255.0000 FORMAT "%8.4" EXTENDED_LIMITS -32768.00 32767.00 AXIS_PTS_REF CrCtl_facAPPReviY_AXIS /end AXIS_DESCR
/end CHARACTERISTIC
/begin CHARACTERISTIC CrCtl_facEC4LGAppDiff_GMAP "Correct value of APP in 4 level lower gear for ECON for open side" MAP 0x805354E2 MapG_Ws16 511.9922 Fact1 -256.0000 255.9922 FORMAT "%8.4"
 /begin AXIS_DESCR COM_AXIS CrCtl_rReq_mp APPCrCtl1 12 0.00 163.8350 FORMAT "%8.4" EXTENDED_LIMITS -163.8400 163.8350 AXIS_PTS_REF CrCtl_facAPPReviX_AXIS /end AXIS_DESCR
 /begin AXIS_DESCR COM_AXIS CrCtl_vVehUpByte Vel_CrCtl1 6 0.00 255.0000 FORMAT "%8.4" EXTENDED_LIMITS -32768.00 32767.00 AXIS_PTS_REF CrCtl_facAPPReviY_AXIS /end AXIS_DESCR
/end CHARACTERISTIC
/begin CHARACTERISTIC CrCtl_facECAppInitCor_CUR "Correct value of TAPUP initial request APP for ECON" CURVE 0x80535572 RB_Curve_S16_U8_Static 3.984 Fact_CrCtl2 0.00 3.984 FORMAT "%5.3"
 /begin AXIS_DESCR STD_AXIS CrCtl_vSpdTab_mp Vel_CrCtl1 6 -32768.00 32767.00 FORMAT "%8.2" DEPOSIT ABSOLUTE /end AXIS_DESCR
/end CHARACTERISTIC
/begin CHARACTERISTIC CrCtl_facECDR1ResA_MAP "Accel differential coeffecient data for DR1 judgement at CC_RESUME for ECON" MAP 0x80535586 Map_Xs16Ys16Ws16 0.9960938 Fact_CrCtl 0.00 0.9960938 FORMAT "%9.7" EXTENDED_LIMITS -128.0000 127.9961
 /begin AXIS_DESCR STD_AXIS CrCtl_tiDRAccnControl_mp Time_ms_100ms 6 0.00 3276700. FORMAT "%8.0" EXTENDED_LIMITS -3276800. 3276700. DEPOSIT ABSOLUTE /end AXIS_DESCR
 /begin AXIS_DESCR STD_AXIS CrCtl_vSpdDvtRgl_mp Vel_CrCtl 6 -128.0000 127.9961 FORMAT "%8.4" DEPOSIT ABSOLUTE /end AXIS_DESCR
/end CHARACTERISTIC
/begin CHARACTERISTIC CrCtl_facECDR2ResA_MAP "Accel differential coeffecient data for DR2 judgement at CC_RESUME for ECON" MAP 0x805355EA Map_Xs16Ys16Ws16 0.9960938 Fact_CrCtl 0.00 0.9960938 FORMAT "%9.7" EXTENDED_LIMITS -128.0000 127.9961
 /begin AXIS_DESCR STD_AXIS CrCtl_tiDRAccnControl_mp Time_ms_100ms 6 0.00 3276700. FORMAT "%8.0" EXTENDED_LIMITS -3276800. 3276700. DEPOSIT ABSOLUTE /end AXIS_DESCR
 /begin AXIS_DESCR STD_AXIS CrCtl_vSpdDvtRgl_mp Vel_CrCtl 6 -128.0000 127.9961 FORMAT "%8.4" DEPOSIT ABSOLUTE /end AXIS_DESCR
/end CHARACTERISTIC
/begin CHARACTERISTIC CrCtl_facECDR3ResA_MAP "Accel differential coeffecient data for DR3 judgement at CC_RESUME for ECON" MAP 0x8053564E Map_Xs16Ys16Ws16 0.9960938 Fact_CrCtl 0.00 0.9960938 FORMAT "%9.7" EXTENDED_LIMITS -128.0000 127.9961
 /begin AXIS_DESCR STD_AXIS CrCtl_tiDRAccnControl_mp Time_ms_100ms 6 0.00 3276700. FORMAT "%8.0" EXTENDED_LIMITS -3276800. 3276700. DEPOSIT ABSOLUTE /end AXIS_DESCR
 /begin AXIS_DESCR STD_AXIS CrCtl_vSpdDvtRgl_mp Vel_CrCtl 6 -128.0000 127.9961 FORMAT "%8.4" DEPOSIT ABSOLUTE /end AXIS_DESCR
/end CHARACTERISTIC
/begin CHARACTERISTIC CrCtl_facECDR4ResA_MAP "Accel differential coeffecient data for DR4 judgement at CC_RESUME for ECON" MAP 0x805356B2 Map_Xs16Ys16Ws16 0.9960938 Fact_CrCtl 0.00 0.9960938 FORMAT "%9.7" EXTENDED_LIMITS -128.0000 127.9961
 /begin AXIS_DESCR STD_AXIS CrCtl_tiDRAccnControl_mp Time_ms_100ms 6 0.00 3276700. FORMAT "%8.0" EXTENDED_LIMITS -3276800. 3276700. DEPOSIT ABSOLUTE /end AXIS_DESCR
 /begin AXIS_DESCR STD_AXIS CrCtl_vSpdDvtRgl_mp Vel_CrCtl 6 -128.0000 127.9961 FORMAT "%8.4" DEPOSIT ABSOLUTE /end AXIS_DESCR
/end CHARACTERISTIC
/begin CHARACTERISTIC CrCtl_facECDR5ResA_MAP "Accel differential coeffecient data for DR5 judgement at CC_RESUME for ECON" MAP 0x80535716 Map_Xs16Ys16Ws16 0.9960938 Fact_CrCtl 0.00 0.9960938 FORMAT "%9.7" EXTENDED_LIMITS -128.0000 127.9961
 /begin AXIS_DESCR STD_AXIS CrCtl_tiDRAccnControl_mp Time_ms_100ms 6 0.00 3276700. FORMAT "%8.0" EXTENDED_LIMITS -3276800. 3276700. DEPOSIT ABSOLUTE /end AXIS_DESCR
 /begin AXIS_DESCR STD_AXIS CrCtl_vSpdDvtRgl_mp Vel_CrCtl 6 -128.0000 127.9961 FORMAT "%8.4" DEPOSIT ABSOLUTE /end AXIS_DESCR
/end CHARACTERISTIC
/begin CHARACTERISTIC CrCtl_facECDR6ResA_MAP "Accel differential coeffecient data for DR6 judgement at CC_RESUME for ECON" MAP 0x8053577A Map_Xs16Ys16Ws16 0.9960938 Fact_CrCtl 0.00 0.9960938 FORMAT "%9.7" EXTENDED_LIMITS -128.0000 127.9961
 /begin AXIS_DESCR STD_AXIS CrCtl_tiDRAccnControl_mp Time_ms_100ms 6 0.00 3276700. FORMAT "%8.0" EXTENDED_LIMITS -3276800. 3276700. DEPOSIT ABSOLUTE /end AXIS_DESCR
 /begin AXIS_DESCR STD_AXIS CrCtl_vSpdDvtRgl_mp Vel_CrCtl 6 -128.0000 127.9961 FORMAT "%8.4" DEPOSIT ABSOLUTE /end AXIS_DESCR
/end CHARACTERISTIC
/begin CHARACTERISTIC CrCtl_facECDR7ResA_MAP "Accel differential coeffecient data for DR7 judgement at CC_RESUME for ECON" MAP 0x805357DE Map_Xs16Ys16Ws16 0.9960938 Fact_CrCtl 0.00 0.9960938 FORMAT "%9.7" EXTENDED_LIMITS -128.0000 127.9961
 /begin AXIS_DESCR STD_AXIS CrCtl_tiDRAccnControl_mp Time_ms_100ms 6 0.00 3276700. FORMAT "%8.0" EXTENDED_LIMITS -3276800. 3276700. DEPOSIT ABSOLUTE /end AXIS_DESCR
 /begin AXIS_DESCR STD_AXIS CrCtl_vSpdDvtRgl_mp Vel_CrCtl 6 -128.0000 127.9961 FORMAT "%8.4" DEPOSIT ABSOLUTE /end AXIS_DESCR
/end CHARACTERISTIC
/begin CHARACTERISTIC CrCtl_facEcoFdbkAccnVal0_C "Acceleration feed back factor value under Gear no.0 for Eco mode" VALUE 0x80535842 Val_Ws16 255.9922 Fact1 0.00 255.9922 FORMAT "%8.4" EXTENDED_LIMITS -256.0000 255.9922 /end CHARACTERISTIC
/begin CHARACTERISTIC CrCtl_facEcoFdbkAccnVal1_C "Acceleration feed back factor value under Gear no.1 for Eco mode" VALUE 0x80535844 Val_Ws16 255.9922 Fact1 0.00 255.9922 FORMAT "%8.4" EXTENDED_LIMITS -256.0000 255.9922 /end CHARACTERISTIC
/begin CHARACTERISTIC CrCtl_facEcoFdbkAccnVal2_C "Acceleration feed back factor value under Gear no.2 for Eco mode" VALUE 0x80535846 Val_Ws16 255.9922 Fact1 0.00 255.9922 FORMAT "%8.4" EXTENDED_LIMITS -256.0000 255.9922 /end CHARACTERISTIC
/begin CHARACTERISTIC CrCtl_facEcoFdbkAccnVal3_C "Acceleration feed back factor value under Gear no.3 for Eco mode" VALUE 0x80535848 Val_Ws16 255.9922 Fact1 0.00 255.9922 FORMAT "%8.4" EXTENDED_LIMITS -256.0000 255.9922 /end CHARACTERISTIC
/begin CHARACTERISTIC CrCtl_facEcoFdbkAccnVal4_C "Acceleration feed back factor value under Gear no.4 for Eco mode" VALUE 0x8053584A Val_Ws16 255.9922 Fact1 0.00 255.9922 FORMAT "%8.4" EXTENDED_LIMITS -256.0000 255.9922 /end CHARACTERISTIC
/begin CHARACTERISTIC CrCtl_facEcoFdbkDReviVal0_C "Feed Back D factor revision value for Eco mode under Gear no.0" VALUE 0x8053584C Val_Ws16 255.9922 Fact1 0.00 255.9922 FORMAT "%8.4" EXTENDED_LIMITS -256.0000 255.9922 /end CHARACTERISTIC
/begin CHARACTERISTIC CrCtl_facEcoFdbkDReviVal1_C "Feed Back D factor revision value for Eco mode under Gear no.1" VALUE 0x8053584E Val_Ws16 255.9922 Fact1 0.00 255.9922 FORMAT "%8.4" EXTENDED_LIMITS -256.0000 255.9922 /end CHARACTERISTIC
/begin CHARACTERISTIC CrCtl_facEcoFdbkDReviVal2_C "Feed Back D factor revision value for Eco mode under Gear no.2" VALUE 0x80535850 Val_Ws16 255.9922 Fact1 0.00 255.9922 FORMAT "%8.4" EXTENDED_LIMITS -256.0000 255.9922 /end CHARACTERISTIC
/begin CHARACTERISTIC CrCtl_facEcoFdbkDReviVal3_C "Feed Back D factor revision value for Eco mode under Gear no.3" VALUE 0x80535852 Val_Ws16 255.9922 Fact1 0.00 255.9922 FORMAT "%8.4" EXTENDED_LIMITS -256.0000 255.9922 /end CHARACTERISTIC
/begin CHARACTERISTIC CrCtl_facEcoFdbkDReviVal4_C "Feed Back D factor revision value for Eco mode under Gear no.4" VALUE 0x80535854 Val_Ws16 255.9922 Fact1 0.00 255.9922 FORMAT "%8.4" EXTENDED_LIMITS -256.0000 255.9922 /end CHARACTERISTIC
/begin CHARACTERISTIC CrCtl_facEcoFdbkPReviVal0_C "Feed Back P factor revision value for Eco mode under Gear no.0" VALUE 0x80535856 Val_Ws16 255.9922 Fact1 0.00 255.9922 FORMAT "%8.4" EXTENDED_LIMITS -256.0000 255.9922 /end CHARACTERISTIC
/begin CHARACTERISTIC CrCtl_facEcoFdbkPReviVal1_C "Feed Back P factor revision value for Eco mode under Gear no.1" VALUE 0x80535858 Val_Ws16 255.9922 Fact1 0.00 255.9922 FORMAT "%8.4" EXTENDED_LIMITS -256.0000 255.9922 /end CHARACTERISTIC
/begin CHARACTERISTIC CrCtl_facEcoFdbkPReviVal2_C "Feed Back P factor revision value for Eco mode under Gear no.2" VALUE 0x8053585A Val_Ws16 255.9922 Fact1 0.00 255.9922 FORMAT "%8.4" EXTENDED_LIMITS -256.0000 255.9922 /end CHARACTERISTIC
/begin CHARACTERISTIC CrCtl_facEcoFdbkPReviVal3_C "Feed Back P factor revision value for Eco mode under Gear no.3" VALUE 0x8053585C Val_Ws16 255.9922 Fact1 0.00 255.9922 FORMAT "%8.4" EXTENDED_LIMITS -256.0000 255.9922 /end CHARACTERISTIC
/begin CHARACTERISTIC CrCtl_facEcoFdbkPReviVal4_C "Feed Back P factor revision value for Eco mode under Gear no.4" VALUE 0x8053585E Val_Ws16 255.9922 Fact1 0.00 255.9922 FORMAT "%8.4" EXTENDED_LIMITS -256.0000 255.9922 /end CHARACTERISTIC
/begin CHARACTERISTIC CrCtl_facECOffAAppUp2_CUR "Acceleration factor for changing APP limitation number for ECON to 3 from 2 (for Acceleration and ECON sw OFF)" CURVE 0x80535860 RB_Cur_Xs16Ws16 0.9960938 Fact_CrCtl 0.00 0.9960938 FORMAT "%9.7" EXTENDED_LIMITS -128.0000 127.9961
 /begin AXIS_DESCR STD_AXIS CrCtl_tiDRAccnControl_mp Time_ms_100ms 6 -3276800. 3276700. FORMAT "%8.0" DEPOSIT ABSOLUTE /end AXIS_DESCR
/end CHARACTERISTIC
/begin CHARACTERISTIC CrCtl_facECOffAAppUp3_CUR "Acceleration factor for changing APP limitation number for ECON to 4 from 3 (for Acceleration and ECON sw OFF)" CURVE 0x8053587A RB_Cur_Xs16Ws16 0.9960938 Fact_CrCtl 0.00 0.9960938 FORMAT "%9.7" EXTENDED_LIMITS -128.0000 127.9961
 /begin AXIS_DESCR STD_AXIS CrCtl_tiDRAccnControl_mp Time_ms_100ms 6 -3276800. 3276700. FORMAT "%8.0" DEPOSIT ABSOLUTE /end AXIS_DESCR
/end CHARACTERISTIC
/begin CHARACTERISTIC CrCtl_facECOffAAppUp4_CUR "Acceleration factor for changing APP limitation number for ECON to 5 from 4 (for Acceleration and ECON sw OFF)" CURVE 0x80535894 RB_Cur_Xs16Ws16 0.9960938 Fact_CrCtl 0.00 0.9960938 FORMAT "%9.7" EXTENDED_LIMITS -128.0000 127.9961
 /begin AXIS_DESCR STD_AXIS CrCtl_tiDRAccnControl_mp Time_ms_100ms 6 -3276800. 3276700. FORMAT "%8.0" DEPOSIT ABSOLUTE /end AXIS_DESCR
/end CHARACTERISTIC
/begin CHARACTERISTIC CrCtl_facECOffAAppUp5_CUR "Acceleration factor for changing APP limitation number for ECON to 2 from 1 (for Acceleration and ECON sw ON)" CURVE 0x805358AE RB_Cur_Xs16Ws16 0.9960938 Fact_CrCtl 0.00 0.9960938 FORMAT "%9.7" EXTENDED_LIMITS -128.0000 127.9961
 /begin AXIS_DESCR STD_AXIS CrCtl_tiDRAccnControl_mp Time_ms_100ms 6 -3276800. 3276700. FORMAT "%8.0" DEPOSIT ABSOLUTE /end AXIS_DESCR
/end CHARACTERISTIC
/begin CHARACTERISTIC CrCtl_facECOffAFbUp2_CUR "Acceleration factor for changing APP limitation number for ECON to 3 from 2 (for FB and ECON sw OFF)" CURVE 0x805358C8 RB_Cur_Xs16Ws16 0.9960938 Fact_CrCtl 0.00 0.9960938 FORMAT "%9.7" EXTENDED_LIMITS -128.0000 127.9961
 /begin AXIS_DESCR STD_AXIS CrCtl_vSpdVar_mp Vel_CrCtl 6 -128.0000 127.9961 FORMAT "%8.4" DEPOSIT ABSOLUTE /end AXIS_DESCR
/end CHARACTERISTIC
/begin CHARACTERISTIC CrCtl_facECOffAFbUp3_CUR "Acceleration factor for changing APP limitation number for ECON to 4 from 3 (for FB and ECON sw OFF)" CURVE 0x805358E2 RB_Cur_Xs16Ws16 0.9960938 Fact_CrCtl 0.00 0.9960938 FORMAT "%9.7" EXTENDED_LIMITS -128.0000 127.9961
 /begin AXIS_DESCR STD_AXIS CrCtl_vSpdVar_mp Vel_CrCtl 6 -128.0000 127.9961 FORMAT "%8.4" DEPOSIT ABSOLUTE /end AXIS_DESCR
/end CHARACTERISTIC
/begin CHARACTERISTIC CrCtl_facECOffAFbUp4_CUR "Acceleration factor for changing APP limitation number for ECON to 5 from 4 (for FB and ECON sw OFF)" CURVE 0x805358FC RB_Cur_Xs16Ws16 0.9960938 Fact_CrCtl 0.00 0.9960938 FORMAT "%9.7" EXTENDED_LIMITS -128.0000 127.9961
 /begin AXIS_DESCR STD_AXIS CrCtl_vSpdVar_mp Vel_CrCtl 6 -128.0000 127.9961 FORMAT "%8.4" DEPOSIT ABSOLUTE /end AXIS_DESCR
/end CHARACTERISTIC
/begin CHARACTERISTIC CrCtl_facECOffAFbUp5_CUR "Acceleration factor for changing APP limitation number for ECON to 2 from 1 (for FB and ECON sw ON)" CURVE 0x80535916 RB_Cur_Xs16Ws16 0.9960938 Fact_CrCtl 0.00 0.9960938 FORMAT "%9.7" EXTENDED_LIMITS -128.0000 127.9961
 /begin AXIS_DESCR STD_AXIS CrCtl_vSpdVar_mp Vel_CrCtl 6 -128.0000 127.9961 FORMAT "%8.4" DEPOSIT ABSOLUTE /end AXIS_DESCR
/end CHARACTERISTIC
/begin CHARACTERISTIC CrCtl_facECOffAResUp2_MAP "Acceleration factor for changing APP limitation number for ECON to 3 from 2 (for Resume and ECON sw OFF)" MAP 0x80535930 Map_Xs16Ys16Ws16 0.9960938 Fact_CrCtl 0.00 0.9960938 FORMAT "%9.7" EXTENDED_LIMITS -128.0000 127.9961
 /begin AXIS_DESCR STD_AXIS CrCtl_tiDRAccnControl_mp Time_ms_100ms 6 -3276800. 3276700. FORMAT "%8.0" DEPOSIT ABSOLUTE /end AXIS_DESCR
 /begin AXIS_DESCR STD_AXIS CrCtl_vSpdVar_mp Vel_CrCtl 6 -128.0000 127.9961 FORMAT "%8.4" DEPOSIT ABSOLUTE /end AXIS_DESCR
/end CHARACTERISTIC
/begin CHARACTERISTIC CrCtl_facECOffAResUp3_MAP "Acceleration factor for changing APP limitation number for ECON to 4 from 3 (for Resume and ECON sw OFF)" MAP 0x80535994 Map_Xs16Ys16Ws16 0.9960938 Fact_CrCtl 0.00 0.9960938 FORMAT "%9.7" EXTENDED_LIMITS -128.0000 127.9961
 /begin AXIS_DESCR STD_AXIS CrCtl_tiDRAccnControl_mp Time_ms_100ms 6 -3276800. 3276700. FORMAT "%8.0" DEPOSIT ABSOLUTE /end AXIS_DESCR
 /begin AXIS_DESCR STD_AXIS CrCtl_vSpdVar_mp Vel_CrCtl 6 -128.0000 127.9961 FORMAT "%8.4" DEPOSIT ABSOLUTE /end AXIS_DESCR
/end CHARACTERISTIC
/begin CHARACTERISTIC CrCtl_facECOffAResUp4_MAP "Acceleration factor for changing APP limitation number for ECON to 5 from 4 (for Resume and ECON sw OFF)" MAP 0x805359F8 Map_Xs16Ys16Ws16 0.9960938 Fact_CrCtl 0.00 0.9960938 FORMAT "%9.7" EXTENDED_LIMITS -128.0000 127.9961
 /begin AXIS_DESCR STD_AXIS CrCtl_tiDRAccnControl_mp Time_ms_100ms 6 -3276800. 3276700. FORMAT "%8.0" DEPOSIT ABSOLUTE /end AXIS_DESCR
 /begin AXIS_DESCR STD_AXIS CrCtl_vSpdVar_mp Vel_CrCtl 6 -128.0000 127.9961 FORMAT "%8.4" DEPOSIT ABSOLUTE /end AXIS_DESCR
/end CHARACTERISTIC
/begin CHARACTERISTIC CrCtl_facECOffAResUp5_MAP "Acceleration factor for changing APP limitation number for ECON to 2 from 1 (for Resume and ECON sw ON)" MAP 0x80535A5C Map_Xs16Ys16Ws16 0.9960938 Fact_CrCtl 0.00 0.9960938 FORMAT "%9.7" EXTENDED_LIMITS -128.0000 127.9961
 /begin AXIS_DESCR STD_AXIS CrCtl_tiDRAccnControl_mp Time_ms_100ms 6 -3276800. 3276700. FORMAT "%8.0" DEPOSIT ABSOLUTE /end AXIS_DESCR
 /begin AXIS_DESCR STD_AXIS CrCtl_vSpdVar_mp Vel_CrCtl 6 -128.0000 127.9961 FORMAT "%8.4" DEPOSIT ABSOLUTE /end AXIS_DESCR
/end CHARACTERISTIC
/begin CHARACTERISTIC CrCtl_facECOnAAppUp2_CUR "Acceleration factor for changing APP limitation number for ECON to 3 from 2 (for Acceleration and ECON sw ON)" CURVE 0x80535AC0 RB_Cur_Xs16Ws16 0.9960938 Fact_CrCtl 0.00 0.9960938 FORMAT "%9.7" EXTENDED_LIMITS -128.0000 127.9961
 /begin AXIS_DESCR STD_AXIS CrCtl_tiDRAccnControl_mp Time_ms_100ms 6 -3276800. 3276700. FORMAT "%8.0" DEPOSIT ABSOLUTE /end AXIS_DESCR
/end CHARACTERISTIC
/begin CHARACTERISTIC CrCtl_facECOnAAppUp3_CUR "Acceleration factor for changing APP limitation number for ECON to 4 from 3 (for Acceleration and ECON sw ON)" CURVE 0x80535ADA RB_Cur_Xs16Ws16 0.9960938 Fact_CrCtl 0.00 0.9960938 FORMAT "%9.7" EXTENDED_LIMITS -128.0000 127.9961
 /begin AXIS_DESCR STD_AXIS CrCtl_tiDRAccnControl_mp Time_ms_100ms 6 -3276800. 3276700. FORMAT "%8.0" DEPOSIT ABSOLUTE /end AXIS_DESCR
/end CHARACTERISTIC
/begin CHARACTERISTIC CrCtl_facECOnAAppUp4_CUR "Acceleration factor for changing APP limitation number for ECON to 5 from 4 (for Acceleration and ECON sw ON)" CURVE 0x80535AF4 RB_Cur_Xs16Ws16 0.9960938 Fact_CrCtl 0.00 0.9960938 FORMAT "%9.7" EXTENDED_LIMITS -128.0000 127.9961
 /begin AXIS_DESCR STD_AXIS CrCtl_tiDRAccnControl_mp Time_ms_100ms 6 -3276800. 3276700. FORMAT "%8.0" DEPOSIT ABSOLUTE /end AXIS_DESCR
/end CHARACTERISTIC
/begin CHARACTERISTIC CrCtl_facECOnAAppUp5_CUR "Acceleration factor for changing APP limitation number for ECON to 2 from 1 (for Acceleration , ECON sw OFF, and during ACC)" CURVE 0x80535B0E RB_Cur_Xs16Ws16 0.9960938 Fact_CrCtl 0.00 0.9960938 FORMAT "%9.7" EXTENDED_LIMITS -128.0000 127.9961
 /begin AXIS_DESCR STD_AXIS CrCtl_tiDRAccnControl_mp Time_ms_100ms 6 -3276800. 3276700. FORMAT "%8.0" DEPOSIT ABSOLUTE /end AXIS_DESCR
/end CHARACTERISTIC
/begin CHARACTERISTIC CrCtl_facECOnAFbUp2_CUR "Acceleration factor for changing APP limitation number for ECON to 3 from 2 (for FB and ECON sw ON)" CURVE 0x80535B28 RB_Cur_Xs16Ws16 0.9960938 Fact_CrCtl 0.00 0.9960938 FORMAT "%9.7" EXTENDED_LIMITS -128.0000 127.9961
 /begin AXIS_DESCR STD_AXIS CrCtl_vSpdVar_mp Vel_CrCtl 6 -128.0000 127.9961 FORMAT "%8.4" DEPOSIT ABSOLUTE /end AXIS_DESCR
/end CHARACTERISTIC
/begin CHARACTERISTIC CrCtl_facECOnAFbUp3_CUR "Acceleration factor for changing APP limitation number for ECON to 4 from 3 (for FB and ECON sw ON)" CURVE 0x80535B42 RB_Cur_Xs16Ws16 0.9960938 Fact_CrCtl 0.00 0.9960938 FORMAT "%9.7" EXTENDED_LIMITS -128.0000 127.9961
 /begin AXIS_DESCR STD_AXIS CrCtl_vSpdVar_mp Vel_CrCtl 6 -128.0000 127.9961 FORMAT "%8.4" DEPOSIT ABSOLUTE /end AXIS_DESCR
/end CHARACTERISTIC
/begin CHARACTERISTIC CrCtl_facECOnAFbUp4_CUR "Acceleration factor for changing APP limitation number for ECON to 5 from 4 (for FB and ECON sw ON)" CURVE 0x80535B5C RB_Cur_Xs16Ws16 0.9960938 Fact_CrCtl 0.00 0.9960938 FORMAT "%9.7" EXTENDED_LIMITS -128.0000 127.9961
 /begin AXIS_DESCR STD_AXIS CrCtl_vSpdVar_mp Vel_CrCtl 6 -128.0000 127.9961 FORMAT "%8.4" DEPOSIT ABSOLUTE /end AXIS_DESCR
/end CHARACTERISTIC
/begin CHARACTERISTIC CrCtl_facECOnAFbUp5_CUR "Acceleration factor for changing APP limitation number for ECON to 2 from 1 (for FB, ECON sw OFF, and during ACC)" CURVE 0x80535B76 RB_Cur_Xs16Ws16 0.9960938 Fact_CrCtl 0.00 0.9960938 FORMAT "%9.7" EXTENDED_LIMITS -128.0000 127.9961
 /begin AXIS_DESCR STD_AXIS CrCtl_vSpdVar_mp Vel_CrCtl 6 -128.0000 127.9961 FORMAT "%8.4" DEPOSIT ABSOLUTE /end AXIS_DESCR
/end CHARACTERISTIC
/begin CHARACTERISTIC CrCtl_facECOnAResUp2_MAP "Acceleration factor for changing APP limitation number for ECON to 3 from 2 (for Resume and ECON sw ON)" MAP 0x80535B90 Map_Xs16Ys16Ws16 0.9960938 Fact_CrCtl 0.00 0.9960938 FORMAT "%9.7" EXTENDED_LIMITS -128.0000 127.9961
 /begin AXIS_DESCR STD_AXIS CrCtl_tiDRAccnControl_mp Time_ms_100ms 6 -3276800. 3276700. FORMAT "%8.0" DEPOSIT ABSOLUTE /end AXIS_DESCR
 /begin AXIS_DESCR STD_AXIS CrCtl_vSpdVar_mp Vel_CrCtl 6 -128.0000 127.9961 FORMAT "%8.4" DEPOSIT ABSOLUTE /end AXIS_DESCR
/end CHARACTERISTIC
/begin CHARACTERISTIC CrCtl_facECOnAResUp3_MAP "Acceleration factor for changing APP limitation number for ECON to 4 from 3 (for Resume and ECON sw ON)" MAP 0x80535BF4 Map_Xs16Ys16Ws16 0.9960938 Fact_CrCtl 0.00 0.9960938 FORMAT "%9.7" EXTENDED_LIMITS -128.0000 127.9961
 /begin AXIS_DESCR STD_AXIS CrCtl_tiDRAccnControl_mp Time_ms_100ms 6 -3276800. 3276700. FORMAT "%8.0" DEPOSIT ABSOLUTE /end AXIS_DESCR
 /begin AXIS_DESCR STD_AXIS CrCtl_vSpdVar_mp Vel_CrCtl 6 -128.0000 127.9961 FORMAT "%8.4" DEPOSIT ABSOLUTE /end AXIS_DESCR
/end CHARACTERISTIC
/begin CHARACTERISTIC CrCtl_facECOnAResUp4_MAP "Acceleration factor for changing APP limitation number for ECON to 5 from 4 (for Resume and ECON sw ON)" MAP 0x80535C58 Map_Xs16Ys16Ws16 0.9960938 Fact_CrCtl 0.00 0.9960938 FORMAT "%9.7" EXTENDED_LIMITS -128.0000 127.9961
 /begin AXIS_DESCR STD_AXIS CrCtl_tiDRAccnControl_mp Time_ms_100ms 6 -3276800. 3276700. FORMAT "%8.0" DEPOSIT ABSOLUTE /end AXIS_DESCR
 /begin AXIS_DESCR STD_AXIS CrCtl_vSpdVar_mp Vel_CrCtl 6 -128.0000 127.9961 FORMAT "%8.4" DEPOSIT ABSOLUTE /end AXIS_DESCR
/end CHARACTERISTIC
/begin CHARACTERISTIC CrCtl_facECOnAResUp5_MAP "Acceleration factor for changing APP limitation number for ECON to 2 from 1 (for Resume, ECON sw OFF, and during ACC)" MAP 0x80535CBC Map_Xs16Ys16Ws16 0.9960938 Fact_CrCtl 0.00 0.9960938 FORMAT "%9.7" EXTENDED_LIMITS -128.0000 127.9961
 /begin AXIS_DESCR STD_AXIS CrCtl_tiDRAccnControl_mp Time_ms_100ms 6 -3276800. 3276700. FORMAT "%8.0" DEPOSIT ABSOLUTE /end AXIS_DESCR
 /begin AXIS_DESCR STD_AXIS CrCtl_vSpdVar_mp Vel_CrCtl 6 -128.0000 127.9961 FORMAT "%8.4" DEPOSIT ABSOLUTE /end AXIS_DESCR
/end CHARACTERISTIC
/begin CHARACTERISTIC CrCtl_facECTGAppDiffCls_GMAP "Correct value of APP in top gear for ECON and close side" MAP 0x80535D20 MapG_Ws16 511.9922 Fact1 -256.0000 255.9922 FORMAT "%8.4"
 /begin AXIS_DESCR COM_AXIS CrCtl_rReq_mp APPCrCtl1 12 0.00 163.8350 FORMAT "%8.4" EXTENDED_LIMITS -163.8400 163.8350 AXIS_PTS_REF CrCtl_facAPPReviX_AXIS /end AXIS_DESCR
 /begin AXIS_DESCR COM_AXIS CrCtl_vVehUpByte Vel_CrCtl1 6 0.00 255.0000 FORMAT "%8.4" EXTENDED_LIMITS -32768.00 32767.00 AXIS_PTS_REF CrCtl_facAPPReviY_AXIS /end AXIS_DESCR
/end CHARACTERISTIC
/begin CHARACTERISTIC CrCtl_facECTGAppDiff_GMAP "Correct value of APP in excepting top gear for ECON" MAP 0x80535DB0 MapG_Ws16 511.9922 Fact1 -256.0000 255.9922 FORMAT "%8.4"
 /begin AXIS_DESCR COM_AXIS CrCtl_rReq_mp APPCrCtl1 12 0.00 163.8350 FORMAT "%8.4" EXTENDED_LIMITS -163.8400 163.8350 AXIS_PTS_REF CrCtl_facAPPReviX_AXIS /end AXIS_DESCR
 /begin AXIS_DESCR COM_AXIS CrCtl_vVehUpByte Vel_CrCtl1 6 0.00 255.0000 FORMAT "%8.4" EXTENDED_LIMITS -32768.00 32767.00 AXIS_PTS_REF CrCtl_facAPPReviY_AXIS /end AXIS_DESCR
/end CHARACTERISTIC
/begin CHARACTERISTIC CrCtl_facFbACmftD12_GMAP "MAP for acceleration Feed Back D factor for comfort mode" MAP 0x80535E40 MapG_Ws16 511.9844 Fact_CrCtl2 0.00 511.9844 FORMAT "%8.4" EXTENDED_LIMITS -512.0000 511.9844
 /begin AXIS_DESCR COM_AXIS CrCtl_vVehUpByte Vel_CrCtl1 12 0.00 255.0000 FORMAT "%8.4" EXTENDED_LIMITS -32768.00 32767.00 AXIS_PTS_REF CrCtl_facFbAX_AXIS /end AXIS_DESCR
 /begin AXIS_DESCR COM_AXIS CrCtl_vAccnVar_mp Vel_CrCtl 9 -128.0000 127.9961 FORMAT "%8.4" AXIS_PTS_REF CrCtl_facFbAY_AXIS /end AXIS_DESCR
/end CHARACTERISTIC
/begin CHARACTERISTIC CrCtl_facFbACmftP12_GMAP "MAP for acceleration Feed Back P factor for comfort mode" MAP 0x80535F18 MapG_Ws16 511.9844 Fact_CrCtl2 0.00 511.9844 FORMAT "%8.4" EXTENDED_LIMITS -512.0000 511.9844
 /begin AXIS_DESCR COM_AXIS CrCtl_vVehUpByte Vel_CrCtl1 12 0.00 255.0000 FORMAT "%8.4" EXTENDED_LIMITS -32768.00 32767.00 AXIS_PTS_REF CrCtl_facFbAX_AXIS /end AXIS_DESCR
 /begin AXIS_DESCR COM_AXIS CrCtl_vAccnVar_mp Vel_CrCtl 9 -128.0000 127.9961 FORMAT "%8.4" AXIS_PTS_REF CrCtl_facFbAY_AXIS /end AXIS_DESCR
/end CHARACTERISTIC
/begin CHARACTERISTIC CrCtl_facFbAD12_GMAP "Map for acceleration FeedBack D factor" MAP 0x80535FF0 MapG_Ws16 511.9844 Fact_CrCtl2 0.00 511.9844 FORMAT "%8.4" EXTENDED_LIMITS -512.0000 511.9844
 /begin AXIS_DESCR COM_AXIS CrCtl_vVehUpByte Vel_CrCtl1 12 0.00 255.0000 FORMAT "%8.4" EXTENDED_LIMITS -32768.00 32767.00 AXIS_PTS_REF CrCtl_facFbAX_AXIS /end AXIS_DESCR
 /begin AXIS_DESCR COM_AXIS CrCtl_vAccnVar_mp Vel_CrCtl 9 -128.0000 127.9961 FORMAT "%8.4" AXIS_PTS_REF CrCtl_facFbAY_AXIS /end AXIS_DESCR
/end CHARACTERISTIC
/begin CHARACTERISTIC CrCtl_facFbAEcoD12_GMAP "Map for acceleration FeedBack D factor for Eco mode" MAP 0x805360C8 MapG_Ws16 511.9844 Fact_CrCtl2 0.00 511.9844 FORMAT "%8.4" EXTENDED_LIMITS -512.0000 511.9844
 /begin AXIS_DESCR COM_AXIS CrCtl_vVehUpByte Vel_CrCtl1 12 0.00 255.0000 FORMAT "%8.4" EXTENDED_LIMITS -32768.00 32767.00 AXIS_PTS_REF CrCtl_facFbAX_AXIS /end AXIS_DESCR
 /begin AXIS_DESCR COM_AXIS CrCtl_vAccnVar_mp Vel_CrCtl 9 -128.0000 127.9961 FORMAT "%8.4" AXIS_PTS_REF CrCtl_facFbAY_AXIS /end AXIS_DESCR
/end CHARACTERISTIC
/begin CHARACTERISTIC CrCtl_facFbAEcoP12_GMAP "Map for acceleration FeedBack P factor for Eco mode" MAP 0x805361A0 MapG_Ws16 511.9844 Fact_CrCtl2 0.00 511.9844 FORMAT "%8.4" EXTENDED_LIMITS -512.0000 511.9844
 /begin AXIS_DESCR COM_AXIS CrCtl_vVehUpByte Vel_CrCtl1 12 0.00 255.0000 FORMAT "%8.4" EXTENDED_LIMITS -32768.00 32767.00 AXIS_PTS_REF CrCtl_facFbAX_AXIS /end AXIS_DESCR
 /begin AXIS_DESCR COM_AXIS CrCtl_vAccnVar_mp Vel_CrCtl 9 -128.0000 127.9961 FORMAT "%8.4" AXIS_PTS_REF CrCtl_facFbAY_AXIS /end AXIS_DESCR
/end CHARACTERISTIC
/begin CHARACTERISTIC CrCtl_facFbAP12_GMAP "Map for acceleration FeedBack P factor" MAP 0x80536278 MapG_Ws16 511.9844 Fact_CrCtl2 0.00 511.9844 FORMAT "%8.4" EXTENDED_LIMITS -512.0000 511.9844
 /begin AXIS_DESCR COM_AXIS CrCtl_vVehUpByte Vel_CrCtl1 12 0.00 255.0000 FORMAT "%8.4" EXTENDED_LIMITS -32768.00 32767.00 AXIS_PTS_REF CrCtl_facFbAX_AXIS /end AXIS_DESCR
 /begin AXIS_DESCR COM_AXIS CrCtl_vAccnVar_mp Vel_CrCtl 9 -128.0000 127.9961 FORMAT "%8.4" AXIS_PTS_REF CrCtl_facFbAY_AXIS /end AXIS_DESCR
/end CHARACTERISTIC
/begin AXIS_PTS CrCtl_facFbAreaX_AXIS "X-Axis for vehicle speed feed back APP request group MAP" 0x80536350 CrCtl_vDesUpByte_mp Axis_Xs16 255.0000 Vel_CrCtl1 12 0.00 255.0000 FORMAT "%8.4" EXTENDED_LIMITS -32768.00 32767.00 DEPOSIT ABSOLUTE /end AXIS_PTS
/begin AXIS_PTS CrCtl_facFbAreaY_AXIS "Y-Axis for vehicle speed feed back APP request group MAP" 0x8053636A CrCtl_vSpdVar_mp Axis_Xs16 255.9961 Vel_CrCtl 12 -128.0000 127.9961 FORMAT "%8.4" DEPOSIT ABSOLUTE /end AXIS_PTS
/begin CHARACTERISTIC CrCtl_facFbASptD12_GMAP "Map for acceleration FeedBack D factor for Sport mode" MAP 0x80536384 MapG_Ws16 511.9844 Fact_CrCtl2 0.00 511.9844 FORMAT "%8.4" EXTENDED_LIMITS -512.0000 511.9844
 /begin AXIS_DESCR COM_AXIS CrCtl_vVehUpByte Vel_CrCtl1 12 0.00 255.0000 FORMAT "%8.4" EXTENDED_LIMITS -32768.00 32767.00 AXIS_PTS_REF CrCtl_facFbAX_AXIS /end AXIS_DESCR
 /begin AXIS_DESCR COM_AXIS CrCtl_vAccnVar_mp Vel_CrCtl 9 -128.0000 127.9961 FORMAT "%8.4" AXIS_PTS_REF CrCtl_facFbAY_AXIS /end AXIS_DESCR
/end CHARACTERISTIC
/begin CHARACTERISTIC CrCtl_facFbASptP12_GMAP "Map for acceleration FeedBack P factor for Sport mode" MAP 0x8053645C MapG_Ws16 511.9844 Fact_CrCtl2 0.00 511.9844 FORMAT "%8.4" EXTENDED_LIMITS -512.0000 511.9844
 /begin AXIS_DESCR COM_AXIS CrCtl_vVehUpByte Vel_CrCtl1 12 0.00 255.0000 FORMAT "%8.4" EXTENDED_LIMITS -32768.00 32767.00 AXIS_PTS_REF CrCtl_facFbAX_AXIS /end AXIS_DESCR
 /begin AXIS_DESCR COM_AXIS CrCtl_vAccnVar_mp Vel_CrCtl 9 -128.0000 127.9961 FORMAT "%8.4" AXIS_PTS_REF CrCtl_facFbAY_AXIS /end AXIS_DESCR
/end CHARACTERISTIC
/begin AXIS_PTS CrCtl_facFbAX_AXIS "X-Asix for output acceleration factor of Group MAP" 0x80536534 CrCtl_vVehUpByte Axis_Xs16 255.0000 Vel_CrCtl1 12 0.00 255.0000 FORMAT "%8.4" EXTENDED_LIMITS -32768.00 32767.00 DEPOSIT ABSOLUTE /end AXIS_PTS
/begin AXIS_PTS CrCtl_facFbAY_AXIS "Y-Asix for output acceleration factor of Group MAP" 0x8053654E CrCtl_vAccnVar_mp Axis_Xs16 255.9961 Vel_CrCtl 9 -128.0000 127.9961 FORMAT "%8.4" DEPOSIT ABSOLUTE /end AXIS_PTS
/begin CHARACTERISTIC CrCtl_facFbCmftD12_GMAP "MAP for vehicle speed feed back area D factor value for comfort mode" MAP 0x80536562 MapG_Ws16 511.9844 Fact_CrCtl2 0.00 511.9844 FORMAT "%8.4" EXTENDED_LIMITS -512.0000 511.9844
 /begin AXIS_DESCR COM_AXIS CrCtl_vDesUpByte_mp Vel_CrCtl1 12 0.00 255.0000 FORMAT "%8.4" EXTENDED_LIMITS -32768.00 32767.00 AXIS_PTS_REF CrCtl_facFbAreaX_AXIS /end AXIS_DESCR
 /begin AXIS_DESCR COM_AXIS CrCtl_vSpdVar_mp Vel_CrCtl 12 -128.0000 127.9961 FORMAT "%8.4" AXIS_PTS_REF CrCtl_facFbAreaY_AXIS /end AXIS_DESCR
/end CHARACTERISTIC
/begin CHARACTERISTIC CrCtl_facFbCmftP12_GMAP "MAP for vehicle speed feed back area P factor value for comfort mode" MAP 0x80536682 MapG_Ws16 31.99902 Fact_CrCtl3 0.00 31.99902 FORMAT "%8.5" EXTENDED_LIMITS -32.00000 31.99902
 /begin AXIS_DESCR COM_AXIS CrCtl_vDesUpByte_mp Vel_CrCtl1 12 0.00 255.0000 FORMAT "%8.4" EXTENDED_LIMITS -32768.00 32767.00 AXIS_PTS_REF CrCtl_facFbAreaX_AXIS /end AXIS_DESCR
 /begin AXIS_DESCR COM_AXIS CrCtl_vSpdVar_mp Vel_CrCtl 12 -128.0000 127.9961 FORMAT "%8.4" AXIS_PTS_REF CrCtl_facFbAreaY_AXIS /end AXIS_DESCR
/end CHARACTERISTIC
/begin CHARACTERISTIC CrCtl_facFbD12_GMAP "MAP for vehicle speed feed back area D factor value for normal mode" MAP 0x805367A2 MapG_Ws16 511.9844 Fact_CrCtl2 0.00 511.9844 FORMAT "%8.4" EXTENDED_LIMITS -512.0000 511.9844
 /begin AXIS_DESCR COM_AXIS CrCtl_vDesUpByte_mp Vel_CrCtl1 12 0.00 255.0000 FORMAT "%8.4" EXTENDED_LIMITS -32768.00 32767.00 AXIS_PTS_REF CrCtl_facFbAreaX_AXIS /end AXIS_DESCR
 /begin AXIS_DESCR COM_AXIS CrCtl_vSpdVar_mp Vel_CrCtl 12 -128.0000 127.9961 FORMAT "%8.4" AXIS_PTS_REF CrCtl_facFbAreaY_AXIS /end AXIS_DESCR
/end CHARACTERISTIC
/begin CHARACTERISTIC CrCtl_facFbEcoD12_GMAP "MAP for vehicle speed feed back area D factor value for economy mode" MAP 0x805368C2 MapG_Ws16 511.9844 Fact_CrCtl2 0.00 511.9844 FORMAT "%8.4" EXTENDED_LIMITS -512.0000 511.9844
 /begin AXIS_DESCR COM_AXIS CrCtl_vDesUpByte_mp Vel_CrCtl1 12 0.00 255.0000 FORMAT "%8.4" EXTENDED_LIMITS -32768.00 32767.00 AXIS_PTS_REF CrCtl_facFbAreaX_AXIS /end AXIS_DESCR
 /begin AXIS_DESCR COM_AXIS CrCtl_vSpdVar_mp Vel_CrCtl 12 -128.0000 127.9961 FORMAT "%8.4" AXIS_PTS_REF CrCtl_facFbAreaY_AXIS /end AXIS_DESCR
/end CHARACTERISTIC
/begin CHARACTERISTIC CrCtl_facFbEcoP12_GMAP "MAP for vehicle speed feed back area P factor value for economy mode" MAP 0x805369E2 MapG_Ws16 31.99902 Fact_CrCtl3 0.00 31.99902 FORMAT "%8.5" EXTENDED_LIMITS -32.00000 31.99902
 /begin AXIS_DESCR COM_AXIS CrCtl_vDesUpByte_mp Vel_CrCtl1 12 0.00 255.0000 FORMAT "%8.4" EXTENDED_LIMITS -32768.00 32767.00 AXIS_PTS_REF CrCtl_facFbAreaX_AXIS /end AXIS_DESCR
 /begin AXIS_DESCR COM_AXIS CrCtl_vSpdVar_mp Vel_CrCtl 12 -128.0000 127.9961 FORMAT "%8.4" AXIS_PTS_REF CrCtl_facFbAreaY_AXIS /end AXIS_DESCR
/end CHARACTERISTIC
/begin CHARACTERISTIC CrCtl_facFbP12_GMAP "MAP for vehicle speed feed back area D factor value for normal mode" MAP 0x80536B02 MapG_Ws16 31.99902 Fact_CrCtl3 0.00 31.99902 FORMAT "%8.5" EXTENDED_LIMITS -32.00000 31.99902
 /begin AXIS_DESCR COM_AXIS CrCtl_vDesUpByte_mp Vel_CrCtl1 12 0.00 255.0000 FORMAT "%8.4" EXTENDED_LIMITS -32768.00 32767.00 AXIS_PTS_REF CrCtl_facFbAreaX_AXIS /end AXIS_DESCR
 /begin AXIS_DESCR COM_AXIS CrCtl_vSpdVar_mp Vel_CrCtl 12 -128.0000 127.9961 FORMAT "%8.4" AXIS_PTS_REF CrCtl_facFbAreaY_AXIS /end AXIS_DESCR
/end CHARACTERISTIC
/begin CHARACTERISTIC CrCtl_facFbPlusRD12_GMAP "MAP for vehicle speed feed back area D factor value for Plus R mode" MAP 0x80536C22 MapG_Ws16 511.9844 Fact_CrCtl2 0.00 511.9844 FORMAT "%8.4" EXTENDED_LIMITS -512.0000 511.9844
 /begin AXIS_DESCR COM_AXIS CrCtl_vDesUpByte_mp Vel_CrCtl1 12 0.00 255.0000 FORMAT "%8.4" EXTENDED_LIMITS -32768.00 32767.00 AXIS_PTS_REF CrCtl_facFbAreaX_AXIS /end AXIS_DESCR
 /begin AXIS_DESCR COM_AXIS CrCtl_vSpdVar_mp Vel_CrCtl 12 -128.0000 127.9961 FORMAT "%8.4" AXIS_PTS_REF CrCtl_facFbAreaY_AXIS /end AXIS_DESCR
/end CHARACTERISTIC
/begin CHARACTERISTIC CrCtl_facFbPlusRP12_GMAP "MAP for vehicle speed feed back area P factor value for Plus R mode" MAP 0x80536D42 MapG_Ws16 31.99902 Fact_CrCtl3 0.00 31.99902 FORMAT "%8.5" EXTENDED_LIMITS -32.00000 31.99902
 /begin AXIS_DESCR COM_AXIS CrCtl_vDesUpByte_mp Vel_CrCtl1 12 0.00 255.0000 FORMAT "%8.4" EXTENDED_LIMITS -32768.00 32767.00 AXIS_PTS_REF CrCtl_facFbAreaX_AXIS /end AXIS_DESCR
 /begin AXIS_DESCR COM_AXIS CrCtl_vSpdVar_mp Vel_CrCtl 12 -128.0000 127.9961 FORMAT "%8.4" AXIS_PTS_REF CrCtl_facFbAreaY_AXIS /end AXIS_DESCR
/end CHARACTERISTIC
/begin CHARACTERISTIC CrCtl_facFbSptD12_GMAP "MAP for vehicle speed feed back area D factor value for sport mode" MAP 0x80536E62 MapG_Ws16 511.9844 Fact_CrCtl2 0.00 511.9844 FORMAT "%8.4" EXTENDED_LIMITS -512.0000 511.9844
 /begin AXIS_DESCR COM_AXIS CrCtl_vDesUpByte_mp Vel_CrCtl1 12 0.00 255.0000 FORMAT "%8.4" EXTENDED_LIMITS -32768.00 32767.00 AXIS_PTS_REF CrCtl_facFbAreaX_AXIS /end AXIS_DESCR
 /begin AXIS_DESCR COM_AXIS CrCtl_vSpdVar_mp Vel_CrCtl 12 -128.0000 127.9961 FORMAT "%8.4" AXIS_PTS_REF CrCtl_facFbAreaY_AXIS /end AXIS_DESCR
/end CHARACTERISTIC
/begin CHARACTERISTIC CrCtl_facFbSptP12_GMAP "MAP for vehicle speed feed back area P factor value for sport mode" MAP 0x80536F82 MapG_Ws16 31.99902 Fact_CrCtl3 0.00 31.99902 FORMAT "%8.5" EXTENDED_LIMITS -32.00000 31.99902
 /begin AXIS_DESCR COM_AXIS CrCtl_vDesUpByte_mp Vel_CrCtl1 12 0.00 255.0000 FORMAT "%8.4" EXTENDED_LIMITS -32768.00 32767.00 AXIS_PTS_REF CrCtl_facFbAreaX_AXIS /end AXIS_DESCR
 /begin AXIS_DESCR COM_AXIS CrCtl_vSpdVar_mp Vel_CrCtl 12 -128.0000 127.9961 FORMAT "%8.4" AXIS_PTS_REF CrCtl_facFbAreaY_AXIS /end AXIS_DESCR
/end CHARACTERISTIC
/begin CHARACTERISTIC CrCtl_facFdbkAccnP0Kmh_GCUR "Curve for acceleration Feed Back P factor 0 value(Km/h spec)" CURVE 0x805370A2 CurG_Ws16 511.9844 Fact_CrCtl2 0.00 511.9844 FORMAT "%8.4" EXTENDED_LIMITS -512.0000 511.9844
 /begin AXIS_DESCR COM_AXIS CrCtl_vVehUpByte Vel_CrCtl1 6 0.00 255.0000 FORMAT "%8.4" EXTENDED_LIMITS -32768.00 32767.00 AXIS_PTS_REF CrCtl_vAccnCont_AXIS /end AXIS_DESCR
/end CHARACTERISTIC
/begin CHARACTERISTIC CrCtl_facFdbkAccnP0_GCUR "Curve for acceleration Feed Back P factor 0 value" CURVE 0x805370AE CurG_Ws16 511.9844 Fact_CrCtl2 0.00 511.9844 FORMAT "%8.4" EXTENDED_LIMITS -512.0000 511.9844
 /begin AXIS_DESCR COM_AXIS CrCtl_vVehUpByte Vel_CrCtl1 6 0.00 255.0000 FORMAT "%8.4" EXTENDED_LIMITS -32768.00 32767.00 AXIS_PTS_REF CrCtl_vAccnCont_AXIS /end AXIS_DESCR
/end CHARACTERISTIC
/begin CHARACTERISTIC CrCtl_facFdbkAccnP1Kmh_GCUR "Curve for acceleration Feed Back P factor 1 value(Km/h spec)" CURVE 0x805370BA CurG_Ws16 511.9844 Fact_CrCtl2 0.00 511.9844 FORMAT "%8.4" EXTENDED_LIMITS -512.0000 511.9844
 /begin AXIS_DESCR COM_AXIS CrCtl_vVehUpByte Vel_CrCtl1 6 0.00 255.0000 FORMAT "%8.4" EXTENDED_LIMITS -32768.00 32767.00 AXIS_PTS_REF CrCtl_vAccnCont_AXIS /end AXIS_DESCR
/end CHARACTERISTIC
/begin CHARACTERISTIC CrCtl_facFdbkAccnP1_GCUR "Curve for acceleration Feed Back P factor 1 value" CURVE 0x805370C6 CurG_Ws16 511.9844 Fact_CrCtl2 0.00 511.9844 FORMAT "%8.4" EXTENDED_LIMITS -512.0000 511.9844
 /begin AXIS_DESCR COM_AXIS CrCtl_vVehUpByte Vel_CrCtl1 6 0.00 255.0000 FORMAT "%8.4" EXTENDED_LIMITS -32768.00 32767.00 AXIS_PTS_REF CrCtl_vAccnCont_AXIS /end AXIS_DESCR
/end CHARACTERISTIC
/begin CHARACTERISTIC CrCtl_facFdbkAccnP2Kmh_GCUR "Curve for acceleration Feed Back P factor 2 value(Km/h spec)" CURVE 0x805370D2 CurG_Ws16 511.9844 Fact_CrCtl2 0.00 511.9844 FORMAT "%8.4" EXTENDED_LIMITS -512.0000 511.9844
 /begin AXIS_DESCR COM_AXIS CrCtl_vVehUpByte Vel_CrCtl1 6 0.00 255.0000 FORMAT "%8.4" EXTENDED_LIMITS -32768.00 32767.00 AXIS_PTS_REF CrCtl_vAccnCont_AXIS /end AXIS_DESCR
/end CHARACTERISTIC
/begin CHARACTERISTIC CrCtl_facFdbkAccnP2_GCUR "Curve for acceleration Feed Back P factor 2 value" CURVE 0x805370DE CurG_Ws16 511.9844 Fact_CrCtl2 0.00 511.9844 FORMAT "%8.4" EXTENDED_LIMITS -512.0000 511.9844
 /begin AXIS_DESCR COM_AXIS CrCtl_vVehUpByte Vel_CrCtl1 6 0.00 255.0000 FORMAT "%8.4" EXTENDED_LIMITS -32768.00 32767.00 AXIS_PTS_REF CrCtl_vAccnCont_AXIS /end AXIS_DESCR
/end CHARACTERISTIC
/begin CHARACTERISTIC CrCtl_facFdbkAccnP3Kmh_GCUR "Curve for acceleration Feed Back P factor 3 value(Km/h spec)" CURVE 0x805370EA CurG_Ws16 511.9844 Fact_CrCtl2 0.00 511.9844 FORMAT "%8.4" EXTENDED_LIMITS -512.0000 511.9844
 /begin AXIS_DESCR COM_AXIS CrCtl_vVehUpByte Vel_CrCtl1 6 0.00 255.0000 FORMAT "%8.4" EXTENDED_LIMITS -32768.00 32767.00 AXIS_PTS_REF CrCtl_vAccnCont_AXIS /end AXIS_DESCR
/end CHARACTERISTIC
/begin CHARACTERISTIC CrCtl_facFdbkAccnP3_GCUR "Curve for acceleration Feed Back P factor 3 value" CURVE 0x805370F6 CurG_Ws16 511.9844 Fact_CrCtl2 0.00 511.9844 FORMAT "%8.4" EXTENDED_LIMITS -512.0000 511.9844
 /begin AXIS_DESCR COM_AXIS CrCtl_vVehUpByte Vel_CrCtl1 6 0.00 255.0000 FORMAT "%8.4" EXTENDED_LIMITS -32768.00 32767.00 AXIS_PTS_REF CrCtl_vAccnCont_AXIS /end AXIS_DESCR
/end CHARACTERISTIC
/begin CHARACTERISTIC CrCtl_facFdbkAccnP4Kmh_GCUR "Curve for acceleration Feed Back P factor 4 value(Km/h spec)" CURVE 0x80537102 CurG_Ws16 511.9844 Fact_CrCtl2 0.00 511.9844 FORMAT "%8.4" EXTENDED_LIMITS -512.0000 511.9844
 /begin AXIS_DESCR COM_AXIS CrCtl_vVehUpByte Vel_CrCtl1 6 0.00 255.0000 FORMAT "%8.4" EXTENDED_LIMITS -32768.00 32767.00 AXIS_PTS_REF CrCtl_vAccnCont_AXIS /end AXIS_DESCR
/end CHARACTERISTIC
/begin CHARACTERISTIC CrCtl_facFdbkAccnP4_GCUR "Curve for acceleration Feed Back P factor 4 value" CURVE 0x8053710E CurG_Ws16 511.9844 Fact_CrCtl2 0.00 511.9844 FORMAT "%8.4" EXTENDED_LIMITS -512.0000 511.9844
 /begin AXIS_DESCR COM_AXIS CrCtl_vVehUpByte Vel_CrCtl1 6 0.00 255.0000 FORMAT "%8.4" EXTENDED_LIMITS -32768.00 32767.00 AXIS_PTS_REF CrCtl_vAccnCont_AXIS /end AXIS_DESCR
/end CHARACTERISTIC
/begin CHARACTERISTIC CrCtl_facFdbkAccnVal0_C "Acceleration feed back factor value under Gear no.0" VALUE 0x8053711A Val_Ws16 255.9922 Fact1 0.00 255.9922 FORMAT "%8.4" EXTENDED_LIMITS -256.0000 255.9922 /end CHARACTERISTIC
/begin CHARACTERISTIC CrCtl_facFdbkAccnVal1_C "Acceleration feed back factor value under Gear no.1" VALUE 0x8053711C Val_Ws16 255.9922 Fact1 0.00 255.9922 FORMAT "%8.4" EXTENDED_LIMITS -256.0000 255.9922 /end CHARACTERISTIC
/begin CHARACTERISTIC CrCtl_facFdbkAccnVal2_C "Acceleration feed back factor value under Gear no.2" VALUE 0x8053711E Val_Ws16 255.9922 Fact1 0.00 255.9922 FORMAT "%8.4" EXTENDED_LIMITS -256.0000 255.9922 /end CHARACTERISTIC
/begin CHARACTERISTIC CrCtl_facFdbkAccnVal3_C "Acceleration feed back factor value under Gear no.3" VALUE 0x80537120 Val_Ws16 255.9922 Fact1 0.00 255.9922 FORMAT "%8.4" EXTENDED_LIMITS -256.0000 255.9922 /end CHARACTERISTIC
/begin CHARACTERISTIC CrCtl_facFdbkAccnVal4_C "Acceleration feed back factor value under Gear no.4" VALUE 0x80537122 Val_Ws16 255.9922 Fact1 0.00 255.9922 FORMAT "%8.4" EXTENDED_LIMITS -256.0000 255.9922 /end CHARACTERISTIC
/begin CHARACTERISTIC CrCtl_facFdbkDReviVal0_C "Feed Back D factor revision value under Gear no.0" VALUE 0x80537124 Val_Ws16 255.9922 Fact1 0.00 255.9922 FORMAT "%8.4" EXTENDED_LIMITS -256.0000 255.9922 /end CHARACTERISTIC
/begin CHARACTERISTIC CrCtl_facFdbkDReviVal1_C "Feed Back D factor revision value under Gear no.1" VALUE 0x80537126 Val_Ws16 255.9922 Fact1 0.00 255.9922 FORMAT "%8.4" EXTENDED_LIMITS -256.0000 255.9922 /end CHARACTERISTIC
/begin CHARACTERISTIC CrCtl_facFdbkDReviVal2_C "Feed Back D factor revision value under Gear no.2" VALUE 0x80537128 Val_Ws16 255.9922 Fact1 0.00 255.9922 FORMAT "%8.4" EXTENDED_LIMITS -256.0000 255.9922 /end CHARACTERISTIC
/begin CHARACTERISTIC CrCtl_facFdbkDReviVal3_C "Feed Back D factor revision value under Gear no.3" VALUE 0x8053712A Val_Ws16 255.9922 Fact1 0.00 255.9922 FORMAT "%8.4" EXTENDED_LIMITS -256.0000 255.9922 /end CHARACTERISTIC
/begin CHARACTERISTIC CrCtl_facFdbkDReviVal4_C "Feed Back D factor revision value under Gear no.4" VALUE 0x8053712C Val_Ws16 255.9922 Fact1 0.00 255.9922 FORMAT "%8.4" EXTENDED_LIMITS -256.0000 255.9922 /end CHARACTERISTIC
/begin CHARACTERISTIC CrCtl_facFdbkPReviVal0_C "Feed Back P factor revision value under Gear no.0" VALUE 0x8053712E Val_Ws16 255.9922 Fact1 0.00 255.9922 FORMAT "%8.4" EXTENDED_LIMITS -256.0000 255.9922 /end CHARACTERISTIC
/begin CHARACTERISTIC CrCtl_facFdbkPReviVal1_C "Feed Back P factor revision value under Gear no.1" VALUE 0x80537130 Val_Ws16 255.9922 Fact1 0.00 255.9922 FORMAT "%8.4" EXTENDED_LIMITS -256.0000 255.9922 /end CHARACTERISTIC
/begin CHARACTERISTIC CrCtl_facFdbkPReviVal2_C "Feed Back P factor revision value under Gear no.2" VALUE 0x80537132 Val_Ws16 255.9922 Fact1 0.00 255.9922 FORMAT "%8.4" EXTENDED_LIMITS -256.0000 255.9922 /end CHARACTERISTIC
/begin CHARACTERISTIC CrCtl_facFdbkPReviVal3_C "Feed Back P factor revision value under Gear no.3" VALUE 0x80537134 Val_Ws16 255.9922 Fact1 0.00 255.9922 FORMAT "%8.4" EXTENDED_LIMITS -256.0000 255.9922 /end CHARACTERISTIC
/begin CHARACTERISTIC CrCtl_facFdbkPReviVal4_C "Feed Back P factor revision value under Gear no.4" VALUE 0x80537136 Val_Ws16 255.9922 Fact1 0.00 255.9922 FORMAT "%8.4" EXTENDED_LIMITS -256.0000 255.9922 /end CHARACTERISTIC
/begin CHARACTERISTIC CrCtl_facFolFdbkGn12_GCUR "Curve for Feed Back Gain factor of ACC acceleration value" CURVE 0x80537138 CurG_Ws16 2047.938 Fact2 0.00 2047.938 FORMAT "%8.3" EXTENDED_LIMITS -2048.000 2047.938
 /begin AXIS_DESCR COM_AXIS CrCtl_vDesUpByte_mp Vel_CrCtl1 12 0.00 255.0000 FORMAT "%8.4" EXTENDED_LIMITS -32768.00 32767.00 AXIS_PTS_REF CrCtl_vFdbkArea_AX /end AXIS_DESCR
/end CHARACTERISTIC
/begin CHARACTERISTIC CrCtl_facNeLimDCont_GCUR "Curve for Clutch out Ne Set D factor value" CURVE 0x80537150 CurG_Ws16 511.9844 Fact_CrCtl2 0.00 511.9844 FORMAT "%8.4" EXTENDED_LIMITS -512.0000 511.9844
 /begin AXIS_DESCR COM_AXIS CrCUI_nFlt EngNCrCtl 6 0.00 32767.00 FORMAT "%8.2" EXTENDED_LIMITS -32768.00 32767.00 AXIS_PTS_REF CrCtl_nFlt_AXIS /end AXIS_DESCR
/end CHARACTERISTIC
/begin CHARACTERISTIC CrCtl_facNeLimPCont_GCUR "Curve for Clutch out Ne Set P factor value" CURVE 0x8053715C CurG_Ws16 31.99902 Fact_CrCtl3 0.00 31.99902 FORMAT "%8.5" EXTENDED_LIMITS -32.00000 31.99902
 /begin AXIS_DESCR COM_AXIS CrCUI_nFlt EngNCrCtl 6 0.00 32767.00 FORMAT "%8.2" EXTENDED_LIMITS -32768.00 32767.00 AXIS_PTS_REF CrCtl_nFlt_AXIS /end AXIS_DESCR
/end CHARACTERISTIC
/begin CHARACTERISTIC CrCtl_facSpt1LGAppDiffCls_GMAP "Correct value of APP in 1 level lower gear for close side for sport mode" MAP 0x80537168 MapG_Ws16 511.9922 Fact1 -256.0000 255.9922 FORMAT "%8.4"
 /begin AXIS_DESCR COM_AXIS CrCtl_rReq_mp APPCrCtl1 12 0.00 163.8350 FORMAT "%8.4" EXTENDED_LIMITS -163.8400 163.8350 AXIS_PTS_REF CrCtl_facAPPReviX_AXIS /end AXIS_DESCR
 /begin AXIS_DESCR COM_AXIS CrCtl_vVehUpByte Vel_CrCtl1 6 0.00 255.0000 FORMAT "%8.4" EXTENDED_LIMITS -32768.00 32767.00 AXIS_PTS_REF CrCtl_facAPPReviY_AXIS /end AXIS_DESCR
/end CHARACTERISTIC
/begin CHARACTERISTIC CrCtl_facSpt1LGAppDiff_GMAP "Correct value of APP in 1 level lower gear for open side for sport mode" MAP 0x805371F8 MapG_Ws16 511.9922 Fact1 -256.0000 255.9922 FORMAT "%8.4"
 /begin AXIS_DESCR COM_AXIS CrCtl_rReq_mp APPCrCtl1 12 0.00 163.8350 FORMAT "%8.4" EXTENDED_LIMITS -163.8400 163.8350 AXIS_PTS_REF CrCtl_facAPPReviX_AXIS /end AXIS_DESCR
 /begin AXIS_DESCR COM_AXIS CrCtl_vVehUpByte Vel_CrCtl1 6 0.00 255.0000 FORMAT "%8.4" EXTENDED_LIMITS -32768.00 32767.00 AXIS_PTS_REF CrCtl_facAPPReviY_AXIS /end AXIS_DESCR
/end CHARACTERISTIC
/begin CHARACTERISTIC CrCtl_facSpt2LGAppDiffCls_GMAP "Correct value of APP in 2 level lower gear for close side for sport mode" MAP 0x80537288 MapG_Ws16 511.9922 Fact1 -256.0000 255.9922 FORMAT "%8.4"
 /begin AXIS_DESCR COM_AXIS CrCtl_rReq_mp APPCrCtl1 12 0.00 163.8350 FORMAT "%8.4" EXTENDED_LIMITS -163.8400 163.8350 AXIS_PTS_REF CrCtl_facAPPReviX_AXIS /end AXIS_DESCR
 /begin AXIS_DESCR COM_AXIS CrCtl_vVehUpByte Vel_CrCtl1 6 0.00 255.0000 FORMAT "%8.4" EXTENDED_LIMITS -32768.00 32767.00 AXIS_PTS_REF CrCtl_facAPPReviY_AXIS /end AXIS_DESCR
/end CHARACTERISTIC
/begin CHARACTERISTIC CrCtl_facSpt2LGAppDiff_GMAP "Correct value of APP in 2 level lower gear for open side for sport mode" MAP 0x80537318 MapG_Ws16 511.9922 Fact1 -256.0000 255.9922 FORMAT "%8.4"
 /begin AXIS_DESCR COM_AXIS CrCtl_rReq_mp APPCrCtl1 12 0.00 163.8350 FORMAT "%8.4" EXTENDED_LIMITS -163.8400 163.8350 AXIS_PTS_REF CrCtl_facAPPReviX_AXIS /end AXIS_DESCR
 /begin AXIS_DESCR COM_AXIS CrCtl_vVehUpByte Vel_CrCtl1 6 0.00 255.0000 FORMAT "%8.4" EXTENDED_LIMITS -32768.00 32767.00 AXIS_PTS_REF CrCtl_facAPPReviY_AXIS /end AXIS_DESCR
/end CHARACTERISTIC
/begin CHARACTERISTIC CrCtl_facSpt3LGAppDiffCls_GMAP "Correct value of APP in 3 level lower gear for close side for sport mode" MAP 0x805373A8 MapG_Ws16 511.9922 Fact1 -256.0000 255.9922 FORMAT "%8.4"
 /begin AXIS_DESCR COM_AXIS CrCtl_rReq_mp APPCrCtl1 12 0.00 163.8350 FORMAT "%8.4" EXTENDED_LIMITS -163.8400 163.8350 AXIS_PTS_REF CrCtl_facAPPReviX_AXIS /end AXIS_DESCR
 /begin AXIS_DESCR COM_AXIS CrCtl_vVehUpByte Vel_CrCtl1 6 0.00 255.0000 FORMAT "%8.4" EXTENDED_LIMITS -32768.00 32767.00 AXIS_PTS_REF CrCtl_facAPPReviY_AXIS /end AXIS_DESCR
/end CHARACTERISTIC
/begin CHARACTERISTIC CrCtl_facSpt3LGAppDiff_GMAP "Correct value of APP in 3 level lower gear for open side for sport mode" MAP 0x80537438 MapG_Ws16 511.9922 Fact1 -256.0000 255.9922 FORMAT "%8.4"
 /begin AXIS_DESCR COM_AXIS CrCtl_rReq_mp APPCrCtl1 12 0.00 163.8350 FORMAT "%8.4" EXTENDED_LIMITS -163.8400 163.8350 AXIS_PTS_REF CrCtl_facAPPReviX_AXIS /end AXIS_DESCR
 /begin AXIS_DESCR COM_AXIS CrCtl_vVehUpByte Vel_CrCtl1 6 0.00 255.0000 FORMAT "%8.4" EXTENDED_LIMITS -32768.00 32767.00 AXIS_PTS_REF CrCtl_facAPPReviY_AXIS /end AXIS_DESCR
/end CHARACTERISTIC
/begin CHARACTERISTIC CrCtl_facSpt4LGAppDiffCls_GMAP "Correct value of APP in 4 level lower gear for close side for sport mode" MAP 0x805374C8 MapG_Ws16 511.9922 Fact1 -256.0000 255.9922 FORMAT "%8.4"
 /begin AXIS_DESCR COM_AXIS CrCtl_rReq_mp APPCrCtl1 12 0.00 163.8350 FORMAT "%8.4" EXTENDED_LIMITS -163.8400 163.8350 AXIS_PTS_REF CrCtl_facAPPReviX_AXIS /end AXIS_DESCR
 /begin AXIS_DESCR COM_AXIS CrCtl_vVehUpByte Vel_CrCtl1 6 0.00 255.0000 FORMAT "%8.4" EXTENDED_LIMITS -32768.00 32767.00 AXIS_PTS_REF CrCtl_facAPPReviY_AXIS /end AXIS_DESCR
/end CHARACTERISTIC
/begin CHARACTERISTIC CrCtl_facSpt4LGAppDiff_GMAP "Correct value of APP in 4 level lower gear for open side for sport mode" MAP 0x80537558 MapG_Ws16 511.9922 Fact1 -256.0000 255.9922 FORMAT "%8.4"
 /begin AXIS_DESCR COM_AXIS CrCtl_rReq_mp APPCrCtl1 12 0.00 163.8350 FORMAT "%8.4" EXTENDED_LIMITS -163.8400 163.8350 AXIS_PTS_REF CrCtl_facAPPReviX_AXIS /end AXIS_DESCR
 /begin AXIS_DESCR COM_AXIS CrCtl_vVehUpByte Vel_CrCtl1 6 0.00 255.0000 FORMAT "%8.4" EXTENDED_LIMITS -32768.00 32767.00 AXIS_PTS_REF CrCtl_facAPPReviY_AXIS /end AXIS_DESCR
/end CHARACTERISTIC
/begin CHARACTERISTIC CrCtl_facSptAccnRed12_GCUR "Curve for Reducing factor of acceleration control value for sport mode" CURVE 0x805375E8 CurG_Ws16 511.9844 Fact_CrCtl2 0.00 511.9844 FORMAT "%8.4" EXTENDED_LIMITS -512.0000 511.9844
 /begin AXIS_DESCR COM_AXIS CrCtl_vVehUpByte Vel_CrCtl1 12 0.00 255.0000 FORMAT "%8.4" EXTENDED_LIMITS -32768.00 32767.00 AXIS_PTS_REF CrCtl_vAccnCont_AX /end AXIS_DESCR
/end CHARACTERISTIC
/begin CHARACTERISTIC CrCtl_facSptFdbkAccnP0_GCUR "Curve for acceleration Feed Back P factor 0 value for sport mode" CURVE 0x80537600 CurG_Ws16 511.9844 Fact_CrCtl2 0.00 511.9844 FORMAT "%8.4" EXTENDED_LIMITS -512.0000 511.9844
 /begin AXIS_DESCR COM_AXIS CrCtl_vVehUpByte Vel_CrCtl1 6 0.00 255.0000 FORMAT "%8.4" EXTENDED_LIMITS -32768.00 32767.00 AXIS_PTS_REF CrCtl_vAccnCont_AXIS /end AXIS_DESCR
/end CHARACTERISTIC
/begin CHARACTERISTIC CrCtl_facSptFdbkAccnP1_GCUR "Curve for acceleration Feed Back P factor 1 value for sport mode" CURVE 0x8053760C CurG_Ws16 511.9844 Fact_CrCtl2 0.00 511.9844 FORMAT "%8.4" EXTENDED_LIMITS -512.0000 511.9844
 /begin AXIS_DESCR COM_AXIS CrCtl_vVehUpByte Vel_CrCtl1 6 0.00 255.0000 FORMAT "%8.4" EXTENDED_LIMITS -32768.00 32767.00 AXIS_PTS_REF CrCtl_vAccnCont_AXIS /end AXIS_DESCR
/end CHARACTERISTIC
/begin CHARACTERISTIC CrCtl_facSptFdbkAccnP2_GCUR "Curve for acceleration Feed Back P factor 2 value for sport mode" CURVE 0x80537618 CurG_Ws16 511.9844 Fact_CrCtl2 0.00 511.9844 FORMAT "%8.4" EXTENDED_LIMITS -512.0000 511.9844
 /begin AXIS_DESCR COM_AXIS CrCtl_vVehUpByte Vel_CrCtl1 6 0.00 255.0000 FORMAT "%8.4" EXTENDED_LIMITS -32768.00 32767.00 AXIS_PTS_REF CrCtl_vAccnCont_AXIS /end AXIS_DESCR
/end CHARACTERISTIC
/begin CHARACTERISTIC CrCtl_facSptFdbkAccnP3_GCUR "Curve for acceleration Feed Back P factor 3 value for sport mode" CURVE 0x80537624 CurG_Ws16 511.9844 Fact_CrCtl2 0.00 511.9844 FORMAT "%8.4" EXTENDED_LIMITS -512.0000 511.9844
 /begin AXIS_DESCR COM_AXIS CrCtl_vVehUpByte Vel_CrCtl1 6 0.00 255.0000 FORMAT "%8.4" EXTENDED_LIMITS -32768.00 32767.00 AXIS_PTS_REF CrCtl_vAccnCont_AXIS /end AXIS_DESCR
/end CHARACTERISTIC
/begin CHARACTERISTIC CrCtl_facSptFdbkAccnP4_GCUR "Curve for acceleration Feed Back P factor 4 value for sport mode" CURVE 0x80537630 CurG_Ws16 511.9844 Fact_CrCtl2 0.00 511.9844 FORMAT "%8.4" EXTENDED_LIMITS -512.0000 511.9844
 /begin AXIS_DESCR COM_AXIS CrCtl_vVehUpByte Vel_CrCtl1 6 0.00 255.0000 FORMAT "%8.4" EXTENDED_LIMITS -32768.00 32767.00 AXIS_PTS_REF CrCtl_vAccnCont_AXIS /end AXIS_DESCR
/end CHARACTERISTIC
/begin CHARACTERISTIC CrCtl_facSptFdbkAccnVal0_C "Acceleration feed back factor value under Gear no.0 for Sport mode" VALUE 0x8053763C Val_Ws16 255.9922 Fact1 0.00 255.9922 FORMAT "%8.4" EXTENDED_LIMITS -256.0000 255.9922 /end CHARACTERISTIC
/begin CHARACTERISTIC CrCtl_facSptFdbkAccnVal1_C "Acceleration feed back factor value under Gear no.1 for Sport mode" VALUE 0x8053763E Val_Ws16 255.9922 Fact1 0.00 255.9922 FORMAT "%8.4" EXTENDED_LIMITS -256.0000 255.9922 /end CHARACTERISTIC
/begin CHARACTERISTIC CrCtl_facSptFdbkAccnVal2_C "Acceleration feed back factor value under Gear no.2 for Sport mode" VALUE 0x80537640 Val_Ws16 255.9922 Fact1 0.00 255.9922 FORMAT "%8.4" EXTENDED_LIMITS -256.0000 255.9922 /end CHARACTERISTIC
/begin CHARACTERISTIC CrCtl_facSptFdbkAccnVal3_C "Acceleration feed back factor value under Gear no.3 for Sport mode" VALUE 0x80537642 Val_Ws16 255.9922 Fact1 0.00 255.9922 FORMAT "%8.4" EXTENDED_LIMITS -256.0000 255.9922 /end CHARACTERISTIC
/begin CHARACTERISTIC CrCtl_facSptFdbkAccnVal4_C "Acceleration feed back factor value under Gear no.4 for Sport mode" VALUE 0x80537644 Val_Ws16 255.9922 Fact1 0.00 255.9922 FORMAT "%8.4" EXTENDED_LIMITS -256.0000 255.9922 /end CHARACTERISTIC
/begin CHARACTERISTIC CrCtl_facSptFdbkDReviVal0_C "Feed Back D factor revision value for sport mode under Gear no.0" VALUE 0x80537646 Val_Ws16 255.9922 Fact1 0.00 255.9922 FORMAT "%8.4" EXTENDED_LIMITS -256.0000 255.9922 /end CHARACTERISTIC
/begin CHARACTERISTIC CrCtl_facSptFdbkDReviVal1_C "Feed Back D factor revision value for sport mode under Gear no.1" VALUE 0x80537648 Val_Ws16 255.9922 Fact1 0.00 255.9922 FORMAT "%8.4" EXTENDED_LIMITS -256.0000 255.9922 /end CHARACTERISTIC
/begin CHARACTERISTIC CrCtl_facSptFdbkDReviVal2_C "Feed Back D factor revision value for sport mode under Gear no.2" VALUE 0x8053764A Val_Ws16 255.9922 Fact1 0.00 255.9922 FORMAT "%8.4" EXTENDED_LIMITS -256.0000 255.9922 /end CHARACTERISTIC
/begin CHARACTERISTIC CrCtl_facSptFdbkDReviVal3_C "Feed Back D factor revision value for sport mode under Gear no.3" VALUE 0x8053764C Val_Ws16 255.9922 Fact1 0.00 255.9922 FORMAT "%8.4" EXTENDED_LIMITS -256.0000 255.9922 /end CHARACTERISTIC
/begin CHARACTERISTIC CrCtl_facSptFdbkDReviVal4_C "Feed Back D factor revision value for sport mode under Gear no.4" VALUE 0x8053764E Val_Ws16 255.9922 Fact1 0.00 255.9922 FORMAT "%8.4" EXTENDED_LIMITS -256.0000 255.9922 /end CHARACTERISTIC
/begin CHARACTERISTIC CrCtl_facSptFdbkPReviVal0_C "Feed Back P factor revision value for sport mode under Gear no.0" VALUE 0x80537650 Val_Ws16 255.9922 Fact1 0.00 255.9922 FORMAT "%8.4" EXTENDED_LIMITS -256.0000 255.9922 /end CHARACTERISTIC
/begin CHARACTERISTIC CrCtl_facSptFdbkPReviVal1_C "Feed Back P factor revision value for sport mode under Gear no.1" VALUE 0x80537652 Val_Ws16 255.9922 Fact1 0.00 255.9922 FORMAT "%8.4" EXTENDED_LIMITS -256.0000 255.9922 /end CHARACTERISTIC
/begin CHARACTERISTIC CrCtl_facSptFdbkPReviVal2_C "Feed Back P factor revision value for sport mode under Gear no.2" VALUE 0x80537654 Val_Ws16 255.9922 Fact1 0.00 255.9922 FORMAT "%8.4" EXTENDED_LIMITS -256.0000 255.9922 /end CHARACTERISTIC
/begin CHARACTERISTIC CrCtl_facSptFdbkPReviVal3_C "Feed Back P factor revision value for sport mode under Gear no.3" VALUE 0x80537656 Val_Ws16 255.9922 Fact1 0.00 255.9922 FORMAT "%8.4" EXTENDED_LIMITS -256.0000 255.9922 /end CHARACTERISTIC
/begin CHARACTERISTIC CrCtl_facSptFdbkPReviVal4_C "Feed Back P factor revision value for sport mode under Gear no.4" VALUE 0x80537658 Val_Ws16 255.9922 Fact1 0.00 255.9922 FORMAT "%8.4" EXTENDED_LIMITS -256.0000 255.9922 /end CHARACTERISTIC
/begin CHARACTERISTIC CrCtl_facSptTGAppDiffCls_GMAP "Correct value of APP in top gear for close side for sport mode" MAP 0x8053765A MapG_Ws16 511.9922 Fact1 -256.0000 255.9922 FORMAT "%8.4"
 /begin AXIS_DESCR COM_AXIS CrCtl_rReq_mp APPCrCtl1 12 0.00 163.8350 FORMAT "%8.4" EXTENDED_LIMITS -163.8400 163.8350 AXIS_PTS_REF CrCtl_facAPPReviX_AXIS /end AXIS_DESCR
 /begin AXIS_DESCR COM_AXIS CrCtl_vVehUpByte Vel_CrCtl1 6 0.00 255.0000 FORMAT "%8.4" EXTENDED_LIMITS -32768.00 32767.00 AXIS_PTS_REF CrCtl_facAPPReviY_AXIS /end AXIS_DESCR
/end CHARACTERISTIC
/begin CHARACTERISTIC CrCtl_facSptTGAppDiff_GMAP "Correct value of APP in top gear for open side for sport mode" MAP 0x805376EA MapG_Ws16 511.9922 Fact1 -256.0000 255.9922 FORMAT "%8.4"
 /begin AXIS_DESCR COM_AXIS CrCtl_rReq_mp APPCrCtl1 12 0.00 163.8350 FORMAT "%8.4" EXTENDED_LIMITS -163.8400 163.8350 AXIS_PTS_REF CrCtl_facAPPReviX_AXIS /end AXIS_DESCR
 /begin AXIS_DESCR COM_AXIS CrCtl_vVehUpByte Vel_CrCtl1 6 0.00 255.0000 FORMAT "%8.4" EXTENDED_LIMITS -32768.00 32767.00 AXIS_PTS_REF CrCtl_facAPPReviY_AXIS /end AXIS_DESCR
/end CHARACTERISTIC
/begin CHARACTERISTIC CrCtl_facTGAppDiffCls_GMAP "Correct value of APP in top gear for close side" MAP 0x8053777A MapG_Ws16 511.9922 Fact1 -256.0000 255.9922 FORMAT "%8.4"
 /begin AXIS_DESCR COM_AXIS CrCtl_rReq_mp APPCrCtl1 12 0.00 163.8350 FORMAT "%8.4" EXTENDED_LIMITS -163.8400 163.8350 AXIS_PTS_REF CrCtl_facAPPReviX_AXIS /end AXIS_DESCR
 /begin AXIS_DESCR COM_AXIS CrCtl_vVehUpByte Vel_CrCtl1 6 0.00 255.0000 FORMAT "%8.4" EXTENDED_LIMITS -32768.00 32767.00 AXIS_PTS_REF CrCtl_facAPPReviY_AXIS /end AXIS_DESCR
/end CHARACTERISTIC
/begin CHARACTERISTIC CrCtl_facTGAppDiff_GMAP "Correct value of APP in top gear for open side" MAP 0x8053780A MapG_Ws16 511.9922 Fact1 -256.0000 255.9922 FORMAT "%8.4"
 /begin AXIS_DESCR COM_AXIS CrCtl_rReq_mp APPCrCtl1 12 0.00 163.8350 FORMAT "%8.4" EXTENDED_LIMITS -163.8400 163.8350 AXIS_PTS_REF CrCtl_facAPPReviX_AXIS /end AXIS_DESCR
 /begin AXIS_DESCR COM_AXIS CrCtl_vVehUpByte Vel_CrCtl1 6 0.00 255.0000 FORMAT "%8.4" EXTENDED_LIMITS -32768.00 32767.00 AXIS_PTS_REF CrCtl_facAPPReviY_AXIS /end AXIS_DESCR
/end CHARACTERISTIC
/begin CHARACTERISTIC CrCtl_facTrgAccnRateEcon_T "Calibration to determine the target accleration rate based on the difference between target speed and current speed in economy mode" CURVE 0x8053789A RB_Cur_Xs16Ws16 655.3500 Fact100 -327.6800 327.6700 FORMAT "%8.4"
 /begin AXIS_DESCR STD_AXIS CrCtl_vSpdVar_mp Vel_CrCtl 6 -128.0000 127.9961 FORMAT "%8.4" DEPOSIT ABSOLUTE /end AXIS_DESCR
/end CHARACTERISTIC
/begin CHARACTERISTIC CrCtl_facTrgAccnRateNrml_T "Calibration to determine the target accleration rate based on the difference between target speed and current speed in Normal mode" CURVE 0x805378B4 RB_Cur_Xs16Ws16 655.3500 Fact100 -327.6800 327.6700 FORMAT "%8.4"
 /begin AXIS_DESCR STD_AXIS CrCtl_vSpdVar_mp Vel_CrCtl 6 -128.0000 127.9961 FORMAT "%8.4" DEPOSIT ABSOLUTE /end AXIS_DESCR
/end CHARACTERISTIC
/begin CHARACTERISTIC CrCtl_facVehSpdFlt_C "factor for Filtering Vehicle Speed" VALUE 0x805378CE Val_Wu8 1.000 fak_q0p00392 0.00 1.000 FORMAT "%5.3" /end CHARACTERISTIC
/begin AXIS_PTS CrCtl_nAPPReqChng_AXIS "Axis for Gear Change APP request group curve." 0x805378D0 CrCtl_nDesVal_mp Axis_Xs16 32767.00 EngNCrCtl 6 0.00 32767.00 FORMAT "%8.2" EXTENDED_LIMITS -32768.00 32767.00 DEPOSIT ABSOLUTE /end AXIS_PTS
/begin AXIS_PTS CrCtl_nFlt_AXIS "Axis Points for filtered Ne value of cruise control" 0x805378DE CrCUI_nFlt Axis_Xs16 32767.00 EngNCrCtl 6 0.00 32767.00 FORMAT "%8.2" EXTENDED_LIMITS -32768.00 32767.00 DEPOSIT ABSOLUTE /end AXIS_PTS
/begin CHARACTERISTIC CrCtl_nTrqOffChkAdd_C "Torque off Check NE additional value" VALUE 0x805378EC Val_Ws16 32767.00 EngNCrCtl 0.00 32767.00 FORMAT "%8.2" EXTENDED_LIMITS -32768.00 32767.00 /end CHARACTERISTIC
/begin CHARACTERISTIC CrCtl_nTrqOffReqChk_CUR "Curve for Torque off Check NE value" CURVE 0x805378EE RB_Cur_Xs16Ws16 32767.00 EngNCrCtl 0.00 32767.00 FORMAT "%8.2" EXTENDED_LIMITS -32768.00 32767.00
 /begin AXIS_DESCR STD_AXIS CrCUI_nLIDes EngNCrCtl 6 -32768.00 32767.00 FORMAT "%8.2" DEPOSIT ABSOLUTE /end AXIS_DESCR
/end CHARACTERISTIC
/begin CHARACTERISTIC CrCtl_numACCECAppLowrLim_C "RP (hysteresis Lo) value for ECON" VALUE 0x80537908 Val_Wu8 127.0 OneToOne 0.00 127.0 FORMAT "%5.1" EXTENDED_LIMITS 0.00 255.0 /end CHARACTERISTIC
/begin CHARACTERISTIC CrCtl_numATType_C "switch for selecting the type of transmission used" VALUE 0x80537909 Val_Wu8 255.0 OneToOne 0.00 255.0 FORMAT "%5.1" /end CHARACTERISTIC
/begin CHARACTERISTIC CrCtl_numCCECAppLowrLim_C "Curve for target acceleration standerd value for ECON" VALUE 0x8053790A Val_Wu8 127.0 OneToOne 0.00 127.0 FORMAT "%5.1" EXTENDED_LIMITS 0.00 255.0 /end CHARACTERISTIC
/begin CHARACTERISTIC CrCtl_numDRPrmntCvtGearShiftMap_CA "Array for CVT gear shift map number" VAL_BLK 0x8053790B ValA_Wu8 255.0 OneToOne 0.00 255.0 FORMAT "%5.1" NUMBER 3 /end CHARACTERISTIC
/begin CHARACTERISTIC CrCtl_numTrqRat_C "Torque Ratio calculation Number" VALUE 0x8053790E Val_Wu8 127.0 OneToOne 0.00 127.0 FORMAT "%5.1" EXTENDED_LIMITS 0.00 255.0 /end CHARACTERISTIC
/begin CHARACTERISTIC CrCtl_r10msAddVar_C "APP request every 10ms Add variant value" VALUE 0x80537910 Val_Ws16 163.8350 APPCrCtl1 0.00 163.8350 FORMAT "%8.4" EXTENDED_LIMITS -163.8400 163.8350 /end CHARACTERISTIC
/begin CHARACTERISTIC CrCtl_r10msSubVar_C "APP request every 10ms Sub variant value" VALUE 0x80537912 Val_Ws16 163.8350 APPCrCtl1 0.00 163.8350 FORMAT "%8.4" EXTENDED_LIMITS -163.8400 163.8350 /end CHARACTERISTIC
/begin CHARACTERISTIC CrCtl_rACCBrkReqChng_CUR "Curve for APP request value of Gear Change for ACC Brake On" CURVE 0x80537914 RB_Cur_Xs16Ws16 163.8350 APPCrCtl1 0.00 163.8350 FORMAT "%8.4" EXTENDED_LIMITS -163.8400 163.8350
 /begin AXIS_DESCR STD_AXIS CrCUI_nFlt EngNCrCtl 6 -32768.00 32767.00 FORMAT "%8.2" DEPOSIT ABSOLUTE /end AXIS_DESCR
/end CHARACTERISTIC
/begin CHARACTERISTIC CrCtl_rACCECOffSlopDwn1_CUR "Slope for changing APP limitation number for ECON to 2 from 3 (for ECON sw OFF and during ACC)" CURVE 0x8053792E RB_Cur_Xs16Ws16 255.9961 Prc_CrCtl4 -128.0000 127.9961 FORMAT "%8.4"
 /begin AXIS_DESCR STD_AXIS CrCtl_vVehUpByte Vel_CrCtl1 6 -32768.00 32767.00 FORMAT "%8.2" DEPOSIT ABSOLUTE /end AXIS_DESCR
/end CHARACTERISTIC
/begin CHARACTERISTIC CrCtl_rACCECOffSlopDwn2_CUR "Slope for changing APP limitation number for ECON to 3 from 4 (for ECON sw OFF and during ACC)" CURVE 0x80537948 RB_Cur_Xs16Ws16 255.9961 Prc_CrCtl4 -128.0000 127.9961 FORMAT "%8.4"
 /begin AXIS_DESCR STD_AXIS CrCtl_vVehUpByte Vel_CrCtl1 6 -32768.00 32767.00 FORMAT "%8.2" DEPOSIT ABSOLUTE /end AXIS_DESCR
/end CHARACTERISTIC
/begin CHARACTERISTIC CrCtl_rACCECOffSlopDwn3_CUR "Slope for changing APP limitation number for ECON to 4 from 5 (for ECON sw OFF and during ACC)" CURVE 0x80537962 RB_Cur_Xs16Ws16 255.9961 Prc_CrCtl4 -128.0000 127.9961 FORMAT "%8.4"
 /begin AXIS_DESCR STD_AXIS CrCtl_vVehUpByte Vel_CrCtl1 6 -32768.00 32767.00 FORMAT "%8.2" DEPOSIT ABSOLUTE /end AXIS_DESCR
/end CHARACTERISTIC
/begin CHARACTERISTIC CrCtl_rACCECOffSlopDwn4_CUR "Slope for changing APP limitation number for ECON to 1 from 2 (for ECON sw ON and during ACC)" CURVE 0x8053797C RB_Cur_Xs16Ws16 255.9961 Prc_CrCtl4 -128.0000 127.9961 FORMAT "%8.4"
 /begin AXIS_DESCR STD_AXIS CrCtl_vVehUpByte Vel_CrCtl1 6 -32768.00 32767.00 FORMAT "%8.2" DEPOSIT ABSOLUTE /end AXIS_DESCR
/end CHARACTERISTIC
/begin CHARACTERISTIC CrCtl_rACCECOnSlopDwn1_CUR "Slope for changing APP limitation number for ECON to 2 from 3 (for ECON sw ON and during ACC)" CURVE 0x80537996 RB_Cur_Xs16Ws16 255.9961 Prc_CrCtl4 -128.0000 127.9961 FORMAT "%8.4"
 /begin AXIS_DESCR STD_AXIS CrCtl_vVehUpByte Vel_CrCtl1 6 -32768.00 32767.00 FORMAT "%8.2" DEPOSIT ABSOLUTE /end AXIS_DESCR
/end CHARACTERISTIC
/begin CHARACTERISTIC CrCtl_rACCECOnSlopDwn2_CUR "Slope for changing APP limitation number for ECON to 3 from 4 (for ECON sw ON and during ACC)" CURVE 0x805379B0 RB_Cur_Xs16Ws16 255.9961 Prc_CrCtl4 -128.0000 127.9961 FORMAT "%8.4"
 /begin AXIS_DESCR STD_AXIS CrCtl_vVehUpByte Vel_CrCtl1 6 -32768.00 32767.00 FORMAT "%8.2" DEPOSIT ABSOLUTE /end AXIS_DESCR
/end CHARACTERISTIC
/begin CHARACTERISTIC CrCtl_rACCECOnSlopDwn3_CUR "Slope for changing APP limitation number for ECON to 4 from 5 (for ECON sw ON and during ACC)" CURVE 0x805379CA RB_Cur_Xs16Ws16 255.9961 Prc_CrCtl4 -128.0000 127.9961 FORMAT "%8.4"
 /begin AXIS_DESCR STD_AXIS CrCtl_vVehUpByte Vel_CrCtl1 6 -32768.00 32767.00 FORMAT "%8.2" DEPOSIT ABSOLUTE /end AXIS_DESCR
/end CHARACTERISTIC
/begin CHARACTERISTIC CrCtl_rACCECOnSlopDwn4_CUR "Mask timer for changing APP limitation number for ECON (for APP limitation number up)" CURVE 0x805379E4 RB_Cur_Xs16Ws16 255.9961 Prc_CrCtl4 -128.0000 127.9961 FORMAT "%8.4"
 /begin AXIS_DESCR STD_AXIS CrCtl_vVehUpByte Vel_CrCtl1 6 -32768.00 32767.00 FORMAT "%8.2" DEPOSIT ABSOLUTE /end AXIS_DESCR
/end CHARACTERISTIC
/begin CHARACTERISTIC CrCtl_rACCFstTUTrgAccnFdbk_C "ACC First Tap Up target acceleration reduce feed back value" VALUE 0x805379FE Val_Ws16 3276.700 Prc_CrCtl2 0.00 3276.700 FORMAT "%8.3" EXTENDED_LIMITS -3276.800 3276.700 /end CHARACTERISTIC
/begin CHARACTERISTIC CrCtl_rACCFstTUTrgAccnRed_C "ACC First Tap Up target acceleration reduce value" VALUE 0x80537A00 Val_Ws16 3276.700 Prc_CrCtl2 0.00 3276.700 FORMAT "%8.3" EXTENDED_LIMITS -3276.800 3276.700 /end CHARACTERISTIC
/begin CHARACTERISTIC CrCtl_rAccOffNTG_GMAP "MAP for output Accel off(Not Top Gear)" MAP 0x80537A02 MapG_Ws16 163.8350 APPCrCtl1 0.00 163.8350 FORMAT "%8.4" EXTENDED_LIMITS -163.8400 163.8350
 /begin AXIS_DESCR COM_AXIS CrCtl_vVehUpByte Vel_CrCtl1 6 0.00 255.0000 FORMAT "%8.4" EXTENDED_LIMITS -32768.00 32767.00 AXIS_PTS_REF CrCtl_rAccOffX_AXIS /end AXIS_DESCR
 /begin AXIS_DESCR COM_AXIS CrCtl_rEstSlpFltVal Prc_CrCtl4 9 -128.0000 127.9961 FORMAT "%8.4" AXIS_PTS_REF CrCtl_rAccOffY_AXIS /end AXIS_DESCR
/end CHARACTERISTIC
/begin CHARACTERISTIC CrCtl_rAccOffTG_GMAP "MAP for output Accel off(Top Gear)" MAP 0x80537A6E MapG_Ws16 163.8350 APPCrCtl1 0.00 163.8350 FORMAT "%8.4" EXTENDED_LIMITS -163.8400 163.8350
 /begin AXIS_DESCR COM_AXIS CrCtl_vVehUpByte Vel_CrCtl1 6 0.00 255.0000 FORMAT "%8.4" EXTENDED_LIMITS -32768.00 32767.00 AXIS_PTS_REF CrCtl_rAccOffX_AXIS /end AXIS_DESCR
 /begin AXIS_DESCR COM_AXIS CrCtl_rEstSlpFltVal Prc_CrCtl4 9 -128.0000 127.9961 FORMAT "%8.4" AXIS_PTS_REF CrCtl_rAccOffY_AXIS /end AXIS_DESCR
/end CHARACTERISTIC
/begin AXIS_PTS CrCtl_rAccOffX_AXIS "X-Axis for Output Accel Off group MAP" 0x80537ADA CrCtl_vVehUpByte Axis_Xs16 255.0000 Vel_CrCtl1 6 0.00 255.0000 FORMAT "%8.4" EXTENDED_LIMITS -32768.00 32767.00 DEPOSIT ABSOLUTE /end AXIS_PTS
/begin AXIS_PTS CrCtl_rAccOffY_AXIS "Y-Axis for Output Accel Off group MAP" 0x80537AE8 CrCtl_rEstSlpFltVal Axis_Xs16 255.9961 Prc_CrCtl4 9 -128.0000 127.9961 FORMAT "%8.4" DEPOSIT ABSOLUTE /end AXIS_PTS
/begin CHARACTERISTIC CrCtl_rACCReqChngStrt_GCUR "Curve for Gear Change start APP request value" CURVE 0x80537AFC CurG_Ws16 163.8350 APPCrCtl1 0.00 163.8350 FORMAT "%8.4" EXTENDED_LIMITS -163.8400 163.8350
 /begin AXIS_DESCR COM_AXIS CrCtl_nDesVal_mp EngNCrCtl 6 0.00 32767.00 FORMAT "%8.2" EXTENDED_LIMITS -32768.00 32767.00 AXIS_PTS_REF CrCtl_nAPPReqChng_AXIS /end AXIS_DESCR
/end CHARACTERISTIC
/begin CHARACTERISTIC CrCtl_rACCTDInitNTG_GCUR "Curve for Tap Down initial value(Not Top Gear) for ACC" CURVE 0x80537B08 CurG_Ws16 163.8350 APPCrCtl1 0.00 163.8350 FORMAT "%8.4" EXTENDED_LIMITS -163.8400 163.8350
 /begin AXIS_DESCR COM_AXIS CrCtl_vVehUpByte Vel_CrCtl1 6 0.00 255.0000 FORMAT "%8.4" EXTENDED_LIMITS -32768.00 32767.00 AXIS_PTS_REF CrCtl_vTapDnInit_AXIS /end AXIS_DESCR
/end CHARACTERISTIC
/begin CHARACTERISTIC CrCtl_rACCTDInitTG_GCUR "Curve for Tap Down initial value(Top Gear) for ACC" CURVE 0x80537B14 CurG_Ws16 163.8350 APPCrCtl1 0.00 163.8350 FORMAT "%8.4" EXTENDED_LIMITS -163.8400 163.8350
 /begin AXIS_DESCR COM_AXIS CrCtl_vVehUpByte Vel_CrCtl1 6 0.00 255.0000 FORMAT "%8.4" EXTENDED_LIMITS -32768.00 32767.00 AXIS_PTS_REF CrCtl_vTapDnInit_AXIS /end AXIS_DESCR
/end CHARACTERISTIC
/begin CHARACTERISTIC CrCtl_rACCTUInitNTG_GCUR "Curve for Tap Up initial value(Not Top Gear) for ACC" CURVE 0x80537B20 CurG_Ws16 163.8350 APPCrCtl1 0.00 163.8350 FORMAT "%8.4" EXTENDED_LIMITS -163.8400 163.8350
 /begin AXIS_DESCR COM_AXIS CrCtl_vVehUpByte Vel_CrCtl1 6 0.00 255.0000 FORMAT "%8.4" EXTENDED_LIMITS -32768.00 32767.00 AXIS_PTS_REF CrCtl_vTapUpInit_AXIS /end AXIS_DESCR
/end CHARACTERISTIC
/begin CHARACTERISTIC CrCtl_rACCTUInitTG_GCUR "Curve for Tap Up initial value(Top Gear) for ACC" CURVE 0x80537B2C CurG_Ws16 163.8350 APPCrCtl1 0.00 163.8350 FORMAT "%8.4" EXTENDED_LIMITS -163.8400 163.8350
 /begin AXIS_DESCR COM_AXIS CrCtl_vVehUpByte Vel_CrCtl1 6 0.00 255.0000 FORMAT "%8.4" EXTENDED_LIMITS -32768.00 32767.00 AXIS_PTS_REF CrCtl_vTapUpInit_AXIS /end AXIS_DESCR
/end CHARACTERISTIC
/begin CHARACTERISTIC CrCtl_rAppACCFUEC_GCUR "Added value1 in each 100ms to desired vehicle speed for ECON (ECON sw OFF, Continuous TAPUP)" CURVE 0x80537B38 CurG_Ws16 327.6750 APPCrCtl1 -163.8400 163.8350 FORMAT "%8.4"
 /begin AXIS_DESCR COM_AXIS CrCtl_vVehSpd_mp Vel_CrCtl1 12 -32768.00 32767.00 FORMAT "%8.2" AXIS_PTS_REF CrCtl_vAPPLim_AXIS /end AXIS_DESCR
/end CHARACTERISTIC
/begin CHARACTERISTIC CrCtl_rAPPACCFUKmph_GCUR "Upper limit of acc. pedal opening at ACC follow-up control (Kmph)" CURVE 0x80537B50 CurG_Ws16 327.6750 APPCrCtl1 -163.8400 163.8350 FORMAT "%8.4"
 /begin AXIS_DESCR COM_AXIS CrCtl_vVehSpd_mp Vel_CrCtl1 12 -32768.00 32767.00 FORMAT "%8.2" AXIS_PTS_REF CrCtl_vAPPLim_AXIS /end AXIS_DESCR
/end CHARACTERISTIC
/begin CHARACTERISTIC CrCtl_rAPPACCFUMph_GCUR "Upper limit of acc. pedal opening at ACC follow-up control(MPH)" CURVE 0x80537B68 CurG_Ws16 327.6750 APPCrCtl1 -163.8400 163.8350 FORMAT "%8.4"
 /begin AXIS_DESCR COM_AXIS CrCtl_vVehSpd_mp Vel_CrCtl1 12 -32768.00 32767.00 FORMAT "%8.2" AXIS_PTS_REF CrCtl_vAPPLim_AXIS /end AXIS_DESCR
/end CHARACTERISTIC
/begin CHARACTERISTIC CrCtl_rAPPOpnDR1CnclDwnSlp_CUR "Accped opening for DR1 cancellation at CC down slope" CURVE 0x80537B80 RB_Cur_Xs16Ws16 163.8350 APPCrCtl1 0.00 163.8350 FORMAT "%8.4" EXTENDED_LIMITS -163.8400 163.8350
 /begin AXIS_DESCR STD_AXIS CrCtl_vVehUpByte Vel_CrCtl1 6 0.00 32767.00 FORMAT "%8.2" EXTENDED_LIMITS -32768.00 32767.00 DEPOSIT ABSOLUTE /end AXIS_DESCR
/end CHARACTERISTIC
/begin CHARACTERISTIC CrCtl_rAPPOpnDR2CnclDwnSlp_CUR "Accped opening for DR2 cancellation at CC down slope" CURVE 0x80537B9A RB_Cur_Xs16Ws16 163.8350 APPCrCtl1 0.00 163.8350 FORMAT "%8.4" EXTENDED_LIMITS -163.8400 163.8350
 /begin AXIS_DESCR STD_AXIS CrCtl_vVehUpByte Vel_CrCtl1 6 0.00 32767.00 FORMAT "%8.2" EXTENDED_LIMITS -32768.00 32767.00 DEPOSIT ABSOLUTE /end AXIS_DESCR
/end CHARACTERISTIC
/begin CHARACTERISTIC CrCtl_rAPPOpnDR3CnclDwnSlp_CUR "Accped opening for DR3 cancellation at CC down slope" CURVE 0x80537BB4 RB_Cur_Xs16Ws16 163.8350 APPCrCtl1 0.00 163.8350 FORMAT "%8.4" EXTENDED_LIMITS -163.8400 163.8350
 /begin AXIS_DESCR STD_AXIS CrCtl_vVehUpByte Vel_CrCtl1 6 0.00 32767.00 FORMAT "%8.2" EXTENDED_LIMITS -32768.00 32767.00 DEPOSIT ABSOLUTE /end AXIS_DESCR
/end CHARACTERISTIC
/begin CHARACTERISTIC CrCtl_rAPPOpnDR4CnclDwnSlp_CUR "Accped opening for DR4 cancellation at CC down slope" CURVE 0x80537BCE RB_Cur_Xs16Ws16 163.8350 APPCrCtl1 0.00 163.8350 FORMAT "%8.4" EXTENDED_LIMITS -163.8400 163.8350
 /begin AXIS_DESCR STD_AXIS CrCtl_vVehUpByte Vel_CrCtl1 6 0.00 32767.00 FORMAT "%8.2" EXTENDED_LIMITS -32768.00 32767.00 DEPOSIT ABSOLUTE /end AXIS_DESCR
/end CHARACTERISTIC
/begin CHARACTERISTIC CrCtl_rAPPOpnDR5CnclDwnSlp_CUR "Accped opening for DR5 cancellation at CC down slope" CURVE 0x80537BE8 RB_Cur_Xs16Ws16 163.8350 APPCrCtl1 0.00 163.8350 FORMAT "%8.4" EXTENDED_LIMITS -163.8400 163.8350
 /begin AXIS_DESCR STD_AXIS CrCtl_vVehUpByte Vel_CrCtl1 6 0.00 32767.00 FORMAT "%8.2" EXTENDED_LIMITS -32768.00 32767.00 DEPOSIT ABSOLUTE /end AXIS_DESCR
/end CHARACTERISTIC
/begin CHARACTERISTIC CrCtl_rAPPOpnDR6CnclDwnSlp_CUR "Accped opening for DR6 cancellation at CC down slope" CURVE 0x80537C02 RB_Cur_Xs16Ws16 163.8350 APPCrCtl1 0.00 163.8350 FORMAT "%8.4" EXTENDED_LIMITS -163.8400 163.8350
 /begin AXIS_DESCR STD_AXIS CrCtl_vVehUpByte Vel_CrCtl1 6 0.00 32767.00 FORMAT "%8.2" EXTENDED_LIMITS -32768.00 32767.00 DEPOSIT ABSOLUTE /end AXIS_DESCR
/end CHARACTERISTIC
/begin CHARACTERISTIC CrCtl_rAPPOpnDR7CnclDwnSlp_CUR "Accped opening for DR7 cancellation at CC down slope" CURVE 0x80537C1C RB_Cur_Xs16Ws16 163.8350 APPCrCtl1 0.00 163.8350 FORMAT "%8.4" EXTENDED_LIMITS -163.8400 163.8350
 /begin AXIS_DESCR STD_AXIS CrCtl_vVehUpByte Vel_CrCtl1 6 0.00 32767.00 FORMAT "%8.2" EXTENDED_LIMITS -32768.00 32767.00 DEPOSIT ABSOLUTE /end AXIS_DESCR
/end CHARACTERISTIC
/begin CHARACTERISTIC CrCtl_rClthOutLimVal_C "APP limit value for Clutch out" VALUE 0x80537C36 Val_Ws16 163.8350 APPCrCtl1 0.00 163.8350 FORMAT "%8.4" EXTENDED_LIMITS -163.8400 163.8350 /end CHARACTERISTIC
/begin CHARACTERISTIC CrCtl_rCmftAPPACCFUMph_GCUR "Upper limit of acc. pedal opening at ACC follow-up control( MPH) for Comfort mode" CURVE 0x80537C38 CurG_Ws16 327.6750 APPCrCtl1 -163.8400 163.8350 FORMAT "%8.4"
 /begin AXIS_DESCR COM_AXIS CrCtl_vVehSpd_mp Vel_CrCtl1 12 -32768.00 32767.00 FORMAT "%8.2" AXIS_PTS_REF CrCtl_vAPPLim_AXIS /end AXIS_DESCR
/end CHARACTERISTIC
/begin CHARACTERISTIC CrCtl_rCmftLSFStrtAPP1_GCUR "Curve for LSF start demand value for request level 1 for Comfort mode" CURVE 0x80537C50 CurG_Ws16 327.6750 APPCrCtl1 -163.8400 163.8350 FORMAT "%8.4"
 /begin AXIS_DESCR COM_AXIS CrCtl_vVehUpByte Vel_CrCtl1 12 -32768.00 32767.00 FORMAT "%8.2" AXIS_PTS_REF CrCtl_vLSFStrtAPP_AXIS /end AXIS_DESCR
/end CHARACTERISTIC
/begin CHARACTERISTIC CrCtl_rCmftMaxAppCCEC_GCUR "Selected easily condition to change desired vehicle speed for ECON for Comfort mode" CURVE 0x80537C68 CurG_Ws16 327.6750 APPCrCtl1 -163.8400 163.8350 FORMAT "%8.4"
 /begin AXIS_DESCR COM_AXIS CrCtl_vVehSpd_mp Vel_CrCtl1 12 -32768.00 32767.00 FORMAT "%8.2" AXIS_PTS_REF CrCtl_vAPPLim_AXIS /end AXIS_DESCR
/end CHARACTERISTIC
/begin CHARACTERISTIC CrCtl_rCmftMaxAPPCCMph_GCUR "Max. acc pedal opening at CC(MPH) for Comfort mode" CURVE 0x80537C80 CurG_Ws16 327.6750 APPCrCtl1 -163.8400 163.8350 FORMAT "%8.4"
 /begin AXIS_DESCR COM_AXIS CrCtl_vVehSpd_mp Vel_CrCtl1 12 -32768.00 32767.00 FORMAT "%8.2" AXIS_PTS_REF CrCtl_vAPPLim_AXIS /end AXIS_DESCR
/end CHARACTERISTIC
/begin CHARACTERISTIC CrCtl_rCmftMaxCC3LGMph_GCUR "Max. acc. pedal opening at CC3 lower gear (MPH) for Comfort mode" CURVE 0x80537C98 CurG_Ws16 327.6750 APPCrCtl1 -163.8400 163.8350 FORMAT "%8.4"
 /begin AXIS_DESCR COM_AXIS CrCtl_vVehSpd_mp Vel_CrCtl1 12 -32768.00 32767.00 FORMAT "%8.2" AXIS_PTS_REF CrCtl_vAPPLim_AXIS /end AXIS_DESCR
/end CHARACTERISTIC
/begin CHARACTERISTIC CrCtl_rCmftMaxCC4LGMph_GCUR "Max. acc. pedal opening at CC4 lower gear (MPH) for Comfort mode" CURVE 0x80537CB0 CurG_Ws16 327.6750 APPCrCtl1 -163.8400 163.8350 FORMAT "%8.4"
 /begin AXIS_DESCR COM_AXIS CrCtl_vVehSpd_mp Vel_CrCtl1 12 -32768.00 32767.00 FORMAT "%8.2" AXIS_PTS_REF CrCtl_vAPPLim_AXIS /end AXIS_DESCR
/end CHARACTERISTIC
/begin CHARACTERISTIC CrCtl_rCmftMaxCC5LGMph_GCUR "Max. acc. pedal opening at CC5 lower gear (MPH) for Comfort mode" CURVE 0x80537CC8 CurG_Ws16 327.6750 APPCrCtl1 -163.8400 163.8350 FORMAT "%8.4"
 /begin AXIS_DESCR COM_AXIS CrCtl_vVehSpd_mp Vel_CrCtl1 12 -32768.00 32767.00 FORMAT "%8.2" AXIS_PTS_REF CrCtl_vAPPLim_AXIS /end AXIS_DESCR
/end CHARACTERISTIC
/begin CHARACTERISTIC CrCtl_rCmftMaxCC6LGMph_GCUR "Max. acc. pedal opening at CC6 lower gear (MPH) for Comfort mode" CURVE 0x80537CE0 CurG_Ws16 327.6750 APPCrCtl1 -163.8400 163.8350 FORMAT "%8.4"
 /begin AXIS_DESCR COM_AXIS CrCtl_vVehSpd_mp Vel_CrCtl1 12 -32768.00 32767.00 FORMAT "%8.2" AXIS_PTS_REF CrCtl_vAPPLim_AXIS /end AXIS_DESCR
/end CHARACTERISTIC
/begin CHARACTERISTIC CrCtl_rCmftMaxCCLGMph_GCUR "Max. acc. pedal opening at CC2 lower gear (MPH) for Comfort mode" CURVE 0x80537CF8 CurG_Ws16 327.6750 APPCrCtl1 -163.8400 163.8350 FORMAT "%8.4"
 /begin AXIS_DESCR COM_AXIS CrCtl_vVehSpd_mp Vel_CrCtl1 12 -32768.00 32767.00 FORMAT "%8.2" AXIS_PTS_REF CrCtl_vAPPLim_AXIS /end AXIS_DESCR
/end CHARACTERISTIC
/begin CHARACTERISTIC CrCtl_rCmftMaxCCNGMph_GCUR "Max. acc. pedal opening at CC next gear (MPH) for Comfort mode" CURVE 0x80537D10 CurG_Ws16 327.6750 APPCrCtl1 -163.8400 163.8350 FORMAT "%8.4"
 /begin AXIS_DESCR COM_AXIS CrCtl_vVehSpd_mp Vel_CrCtl1 12 -32768.00 32767.00 FORMAT "%8.2" AXIS_PTS_REF CrCtl_vAPPLim_AXIS /end AXIS_DESCR
/end CHARACTERISTIC
/begin CHARACTERISTIC CrCtl_rCmftMaxCCTGMph_GCUR "Max. acc. pedal opening at CC top gear (MPH) for Comfort mode" CURVE 0x80537D28 CurG_Ws16 327.6750 APPCrCtl1 -163.8400 163.8350 FORMAT "%8.4"
 /begin AXIS_DESCR COM_AXIS CrCtl_vVehSpd_mp Vel_CrCtl1 12 -32768.00 32767.00 FORMAT "%8.2" AXIS_PTS_REF CrCtl_vAPPLim_AXIS /end AXIS_DESCR
/end CHARACTERISTIC
/begin CHARACTERISTIC CrCtl_rCmftTDInitNTG_GCUR "Curve for Tap Down initial value(Not Top Gear) for CC for Comfort mode" CURVE 0x80537D40 CurG_Ws16 327.6750 APPCrCtl1 -163.8400 163.8350 FORMAT "%8.4"
 /begin AXIS_DESCR COM_AXIS CrCtl_vVehUpByte Vel_CrCtl1 6 0.00 255.0000 FORMAT "%8.4" EXTENDED_LIMITS -32768.00 32767.00 AXIS_PTS_REF CrCtl_vTapDnInit_AXIS /end AXIS_DESCR
/end CHARACTERISTIC
/begin CHARACTERISTIC CrCtl_rCmftTDInitTG_GCUR "Curve for Tap Down initial value(Top Gear) for CC for Comfort mode" CURVE 0x80537D4C CurG_Ws16 327.6750 APPCrCtl1 -163.8400 163.8350 FORMAT "%8.4"
 /begin AXIS_DESCR COM_AXIS CrCtl_vVehUpByte Vel_CrCtl1 6 0.00 255.0000 FORMAT "%8.4" EXTENDED_LIMITS -32768.00 32767.00 AXIS_PTS_REF CrCtl_vTapDnInit_AXIS /end AXIS_DESCR
/end CHARACTERISTIC
/begin CHARACTERISTIC CrCtl_rCmftTUInitNTG_GCUR "Curve for Tap Up initial value(Not Top Gear) for CC for Comfort mode" CURVE 0x80537D58 CurG_Ws16 327.6750 APPCrCtl1 -163.8400 163.8350 FORMAT "%8.4"
 /begin AXIS_DESCR COM_AXIS CrCtl_vVehUpByte Vel_CrCtl1 6 0.00 255.0000 FORMAT "%8.4" EXTENDED_LIMITS -32768.00 32767.00 AXIS_PTS_REF CrCtl_vTapUpInit_AXIS /end AXIS_DESCR
/end CHARACTERISTIC
/begin CHARACTERISTIC CrCtl_rCmftTUInitTG_GCUR "Curve for Tap Up initial value(Top Gear) for CC for Comfort mode" CURVE 0x80537D64 CurG_Ws16 327.6750 APPCrCtl1 -163.8400 163.8350 FORMAT "%8.4"
 /begin AXIS_DESCR COM_AXIS CrCtl_vVehUpByte Vel_CrCtl1 6 0.00 255.0000 FORMAT "%8.4" EXTENDED_LIMITS -32768.00 32767.00 AXIS_PTS_REF CrCtl_vTapUpInit_AXIS /end AXIS_DESCR
/end CHARACTERISTIC
/begin CHARACTERISTIC CrCtl_rDRAppCnclDnSlp_C "DR cancel judgement acc.pedal opening at CC down slope." VALUE 0x80537D70 Val_Ws16 327.6750 APPCrCtl1 -163.8400 163.8350 FORMAT "%8.4" /end CHARACTERISTIC
/begin AXIS_PTS CrCtl_rDwn_AXIS "Axis for torque or App down for cruise control cancel group curve" 0x80537D72 CrCtl_rDes Axis_Xs16 163.8350 APPCrCtl1 6 0.00 163.8350 FORMAT "%8.4" EXTENDED_LIMITS -163.8400 163.8350 DEPOSIT ABSOLUTE /end AXIS_PTS
/begin CHARACTERISTIC CrCtl_rECAppAdd10ms_C "APP request every 10ms Sub variant value during ECON active" VALUE 0x80537D80 Val_Ws16 163.8350 APPCrCtl1 0.00 163.8350 FORMAT "%8.4" EXTENDED_LIMITS -163.8400 163.8350 /end CHARACTERISTIC
/begin CHARACTERISTIC CrCtl_rECAppSub10ms_C "Corrected deviation speed to check the end of resume off control" VALUE 0x80537D82 Val_Ws16 163.8350 APPCrCtl1 0.00 163.8350 FORMAT "%8.4" EXTENDED_LIMITS -163.8400 163.8350 /end CHARACTERISTIC
/begin CHARACTERISTIC CrCtl_rEcoAccOffNTG_GMAP "MAP for output Accel off(Not Top Gear) for Eco mode" MAP 0x80537D84 MapG_Ws16 327.6750 APPCrCtl1 -163.8400 163.8350 FORMAT "%8.4"
 /begin AXIS_DESCR COM_AXIS CrCtl_vVehUpByte Vel_CrCtl1 6 0.00 255.0000 FORMAT "%8.4" EXTENDED_LIMITS -32768.00 32767.00 AXIS_PTS_REF CrCtl_rAccOffX_AXIS /end AXIS_DESCR
 /begin AXIS_DESCR COM_AXIS CrCtl_rEstSlpFltVal Prc_CrCtl4 9 -128.0000 127.9961 FORMAT "%8.4" AXIS_PTS_REF CrCtl_rAccOffY_AXIS /end AXIS_DESCR
/end CHARACTERISTIC
/begin CHARACTERISTIC CrCtl_rEcoAccOffTG_GMAP "MAP for output Accel off(Top Gear) for Eco mode" MAP 0x80537DF0 MapG_Ws16 327.6750 APPCrCtl1 -163.8400 163.8350 FORMAT "%8.4"
 /begin AXIS_DESCR COM_AXIS CrCtl_vVehUpByte Vel_CrCtl1 6 0.00 255.0000 FORMAT "%8.4" EXTENDED_LIMITS -32768.00 32767.00 AXIS_PTS_REF CrCtl_rAccOffX_AXIS /end AXIS_DESCR
 /begin AXIS_DESCR COM_AXIS CrCtl_rEstSlpFltVal Prc_CrCtl4 9 -128.0000 127.9961 FORMAT "%8.4" AXIS_PTS_REF CrCtl_rAccOffY_AXIS /end AXIS_DESCR
/end CHARACTERISTIC
/begin CHARACTERISTIC CrCtl_rECOffAppLimNum1_MAP "Correct value of APP in top gear for ECON" MAP 0x80537E5C Map_Xs16Ys16Ws16 327.6750 APPCrCtl1 -163.8400 163.8350 FORMAT "%8.4"
 /begin AXIS_DESCR STD_AXIS CrCUI_nEngSpd EngNCrCtl 12 0.00 10000.00 FORMAT "%8.2" EXTENDED_LIMITS -32768.00 32767.00 DEPOSIT ABSOLUTE /end AXIS_DESCR
 /begin AXIS_DESCR STD_AXIS CrCtl_vVehUpByte Vel_CrCtl1 6 0.00 255.0000 FORMAT "%8.4" EXTENDED_LIMITS -32768.00 32767.00 DEPOSIT ABSOLUTE /end AXIS_DESCR
/end CHARACTERISTIC
/begin CHARACTERISTIC CrCtl_rECOffAppLimNum2_MAP "Curve for reducing factor of acceleration contorol value for ECON (close)" MAP 0x80537F14 Map_Xs16Ys16Ws16 327.6750 APPCrCtl1 -163.8400 163.8350 FORMAT "%8.4"
 /begin AXIS_DESCR STD_AXIS CrCUI_nEngSpd EngNCrCtl 12 0.00 10000.00 FORMAT "%8.2" EXTENDED_LIMITS -32768.00 32767.00 DEPOSIT ABSOLUTE /end AXIS_DESCR
 /begin AXIS_DESCR STD_AXIS CrCtl_vVehUpByte Vel_CrCtl1 6 0.00 255.0000 FORMAT "%8.4" EXTENDED_LIMITS -32768.00 32767.00 DEPOSIT ABSOLUTE /end AXIS_DESCR
/end CHARACTERISTIC
/begin CHARACTERISTIC CrCtl_rECOffAppLimNum3_MAP "Curve for reducing factor of acceleration contorol value for ECON (open)" MAP 0x80537FCC Map_Xs16Ys16Ws16 327.6750 APPCrCtl1 -163.8400 163.8350 FORMAT "%8.4"
 /begin AXIS_DESCR STD_AXIS CrCUI_nEngSpd EngNCrCtl 12 0.00 10000.00 FORMAT "%8.2" EXTENDED_LIMITS -32768.00 32767.00 DEPOSIT ABSOLUTE /end AXIS_DESCR
 /begin AXIS_DESCR STD_AXIS CrCtl_vVehUpByte Vel_CrCtl1 6 0.00 255.0000 FORMAT "%8.4" EXTENDED_LIMITS -32768.00 32767.00 DEPOSIT ABSOLUTE /end AXIS_DESCR
/end CHARACTERISTIC
/begin CHARACTERISTIC CrCtl_rECOffAppLimNum4_MAP "Correct value of TAPUP initial request APP for ECON" MAP 0x80538084 Map_Xs16Ys16Ws16 327.6750 APPCrCtl1 -163.8400 163.8350 FORMAT "%8.4"
 /begin AXIS_DESCR STD_AXIS CrCUI_nEngSpd EngNCrCtl 12 0.00 10000.00 FORMAT "%8.2" EXTENDED_LIMITS -32768.00 32767.00 DEPOSIT ABSOLUTE /end AXIS_DESCR
 /begin AXIS_DESCR STD_AXIS CrCtl_vVehUpByte Vel_CrCtl1 6 0.00 255.0000 FORMAT "%8.4" EXTENDED_LIMITS -32768.00 32767.00 DEPOSIT ABSOLUTE /end AXIS_DESCR
/end CHARACTERISTIC
/begin CHARACTERISTIC CrCtl_rECOffAppLimNum5_MAP "Correct value of initial request APP for ECON" MAP 0x8053813C Map_Xs16Ys16Ws16 327.6750 APPCrCtl1 -163.8400 163.8350 FORMAT "%8.4"
 /begin AXIS_DESCR STD_AXIS CrCUI_nEngSpd EngNCrCtl 12 0.00 10000.00 FORMAT "%8.2" EXTENDED_LIMITS -32768.00 32767.00 DEPOSIT ABSOLUTE /end AXIS_DESCR
 /begin AXIS_DESCR STD_AXIS CrCtl_vVehUpByte Vel_CrCtl1 6 0.00 255.0000 FORMAT "%8.4" EXTENDED_LIMITS -32768.00 32767.00 DEPOSIT ABSOLUTE /end AXIS_DESCR
/end CHARACTERISTIC
/begin CHARACTERISTIC CrCtl_rECOffSlopDwn1_CUR "Slope for changing APP limitation number for ECON to 2 from 3 (for ECON sw OFF)" CURVE 0x805381F4 RB_Cur_Xs16Ws16 255.9961 Prc_CrCtl4 -128.0000 127.9961 FORMAT "%8.4"
 /begin AXIS_DESCR STD_AXIS CrCtl_vVehUpByte Vel_CrCtl1 6 -32768.00 32767.00 FORMAT "%8.2" DEPOSIT ABSOLUTE /end AXIS_DESCR
/end CHARACTERISTIC
/begin CHARACTERISTIC CrCtl_rECOffSlopDwn2_CUR "Slope for changing APP limitation number for ECON to 3 from 4 (for ECON sw OFF)" CURVE 0x8053820E RB_Cur_Xs16Ws16 255.9961 Prc_CrCtl4 -128.0000 127.9961 FORMAT "%8.4"
 /begin AXIS_DESCR STD_AXIS CrCtl_vVehUpByte Vel_CrCtl1 6 -32768.00 32767.00 FORMAT "%8.2" DEPOSIT ABSOLUTE /end AXIS_DESCR
/end CHARACTERISTIC
/begin CHARACTERISTIC CrCtl_rECOffSlopDwn3_CUR "Slope for changing APP limitation number for ECON to 4 from 5 (for ECON sw OFF)" CURVE 0x80538228 RB_Cur_Xs16Ws16 255.9961 Prc_CrCtl4 -128.0000 127.9961 FORMAT "%8.4"
 /begin AXIS_DESCR STD_AXIS CrCtl_vVehUpByte Vel_CrCtl1 6 -32768.00 32767.00 FORMAT "%8.2" DEPOSIT ABSOLUTE /end AXIS_DESCR
/end CHARACTERISTIC
/begin CHARACTERISTIC CrCtl_rECOffSlopDwn4_CUR "Slope for changing APP limitation number for ECON to 1 from 2 (for ECON sw ON)" CURVE 0x80538242 RB_Cur_Xs16Ws16 255.9961 Prc_CrCtl4 -128.0000 127.9961 FORMAT "%8.4"
 /begin AXIS_DESCR STD_AXIS CrCtl_vVehUpByte Vel_CrCtl1 6 -32768.00 32767.00 FORMAT "%8.2" DEPOSIT ABSOLUTE /end AXIS_DESCR
/end CHARACTERISTIC
/begin CHARACTERISTIC CrCtl_rEcoLSFStrtAPP1_GCUR "Curve for LSF start demand value for request level 1 for Eco mode" CURVE 0x8053825C CurG_Ws16 327.6750 APPCrCtl1 -163.8400 163.8350 FORMAT "%8.4"
 /begin AXIS_DESCR COM_AXIS CrCtl_vVehUpByte Vel_CrCtl1 12 -32768.00 32767.00 FORMAT "%8.2" AXIS_PTS_REF CrCtl_vLSFStrtAPP_AXIS /end AXIS_DESCR
/end CHARACTERISTIC
/begin CHARACTERISTIC CrCtl_rECOnAppLimNum1_MAP "Enable resume off control" MAP 0x80538274 Map_Xs16Ys16Ws16 327.6750 APPCrCtl1 -163.8400 163.8350 FORMAT "%8.4"
 /begin AXIS_DESCR STD_AXIS CrCUI_nEngSpd EngNCrCtl 12 0.00 10000.00 FORMAT "%8.2" EXTENDED_LIMITS -32768.00 32767.00 DEPOSIT ABSOLUTE /end AXIS_DESCR
 /begin AXIS_DESCR STD_AXIS CrCtl_vVehUpByte Vel_CrCtl1 6 0.00 255.0000 FORMAT "%8.4" EXTENDED_LIMITS -32768.00 32767.00 DEPOSIT ABSOLUTE /end AXIS_DESCR
/end CHARACTERISTIC
/begin CHARACTERISTIC CrCtl_rECOnAppLimNum2_MAP "Corrected deviation speed to check the end of resume off control" MAP 0x8053832C Map_Xs16Ys16Ws16 327.6750 APPCrCtl1 -163.8400 163.8350 FORMAT "%8.4"
 /begin AXIS_DESCR STD_AXIS CrCUI_nEngSpd EngNCrCtl 12 0.00 10000.00 FORMAT "%8.2" EXTENDED_LIMITS -32768.00 32767.00 DEPOSIT ABSOLUTE /end AXIS_DESCR
 /begin AXIS_DESCR STD_AXIS CrCtl_vVehUpByte Vel_CrCtl1 6 0.00 255.0000 FORMAT "%8.4" EXTENDED_LIMITS -32768.00 32767.00 DEPOSIT ABSOLUTE /end AXIS_DESCR
/end CHARACTERISTIC
/begin CHARACTERISTIC CrCtl_rECOnAppLimNum3_MAP "APP request every 10ms Sub variant value during ECON active" MAP 0x805383E4 Map_Xs16Ys16Ws16 327.6750 APPCrCtl1 -163.8400 163.8350 FORMAT "%8.4"
 /begin AXIS_DESCR STD_AXIS CrCUI_nEngSpd EngNCrCtl 12 0.00 10000.00 FORMAT "%8.2" EXTENDED_LIMITS -32768.00 32767.00 DEPOSIT ABSOLUTE /end AXIS_DESCR
 /begin AXIS_DESCR STD_AXIS CrCtl_vVehUpByte Vel_CrCtl1 6 0.00 255.0000 FORMAT "%8.4" EXTENDED_LIMITS -32768.00 32767.00 DEPOSIT ABSOLUTE /end AXIS_DESCR
/end CHARACTERISTIC
/begin CHARACTERISTIC CrCtl_rECOnAppLimNum4_MAP "APP request every 10ms Add variant value during ECON active" MAP 0x8053849C Map_Xs16Ys16Ws16 327.6750 APPCrCtl1 -163.8400 163.8350 FORMAT "%8.4"
 /begin AXIS_DESCR STD_AXIS CrCUI_nEngSpd EngNCrCtl 12 0.00 10000.00 FORMAT "%8.2" EXTENDED_LIMITS -32768.00 32767.00 DEPOSIT ABSOLUTE /end AXIS_DESCR
 /begin AXIS_DESCR STD_AXIS CrCtl_vVehUpByte Vel_CrCtl1 6 0.00 255.0000 FORMAT "%8.4" EXTENDED_LIMITS -32768.00 32767.00 DEPOSIT ABSOLUTE /end AXIS_DESCR
/end CHARACTERISTIC
/begin CHARACTERISTIC CrCtl_rECOnAppLimNum5_MAP "Correct value of APP in excepting top gear for ECON" MAP 0x80538554 Map_Xs16Ys16Ws16 327.6750 APPCrCtl1 -163.8400 163.8350 FORMAT "%8.4"
 /begin AXIS_DESCR STD_AXIS CrCUI_nEngSpd EngNCrCtl 12 0.00 10000.00 FORMAT "%8.2" EXTENDED_LIMITS -32768.00 32767.00 DEPOSIT ABSOLUTE /end AXIS_DESCR
 /begin AXIS_DESCR STD_AXIS CrCtl_vVehUpByte Vel_CrCtl1 6 0.00 255.0000 FORMAT "%8.4" EXTENDED_LIMITS -32768.00 32767.00 DEPOSIT ABSOLUTE /end AXIS_DESCR
/end CHARACTERISTIC
/begin CHARACTERISTIC CrCtl_rECOnSlopDwn1_CUR "Slope for changing APP limitation number for ECON to 2 from 3 (for ECON sw ON)" CURVE 0x8053860C RB_Cur_Xs16Ws16 255.9961 Prc_CrCtl4 -128.0000 127.9961 FORMAT "%8.4"
 /begin AXIS_DESCR STD_AXIS CrCtl_vVehUpByte Vel_CrCtl1 6 -32768.00 32767.00 FORMAT "%8.2" DEPOSIT ABSOLUTE /end AXIS_DESCR
/end CHARACTERISTIC
/begin CHARACTERISTIC CrCtl_rECOnSlopDwn2_CUR "Slope for changing APP limitation number for ECON to 3 from 4 (for ECON sw ON)" CURVE 0x80538626 RB_Cur_Xs16Ws16 255.9961 Prc_CrCtl4 -128.0000 127.9961 FORMAT "%8.4"
 /begin AXIS_DESCR STD_AXIS CrCtl_vVehUpByte Vel_CrCtl1 6 -32768.00 32767.00 FORMAT "%8.2" DEPOSIT ABSOLUTE /end AXIS_DESCR
/end CHARACTERISTIC
/begin CHARACTERISTIC CrCtl_rECOnSlopDwn3_CUR "Slope for changing APP limitation number for ECON to 4 from 5 (for ECON sw ON)" CURVE 0x80538640 RB_Cur_Xs16Ws16 255.9961 Prc_CrCtl4 -128.0000 127.9961 FORMAT "%8.4"
 /begin AXIS_DESCR STD_AXIS CrCtl_vVehUpByte Vel_CrCtl1 6 -32768.00 32767.00 FORMAT "%8.2" DEPOSIT ABSOLUTE /end AXIS_DESCR
/end CHARACTERISTIC
/begin CHARACTERISTIC CrCtl_rECOnSlopDwn4_CUR "Slope for changing APP limitation number for ECON to 1 from 2 (for ECON sw OFF and during ACC)" CURVE 0x8053865A RB_Cur_Xs16Ws16 255.9961 Prc_CrCtl4 -128.0000 127.9961 FORMAT "%8.4"
 /begin AXIS_DESCR STD_AXIS CrCtl_vVehUpByte Vel_CrCtl1 6 -32768.00 32767.00 FORMAT "%8.2" DEPOSIT ABSOLUTE /end AXIS_DESCR
/end CHARACTERISTIC
/begin CHARACTERISTIC CrCtl_rEcoResOffNTG_GMAP "MAP for output resume off (Not Top Gear) for Eco mode" MAP 0x80538674 MapG_Ws16 327.6750 APPCrCtl1 -163.8400 163.8350 FORMAT "%8.4"
 /begin AXIS_DESCR COM_AXIS CrCtl_vVehUpByte Vel_CrCtl1 6 0.00 255.0000 FORMAT "%8.4" EXTENDED_LIMITS -32768.00 32767.00 AXIS_PTS_REF CrCtl_rAccOffX_AXIS /end AXIS_DESCR
 /begin AXIS_DESCR COM_AXIS CrCtl_rEstSlpFltVal Prc_CrCtl4 9 -128.0000 127.9961 FORMAT "%8.4" AXIS_PTS_REF CrCtl_rAccOffY_AXIS /end AXIS_DESCR
/end CHARACTERISTIC
/begin CHARACTERISTIC CrCtl_rEcoResOffTG_GMAP "MAP for output resume off (Top Gear) for Eco mode" MAP 0x805386E0 MapG_Ws16 327.6750 APPCrCtl1 -163.8400 163.8350 FORMAT "%8.4"
 /begin AXIS_DESCR COM_AXIS CrCtl_vVehUpByte Vel_CrCtl1 6 0.00 255.0000 FORMAT "%8.4" EXTENDED_LIMITS -32768.00 32767.00 AXIS_PTS_REF CrCtl_rAccOffX_AXIS /end AXIS_DESCR
 /begin AXIS_DESCR COM_AXIS CrCtl_rEstSlpFltVal Prc_CrCtl4 9 -128.0000 127.9961 FORMAT "%8.4" AXIS_PTS_REF CrCtl_rAccOffY_AXIS /end AXIS_DESCR
/end CHARACTERISTIC
/begin CHARACTERISTIC CrCtl_rEcoTDInitNTG_GCUR "Curve for Tap Down initial value(Not Top Gear) for CC for Eco mode" CURVE 0x8053874C CurG_Ws16 327.6750 APPCrCtl1 -163.8400 163.8350 FORMAT "%8.4"
 /begin AXIS_DESCR COM_AXIS CrCtl_vVehUpByte Vel_CrCtl1 6 0.00 255.0000 FORMAT "%8.4" EXTENDED_LIMITS -32768.00 32767.00 AXIS_PTS_REF CrCtl_vTapDnInit_AXIS /end AXIS_DESCR
/end CHARACTERISTIC
/begin CHARACTERISTIC CrCtl_rEcoTDInitTG_GCUR "Curve for Tap Down initial value(Top Gear) for CC for Eco mode" CURVE 0x80538758 CurG_Ws16 327.6750 APPCrCtl1 -163.8400 163.8350 FORMAT "%8.4"
 /begin AXIS_DESCR COM_AXIS CrCtl_vVehUpByte Vel_CrCtl1 6 0.00 255.0000 FORMAT "%8.4" EXTENDED_LIMITS -32768.00 32767.00 AXIS_PTS_REF CrCtl_vTapDnInit_AXIS /end AXIS_DESCR
/end CHARACTERISTIC
/begin CHARACTERISTIC CrCtl_rEcoTUInitNTG_GCUR "Curve for Tap Up initial value(Not Top Gear) for CC for Eco mode" CURVE 0x80538764 CurG_Ws16 327.6750 APPCrCtl1 -163.8400 163.8350 FORMAT "%8.4"
 /begin AXIS_DESCR COM_AXIS CrCtl_vVehUpByte Vel_CrCtl1 6 0.00 255.0000 FORMAT "%8.4" EXTENDED_LIMITS -32768.00 32767.00 AXIS_PTS_REF CrCtl_vTapUpInit_AXIS /end AXIS_DESCR
/end CHARACTERISTIC
/begin CHARACTERISTIC CrCtl_rEcoTUInitTG_GCUR "Curve for Tap Up initial value(Top Gear) for CC for Eco mode" CURVE 0x80538770 CurG_Ws16 327.6750 APPCrCtl1 -163.8400 163.8350 FORMAT "%8.4"
 /begin AXIS_DESCR COM_AXIS CrCtl_vVehUpByte Vel_CrCtl1 6 0.00 255.0000 FORMAT "%8.4" EXTENDED_LIMITS -32768.00 32767.00 AXIS_PTS_REF CrCtl_vTapUpInit_AXIS /end AXIS_DESCR
/end CHARACTERISTIC
/begin CHARACTERISTIC CrCtl_rECShiftVal1_MAP "MAP for output resume off (Top Gear)" MAP 0x8053877C Map_Xs16Ys16Ws16 327.6750 APPCrCtl1 -163.8400 163.8350 FORMAT "%8.4"
 /begin AXIS_DESCR STD_AXIS CrCUI_nEngSpd EngNCrCtl 12 0.00 10000.00 FORMAT "%8.2" EXTENDED_LIMITS -32768.00 32767.00 DEPOSIT ABSOLUTE /end AXIS_DESCR
 /begin AXIS_DESCR STD_AXIS CrCtl_rDes APPCrCtl1 12 -163.8400 163.8350 FORMAT "%8.4" DEPOSIT ABSOLUTE /end AXIS_DESCR
/end CHARACTERISTIC
/begin CHARACTERISTIC CrCtl_rECShiftVal2_MAP "MAP for output resume off (Not Top Gear)" MAP 0x805388D0 Map_Xs16Ys16Ws16 327.6750 APPCrCtl1 -163.8400 163.8350 FORMAT "%8.4"
 /begin AXIS_DESCR STD_AXIS CrCUI_nEngSpd EngNCrCtl 12 0.00 10000.00 FORMAT "%8.2" EXTENDED_LIMITS -32768.00 32767.00 DEPOSIT ABSOLUTE /end AXIS_DESCR
 /begin AXIS_DESCR STD_AXIS CrCtl_rDes APPCrCtl1 12 -163.8400 163.8350 FORMAT "%8.4" DEPOSIT ABSOLUTE /end AXIS_DESCR
/end CHARACTERISTIC
/begin CHARACTERISTIC CrCtl_rECShiftVal3_MAP "MAP for output resume off (Top Gear, EU Km/h)" MAP 0x80538A24 Map_Xs16Ys16Ws16 327.6750 APPCrCtl1 -163.8400 163.8350 FORMAT "%8.4"
 /begin AXIS_DESCR STD_AXIS CrCUI_nEngSpd EngNCrCtl 12 0.00 10000.00 FORMAT "%8.2" EXTENDED_LIMITS -32768.00 32767.00 DEPOSIT ABSOLUTE /end AXIS_DESCR
 /begin AXIS_DESCR STD_AXIS CrCtl_rDes APPCrCtl1 12 -163.8400 163.8350 FORMAT "%8.4" DEPOSIT ABSOLUTE /end AXIS_DESCR
/end CHARACTERISTIC
/begin CHARACTERISTIC CrCtl_rECShiftVal4_MAP "MAP for output resume off (Not Top Gear, EU Km/h)" MAP 0x80538B78 Map_Xs16Ys16Ws16 327.6750 APPCrCtl1 -163.8400 163.8350 FORMAT "%8.4"
 /begin AXIS_DESCR STD_AXIS CrCUI_nEngSpd EngNCrCtl 12 0.00 10000.00 FORMAT "%8.2" EXTENDED_LIMITS -32768.00 32767.00 DEPOSIT ABSOLUTE /end AXIS_DESCR
 /begin AXIS_DESCR STD_AXIS CrCtl_rDes APPCrCtl1 12 -163.8400 163.8350 FORMAT "%8.4" DEPOSIT ABSOLUTE /end AXIS_DESCR
/end CHARACTERISTIC
/begin CHARACTERISTIC CrCtl_rECShiftVal5_MAP "During ACC follow-up control,deviation in accel data for DR1 judgement for ECON" MAP 0x80538CCC Map_Xs16Ys16Ws16 327.6750 APPCrCtl1 -163.8400 163.8350 FORMAT "%8.4"
 /begin AXIS_DESCR STD_AXIS CrCUI_nEngSpd EngNCrCtl 12 0.00 10000.00 FORMAT "%8.2" EXTENDED_LIMITS -32768.00 32767.00 DEPOSIT ABSOLUTE /end AXIS_DESCR
 /begin AXIS_DESCR STD_AXIS CrCtl_rDes APPCrCtl1 12 -163.8400 163.8350 FORMAT "%8.4" DEPOSIT ABSOLUTE /end AXIS_DESCR
/end CHARACTERISTIC
/begin CHARACTERISTIC CrCtl_rEstSlpValDR1Cncl_CUR "Slope assessed value data for CC_DR1 cancel judgement" CURVE 0x80538E20 RB_Cur_Xs16Ws16 127.9961 Prc_CrCtl4 0.00 127.9961 FORMAT "%8.4" EXTENDED_LIMITS -128.0000 127.9961
 /begin AXIS_DESCR STD_AXIS CrCtl_vVehUpByte Vel_CrCtl1 6 0.00 32767.00 FORMAT "%8.2" EXTENDED_LIMITS -32768.00 32767.00 DEPOSIT ABSOLUTE /end AXIS_DESCR
/end CHARACTERISTIC
/begin CHARACTERISTIC CrCtl_rEstSlpValDR2Cncl_CUR "Slope assessed value data for CC_DR2 cancel judgement" CURVE 0x80538E3A RB_Cur_Xs16Ws16 127.9961 Prc_CrCtl4 0.00 127.9961 FORMAT "%8.4" EXTENDED_LIMITS -128.0000 127.9961
 /begin AXIS_DESCR STD_AXIS CrCtl_vVehUpByte Vel_CrCtl1 6 0.00 32767.00 FORMAT "%8.2" EXTENDED_LIMITS -32768.00 32767.00 DEPOSIT ABSOLUTE /end AXIS_DESCR
/end CHARACTERISTIC
/begin CHARACTERISTIC CrCtl_rEstSlpValDR3Cncl_CUR "Slope assessed value data for CC_DR3 cancel judgement" CURVE 0x80538E54 RB_Cur_Xs16Ws16 127.9961 Prc_CrCtl4 0.00 127.9961 FORMAT "%8.4" EXTENDED_LIMITS -128.0000 127.9961
 /begin AXIS_DESCR STD_AXIS CrCtl_vVehUpByte Vel_CrCtl1 6 0.00 32767.00 FORMAT "%8.2" EXTENDED_LIMITS -32768.00 32767.00 DEPOSIT ABSOLUTE /end AXIS_DESCR
/end CHARACTERISTIC
/begin CHARACTERISTIC CrCtl_rEstSlpValDR4Cncl_CUR "Slope assessed value data for CC_DR4 cancel judgement" CURVE 0x80538E6E RB_Cur_Xs16Ws16 255.9961 Prc_CrCtl4 -128.0000 127.9961 FORMAT "%8.4"
 /begin AXIS_DESCR STD_AXIS CrCtl_vVehUpByte Vel_CrCtl1 6 -32768.00 32767.00 FORMAT "%8.2" DEPOSIT ABSOLUTE /end AXIS_DESCR
/end CHARACTERISTIC
/begin CHARACTERISTIC CrCtl_rEstSlpValDR5Cncl_CUR "Slope assessed value data for CC_DR5 cancel judgement" CURVE 0x80538E88 RB_Cur_Xs16Ws16 255.9961 Prc_CrCtl4 -128.0000 127.9961 FORMAT "%8.4"
 /begin AXIS_DESCR STD_AXIS CrCtl_vVehUpByte Vel_CrCtl1 6 -32768.00 32767.00 FORMAT "%8.2" DEPOSIT ABSOLUTE /end AXIS_DESCR
/end CHARACTERISTIC
/begin CHARACTERISTIC CrCtl_rEstSlpValDR6Cncl_CUR "Slope assessed value data for CC_DR6 cancel judgement" CURVE 0x80538EA2 RB_Cur_Xs16Ws16 255.9961 Prc_CrCtl4 -128.0000 127.9961 FORMAT "%8.4"
 /begin AXIS_DESCR STD_AXIS CrCtl_vVehUpByte Vel_CrCtl1 6 -32768.00 32767.00 FORMAT "%8.2" DEPOSIT ABSOLUTE /end AXIS_DESCR
/end CHARACTERISTIC
/begin CHARACTERISTIC CrCtl_rEstSlpValDR7Cncl_CUR "Slope assessed value data for CC_DR7 cancel judgement" CURVE 0x80538EBC RB_Cur_Xs16Ws16 255.9961 Prc_CrCtl4 -128.0000 127.9961 FORMAT "%8.4"
 /begin AXIS_DESCR STD_AXIS CrCtl_vVehUpByte Vel_CrCtl1 6 -32768.00 32767.00 FORMAT "%8.2" DEPOSIT ABSOLUTE /end AXIS_DESCR
/end CHARACTERISTIC
/begin CHARACTERISTIC CrCtl_rFstDwnCncl_GCUR "Curve for first torque Down for Cruise Control cancel" CURVE 0x80538ED6 CurG_Ws16 163.8350 APPCrCtl1 0.00 163.8350 FORMAT "%8.4" EXTENDED_LIMITS -163.8400 163.8350
 /begin AXIS_DESCR COM_AXIS CrCtl_rDes APPCrCtl1 6 0.00 163.8350 FORMAT "%8.4" EXTENDED_LIMITS -163.8400 163.8350 AXIS_PTS_REF CrCtl_rDwn_AXIS /end AXIS_DESCR
/end CHARACTERISTIC
/begin CHARACTERISTIC CrCtl_rInitCmftReqNTG_GMAP "MAP for initial APP request(Not Top Gear) for comfort mode" MAP 0x80538EE2 MapG_Ws16 327.6750 APPCrCtl1 -163.8400 163.8350 FORMAT "%8.4"
 /begin AXIS_DESCR COM_AXIS CrCtl_vSpdTab_mp Vel_CrCtl1 6 0.00 255.0000 FORMAT "%8.4" EXTENDED_LIMITS -32768.00 32767.00 AXIS_PTS_REF CrCtl_rInitReqX_AXIS /end AXIS_DESCR
 /begin AXIS_DESCR COM_AXIS CrCtl_rEstSlpTab_mp Prc_CrCtl4 5 -128.0000 127.9961 FORMAT "%8.4" AXIS_PTS_REF CrCtl_rInitReqY_AXIS /end AXIS_DESCR
/end CHARACTERISTIC
/begin CHARACTERISTIC CrCtl_rInitCmftReqTG_GMAP "MAP for initial APP request(Top Gear) for comfort mode" MAP 0x80538F1E MapG_Ws16 327.6750 APPCrCtl1 -163.8400 163.8350 FORMAT "%8.4"
 /begin AXIS_DESCR COM_AXIS CrCtl_vSpdTab_mp Vel_CrCtl1 6 0.00 255.0000 FORMAT "%8.4" EXTENDED_LIMITS -32768.00 32767.00 AXIS_PTS_REF CrCtl_rInitReqX_AXIS /end AXIS_DESCR
 /begin AXIS_DESCR COM_AXIS CrCtl_rEstSlpTab_mp Prc_CrCtl4 5 -128.0000 127.9961 FORMAT "%8.4" AXIS_PTS_REF CrCtl_rInitReqY_AXIS /end AXIS_DESCR
/end CHARACTERISTIC
/begin CHARACTERISTIC CrCtl_rInitEcoReqNTG_GMAP "MAP for initial APP request(Not Top Gear) for economy mode" MAP 0x80538F5A MapG_Ws16 327.6750 APPCrCtl1 -163.8400 163.8350 FORMAT "%8.4"
 /begin AXIS_DESCR COM_AXIS CrCtl_vSpdTab_mp Vel_CrCtl1 6 0.00 255.0000 FORMAT "%8.4" EXTENDED_LIMITS -32768.00 32767.00 AXIS_PTS_REF CrCtl_rInitReqX_AXIS /end AXIS_DESCR
 /begin AXIS_DESCR COM_AXIS CrCtl_rEstSlpTab_mp Prc_CrCtl4 5 -128.0000 127.9961 FORMAT "%8.4" AXIS_PTS_REF CrCtl_rInitReqY_AXIS /end AXIS_DESCR
/end CHARACTERISTIC
/begin CHARACTERISTIC CrCtl_rInitEcoReqTG_GMAP "MAP for initial APP request(Top Gear) for economy mode" MAP 0x80538F96 MapG_Ws16 327.6750 APPCrCtl1 -163.8400 163.8350 FORMAT "%8.4"
 /begin AXIS_DESCR COM_AXIS CrCtl_vSpdTab_mp Vel_CrCtl1 6 0.00 255.0000 FORMAT "%8.4" EXTENDED_LIMITS -32768.00 32767.00 AXIS_PTS_REF CrCtl_rInitReqX_AXIS /end AXIS_DESCR
 /begin AXIS_DESCR COM_AXIS CrCtl_rEstSlpTab_mp Prc_CrCtl4 5 -128.0000 127.9961 FORMAT "%8.4" AXIS_PTS_REF CrCtl_rInitReqY_AXIS /end AXIS_DESCR
/end CHARACTERISTIC
/begin CHARACTERISTIC CrCtl_rInitPlusRReqNTG_GMAP "MAP for initial APP request(Not Top Gear) for PlusR mode" MAP 0x80538FD2 MapG_Ws16 327.6750 APPCrCtl1 -163.8400 163.8350 FORMAT "%8.4"
 /begin AXIS_DESCR COM_AXIS CrCtl_vSpdTab_mp Vel_CrCtl1 6 0.00 255.0000 FORMAT "%8.4" EXTENDED_LIMITS -32768.00 32767.00 AXIS_PTS_REF CrCtl_rInitReqX_AXIS /end AXIS_DESCR
 /begin AXIS_DESCR COM_AXIS CrCtl_rEstSlpTab_mp Prc_CrCtl4 5 -128.0000 127.9961 FORMAT "%8.4" AXIS_PTS_REF CrCtl_rInitReqY_AXIS /end AXIS_DESCR
/end CHARACTERISTIC
/begin CHARACTERISTIC CrCtl_rInitPlusRReqTG_GMAP "MAP for initial APP request(Top Gear) for PlusR mode" MAP 0x8053900E MapG_Ws16 327.6750 APPCrCtl1 -163.8400 163.8350 FORMAT "%8.4"
 /begin AXIS_DESCR COM_AXIS CrCtl_vSpdTab_mp Vel_CrCtl1 6 0.00 255.0000 FORMAT "%8.4" EXTENDED_LIMITS -32768.00 32767.00 AXIS_PTS_REF CrCtl_rInitReqX_AXIS /end AXIS_DESCR
 /begin AXIS_DESCR COM_AXIS CrCtl_rEstSlpTab_mp Prc_CrCtl4 5 -128.0000 127.9961 FORMAT "%8.4" AXIS_PTS_REF CrCtl_rInitReqY_AXIS /end AXIS_DESCR
/end CHARACTERISTIC
/begin CHARACTERISTIC CrCtl_rInitReqNTG_GMAP "MAP for initial APP request(Not Top Gear)" MAP 0x8053904A MapG_Ws16 163.8350 APPCrCtl1 0.00 163.8350 FORMAT "%8.4" EXTENDED_LIMITS -163.8400 163.8350
 /begin AXIS_DESCR COM_AXIS CrCtl_vSpdTab_mp Vel_CrCtl1 6 0.00 255.0000 FORMAT "%8.4" EXTENDED_LIMITS -32768.00 32767.00 AXIS_PTS_REF CrCtl_rInitReqX_AXIS /end AXIS_DESCR
 /begin AXIS_DESCR COM_AXIS CrCtl_rEstSlpTab_mp Prc_CrCtl4 5 -128.0000 127.9961 FORMAT "%8.4" AXIS_PTS_REF CrCtl_rInitReqY_AXIS /end AXIS_DESCR
/end CHARACTERISTIC
/begin CHARACTERISTIC CrCtl_rInitReqTG_GMAP "MAP for initial APP request(Top Gear)" MAP 0x80539086 MapG_Ws16 163.8350 APPCrCtl1 0.00 163.8350 FORMAT "%8.4" EXTENDED_LIMITS -163.8400 163.8350
 /begin AXIS_DESCR COM_AXIS CrCtl_vSpdTab_mp Vel_CrCtl1 6 0.00 255.0000 FORMAT "%8.4" EXTENDED_LIMITS -32768.00 32767.00 AXIS_PTS_REF CrCtl_rInitReqX_AXIS /end AXIS_DESCR
 /begin AXIS_DESCR COM_AXIS CrCtl_rEstSlpTab_mp Prc_CrCtl4 5 -128.0000 127.9961 FORMAT "%8.4" AXIS_PTS_REF CrCtl_rInitReqY_AXIS /end AXIS_DESCR
/end CHARACTERISTIC
/begin AXIS_PTS CrCtl_rInitReqX_AXIS "X-Axis for initial APP request group MAP" 0x805390C2 CrCtl_vSpdTab_mp Axis_Xs16 255.0000 Vel_CrCtl1 6 0.00 255.0000 FORMAT "%8.4" EXTENDED_LIMITS -32768.00 32767.00 DEPOSIT ABSOLUTE /end AXIS_PTS
/begin AXIS_PTS CrCtl_rInitReqY_AXIS "Y-Axis for initial APP request group MAP" 0x805390D0 CrCtl_rEstSlpTab_mp Axis_Xs16 255.9961 Prc_CrCtl4 5 -128.0000 127.9961 FORMAT "%8.4" DEPOSIT ABSOLUTE /end AXIS_PTS
/begin CHARACTERISTIC CrCtl_rInitSptReqNTG_GMAP "MAP for initial APP request(Not Top Gear) for sport mode" MAP 0x805390DC MapG_Ws16 327.6750 APPCrCtl1 -163.8400 163.8350 FORMAT "%8.4"
 /begin AXIS_DESCR COM_AXIS CrCtl_vSpdTab_mp Vel_CrCtl1 6 0.00 255.0000 FORMAT "%8.4" EXTENDED_LIMITS -32768.00 32767.00 AXIS_PTS_REF CrCtl_rInitReqX_AXIS /end AXIS_DESCR
 /begin AXIS_DESCR COM_AXIS CrCtl_rEstSlpTab_mp Prc_CrCtl4 5 -128.0000 127.9961 FORMAT "%8.4" AXIS_PTS_REF CrCtl_rInitReqY_AXIS /end AXIS_DESCR
/end CHARACTERISTIC
/begin CHARACTERISTIC CrCtl_rInitSptReqTG_GMAP "MAP for initial APP request(Top Gear) for sport mode" MAP 0x80539118 MapG_Ws16 327.6750 APPCrCtl1 -163.8400 163.8350 FORMAT "%8.4"
 /begin AXIS_DESCR COM_AXIS CrCtl_vSpdTab_mp Vel_CrCtl1 6 0.00 255.0000 FORMAT "%8.4" EXTENDED_LIMITS -32768.00 32767.00 AXIS_PTS_REF CrCtl_rInitReqX_AXIS /end AXIS_DESCR
 /begin AXIS_DESCR COM_AXIS CrCtl_rEstSlpTab_mp Prc_CrCtl4 5 -128.0000 127.9961 FORMAT "%8.4" AXIS_PTS_REF CrCtl_rInitReqY_AXIS /end AXIS_DESCR
/end CHARACTERISTIC
/begin CHARACTERISTIC CrCtl_rLSFStrtAPP1_GCUR "Curve for LSF start demand value for request level 1" CURVE 0x80539154 CurG_Ws16 327.6750 APPCrCtl1 -163.8400 163.8350 FORMAT "%8.4"
 /begin AXIS_DESCR COM_AXIS CrCtl_vVehUpByte Vel_CrCtl1 12 -32768.00 32767.00 FORMAT "%8.2" AXIS_PTS_REF CrCtl_vLSFStrtAPP_AXIS /end AXIS_DESCR
/end CHARACTERISTIC
/begin CHARACTERISTIC CrCtl_rMaxAppCCEC_GCUR "Selected easily condition to change desired vehicle speed for ECON" CURVE 0x8053916C CurG_Ws16 327.6750 APPCrCtl1 -163.8400 163.8350 FORMAT "%8.4"
 /begin AXIS_DESCR COM_AXIS CrCtl_vVehSpd_mp Vel_CrCtl1 12 -32768.00 32767.00 FORMAT "%8.2" AXIS_PTS_REF CrCtl_vAPPLim_AXIS /end AXIS_DESCR
/end CHARACTERISTIC
/begin CHARACTERISTIC CrCtl_rMaxAPPCCKmph_GCUR "Max. acc pedal opening at CC (Kmph)" CURVE 0x80539184 CurG_Ws16 327.6750 APPCrCtl1 -163.8400 163.8350 FORMAT "%8.4"
 /begin AXIS_DESCR COM_AXIS CrCtl_vVehSpd_mp Vel_CrCtl1 12 -32768.00 32767.00 FORMAT "%8.2" AXIS_PTS_REF CrCtl_vAPPLim_AXIS /end AXIS_DESCR
/end CHARACTERISTIC
/begin CHARACTERISTIC CrCtl_rMaxAPPCCMph_GCUR "Max. acc pedal opening at CC(MPH)" CURVE 0x8053919C CurG_Ws16 327.6750 APPCrCtl1 -163.8400 163.8350 FORMAT "%8.4"
 /begin AXIS_DESCR COM_AXIS CrCtl_vVehSpd_mp Vel_CrCtl1 12 -32768.00 32767.00 FORMAT "%8.2" AXIS_PTS_REF CrCtl_vAPPLim_AXIS /end AXIS_DESCR
/end CHARACTERISTIC
/begin CHARACTERISTIC CrCtl_rMaxCC3LGEC_GCUR "Added value3 in each 100ms to desired vehicle speed for ECON (ECON sw ON, Continuous TAPUP)" CURVE 0x805391B4 CurG_Ws16 327.6750 APPCrCtl1 -163.8400 163.8350 FORMAT "%8.4"
 /begin AXIS_DESCR COM_AXIS CrCtl_vVehSpd_mp Vel_CrCtl1 12 -32768.00 32767.00 FORMAT "%8.2" AXIS_PTS_REF CrCtl_vAPPLim_AXIS /end AXIS_DESCR
/end CHARACTERISTIC
/begin CHARACTERISTIC CrCtl_rMaxCC3LGMph_GCUR "Max. acc. pedal opening at CC3 lower gear (MPH)" CURVE 0x805391CC CurG_Ws16 327.6750 APPCrCtl1 -163.8400 163.8350 FORMAT "%8.4"
 /begin AXIS_DESCR COM_AXIS CrCtl_vVehSpd_mp Vel_CrCtl1 12 -32768.00 32767.00 FORMAT "%8.2" AXIS_PTS_REF CrCtl_vAPPLim_AXIS /end AXIS_DESCR
/end CHARACTERISTIC
/begin CHARACTERISTIC CrCtl_rMaxCC4LGEC_GCUR "Added value4 in each 100ms to desired vehicle speed for ECON (ECON sw ON, Continuous TAPUP)" CURVE 0x805391E4 CurG_Ws16 327.6750 APPCrCtl1 -163.8400 163.8350 FORMAT "%8.4"
 /begin AXIS_DESCR COM_AXIS CrCtl_vVehSpd_mp Vel_CrCtl1 12 -32768.00 32767.00 FORMAT "%8.2" AXIS_PTS_REF CrCtl_vAPPLim_AXIS /end AXIS_DESCR
/end CHARACTERISTIC
/begin CHARACTERISTIC CrCtl_rMaxCC4LGMph_GCUR "Max. acc. pedal opening at CC4 lower gear (MPH)" CURVE 0x805391FC CurG_Ws16 327.6750 APPCrCtl1 -163.8400 163.8350 FORMAT "%8.4"
 /begin AXIS_DESCR COM_AXIS CrCtl_vVehSpd_mp Vel_CrCtl1 12 -32768.00 32767.00 FORMAT "%8.2" AXIS_PTS_REF CrCtl_vAPPLim_AXIS /end AXIS_DESCR
/end CHARACTERISTIC
/begin CHARACTERISTIC CrCtl_rMaxCC5LGEC_GCUR "Added value5 in each 100ms to desired vehicle speed for ECON (ECON sw ON, Continuous TAPUP)" CURVE 0x80539214 CurG_Ws16 327.6750 APPCrCtl1 -163.8400 163.8350 FORMAT "%8.4"
 /begin AXIS_DESCR COM_AXIS CrCtl_vVehSpd_mp Vel_CrCtl1 12 -32768.00 32767.00 FORMAT "%8.2" AXIS_PTS_REF CrCtl_vAPPLim_AXIS /end AXIS_DESCR
/end CHARACTERISTIC
/begin CHARACTERISTIC CrCtl_rMaxCC5LGMph_GCUR "Max. acc. pedal opening at CC5 lower gear (MPH)" CURVE 0x8053922C CurG_Ws16 327.6750 APPCrCtl1 -163.8400 163.8350 FORMAT "%8.4"
 /begin AXIS_DESCR COM_AXIS CrCtl_vVehSpd_mp Vel_CrCtl1 12 -32768.00 32767.00 FORMAT "%8.2" AXIS_PTS_REF CrCtl_vAPPLim_AXIS /end AXIS_DESCR
/end CHARACTERISTIC
/begin CHARACTERISTIC CrCtl_rMaxCC6LGEC_GCUR "Added value6 in each 100ms to desired vehicle speed for ECON (ECON sw ON, Continuous TAPUP)" CURVE 0x80539244 CurG_Ws16 327.6750 APPCrCtl1 -163.8400 163.8350 FORMAT "%8.4"
 /begin AXIS_DESCR COM_AXIS CrCtl_vVehSpd_mp Vel_CrCtl1 12 -32768.00 32767.00 FORMAT "%8.2" AXIS_PTS_REF CrCtl_vAPPLim_AXIS /end AXIS_DESCR
/end CHARACTERISTIC
/begin CHARACTERISTIC CrCtl_rMaxCC6LGMph_GCUR "Max. acc. pedal opening at CC6 lower gear (MPH)" CURVE 0x8053925C CurG_Ws16 327.6750 APPCrCtl1 -163.8400 163.8350 FORMAT "%8.4"
 /begin AXIS_DESCR COM_AXIS CrCtl_vVehSpd_mp Vel_CrCtl1 12 -32768.00 32767.00 FORMAT "%8.2" AXIS_PTS_REF CrCtl_vAPPLim_AXIS /end AXIS_DESCR
/end CHARACTERISTIC
/begin CHARACTERISTIC CrCtl_rMaxCCLGEC_GCUR "Added value2 in each 100ms to desired vehicle speed for ECON (ECON sw ON, Continuous TAPUP)" CURVE 0x80539274 CurG_Ws16 327.6750 APPCrCtl1 -163.8400 163.8350 FORMAT "%8.4"
 /begin AXIS_DESCR COM_AXIS CrCtl_vVehSpd_mp Vel_CrCtl1 12 -32768.00 32767.00 FORMAT "%8.2" AXIS_PTS_REF CrCtl_vAPPLim_AXIS /end AXIS_DESCR
/end CHARACTERISTIC
/begin CHARACTERISTIC CrCtl_rMaxCCLGKmph_GCUR "Max. acc. pedal opening at CC2 lower gear (KMPH)" CURVE 0x8053928C CurG_Ws16 327.6750 APPCrCtl1 -163.8400 163.8350 FORMAT "%8.4"
 /begin AXIS_DESCR COM_AXIS CrCtl_vVehSpd_mp Vel_CrCtl1 12 -32768.00 32767.00 FORMAT "%8.2" AXIS_PTS_REF CrCtl_vAPPLim_AXIS /end AXIS_DESCR
/end CHARACTERISTIC
/begin CHARACTERISTIC CrCtl_rMaxCCLGMph_GCUR "Max. acc. pedal opening at CC2 lower gear (MPH)" CURVE 0x805392A4 CurG_Ws16 327.6750 APPCrCtl1 -163.8400 163.8350 FORMAT "%8.4"
 /begin AXIS_DESCR COM_AXIS CrCtl_vVehSpd_mp Vel_CrCtl1 12 -32768.00 32767.00 FORMAT "%8.2" AXIS_PTS_REF CrCtl_vAPPLim_AXIS /end AXIS_DESCR
/end CHARACTERISTIC
/begin CHARACTERISTIC CrCtl_rMaxCCNGEC_GCUR "Added value1 in each 100ms to desired vehicle speed for ECON (ECON sw ON, Continuous TAPUP)" CURVE 0x805392BC CurG_Ws16 327.6750 APPCrCtl1 -163.8400 163.8350 FORMAT "%8.4"
 /begin AXIS_DESCR COM_AXIS CrCtl_vVehSpd_mp Vel_CrCtl1 12 -32768.00 32767.00 FORMAT "%8.2" AXIS_PTS_REF CrCtl_vAPPLim_AXIS /end AXIS_DESCR
/end CHARACTERISTIC
/begin CHARACTERISTIC CrCtl_rMaxCCNGKmph_GCUR "Max. acc. pedal opening at CC next gear(KMPH)" CURVE 0x805392D4 CurG_Ws16 327.6750 APPCrCtl1 -163.8400 163.8350 FORMAT "%8.4"
 /begin AXIS_DESCR COM_AXIS CrCtl_vVehSpd_mp Vel_CrCtl1 12 -32768.00 32767.00 FORMAT "%8.2" AXIS_PTS_REF CrCtl_vAPPLim_AXIS /end AXIS_DESCR
/end CHARACTERISTIC
/begin CHARACTERISTIC CrCtl_rMaxCCNGMph_GCUR "Max. acc. pedal opening at CC next gear (MPH)" CURVE 0x805392EC CurG_Ws16 327.6750 APPCrCtl1 -163.8400 163.8350 FORMAT "%8.4"
 /begin AXIS_DESCR COM_AXIS CrCtl_vVehSpd_mp Vel_CrCtl1 12 -32768.00 32767.00 FORMAT "%8.2" AXIS_PTS_REF CrCtl_vAPPLim_AXIS /end AXIS_DESCR
/end CHARACTERISTIC
/begin CHARACTERISTIC CrCtl_rMaxCCTGEC_GCUR "Added value2 in each 100ms to desired vehicle speed for ECON (ECON sw OFF, Continuous TAPUP)" CURVE 0x80539304 CurG_Ws16 327.6750 APPCrCtl1 -163.8400 163.8350 FORMAT "%8.4"
 /begin AXIS_DESCR COM_AXIS CrCtl_vVehSpd_mp Vel_CrCtl1 12 -32768.00 32767.00 FORMAT "%8.2" AXIS_PTS_REF CrCtl_vAPPLim_AXIS /end AXIS_DESCR
/end CHARACTERISTIC
/begin CHARACTERISTIC CrCtl_rMaxCCTGKmph_GCUR "Max. acc. pedal opening at CC top gear (KMPH)" CURVE 0x8053931C CurG_Ws16 327.6750 APPCrCtl1 -163.8400 163.8350 FORMAT "%8.4"
 /begin AXIS_DESCR COM_AXIS CrCtl_vVehSpd_mp Vel_CrCtl1 12 -32768.00 32767.00 FORMAT "%8.2" AXIS_PTS_REF CrCtl_vAPPLim_AXIS /end AXIS_DESCR
/end CHARACTERISTIC
/begin CHARACTERISTIC CrCtl_rMaxCCTGMph_GCUR "Max. acc. pedal opening at CC top gear (MPH)" CURVE 0x80539334 CurG_Ws16 327.6750 APPCrCtl1 -163.8400 163.8350 FORMAT "%8.4"
 /begin AXIS_DESCR COM_AXIS CrCtl_vVehSpd_mp Vel_CrCtl1 12 -32768.00 32767.00 FORMAT "%8.2" AXIS_PTS_REF CrCtl_vAPPLim_AXIS /end AXIS_DESCR
/end CHARACTERISTIC
/begin CHARACTERISTIC CrCtl_rMaxVal_C "maximum threshold for APP value" VALUE 0x8053934C Val_Ws16 163.8350 APPCrCtl1 0.00 163.8350 FORMAT "%8.4" EXTENDED_LIMITS -163.8400 163.8350 /end CHARACTERISTIC
/begin CHARACTERISTIC CrCtl_rReqChng_GCUR "Curve for Gear Change APP request value" CURVE 0x8053934E CurG_Ws16 163.8350 APPCrCtl1 0.00 163.8350 FORMAT "%8.4" EXTENDED_LIMITS -163.8400 163.8350
 /begin AXIS_DESCR COM_AXIS CrCtl_nDesVal_mp EngNCrCtl 6 0.00 32767.00 FORMAT "%8.2" EXTENDED_LIMITS -32768.00 32767.00 AXIS_PTS_REF CrCtl_nAPPReqChng_AXIS /end AXIS_DESCR
/end CHARACTERISTIC
/begin CHARACTERISTIC CrCtl_rResOffNTGKmh_GMAP "MAP for output resume off (Not Top Gear, EU Km/h)" MAP 0x8053935A MapG_Ws16 327.6750 APPCrCtl1 -163.8400 163.8350 FORMAT "%8.4"
 /begin AXIS_DESCR COM_AXIS CrCtl_vVehUpByte Vel_CrCtl1 6 0.00 255.0000 FORMAT "%8.4" EXTENDED_LIMITS -32768.00 32767.00 AXIS_PTS_REF CrCtl_rAccOffX_AXIS /end AXIS_DESCR
 /begin AXIS_DESCR COM_AXIS CrCtl_rEstSlpFltVal Prc_CrCtl4 9 -128.0000 127.9961 FORMAT "%8.4" AXIS_PTS_REF CrCtl_rAccOffY_AXIS /end AXIS_DESCR
/end CHARACTERISTIC
/begin CHARACTERISTIC CrCtl_rResOffNTG_GMAP "MAP for output resume off (Not Top Gear)" MAP 0x805393C6 MapG_Ws16 327.6750 APPCrCtl1 -163.8400 163.8350 FORMAT "%8.4"
 /begin AXIS_DESCR COM_AXIS CrCtl_vVehUpByte Vel_CrCtl1 6 0.00 255.0000 FORMAT "%8.4" EXTENDED_LIMITS -32768.00 32767.00 AXIS_PTS_REF CrCtl_rAccOffX_AXIS /end AXIS_DESCR
 /begin AXIS_DESCR COM_AXIS CrCtl_rEstSlpFltVal Prc_CrCtl4 9 -128.0000 127.9961 FORMAT "%8.4" AXIS_PTS_REF CrCtl_rAccOffY_AXIS /end AXIS_DESCR
/end CHARACTERISTIC
/begin CHARACTERISTIC CrCtl_rResOffTGKmh_GMAP "MAP for output resume off (Top Gear, EU Km/h)" MAP 0x80539432 MapG_Ws16 327.6750 APPCrCtl1 -163.8400 163.8350 FORMAT "%8.4"
 /begin AXIS_DESCR COM_AXIS CrCtl_vVehUpByte Vel_CrCtl1 6 0.00 255.0000 FORMAT "%8.4" EXTENDED_LIMITS -32768.00 32767.00 AXIS_PTS_REF CrCtl_rAccOffX_AXIS /end AXIS_DESCR
 /begin AXIS_DESCR COM_AXIS CrCtl_rEstSlpFltVal Prc_CrCtl4 9 -128.0000 127.9961 FORMAT "%8.4" AXIS_PTS_REF CrCtl_rAccOffY_AXIS /end AXIS_DESCR
/end CHARACTERISTIC
/begin CHARACTERISTIC CrCtl_rResOffTG_GMAP "MAP for output resume off (Top Gear)" MAP 0x8053949E MapG_Ws16 327.6750 APPCrCtl1 -163.8400 163.8350 FORMAT "%8.4"
 /begin AXIS_DESCR COM_AXIS CrCtl_vVehUpByte Vel_CrCtl1 6 0.00 255.0000 FORMAT "%8.4" EXTENDED_LIMITS -32768.00 32767.00 AXIS_PTS_REF CrCtl_rAccOffX_AXIS /end AXIS_DESCR
 /begin AXIS_DESCR COM_AXIS CrCtl_rEstSlpFltVal Prc_CrCtl4 9 -128.0000 127.9961 FORMAT "%8.4" AXIS_PTS_REF CrCtl_rAccOffY_AXIS /end AXIS_DESCR
/end CHARACTERISTIC
/begin CHARACTERISTIC CrCtl_rSecDwnCncl_GCUR "Curve for second APP Down for Cruise Control cancel" CURVE 0x8053950A CurG_Ws16 163.8350 APPCrCtl1 0.00 163.8350 FORMAT "%8.4" EXTENDED_LIMITS -163.8400 163.8350
 /begin AXIS_DESCR COM_AXIS CrCtl_rDes APPCrCtl1 6 0.00 163.8350 FORMAT "%8.4" EXTENDED_LIMITS -163.8400 163.8350 AXIS_PTS_REF CrCtl_rDwn_AXIS /end AXIS_DESCR
/end CHARACTERISTIC
/begin CHARACTERISTIC CrCtl_rSptAccOffNTG_GMAP "MAP for output Accel off(Not Top Gear) for sport mode" MAP 0x80539516 MapG_Ws16 327.6750 APPCrCtl1 -163.8400 163.8350 FORMAT "%8.4"
 /begin AXIS_DESCR COM_AXIS CrCtl_vVehUpByte Vel_CrCtl1 6 0.00 255.0000 FORMAT "%8.4" EXTENDED_LIMITS -32768.00 32767.00 AXIS_PTS_REF CrCtl_rAccOffX_AXIS /end AXIS_DESCR
 /begin AXIS_DESCR COM_AXIS CrCtl_rEstSlpFltVal Prc_CrCtl4 9 -128.0000 127.9961 FORMAT "%8.4" AXIS_PTS_REF CrCtl_rAccOffY_AXIS /end AXIS_DESCR
/end CHARACTERISTIC
/begin CHARACTERISTIC CrCtl_rSptAccOffTG_GMAP "MAP for output Accel off(Top Gear) for sport mode" MAP 0x80539582 MapG_Ws16 327.6750 APPCrCtl1 -163.8400 163.8350 FORMAT "%8.4"
 /begin AXIS_DESCR COM_AXIS CrCtl_vVehUpByte Vel_CrCtl1 6 0.00 255.0000 FORMAT "%8.4" EXTENDED_LIMITS -32768.00 32767.00 AXIS_PTS_REF CrCtl_rAccOffX_AXIS /end AXIS_DESCR
 /begin AXIS_DESCR COM_AXIS CrCtl_rEstSlpFltVal Prc_CrCtl4 9 -128.0000 127.9961 FORMAT "%8.4" AXIS_PTS_REF CrCtl_rAccOffY_AXIS /end AXIS_DESCR
/end CHARACTERISTIC
/begin CHARACTERISTIC CrCtl_rSptAPPACCFUMph_GCUR "Upper limit of acc. pedal opening at ACC follow-up control( MPH) for sport mode" CURVE 0x805395EE CurG_Ws16 327.6750 APPCrCtl1 -163.8400 163.8350 FORMAT "%8.4"
 /begin AXIS_DESCR COM_AXIS CrCtl_vVehSpd_mp Vel_CrCtl1 12 -32768.00 32767.00 FORMAT "%8.2" AXIS_PTS_REF CrCtl_vAPPLim_AXIS /end AXIS_DESCR
/end CHARACTERISTIC
/begin CHARACTERISTIC CrCtl_rSptLSFStrtAPP1_GCUR "Curve for LSF start demand value for request level 1 for Sport mode" CURVE 0x80539606 CurG_Ws16 327.6750 APPCrCtl1 -163.8400 163.8350 FORMAT "%8.4"
 /begin AXIS_DESCR COM_AXIS CrCtl_vVehUpByte Vel_CrCtl1 12 -32768.00 32767.00 FORMAT "%8.2" AXIS_PTS_REF CrCtl_vLSFStrtAPP_AXIS /end AXIS_DESCR
/end CHARACTERISTIC
/begin CHARACTERISTIC CrCtl_rSptMaxAppCCEC_GCUR "Selected easily condition to change desired vehicle speed for ECON for sport mode" CURVE 0x8053961E CurG_Ws16 327.6750 APPCrCtl1 -163.8400 163.8350 FORMAT "%8.4"
 /begin AXIS_DESCR COM_AXIS CrCtl_vVehSpd_mp Vel_CrCtl1 12 -32768.00 32767.00 FORMAT "%8.2" AXIS_PTS_REF CrCtl_vAPPLim_AXIS /end AXIS_DESCR
/end CHARACTERISTIC
/begin CHARACTERISTIC CrCtl_rSptMaxAPPCCMph_GCUR "Max. acc pedal opening at CC(MPH) for sport mode" CURVE 0x80539636 CurG_Ws16 327.6750 APPCrCtl1 -163.8400 163.8350 FORMAT "%8.4"
 /begin AXIS_DESCR COM_AXIS CrCtl_vVehSpd_mp Vel_CrCtl1 12 -32768.00 32767.00 FORMAT "%8.2" AXIS_PTS_REF CrCtl_vAPPLim_AXIS /end AXIS_DESCR
/end CHARACTERISTIC
/begin CHARACTERISTIC CrCtl_rSptMaxCC3LGMph_GCUR "Max. acc. pedal opening at CC3 lower gear (MPH) for sport mode" CURVE 0x8053964E CurG_Ws16 327.6750 APPCrCtl1 -163.8400 163.8350 FORMAT "%8.4"
 /begin AXIS_DESCR COM_AXIS CrCtl_vVehSpd_mp Vel_CrCtl1 12 -32768.00 32767.00 FORMAT "%8.2" AXIS_PTS_REF CrCtl_vAPPLim_AXIS /end AXIS_DESCR
/end CHARACTERISTIC
/begin CHARACTERISTIC CrCtl_rSptMaxCC4LGMph_GCUR "Max. acc. pedal opening at CC4 lower gear (MPH) for sport mode" CURVE 0x80539666 CurG_Ws16 327.6750 APPCrCtl1 -163.8400 163.8350 FORMAT "%8.4"
 /begin AXIS_DESCR COM_AXIS CrCtl_vVehSpd_mp Vel_CrCtl1 12 -32768.00 32767.00 FORMAT "%8.2" AXIS_PTS_REF CrCtl_vAPPLim_AXIS /end AXIS_DESCR
/end CHARACTERISTIC
/begin CHARACTERISTIC CrCtl_rSptMaxCC5LGMph_GCUR "Max. acc. pedal opening at CC5 lower gear (MPH) for sport mode" CURVE 0x8053967E CurG_Ws16 327.6750 APPCrCtl1 -163.8400 163.8350 FORMAT "%8.4"
 /begin AXIS_DESCR COM_AXIS CrCtl_vVehSpd_mp Vel_CrCtl1 12 -32768.00 32767.00 FORMAT "%8.2" AXIS_PTS_REF CrCtl_vAPPLim_AXIS /end AXIS_DESCR
/end CHARACTERISTIC
/begin CHARACTERISTIC CrCtl_rSptMaxCC6LGMph_GCUR "Max. acc. pedal opening at CC6 lower gear (MPH) for sport mode" CURVE 0x80539696 CurG_Ws16 327.6750 APPCrCtl1 -163.8400 163.8350 FORMAT "%8.4"
 /begin AXIS_DESCR COM_AXIS CrCtl_vVehSpd_mp Vel_CrCtl1 12 -32768.00 32767.00 FORMAT "%8.2" AXIS_PTS_REF CrCtl_vAPPLim_AXIS /end AXIS_DESCR
/end CHARACTERISTIC
/begin CHARACTERISTIC CrCtl_rSptMaxCCLGMph_GCUR "Max. acc. pedal opening at CC2 lower gear (MPH) for sport mode" CURVE 0x805396AE CurG_Ws16 327.6750 APPCrCtl1 -163.8400 163.8350 FORMAT "%8.4"
 /begin AXIS_DESCR COM_AXIS CrCtl_vVehSpd_mp Vel_CrCtl1 12 -32768.00 32767.00 FORMAT "%8.2" AXIS_PTS_REF CrCtl_vAPPLim_AXIS /end AXIS_DESCR
/end CHARACTERISTIC
/begin CHARACTERISTIC CrCtl_rSptMaxCCNGMph_GCUR "Max. acc. pedal opening at CC next gear (MPH) for sport mode" CURVE 0x805396C6 CurG_Ws16 327.6750 APPCrCtl1 -163.8400 163.8350 FORMAT "%8.4"
 /begin AXIS_DESCR COM_AXIS CrCtl_vVehSpd_mp Vel_CrCtl1 12 -32768.00 32767.00 FORMAT "%8.2" AXIS_PTS_REF CrCtl_vAPPLim_AXIS /end AXIS_DESCR
/end CHARACTERISTIC
/begin CHARACTERISTIC CrCtl_rSptMaxCCTGMph_GCUR "Max. acc. pedal opening at CC top gear (MPH) for sport mode" CURVE 0x805396DE CurG_Ws16 327.6750 APPCrCtl1 -163.8400 163.8350 FORMAT "%8.4"
 /begin AXIS_DESCR COM_AXIS CrCtl_vVehSpd_mp Vel_CrCtl1 12 -32768.00 32767.00 FORMAT "%8.2" AXIS_PTS_REF CrCtl_vAPPLim_AXIS /end AXIS_DESCR
/end CHARACTERISTIC
/begin CHARACTERISTIC CrCtl_rSptReqChng_GCUR "Curve for Gear Change APP request value for sport mode" CURVE 0x805396F6 CurG_Ws16 327.6750 APPCrCtl1 -163.8400 163.8350 FORMAT "%8.4"
 /begin AXIS_DESCR COM_AXIS CrCtl_nDesVal_mp EngNCrCtl 6 0.00 32767.00 FORMAT "%8.2" EXTENDED_LIMITS -32768.00 32767.00 AXIS_PTS_REF CrCtl_nAPPReqChng_AXIS /end AXIS_DESCR
/end CHARACTERISTIC
/begin CHARACTERISTIC CrCtl_rSptResOffNTG_GMAP "MAP for output resume off (Not Top Gear) for sport mode" MAP 0x80539702 MapG_Ws16 327.6750 APPCrCtl1 -163.8400 163.8350 FORMAT "%8.4"
 /begin AXIS_DESCR COM_AXIS CrCtl_vVehUpByte Vel_CrCtl1 6 0.00 255.0000 FORMAT "%8.4" EXTENDED_LIMITS -32768.00 32767.00 AXIS_PTS_REF CrCtl_rAccOffX_AXIS /end AXIS_DESCR
 /begin AXIS_DESCR COM_AXIS CrCtl_rEstSlpFltVal Prc_CrCtl4 9 -128.0000 127.9961 FORMAT "%8.4" AXIS_PTS_REF CrCtl_rAccOffY_AXIS /end AXIS_DESCR
/end CHARACTERISTIC
/begin CHARACTERISTIC CrCtl_rSptResOffTG_GMAP "MAP for output resume off (Top Gear) for sport mode" MAP 0x8053976E MapG_Ws16 327.6750 APPCrCtl1 -163.8400 163.8350 FORMAT "%8.4"
 /begin AXIS_DESCR COM_AXIS CrCtl_vVehUpByte Vel_CrCtl1 6 0.00 255.0000 FORMAT "%8.4" EXTENDED_LIMITS -32768.00 32767.00 AXIS_PTS_REF CrCtl_rAccOffX_AXIS /end AXIS_DESCR
 /begin AXIS_DESCR COM_AXIS CrCtl_rEstSlpFltVal Prc_CrCtl4 9 -128.0000 127.9961 FORMAT "%8.4" AXIS_PTS_REF CrCtl_rAccOffY_AXIS /end AXIS_DESCR
/end CHARACTERISTIC
/begin CHARACTERISTIC CrCtl_rSptTDInitNTG_GCUR "Curve for Tap Down initial value(Not Top Gear) for CC for sport mode" CURVE 0x805397DA CurG_Ws16 327.6750 APPCrCtl1 -163.8400 163.8350 FORMAT "%8.4"
 /begin AXIS_DESCR COM_AXIS CrCtl_vVehUpByte Vel_CrCtl1 6 0.00 255.0000 FORMAT "%8.4" EXTENDED_LIMITS -32768.00 32767.00 AXIS_PTS_REF CrCtl_vTapDnInit_AXIS /end AXIS_DESCR
/end CHARACTERISTIC
/begin CHARACTERISTIC CrCtl_rSptTDInitTG_GCUR "Curve for Tap Down initial value(Top Gear) for CC for sport mode" CURVE 0x805397E6 CurG_Ws16 327.6750 APPCrCtl1 -163.8400 163.8350 FORMAT "%8.4"
 /begin AXIS_DESCR COM_AXIS CrCtl_vVehUpByte Vel_CrCtl1 6 0.00 255.0000 FORMAT "%8.4" EXTENDED_LIMITS -32768.00 32767.00 AXIS_PTS_REF CrCtl_vTapDnInit_AXIS /end AXIS_DESCR
/end CHARACTERISTIC
/begin CHARACTERISTIC CrCtl_rSptTUInitNTG_GCUR "Curve for Tap Up initial value(Not Top Gear) for CC for sport mode" CURVE 0x805397F2 CurG_Ws16 327.6750 APPCrCtl1 -163.8400 163.8350 FORMAT "%8.4"
 /begin AXIS_DESCR COM_AXIS CrCtl_vVehUpByte Vel_CrCtl1 6 0.00 255.0000 FORMAT "%8.4" EXTENDED_LIMITS -32768.00 32767.00 AXIS_PTS_REF CrCtl_vTapUpInit_AXIS /end AXIS_DESCR
/end CHARACTERISTIC
/begin CHARACTERISTIC CrCtl_rSptTUInitTG_GCUR "Curve for Tap Up initial value(Top Gear) for CC for sport mode" CURVE 0x805397FE CurG_Ws16 327.6750 APPCrCtl1 -163.8400 163.8350 FORMAT "%8.4"
 /begin AXIS_DESCR COM_AXIS CrCtl_vVehUpByte Vel_CrCtl1 6 0.00 255.0000 FORMAT "%8.4" EXTENDED_LIMITS -32768.00 32767.00 AXIS_PTS_REF CrCtl_vTapUpInit_AXIS /end AXIS_DESCR
/end CHARACTERISTIC
/begin CHARACTERISTIC CrCtl_rTDInitNTG_GCUR "Curve for Tap Down initial value(Not Top Gear) for CC" CURVE 0x8053980A CurG_Ws16 163.8350 APPCrCtl1 0.00 163.8350 FORMAT "%8.4" EXTENDED_LIMITS -163.8400 163.8350
 /begin AXIS_DESCR COM_AXIS CrCtl_vVehUpByte Vel_CrCtl1 6 0.00 255.0000 FORMAT "%8.4" EXTENDED_LIMITS -32768.00 32767.00 AXIS_PTS_REF CrCtl_vTapDnInit_AXIS /end AXIS_DESCR
/end CHARACTERISTIC
/begin CHARACTERISTIC CrCtl_rTDInitTG_GCUR "Curve for Tap Down initial value(Top Gear) for CC" CURVE 0x80539816 CurG_Ws16 163.8350 APPCrCtl1 0.00 163.8350 FORMAT "%8.4" EXTENDED_LIMITS -163.8400 163.8350
 /begin AXIS_DESCR COM_AXIS CrCtl_vVehUpByte Vel_CrCtl1 6 0.00 255.0000 FORMAT "%8.4" EXTENDED_LIMITS -32768.00 32767.00 AXIS_PTS_REF CrCtl_vTapDnInit_AXIS /end AXIS_DESCR
/end CHARACTERISTIC
/begin CHARACTERISTIC CrCtl_rTrgSub_CUR "Curve for subtraction value of target APP value" CURVE 0x80539822 RB_Cur_Xs16Ws16 163.8350 APPCrCtl1 0.00 163.8350 FORMAT "%8.4" EXTENDED_LIMITS -163.8400 163.8350
 /begin AXIS_DESCR STD_AXIS CrCtl_vVehUpByte Vel_CrCtl1 6 0.00 255.0000 FORMAT "%8.4" EXTENDED_LIMITS -32768.00 32767.00 DEPOSIT ABSOLUTE /end AXIS_DESCR
/end CHARACTERISTIC
/begin CHARACTERISTIC CrCtl_rTrqDflVal_C "default value of Torque Ratio value" VALUE 0x8053983C Val_Ws8 127.0 Prc_CrCtl 0.00 127.0 FORMAT "%5.1" EXTENDED_LIMITS -128.0 127.0 /end CHARACTERISTIC
/begin CHARACTERISTIC CrCtl_rTUInitDRlo_GCUR "Tap up initialisation value incase of down request" CURVE 0x8053983E CurG_Ws16 163.8350 APPCrCtl1 0.00 163.8350 FORMAT "%8.4" EXTENDED_LIMITS -163.8400 163.8350
 /begin AXIS_DESCR COM_AXIS CrCtl_vVehUpByte Vel_CrCtl1 6 0.00 255.0000 FORMAT "%8.4" EXTENDED_LIMITS -32768.00 32767.00 AXIS_PTS_REF CrCtl_vTapUpInit_AXIS /end AXIS_DESCR
/end CHARACTERISTIC
/begin CHARACTERISTIC CrCtl_rTUInitNTG_GCUR "Curve for Tap Up initial value(Not Top Gear) for CC" CURVE 0x8053984A CurG_Ws16 163.8350 APPCrCtl1 0.00 163.8350 FORMAT "%8.4" EXTENDED_LIMITS -163.8400 163.8350
 /begin AXIS_DESCR COM_AXIS CrCtl_vVehUpByte Vel_CrCtl1 6 0.00 255.0000 FORMAT "%8.4" EXTENDED_LIMITS -32768.00 32767.00 AXIS_PTS_REF CrCtl_vTapUpInit_AXIS /end AXIS_DESCR
/end CHARACTERISTIC
/begin CHARACTERISTIC CrCtl_rTUInitTG_GCUR "Curve for Tap Up initial value(Top Gear) for CC" CURVE 0x80539856 CurG_Ws16 163.8350 APPCrCtl1 0.00 163.8350 FORMAT "%8.4" EXTENDED_LIMITS -163.8400 163.8350
 /begin AXIS_DESCR COM_AXIS CrCtl_vVehUpByte Vel_CrCtl1 6 0.00 255.0000 FORMAT "%8.4" EXTENDED_LIMITS -32768.00 32767.00 AXIS_PTS_REF CrCtl_vTapUpInit_AXIS /end AXIS_DESCR
/end CHARACTERISTIC
/begin CHARACTERISTIC CrCtl_stACCClthOutSel_C "selected value by Clutch out case carry out control for ACC" VALUE 0x80539862 Val_Wu8 1.000 OneToOne 0.00 1.000 FORMAT "%5.3" EXTENDED_LIMITS 0.00 255.0 /end CHARACTERISTIC
/begin CHARACTERISTIC CrCtl_stACCECActv_C "Selected control to change desired vehicle speed for ECON in stages" VALUE 0x80539863 Val_Wu8 1.000 OneToOne 0.00 1.000 FORMAT "%5.3" EXTENDED_LIMITS 0.00 255.0 /end CHARACTERISTIC
/begin CHARACTERISTIC CrCtl_stACCUpLimCnclGDwnNr_C "Down No of ACC ceiling release instruction judgment gear" VALUE 0x80539864 Val_Wu8 127.0 OneToOne 0.00 127.0 FORMAT "%5.1" EXTENDED_LIMITS 0.00 255.0 /end CHARACTERISTIC
/begin CHARACTERISTIC CrCtl_stCCECActv_C "ACC RP (hysteresis Lo) value for ECON" VALUE 0x80539865 Val_Wu8 1.000 OneToOne 0.00 1.000 FORMAT "%5.3" EXTENDED_LIMITS 0.00 255.0 /end CHARACTERISTIC
/begin CHARACTERISTIC CrCtl_stCCMaxAPPGDwnNr_C "Down No of gear of judgment of opening of greatest acceleration" VALUE 0x80539866 Val_Wu8 127.0 OneToOne 0.00 127.0 FORMAT "%5.1" EXTENDED_LIMITS 0.00 255.0 /end CHARACTERISTIC
/begin CHARACTERISTIC CrCtl_stCCUpLimCnclGDwnNr_C "Down No of CC ceiling release instruction judgment gear" VALUE 0x80539867 Val_Wu8 127.0 OneToOne 0.00 127.0 FORMAT "%5.1" EXTENDED_LIMITS 0.00 255.0 /end CHARACTERISTIC
/begin CHARACTERISTIC CrCtl_stDisAPPInc_C "Flag for disabling the increase in reqtd. acc. pedal opening after deciding CC_DR" VALUE 0x80539868 Val_Wu8 255.0 OneToOne 0.00 255.0 FORMAT "%5.1" /end CHARACTERISTIC
/begin CHARACTERISTIC CrCtl_stDR1AccnTmrDisbl_C "DR1 acceleration judgement timer disabling flag for CC up slope" VALUE 0x80539869 Val_Wu8 255.0 OneToOne 0.00 255.0 FORMAT "%5.1" /end CHARACTERISTIC
/begin CHARACTERISTIC CrCtl_stDR2AccnTmrDisbl_C "DR2 acceleration judgement timer disabling flag for CC upslope" VALUE 0x8053986A Val_Wu8 255.0 OneToOne 0.00 255.0 FORMAT "%5.1" /end CHARACTERISTIC
/begin CHARACTERISTIC CrCtl_stDR3AccnTmrDisbl_C "DR3 cancellation judgement timer disabling flag for CC up slope" VALUE 0x8053986B Val_Wu8 255.0 OneToOne 0.00 255.0 FORMAT "%5.1" /end CHARACTERISTIC
/begin CHARACTERISTIC CrCtl_stDR4AccnTmrDisbl_C "DR4 acceleration judgement timer disabling flag for CC up slope" VALUE 0x8053986C Val_Wu8 255.0 OneToOne 0.00 255.0 FORMAT "%5.1" /end CHARACTERISTIC
/begin CHARACTERISTIC CrCtl_stDR5AccnTmrDisbl_C "DR5 acceleration judgement timer disabling flag for CC up slope" VALUE 0x8053986D Val_Wu8 255.0 OneToOne 0.00 255.0 FORMAT "%5.1" /end CHARACTERISTIC
/begin CHARACTERISTIC CrCtl_stDR6AccnTmrDisbl_C "DR6 acceleration judgement timer disabling flag for CC up slope" VALUE 0x8053986E Val_Wu8 255.0 OneToOne 0.00 255.0 FORMAT "%5.1" /end CHARACTERISTIC
/begin CHARACTERISTIC CrCtl_stDR7AccnTmrDisbl_C "DR7 acceleration judgement timer disabling flag for CC up slope" VALUE 0x8053986F Val_Wu8 255.0 OneToOne 0.00 255.0 FORMAT "%5.1" /end CHARACTERISTIC
/begin CHARACTERISTIC CrCtl_stECAppLimSel_C "Curve for target acceleration standerd value for ECON (during accel)" VALUE 0x80539870 Val_Wu8 1.000 OneToOne 0.00 1.000 FORMAT "%5.3" EXTENDED_LIMITS 0.00 255.0 /end CHARACTERISTIC
/begin CHARACTERISTIC CrCtl_stECAppUpprLim_C "Added value1 in each 100ms to desired vehicle speed for ECON (ECON sw ON)" VALUE 0x80539871 Val_Wu8 1.000 OneToOne 0.00 1.000 FORMAT "%5.3" EXTENDED_LIMITS 0.00 255.0 /end CHARACTERISTIC
/begin CHARACTERISTIC CrCtl_stECDesSelCdn_C "Selected control to change desired vehicle speed for ECON in stages" VALUE 0x80539872 Val_Wu8 1.000 OneToOne 0.00 1.000 FORMAT "%5.3" EXTENDED_LIMITS 0.00 255.0 /end CHARACTERISTIC
/begin CHARACTERISTIC CrCtl_stECDesSelProc_C "RP (hysteresis Lo) value for ECON" VALUE 0x80539873 Val_Wu8 1.000 OneToOne 0.00 1.000 FORMAT "%5.3" EXTENDED_LIMITS 0.00 255.0 /end CHARACTERISTIC
/begin CHARACTERISTIC CrCtl_stECDR1DwnSlpDi_C "Output select flag for DR1 judgement at CC down slp for ECON" VALUE 0x80539874 Val_Wu8 1.000 OneToOne 0.00 1.000 FORMAT "%5.3" EXTENDED_LIMITS 0.00 255.0 /end CHARACTERISTIC
/begin CHARACTERISTIC CrCtl_stECDR2DwnSlpDi_C "Output select flag for DR2 judgement at CC down slp for ECON" VALUE 0x80539875 Val_Wu8 1.000 OneToOne 0.00 1.000 FORMAT "%5.3" EXTENDED_LIMITS 0.00 255.0 /end CHARACTERISTIC
/begin CHARACTERISTIC CrCtl_stECDR3DwnSlpDi_C "Output select flag for DR3 judgement at CC down slp for ECON" VALUE 0x80539876 Val_Wu8 1.000 OneToOne 0.00 1.000 FORMAT "%5.3" EXTENDED_LIMITS 0.00 255.0 /end CHARACTERISTIC
/begin CHARACTERISTIC CrCtl_stGearMapNo_CA "Array for Gear Map Number for Cruise Control" VAL_BLK 0x80539877 ValA_Wu8 255.0 OneToOne 0.00 255.0 FORMAT "%5.1" NUMBER 4 /end CHARACTERISTIC
/begin CHARACTERISTIC CrCtl_stNeLimSel_C "Engine speed limit control select value" VALUE 0x8053987B Val_Wu8 1.000 OneToOne 0.00 1.000 FORMAT "%5.3" EXTENDED_LIMITS 0.00 255.0 /end CHARACTERISTIC
/begin CHARACTERISTIC CrCtl_stResOffEna_C "Enable resume off control" VALUE 0x8053987C Val_Wu8 1.000 OneToOne 0.00 1.000 FORMAT "%5.3" EXTENDED_LIMITS 0.00 255.0 /end CHARACTERISTIC
/begin CHARACTERISTIC CrCtl_stSwtPDCtrlEna_C "Switch to enable PD control" VALUE 0x8053987D Val_Wu8 1.000 OneToOne 0.00 1.000 FORMAT "%5.3" EXTENDED_LIMITS 0.00 255.0 /end CHARACTERISTIC
/begin CHARACTERISTIC CrCtl_stUpACC1LG_C "Flag for indicating the upper limit canc. in ACC1 lower gear" VALUE 0x8053987E Val_Wu8 255.0 OneToOne 0.00 255.0 FORMAT "%5.1" /end CHARACTERISTIC
/begin CHARACTERISTIC CrCtl_stUpACC2LG_C "Flag for indicating the upper limit canc. in ACC2 lower gear" VALUE 0x8053987F Val_Wu8 255.0 OneToOne 0.00 255.0 FORMAT "%5.1" /end CHARACTERISTIC
/begin CHARACTERISTIC CrCtl_stUpACCTG_C "Flag for indicating the upper limit canc. in ACC top gear" VALUE 0x80539880 Val_Wu8 255.0 OneToOne 0.00 255.0 FORMAT "%5.1" /end CHARACTERISTIC
/begin CHARACTERISTIC CrCtl_stUpCC1LG_C "Flag for indicating the upper limit canc. in CC1 lower gear" VALUE 0x80539881 Val_Wu8 255.0 OneToOne 0.00 255.0 FORMAT "%5.1" /end CHARACTERISTIC
/begin CHARACTERISTIC CrCtl_stUpCC2LG_C "Flag for indicating the upper limit canc. in CC2 lower gear" VALUE 0x80539882 Val_Wu8 255.0 OneToOne 0.00 255.0 FORMAT "%5.1" /end CHARACTERISTIC
/begin CHARACTERISTIC CrCtl_stUpCCTG_C "Flag for indicating the upper limit canc. in CC top gear" VALUE 0x80539883 Val_Wu8 255.0 OneToOne 0.00 255.0 FORMAT "%5.1" /end CHARACTERISTIC
/begin CHARACTERISTIC CrCtl_stUpperGear_C "Status of Upper Gear" VALUE 0x80539884 Val_Wu8 255.0 OneToOne 0.00 255.0 FORMAT "%5.1" /end CHARACTERISTIC
/begin CHARACTERISTIC CrCtl_stVehSpdSel_C "Status value for vehicle speed selection" VALUE 0x80539885 Val_Wu8 1.000 OneToOne 0.00 1.000 FORMAT "%5.3" EXTENDED_LIMITS 0.00 255.0 /end CHARACTERISTIC
/begin CHARACTERISTIC CrCtl_swtACCTrgAccnSel_C "Switch to select target acceleration value for ACC" VALUE 0x80539886 Val_Wu8 1.000 OneToOne 0.00 1.000 FORMAT "%5.3" EXTENDED_LIMITS 0.00 255.0 /end CHARACTERISTIC
/begin CHARACTERISTIC CrCtl_SwtDRnrEna_C "Switch to enable cruise control Down Request number for AT" VALUE 0x80539887 Val_Wu8 1.000 OneToOne 0.00 1.000 FORMAT "%5.3" EXTENDED_LIMITS 0.00 255.0 /end CHARACTERISTIC
/begin CHARACTERISTIC CrCtl_tiACCChngRes_C "Resume to ACC Change Gear for setpoint speed change check time" VALUE 0x80539888 Val_Ws16 327670.0 Time_ms 0.00 327670.0 FORMAT "%8.1" EXTENDED_LIMITS -327680.0 327670.0 /end CHARACTERISTIC
/begin CHARACTERISTIC CrCtl_tiAccnDR1UpSlp_C "Judgement time for DR1 acceleration at CC upslope DR1 acceleration judgement time for CC up slope" VALUE 0x8053988A Val_Ws16 6553500. Time_ms_100ms -3276800. 3276700. FORMAT "%8.0" /end CHARACTERISTIC
/begin CHARACTERISTIC CrCtl_tiAccnDR2UpSlp_C "Judgement time for DR2 acceleration at CC upslope/DR2 acceleration judgement time for CC up slope" VALUE 0x8053988C Val_Ws16 6553500. Time_ms_100ms -3276800. 3276700. FORMAT "%8.0" /end CHARACTERISTIC
/begin CHARACTERISTIC CrCtl_tiAccnDR3UpSlp_C "Judgement time for DR3 acceleration at CC upslope/DR2 acceleration judgement time for CC up slope" VALUE 0x8053988E Val_Ws16 6553500. Time_ms_100ms -3276800. 3276700. FORMAT "%8.0" /end CHARACTERISTIC
/begin CHARACTERISTIC CrCtl_tiAccnDR4UpSlp_C "Judgement time for DR4 acceleration at CC up slope\ DR4 acceleration judgement time for CC up slope" VALUE 0x80539890 Val_Ws16 6553500. Time_ms_100ms -3276800. 3276700. FORMAT "%8.0" /end CHARACTERISTIC
/begin CHARACTERISTIC CrCtl_tiAccnDR5UpSlp_C "Judgement time for DR5 acceleration at CC up slope\ DR5 acceleration judgement time for CC up slope" VALUE 0x80539892 Val_Ws16 6553500. Time_ms_100ms -3276800. 3276700. FORMAT "%8.0" /end CHARACTERISTIC
/begin CHARACTERISTIC CrCtl_tiAccnDR6UpSlp_C "Judgement time for DR6 acceleration at CC up slope\ DR6 acceleration judgement time for CC up slope" VALUE 0x80539894 Val_Ws16 6553500. Time_ms_100ms -3276800. 3276700. FORMAT "%8.0" /end CHARACTERISTIC
/begin CHARACTERISTIC CrCtl_tiAccnDR7UpSlp_C "Judgement time for DR7 acceleration at CC up slope\ DR7 acceleration judgement time for CC up slope" VALUE 0x80539896 Val_Ws16 6553500. Time_ms_100ms -3276800. 3276700. FORMAT "%8.0" /end CHARACTERISTIC
/begin CHARACTERISTIC CrCtl_tiCC1LGMaxRat_C "CC1 lower gear max. opening stick time" VALUE 0x80539898 Val_Ws16 6553500. Time_ms_100ms -3276800. 3276700. FORMAT "%8.0" /end CHARACTERISTIC
/begin CHARACTERISTIC CrCtl_tiCC2LGMaxRat_C "CC2 lower gear max. opening stick time" VALUE 0x8053989A Val_Ws16 6553500. Time_ms_100ms -3276800. 3276700. FORMAT "%8.0" /end CHARACTERISTIC
/begin CHARACTERISTIC CrCtl_tiCC3LGMaxRat_C "CC3 lower gear max. opening stick time" VALUE 0x8053989C Val_Ws16 6553500. Time_ms_100ms -3276800. 3276700. FORMAT "%8.0" /end CHARACTERISTIC
/begin CHARACTERISTIC CrCtl_tiCC4LGMaxRat_C "CC4 lower gear max. opening stick time" VALUE 0x8053989E Val_Ws16 6553500. Time_ms_100ms -3276800. 3276700. FORMAT "%8.0" /end CHARACTERISTIC
/begin CHARACTERISTIC CrCtl_tiCC5LGMaxRat_C "CC5 lower gear max. opening stick time" VALUE 0x805398A0 Val_Ws16 6553500. Time_ms_100ms -3276800. 3276700. FORMAT "%8.0" /end CHARACTERISTIC
/begin CHARACTERISTIC CrCtl_tiCC6LGMaxRat_C "CC6 lower gear max. opening stick time" VALUE 0x805398A2 Val_Ws16 6553500. Time_ms_100ms -3276800. 3276700. FORMAT "%8.0" /end CHARACTERISTIC
/begin CHARACTERISTIC CrCtl_tiCCMaxRat_C "CC max. opening stick time" VALUE 0x805398A4 Val_Ws16 6553500. Time_ms_100ms -3276800. 3276700. FORMAT "%8.0" /end CHARACTERISTIC
/begin CHARACTERISTIC CrCtl_tiCCTGMaxRat_C "CC top gear max. opening stick time" VALUE 0x805398A6 Val_Ws16 6553500. Time_ms_100ms -3276800. 3276700. FORMAT "%8.0" /end CHARACTERISTIC
/begin CHARACTERISTIC CrCtl_tiClthOnContChng_C "time to Clutch On NE F/B control change check" VALUE 0x805398A8 Val_Ws16 327670.0 Time_ms 0.00 327670.0 FORMAT "%8.1" EXTENDED_LIMITS -327680.0 327670.0 /end CHARACTERISTIC
/begin CHARACTERISTIC CrCtl_tiContnsErrChk_C "Time of Cruise control error continuous check value" VALUE 0x805398AA Val_Ws16 327670.0 Time_ms 0.00 327670.0 FORMAT "%8.1" EXTENDED_LIMITS -327680.0 327670.0 /end CHARACTERISTIC
/begin CHARACTERISTIC CrCtl_tiDR1CnclHold_C "Time for retaining DR1 cancellation at CC up slope(also DR1 cancel hold time for CC up-slope" VALUE 0x805398AC Val_Ws16 3276700. Time_ms_100ms 0.00 3276700. FORMAT "%8.0" EXTENDED_LIMITS -3276800. 3276700. /end CHARACTERISTIC
/begin CHARACTERISTIC CrCtl_tiDR1CnclMskDwnSlp_C "DR1 cancellation judgement time at CC down slope" VALUE 0x805398AE Val_Ws16 6553500. Time_ms_100ms -3276800. 3276700. FORMAT "%8.0" /end CHARACTERISTIC
/begin CHARACTERISTIC CrCtl_tiDR1CnclUpSlp_C "DR1 cancel judgement time for CC up slope" VALUE 0x805398B0 Val_Ws16 6553500. Time_ms_100ms -3276800. 3276700. FORMAT "%8.0" /end CHARACTERISTIC
/begin CHARACTERISTIC CrCtl_tiDR2CnclHold_C "Time for retaining DR2 cancellation at CC up slope(also DR cancel hold time for CC up-slope )" VALUE 0x805398B2 Val_Ws16 3276700. Time_ms_100ms 0.00 3276700. FORMAT "%8.0" EXTENDED_LIMITS -3276800. 3276700. /end CHARACTERISTIC
/begin CHARACTERISTIC CrCtl_tiDR2CnclMskDwnSlp_C "DR2 cancellation judgement time at CC down slope" VALUE 0x805398B4 Val_Ws16 6553500. Time_ms_100ms -3276800. 3276700. FORMAT "%8.0" /end CHARACTERISTIC
/begin CHARACTERISTIC CrCtl_tiDR2CnclUpSlp_C "DR2 cancel judgement time for CC up slope" VALUE 0x805398B6 Val_Ws16 6553500. Time_ms_100ms -3276800. 3276700. FORMAT "%8.0" /end CHARACTERISTIC
/begin CHARACTERISTIC CrCtl_tiDR3CnclHold_C "Time for retaining DR3 cancellation at CC up slope(also DR3 cancel hold time for CC up-slope )" VALUE 0x805398B8 Val_Ws16 3276700. Time_ms_100ms 0.00 3276700. FORMAT "%8.0" EXTENDED_LIMITS -3276800. 3276700. /end CHARACTERISTIC
/begin CHARACTERISTIC CrCtl_tiDR3CnclMskDwnSlp_C "DR3 cancellation judgement time at CC down slope" VALUE 0x805398BA Val_Ws16 6553500. Time_ms_100ms -3276800. 3276700. FORMAT "%8.0" /end CHARACTERISTIC
/begin CHARACTERISTIC CrCtl_tiDR3CnclUpSlp_C "DR3 cancel judgement time for CC up slope" VALUE 0x805398BC Val_Ws16 6553500. Time_ms_100ms -3276800. 3276700. FORMAT "%8.0" /end CHARACTERISTIC
/begin CHARACTERISTIC CrCtl_tiDR4CnclHold_C "Time for retaining DR4 cancellation at CC up slope(also DR4 cancel hold time for CC up-slope )" VALUE 0x805398BE Val_Ws16 3276700. Time_ms_100ms 0.00 3276700. FORMAT "%8.0" EXTENDED_LIMITS -3276800. 3276700. /end CHARACTERISTIC
/begin CHARACTERISTIC CrCtl_tiDR4CnclMskDwnSlp_C "DR4 cancellation judgement time at CC down slope" VALUE 0x805398C0 Val_Ws16 6553500. Time_ms_100ms -3276800. 3276700. FORMAT "%8.0" /end CHARACTERISTIC
/begin CHARACTERISTIC CrCtl_tiDR4CnclUpSlp_C "DR4 cancel judgement time for CC up slope" VALUE 0x805398C2 Val_Ws16 6553500. Time_ms_100ms -3276800. 3276700. FORMAT "%8.0" /end CHARACTERISTIC
/begin CHARACTERISTIC CrCtl_tiDR5CnclHold_C "Time for retaining DR5 cancellation at CC up slope(also DR5 cancel hold time for CC up-slope )" VALUE 0x805398C4 Val_Ws16 3276700. Time_ms_100ms 0.00 3276700. FORMAT "%8.0" EXTENDED_LIMITS -3276800. 3276700. /end CHARACTERISTIC
/begin CHARACTERISTIC CrCtl_tiDR5CnclMskDwnSlp_C "DR5 cancellation judgement time at CC down slope" VALUE 0x805398C6 Val_Ws16 6553500. Time_ms_100ms -3276800. 3276700. FORMAT "%8.0" /end CHARACTERISTIC
/begin CHARACTERISTIC CrCtl_tiDR5CnclUpSlp_C "DR5 cancel judgement time for CC up slope" VALUE 0x805398C8 Val_Ws16 6553500. Time_ms_100ms -3276800. 3276700. FORMAT "%8.0" /end CHARACTERISTIC
/begin CHARACTERISTIC CrCtl_tiDR6CnclHold_C "Time for retaining DR6 cancellation at CC up slope(also DR6 cancel hold time for CC up-slope )" VALUE 0x805398CA Val_Ws16 3276700. Time_ms_100ms 0.00 3276700. FORMAT "%8.0" EXTENDED_LIMITS -3276800. 3276700. /end CHARACTERISTIC
/begin CHARACTERISTIC CrCtl_tiDR6CnclMskDwnSlp_C "DR6 cancellation judgement time at CC down slope" VALUE 0x805398CC Val_Ws16 6553500. Time_ms_100ms -3276800. 3276700. FORMAT "%8.0" /end CHARACTERISTIC
/begin CHARACTERISTIC CrCtl_tiDR6CnclUpSlp_C "DR6 cancel judgement time for CC up slope" VALUE 0x805398CE Val_Ws16 6553500. Time_ms_100ms -3276800. 3276700. FORMAT "%8.0" /end CHARACTERISTIC
/begin CHARACTERISTIC CrCtl_tiDR7CnclHold_C "Time for retaining DR7 cancellation at CC up slope(also DR7 cancel hold time for CC up-slope )" VALUE 0x805398D0 Val_Ws16 3276700. Time_ms_100ms 0.00 3276700. FORMAT "%8.0" EXTENDED_LIMITS -3276800. 3276700. /end CHARACTERISTIC
/begin CHARACTERISTIC CrCtl_tiDR7CnclMskDwnSlp_C "DR7 cancellation judgement time at CC down slope" VALUE 0x805398D2 Val_Ws16 6553500. Time_ms_100ms -3276800. 3276700. FORMAT "%8.0" /end CHARACTERISTIC
/begin CHARACTERISTIC CrCtl_tiDR7CnclUpSlp_C "DR7 cancel judgement time for CC up slope" VALUE 0x805398D4 Val_Ws16 6553500. Time_ms_100ms -3276800. 3276700. FORMAT "%8.0" /end CHARACTERISTIC
/begin CHARACTERISTIC CrCtl_tiDRCnclPROSMADisbl_C "Down-slope prosma disable request flag at CC_DR cancellation" VALUE 0x805398D6 Val_Ws16 6553500. Time_ms_100ms -3276800. 3276700. FORMAT "%8.0" /end CHARACTERISTIC
/begin CHARACTERISTIC CrCtl_tiDRMskB_C "CC_DR mask time B" VALUE 0x805398D8 Val_Ws16 6553500. Time_ms_100ms -3276800. 3276700. FORMAT "%8.0" /end CHARACTERISTIC
/begin CHARACTERISTIC CrCtl_tiDRMskC_C "CC_DR mask time C" VALUE 0x805398DA Val_Ws16 6553500. Time_ms_100ms -3276800. 3276700. FORMAT "%8.0" /end CHARACTERISTIC
/begin CHARACTERISTIC CrCtl_tiDRMskD_C "CC_DR mask time D" VALUE 0x805398DC Val_Ws16 6553500. Time_ms_100ms -3276800. 3276700. FORMAT "%8.0" /end CHARACTERISTIC
/begin CHARACTERISTIC CrCtl_tiDRMskE_C "CC_DR mask time E" VALUE 0x805398DE Val_Ws16 6553500. Time_ms_100ms -3276800. 3276700. FORMAT "%8.0" /end CHARACTERISTIC
/begin CHARACTERISTIC CrCtl_tiDRMskF_C "CC_DR mask time F" VALUE 0x805398E0 Val_Ws16 6553500. Time_ms_100ms -3276800. 3276700. FORMAT "%8.0" /end CHARACTERISTIC
/begin CHARACTERISTIC CrCtl_tiDwnReqDisbl_C "DR disable timer at start of CC Control" VALUE 0x805398E2 Val_Ws16 3276700. Time_ms_100ms 0.00 3276700. FORMAT "%8.0" EXTENDED_LIMITS -3276800. 3276700. /end CHARACTERISTIC
/begin CHARACTERISTIC CrCtl_tiECAppContns1_C "Deviation in accel data for DR1 judgement at CC up slope for ECON" VALUE 0x805398E4 Val_Ws16 3276700. Time_ms_100ms 0.00 3276700. FORMAT "%8.0" EXTENDED_LIMITS -3276800. 3276700. /end CHARACTERISTIC
/begin CHARACTERISTIC CrCtl_tiECAppContns2_C "Accel differential coeffecient data for DR1 judgement at CC_RESUME for ECON" VALUE 0x805398E6 Val_Ws16 3276700. Time_ms_100ms 0.00 3276700. FORMAT "%8.0" EXTENDED_LIMITS -3276800. 3276700. /end CHARACTERISTIC
/begin CHARACTERISTIC CrCtl_tiECAppContns3_C "Accel differential coeffecient data for DR1 judgement at ACC_RESUME" VALUE 0x805398E8 Val_Ws16 3276700. Time_ms_100ms 0.00 3276700. FORMAT "%8.0" EXTENDED_LIMITS -3276800. 3276700. /end CHARACTERISTIC
/begin CHARACTERISTIC CrCtl_tiECAppContns4_C "Accel differential coeffecient data for DR1 judgement at ACC_RESUME for ECON" VALUE 0x805398EA Val_Ws16 3276700. Time_ms_100ms 0.00 3276700. FORMAT "%8.0" EXTENDED_LIMITS -3276800. 3276700. /end CHARACTERISTIC
/begin CHARACTERISTIC CrCtl_tiECMaskAUp2_C "Mask timer for changing APP limitation number for ECON to 3 from 2 (for Acceleration)" VALUE 0x805398EC Val_Ws16 3276700. Time_ms_100ms 0.00 3276700. FORMAT "%8.0" EXTENDED_LIMITS -3276800. 3276700. /end CHARACTERISTIC
/begin CHARACTERISTIC CrCtl_tiECMaskAUp3_C "Mask timer for changing APP limitation number for ECON to 4 from 3 (for Acceleration)" VALUE 0x805398EE Val_Ws16 3276700. Time_ms_100ms 0.00 3276700. FORMAT "%8.0" EXTENDED_LIMITS -3276800. 3276700. /end CHARACTERISTIC
/begin CHARACTERISTIC CrCtl_tiECMaskAUp4_C "Mask timer for changing APP limitation number for ECON to 5 from 4 (for Acceleration)" VALUE 0x805398F0 Val_Ws16 3276700. Time_ms_100ms 0.00 3276700. FORMAT "%8.0" EXTENDED_LIMITS -3276800. 3276700. /end CHARACTERISTIC
/begin CHARACTERISTIC CrCtl_tiECMaskAUp5_C "Mask timer for changing APP limitation number for ECON to 1 from 2" VALUE 0x805398F2 Val_Ws16 3276700. Time_ms_100ms 0.00 3276700. FORMAT "%8.0" EXTENDED_LIMITS -3276800. 3276700. /end CHARACTERISTIC
/begin CHARACTERISTIC CrCtl_tiECMaskDwn1_C "Mask timer for changing APP limitation number for ECON to 2 from 3" VALUE 0x805398F4 Val_Ws16 3276700. Time_ms_100ms 0.00 3276700. FORMAT "%8.0" EXTENDED_LIMITS -3276800. 3276700. /end CHARACTERISTIC
/begin CHARACTERISTIC CrCtl_tiECMaskDwn2_C "Mask timer for changing APP limitation number for ECON to 3 from 4" VALUE 0x805398F6 Val_Ws16 3276700. Time_ms_100ms 0.00 3276700. FORMAT "%8.0" EXTENDED_LIMITS -3276800. 3276700. /end CHARACTERISTIC
/begin CHARACTERISTIC CrCtl_tiECMaskDwn3_C "Mask timer for changing APP limitation number for ECON to 4 from 5" VALUE 0x805398F8 Val_Ws16 3276700. Time_ms_100ms 0.00 3276700. FORMAT "%8.0" EXTENDED_LIMITS -3276800. 3276700. /end CHARACTERISTIC
/begin CHARACTERISTIC CrCtl_tiECMaskDwn4_C "Deviation speed for selecting variation of desired vehicle speed for ECON (Continuous TAPUP, Enable hysteresis, ECON sw OFF)" VALUE 0x805398FA Val_Ws16 3276700. Time_ms_100ms 0.00 3276700. FORMAT "%8.0" EXTENDED_LIMITS -3276800. 3276700. /end CHARACTERISTIC
/begin CHARACTERISTIC CrCtl_tiECMaskNumUp_C "Mask timer for changing APP limitation number for ECON to 2 from 1 (for Acceleration)" VALUE 0x805398FC Val_Ws16 3276700. Time_ms_100ms 0.00 3276700. FORMAT "%8.0" EXTENDED_LIMITS -3276800. 3276700. /end CHARACTERISTIC
/begin CHARACTERISTIC CrCtl_tiExtCont_C "time to extend Cruise Control check" VALUE 0x805398FE Val_Ws16 327670.0 Time_ms 0.00 327670.0 FORMAT "%8.1" EXTENDED_LIMITS -327680.0 327670.0 /end CHARACTERISTIC
/begin CHARACTERISTIC CrCtl_tiGuidDispTime_C "Time of guide display check value" VALUE 0x80539900 Val_Ws16 327670.0 Time_ms 0.00 327670.0 FORMAT "%8.1" EXTENDED_LIMITS -327680.0 327670.0 /end CHARACTERISTIC
/begin CHARACTERISTIC CrCtl_tiMskDR2DwnSlp_C "Mask time for DR2 judgement at CC down slope" VALUE 0x80539902 Val_Ws16 6553500. Time_ms_100ms -3276800. 3276700. FORMAT "%8.0" /end CHARACTERISTIC
/begin CHARACTERISTIC CrCtl_tiMskDR2UpSlp_C "Mask time for DR2 judgement at CC upslope" VALUE 0x80539904 Val_Ws16 6553500. Time_ms_100ms -3276800. 3276700. FORMAT "%8.0" /end CHARACTERISTIC
/begin CHARACTERISTIC CrCtl_tiMskDR3DwnSlp_C "Mask time for DR3 judgement at CC down slope" VALUE 0x80539906 Val_Ws16 6553500. Time_ms_100ms -3276800. 3276700. FORMAT "%8.0" /end CHARACTERISTIC
/begin CHARACTERISTIC CrCtl_tiMskDR3UpSlp_C "Mask time for DR3 judgement at CC upslope" VALUE 0x80539908 Val_Ws16 6553500. Time_ms_100ms -3276800. 3276700. FORMAT "%8.0" /end CHARACTERISTIC
/begin CHARACTERISTIC CrCtl_tiMskDR4DwnSlp_C "Mask time for DR4 judgement at CC down slope" VALUE 0x8053990A Val_Ws16 6553500. Time_ms_100ms -3276800. 3276700. FORMAT "%8.0" /end CHARACTERISTIC
/begin CHARACTERISTIC CrCtl_tiMskDR4UpSlp_C "Mask time for DR4 judgement at CC upslope" VALUE 0x8053990C Val_Ws16 6553500. Time_ms_100ms -3276800. 3276700. FORMAT "%8.0" /end CHARACTERISTIC
/begin CHARACTERISTIC CrCtl_tiMskDR5DwnSlp_C "Mask time for DR5 judgement at CC down slope" VALUE 0x8053990E Val_Ws16 6553500. Time_ms_100ms -3276800. 3276700. FORMAT "%8.0" /end CHARACTERISTIC
/begin CHARACTERISTIC CrCtl_tiMskDR5UpSlp_C "Mask time for DR5 judgement at CC upslope" VALUE 0x80539910 Val_Ws16 6553500. Time_ms_100ms -3276800. 3276700. FORMAT "%8.0" /end CHARACTERISTIC
/begin CHARACTERISTIC CrCtl_tiMskDR6DwnSlp_C "Mask time for DR6 judgement at CC down slope" VALUE 0x80539912 Val_Ws16 6553500. Time_ms_100ms -3276800. 3276700. FORMAT "%8.0" /end CHARACTERISTIC
/begin CHARACTERISTIC CrCtl_tiMskDR6UpSlp_C "Mask time for DR6 judgement at CC upslope" VALUE 0x80539914 Val_Ws16 6553500. Time_ms_100ms -3276800. 3276700. FORMAT "%8.0" /end CHARACTERISTIC
/begin CHARACTERISTIC CrCtl_tiMskDR7DwnSlp_C "Mask time for DR7 judgement at CC down slope" VALUE 0x80539916 Val_Ws16 6553500. Time_ms_100ms -3276800. 3276700. FORMAT "%8.0" /end CHARACTERISTIC
/begin CHARACTERISTIC CrCtl_tiMskDR7UpSlp_C "Mask time for DR7 judgement at CC upslope" VALUE 0x80539918 Val_Ws16 6553500. Time_ms_100ms -3276800. 3276700. FORMAT "%8.0" /end CHARACTERISTIC
/begin CHARACTERISTIC CrCtl_tiSpdCnclMskDR2DR1_C "DR2/DR1 speed cancel time for CC down slope" VALUE 0x8053991A Val_Ws16 6553500. Time_ms_100ms -3276800. 3276700. FORMAT "%8.0" /end CHARACTERISTIC
/begin CHARACTERISTIC CrCtl_tiSpdCnclMskDR3DR2_C "DR3/DR2 speed cancel mask time for CC down slope" VALUE 0x8053991C Val_Ws16 6553500. Time_ms_100ms -3276800. 3276700. FORMAT "%8.0" /end CHARACTERISTIC
/begin CHARACTERISTIC CrCtl_tiSpdCnclMskDR4DR3_C "DR4\DR3 speed cancel time for CC down slope" VALUE 0x8053991E Val_Ws16 6553500. Time_ms_100ms -3276800. 3276700. FORMAT "%8.0" /end CHARACTERISTIC
/begin CHARACTERISTIC CrCtl_tiSpdCnclMskDR5DR4_C "DR5\DR4 speed cancel time for CC down slope" VALUE 0x80539920 Val_Ws16 6553500. Time_ms_100ms -3276800. 3276700. FORMAT "%8.0" /end CHARACTERISTIC
/begin CHARACTERISTIC CrCtl_tiSpdCnclMskDR6DR5_C "DR6\DR5 speed cancel time for CC down slope" VALUE 0x80539922 Val_Ws16 6553500. Time_ms_100ms -3276800. 3276700. FORMAT "%8.0" /end CHARACTERISTIC
/begin CHARACTERISTIC CrCtl_tiSpdCnclMskDR7DR6_C "DR7\DR6 speed cancel time for CC down slope" VALUE 0x80539924 Val_Ws16 6553500. Time_ms_100ms -3276800. 3276700. FORMAT "%8.0" /end CHARACTERISTIC
/begin CHARACTERISTIC CrCtl_tiTrqIncReqDisbl_C "Time for disabling the increase in torque during acc.ped opening requested after CC_DR judgement." VALUE 0x80539926 Val_Ws16 6553500. Time_ms_100ms -3276800. 3276700. FORMAT "%8.0" /end CHARACTERISTIC
/begin CHARACTERISTIC CrCtl_tiWaitReqDR0DR1_C "Time to wait DR1 request after DR0 request" VALUE 0x80539928 Val_Ws16 655350.0 Time_ms -327680.0 327670.0 FORMAT "%8.1" /end CHARACTERISTIC
/begin CHARACTERISTIC CrCtl_tiWaitReqDR1DR0_C "Time to wait DR0 request after DR1 request" VALUE 0x8053992A Val_Ws16 655350.0 Time_ms -327680.0 327670.0 FORMAT "%8.1" /end CHARACTERISTIC
/begin CHARACTERISTIC CrCtl_tiWaitReqDR1DR2_C "Time to wait DR2 request after DR1 request" VALUE 0x8053992C Val_Ws16 655350.0 Time_ms -327680.0 327670.0 FORMAT "%8.1" /end CHARACTERISTIC
/begin CHARACTERISTIC CrCtl_tiWaitReqDR2DR1_C "Time to wait DR1 request after DR2 request" VALUE 0x8053992E Val_Ws16 655350.0 Time_ms -327680.0 327670.0 FORMAT "%8.1" /end CHARACTERISTIC
/begin CHARACTERISTIC CrCtl_tiWaitReqDR2DR3_C "Time to wait DR3 request after DR2 request" VALUE 0x80539930 Val_Ws16 655350.0 Time_ms -327680.0 327670.0 FORMAT "%8.1" /end CHARACTERISTIC
/begin CHARACTERISTIC CrCtl_tiWaitReqDR3DR2_C "Time to wait DR2 request after DR3 request" VALUE 0x80539932 Val_Ws16 655350.0 Time_ms -327680.0 327670.0 FORMAT "%8.1" /end CHARACTERISTIC
/begin CHARACTERISTIC CrCtl_tiWaitReqDR3DR4_C "Time to wait DR2 request after DR3 request" VALUE 0x80539934 Val_Ws16 655350.0 Time_ms -327680.0 327670.0 FORMAT "%8.1" /end CHARACTERISTIC
/begin CHARACTERISTIC CrCtl_tiWaitReqDR4DR3_C "Time to wait DR3 request after DR4 request" VALUE 0x80539936 Val_Ws16 655350.0 Time_ms -327680.0 327670.0 FORMAT "%8.1" /end CHARACTERISTIC
/begin CHARACTERISTIC CrCtl_tiWaitReqDR4DR5_C "Time to wait DR5 request after DR4 request" VALUE 0x80539938 Val_Ws16 655350.0 Time_ms -327680.0 327670.0 FORMAT "%8.1" /end CHARACTERISTIC
/begin CHARACTERISTIC CrCtl_tiWaitReqDR5DR4_C "Time to wait DR4 request after DR5 request" VALUE 0x8053993A Val_Ws16 655350.0 Time_ms -327680.0 327670.0 FORMAT "%8.1" /end CHARACTERISTIC
/begin CHARACTERISTIC CrCtl_tiWaitReqDR5DR6_C "Time to wait DR6 request after DR5 request" VALUE 0x8053993C Val_Ws16 655350.0 Time_ms -327680.0 327670.0 FORMAT "%8.1" /end CHARACTERISTIC
/begin CHARACTERISTIC CrCtl_tiWaitReqDR6DR5_C "Time to wait DR5 request after DR6 request" VALUE 0x8053993E Val_Ws16 655350.0 Time_ms -327680.0 327670.0 FORMAT "%8.1" /end CHARACTERISTIC
/begin CHARACTERISTIC CrCtl_tiWaitReqDR6DR7_C "Time to wait DR7 request after DR6 request" VALUE 0x80539940 Val_Ws16 655350.0 Time_ms -327680.0 327670.0 FORMAT "%8.1" /end CHARACTERISTIC
/begin CHARACTERISTIC CrCtl_vACCECDvtDR1UpSlp_C "During ACC follow-up control,deviation in accel data for DR1 judgement for ECON" VALUE 0x80539942 Val_Ws16 127.9961 Vel_CrCtl 0.00 127.9961 FORMAT "%8.4" EXTENDED_LIMITS -128.0000 127.9961 /end CHARACTERISTIC
/begin CHARACTERISTIC CrCtl_vACCECDvtDR2UpSlp_C "During ACC follow-up control,deviation in accel data for DR2 judgement for ECON" VALUE 0x80539944 Val_Ws16 127.9961 Vel_CrCtl 0.00 127.9961 FORMAT "%8.4" EXTENDED_LIMITS -128.0000 127.9961 /end CHARACTERISTIC
/begin CHARACTERISTIC CrCtl_vACCECDvtDR3UpSlp_C "During ACC follow-up control,deviation in accel data for DR3 judgement for ECON" VALUE 0x80539946 Val_Ws16 127.9961 Vel_CrCtl 0.00 127.9961 FORMAT "%8.4" EXTENDED_LIMITS -128.0000 127.9961 /end CHARACTERISTIC
/begin CHARACTERISTIC CrCtl_vACCECDvtDR4UpSlp_C "During ACC follow-up control,deviation in accel data for DR4 judgement for ECON" VALUE 0x80539948 Val_Ws16 127.9961 Vel_CrCtl 0.00 127.9961 FORMAT "%8.4" EXTENDED_LIMITS -128.0000 127.9961 /end CHARACTERISTIC
/begin CHARACTERISTIC CrCtl_vACCECDvtDR5UpSlp_C "During ACC follow-up control,deviation in accel data for DR5 judgement for ECON" VALUE 0x8053994A Val_Ws16 127.9961 Vel_CrCtl 0.00 127.9961 FORMAT "%8.4" EXTENDED_LIMITS -128.0000 127.9961 /end CHARACTERISTIC
/begin CHARACTERISTIC CrCtl_vACCECDvtDR6UpSlp_C "During ACC follow-up control,deviation in accel data for DR6 judgement for ECON" VALUE 0x8053994C Val_Ws16 127.9961 Vel_CrCtl 0.00 127.9961 FORMAT "%8.4" EXTENDED_LIMITS -128.0000 127.9961 /end CHARACTERISTIC
/begin CHARACTERISTIC CrCtl_vACCECDvtDR7UpSlp_C "During ACC follow-up control,deviation in accel data for DR7 judgement for ECON" VALUE 0x8053994E Val_Ws16 127.9961 Vel_CrCtl 0.00 127.9961 FORMAT "%8.4" EXTENDED_LIMITS -128.0000 127.9961 /end CHARACTERISTIC
/begin CHARACTERISTIC CrCtl_vACCECOffDvtDwn1_C "Output select flag for DR3 judgement at CC down slp for ECON" VALUE 0x80539950 Val_Ws16 127.9961 Vel_CrCtl 0.00 127.9961 FORMAT "%8.4" EXTENDED_LIMITS -128.0000 127.9961 /end CHARACTERISTIC
/begin CHARACTERISTIC CrCtl_vACCECOffDvtDwn2_C "Deviation speed for changing APP limitation number for ECON to 3 from 4 (for ECON sw OFF and during ACC)" VALUE 0x80539952 Val_Ws16 127.9961 Vel_CrCtl 0.00 127.9961 FORMAT "%8.4" EXTENDED_LIMITS -128.0000 127.9961 /end CHARACTERISTIC
/begin CHARACTERISTIC CrCtl_vACCECOffDvtDwn3_C "Deviation speed for changing APP limitation number for ECON to 4 from 5 (for ECON sw OFF and during ACC)" VALUE 0x80539954 Val_Ws16 127.9961 Vel_CrCtl 0.00 127.9961 FORMAT "%8.4" EXTENDED_LIMITS -128.0000 127.9961 /end CHARACTERISTIC
/begin CHARACTERISTIC CrCtl_vACCECOffDvtDwn4_C "Deviation speed for changing APP limitation number for ECON to 1 from 2 (for ECON sw ON and during ACC)" VALUE 0x80539956 Val_Ws16 127.9961 Vel_CrCtl 0.00 127.9961 FORMAT "%8.4" EXTENDED_LIMITS -128.0000 127.9961 /end CHARACTERISTIC
/begin CHARACTERISTIC CrCtl_vACCECOffDvtUp2_C "Accel differential coeffecient for DR2 judgement at ACC_F/B" VALUE 0x80539958 Val_Ws16 127.9961 Vel_CrCtl 0.00 127.9961 FORMAT "%8.4" EXTENDED_LIMITS -128.0000 127.9961 /end CHARACTERISTIC
/begin CHARACTERISTIC CrCtl_vACCECOffDvtUp3_C "Accel differential coeffecient for DR2 judgement at ACC_F/B for ECON" VALUE 0x8053995A Val_Ws16 127.9961 Vel_CrCtl 0.00 127.9961 FORMAT "%8.4" EXTENDED_LIMITS -128.0000 127.9961 /end CHARACTERISTIC
/begin CHARACTERISTIC CrCtl_vACCECOffDvtUp4_C "Accel differential coeffecient for DR2 judgement at CC_ACCEL for ECON" VALUE 0x8053995C Val_Ws16 127.9961 Vel_CrCtl 0.00 127.9961 FORMAT "%8.4" EXTENDED_LIMITS -128.0000 127.9961 /end CHARACTERISTIC
/begin CHARACTERISTIC CrCtl_vACCECOffDvtUp5_C "During ACC follow-up control,deviation in accel data for DR3 judgement for ECON" VALUE 0x8053995E Val_Ws16 127.9961 Vel_CrCtl 0.00 127.9961 FORMAT "%8.4" EXTENDED_LIMITS -128.0000 127.9961 /end CHARACTERISTIC
/begin CHARACTERISTIC CrCtl_vACCECOnDvtDwn1_C "Deviation speed for changing APP limitation number for ECON to 2 from 3 (for ECON sw ON and during ACC)" VALUE 0x80539960 Val_Ws16 127.9961 Vel_CrCtl 0.00 127.9961 FORMAT "%8.4" EXTENDED_LIMITS -128.0000 127.9961 /end CHARACTERISTIC
/begin CHARACTERISTIC CrCtl_vACCECOnDvtDwn2_C "Deviation speed for changing APP limitation number for ECON to 3 from 4 (for ECON sw ON and during ACC)" VALUE 0x80539962 Val_Ws16 127.9961 Vel_CrCtl 0.00 127.9961 FORMAT "%8.4" EXTENDED_LIMITS -128.0000 127.9961 /end CHARACTERISTIC
/begin CHARACTERISTIC CrCtl_vACCECOnDvtDwn3_C "Deviation speed for changing APP limitation number for ECON to 4 from 5 (for ECON sw ON and during ACC)" VALUE 0x80539964 Val_Ws16 127.9961 Vel_CrCtl 0.00 127.9961 FORMAT "%8.4" EXTENDED_LIMITS -128.0000 127.9961 /end CHARACTERISTIC
/begin CHARACTERISTIC CrCtl_vACCECOnDvtDwn4_C "Acceleration factor for changing APP limitation number for ECON to 2 from 1 (for Resume and ECON sw OFF)" VALUE 0x80539966 Val_Ws16 127.9961 Vel_CrCtl 0.00 127.9961 FORMAT "%8.4" EXTENDED_LIMITS -128.0000 127.9961 /end CHARACTERISTIC
/begin CHARACTERISTIC CrCtl_vACCECOnDvtUp2_C "Deviation in accel data for DR3 judgement at CC up slope for ECON" VALUE 0x80539968 Val_Ws16 127.9961 Vel_CrCtl 0.00 127.9961 FORMAT "%8.4" EXTENDED_LIMITS -128.0000 127.9961 /end CHARACTERISTIC
/begin CHARACTERISTIC CrCtl_vACCECOnDvtUp3_C "Accel differential coeffecient data for DR3 judgement at CC_RESUME for ECON" VALUE 0x8053996A Val_Ws16 127.9961 Vel_CrCtl 0.00 127.9961 FORMAT "%8.4" EXTENDED_LIMITS -128.0000 127.9961 /end CHARACTERISTIC
/begin CHARACTERISTIC CrCtl_vACCECOnDvtUp4_C "Accel differential coeffecient data for DR3 judgement at ACC_RESUME" VALUE 0x8053996C Val_Ws16 127.9961 Vel_CrCtl 0.00 127.9961 FORMAT "%8.4" EXTENDED_LIMITS -128.0000 127.9961 /end CHARACTERISTIC
/begin CHARACTERISTIC CrCtl_vACCECOnDvtUp5_C "Accel differential coeffecient data for DR3 judgement at ACC_RESUME for ECON" VALUE 0x8053996E Val_Ws16 127.9961 Vel_CrCtl 0.00 127.9961 FORMAT "%8.4" EXTENDED_LIMITS -128.0000 127.9961 /end CHARACTERISTIC
/begin AXIS_PTS CrCtl_vAccnBas_AX "Axis Points for Acceleration Base of cruise control" 0x80539970 CrCtl_vVehUpByte Axis_Xs16 255.0000 Vel_CrCtl1 12 0.00 255.0000 FORMAT "%8.4" EXTENDED_LIMITS -32768.00 32767.00 DEPOSIT ABSOLUTE /end AXIS_PTS
/begin AXIS_PTS CrCtl_vAccnBas_AXIS "Axis Points for Acceleration Base of cruise control" 0x8053998A CrCtl_vVehUpByte Axis_Xs16 255.0000 Vel_CrCtl1 6 0.00 255.0000 FORMAT "%8.4" EXTENDED_LIMITS -32768.00 32767.00 DEPOSIT ABSOLUTE /end AXIS_PTS
/begin AXIS_PTS CrCtl_vAccnCont_AX "Axis Points for Acceleration Continuous of cruise control" 0x80539998 CrCtl_vVehUpByte Axis_Xs16 255.0000 Vel_CrCtl1 12 0.00 255.0000 FORMAT "%8.4" EXTENDED_LIMITS -32768.00 32767.00 DEPOSIT ABSOLUTE /end AXIS_PTS
/begin AXIS_PTS CrCtl_vAccnCont_AXIS "Axis Points for Acceleration Continuous of cruise control" 0x805399B2 CrCtl_vVehUpByte Axis_Xs16 255.0000 Vel_CrCtl1 6 0.00 255.0000 FORMAT "%8.4" EXTENDED_LIMITS -32768.00 32767.00 DEPOSIT ABSOLUTE /end AXIS_PTS
/begin CHARACTERISTIC CrCtl_vAccnDR1DwnSlpCoast_CUR "Acc. Data for DR1 Judgement at CC down slope during coast" CURVE 0x805399C0 RB_Cur_Xs16Ws16 255.9961 Vel_CrCtl -128.0000 127.9961 FORMAT "%8.4"
 /begin AXIS_DESCR STD_AXIS CrCtl_vVehUpByte Vel_CrCtl1 6 0.00 32767.00 FORMAT "%8.2" EXTENDED_LIMITS -32768.00 32767.00 DEPOSIT ABSOLUTE /end AXIS_DESCR
/end CHARACTERISTIC
/begin CHARACTERISTIC CrCtl_vAccnDR1DwnSlp_CUR "Acc. Data for DR1 Judgement at CC down slope" CURVE 0x805399DA RB_Cur_Xs16Ws16 127.9961 Vel_CrCtl 0.00 127.9961 FORMAT "%8.4" EXTENDED_LIMITS -128.0000 127.9961
 /begin AXIS_DESCR STD_AXIS CrCtl_vVehUpByte Vel_CrCtl1 6 0.00 32767.00 FORMAT "%8.2" EXTENDED_LIMITS -32768.00 32767.00 DEPOSIT ABSOLUTE /end AXIS_DESCR
/end CHARACTERISTIC
/begin CHARACTERISTIC CrCtl_vAccnDR2DwnSlpCoast_CUR "Acc. Data for DR2 Judgement at CC down slope during coast" CURVE 0x805399F4 RB_Cur_Xs16Ws16 127.9961 Vel_CrCtl 0.00 127.9961 FORMAT "%8.4" EXTENDED_LIMITS -128.0000 127.9961
 /begin AXIS_DESCR STD_AXIS CrCtl_vVehUpByte Vel_CrCtl1 6 0.00 32767.00 FORMAT "%8.2" EXTENDED_LIMITS -32768.00 32767.00 DEPOSIT ABSOLUTE /end AXIS_DESCR
/end CHARACTERISTIC
/begin CHARACTERISTIC CrCtl_vAccnDR2DwnSlp_CUR "Acc. Data for DR2 Judgement at CC down slope" CURVE 0x80539A0E RB_Cur_Xs16Ws16 127.9961 Vel_CrCtl 0.00 127.9961 FORMAT "%8.4" EXTENDED_LIMITS -128.0000 127.9961
 /begin AXIS_DESCR STD_AXIS CrCtl_vVehUpByte Vel_CrCtl1 6 0.00 32767.00 FORMAT "%8.2" EXTENDED_LIMITS -32768.00 32767.00 DEPOSIT ABSOLUTE /end AXIS_DESCR
/end CHARACTERISTIC
/begin CHARACTERISTIC CrCtl_vAccnDR3DwnSlpCoast_CUR "Acc. Data for DR3 Judgement at CC down slope during coast" CURVE 0x80539A28 RB_Cur_Xs16Ws16 127.9961 Vel_CrCtl 0.00 127.9961 FORMAT "%8.4" EXTENDED_LIMITS -128.0000 127.9961
 /begin AXIS_DESCR STD_AXIS CrCtl_vVehUpByte Vel_CrCtl1 6 0.00 32767.00 FORMAT "%8.2" EXTENDED_LIMITS -32768.00 32767.00 DEPOSIT ABSOLUTE /end AXIS_DESCR
/end CHARACTERISTIC
/begin CHARACTERISTIC CrCtl_vAccnDR3DwnSlp_CUR "Acc. Data for DR3 Judgement at CC down slope" CURVE 0x80539A42 RB_Cur_Xs16Ws16 127.9961 Vel_CrCtl 0.00 127.9961 FORMAT "%8.4" EXTENDED_LIMITS -128.0000 127.9961
 /begin AXIS_DESCR STD_AXIS CrCtl_vVehUpByte Vel_CrCtl1 6 0.00 32767.00 FORMAT "%8.2" EXTENDED_LIMITS -32768.00 32767.00 DEPOSIT ABSOLUTE /end AXIS_DESCR
/end CHARACTERISTIC
/begin CHARACTERISTIC CrCtl_vAccnDR4DwnSlpCoast_CUR "Accel. Data for DR4 Judgement at CC down slope during coast" CURVE 0x80539A5C RB_Cur_Xs16Ws16 127.9961 Vel_CrCtl 0.00 127.9961 FORMAT "%8.4" EXTENDED_LIMITS -128.0000 127.9961
 /begin AXIS_DESCR STD_AXIS CrCtl_vVehUpByte Vel_CrCtl1 6 0.00 32767.00 FORMAT "%8.2" EXTENDED_LIMITS -32768.00 32767.00 DEPOSIT ABSOLUTE /end AXIS_DESCR
/end CHARACTERISTIC
/begin CHARACTERISTIC CrCtl_vAccnDR4DwnSlp_CUR "Accel. Data for DR4 Judgement at CC down slope" CURVE 0x80539A76 RB_Cur_Xs16Ws16 127.9961 Vel_CrCtl 0.00 127.9961 FORMAT "%8.4" EXTENDED_LIMITS -128.0000 127.9961
 /begin AXIS_DESCR STD_AXIS CrCtl_vVehUpByte Vel_CrCtl1 6 0.00 32767.00 FORMAT "%8.2" EXTENDED_LIMITS -32768.00 32767.00 DEPOSIT ABSOLUTE /end AXIS_DESCR
/end CHARACTERISTIC
/begin CHARACTERISTIC CrCtl_vAccnDR5DwnSlpCoast_CUR "Accel. Data for DR5 Judgement at CC down slope during coast" CURVE 0x80539A90 RB_Cur_Xs16Ws16 127.9961 Vel_CrCtl 0.00 127.9961 FORMAT "%8.4" EXTENDED_LIMITS -128.0000 127.9961
 /begin AXIS_DESCR STD_AXIS CrCtl_vVehUpByte Vel_CrCtl1 6 0.00 32767.00 FORMAT "%8.2" EXTENDED_LIMITS -32768.00 32767.00 DEPOSIT ABSOLUTE /end AXIS_DESCR
/end CHARACTERISTIC
/begin CHARACTERISTIC CrCtl_vAccnDR5DwnSlp_CUR "Accel. Data for DR5 Judgement at CC down slope" CURVE 0x80539AAA RB_Cur_Xs16Ws16 127.9961 Vel_CrCtl 0.00 127.9961 FORMAT "%8.4" EXTENDED_LIMITS -128.0000 127.9961
 /begin AXIS_DESCR STD_AXIS CrCtl_vVehUpByte Vel_CrCtl1 6 0.00 32767.00 FORMAT "%8.2" EXTENDED_LIMITS -32768.00 32767.00 DEPOSIT ABSOLUTE /end AXIS_DESCR
/end CHARACTERISTIC
/begin CHARACTERISTIC CrCtl_vAccnDR6DwnSlpCoast_CUR "Accel. Data for DR6 Judgement at CC down slope during coast" CURVE 0x80539AC4 RB_Cur_Xs16Ws16 127.9961 Vel_CrCtl 0.00 127.9961 FORMAT "%8.4" EXTENDED_LIMITS -128.0000 127.9961
 /begin AXIS_DESCR STD_AXIS CrCtl_vVehUpByte Vel_CrCtl1 6 0.00 32767.00 FORMAT "%8.2" EXTENDED_LIMITS -32768.00 32767.00 DEPOSIT ABSOLUTE /end AXIS_DESCR
/end CHARACTERISTIC
/begin CHARACTERISTIC CrCtl_vAccnDR6DwnSlp_CUR "Accel. Data for DR6 Judgement at CC down slope" CURVE 0x80539ADE RB_Cur_Xs16Ws16 127.9961 Vel_CrCtl 0.00 127.9961 FORMAT "%8.4" EXTENDED_LIMITS -128.0000 127.9961
 /begin AXIS_DESCR STD_AXIS CrCtl_vVehUpByte Vel_CrCtl1 6 0.00 32767.00 FORMAT "%8.2" EXTENDED_LIMITS -32768.00 32767.00 DEPOSIT ABSOLUTE /end AXIS_DESCR
/end CHARACTERISTIC
/begin AXIS_PTS CrCtl_vAPPLim_AXIS "Axis Points for APP Limit speed of cruise control" 0x80539B94 CrCtl_vVehSpd_mp Axis_Xs16 65535.00 Vel_CrCtl1 12 -32768.00 32767.00 FORMAT "%8.2" DEPOSIT ABSOLUTE /end AXIS_PTS
/begin AXIS_PTS CrCtl_vFdbkArea_AX "Axis Points for Feedback Area speed of cruise control" 0x8053A5A4 CrCtl_vDesUpByte_mp Axis_Xs16 255.0000 Vel_CrCtl1 12 0.00 255.0000 FORMAT "%8.4" EXTENDED_LIMITS -32768.00 32767.00 DEPOSIT ABSOLUTE /end AXIS_PTS
/begin AXIS_PTS CrCtl_vLSFStrtAPP_AXIS "Axis for LSF start demand value" 0x8053A600 CrCtl_vVehUpByte Axis_Xs16 65535.00 Vel_CrCtl1 12 -32768.00 32767.00 FORMAT "%8.2" DEPOSIT ABSOLUTE /end AXIS_PTS
/begin AXIS_PTS CrCtl_vTapDnInit_AXIS "Axis Points for Tap Down initial speed of cruise control" 0x8053A716 CrCtl_vVehUpByte Axis_Xs16 255.0000 Vel_CrCtl1 6 0.00 255.0000 FORMAT "%8.4" EXTENDED_LIMITS -32768.00 32767.00 DEPOSIT ABSOLUTE /end AXIS_PTS
/begin AXIS_PTS CrCtl_vTapUpInit_AXIS "Axis Points for Tap Up initial speed of cruise control" 0x8053A724 CrCtl_vVehUpByte Axis_Xs16 255.0000 Vel_CrCtl1 6 0.00 255.0000 FORMAT "%8.4" EXTENDED_LIMITS -32768.00 32767.00 DEPOSIT ABSOLUTE /end AXIS_PTS
/begin FUNCTION CrCtl_TrqCalc "6.3.0     Cruise Control torque calculation"
 /begin DEF_CHARACTERISTIC CrCtl_facACCECOnAAppUp3_CUR CrCtl_facACCECOnAAppUp4_CUR CrCtl_facACCECOnAAppUp5_CUR CrCtl_facACCECOnAFbUp2_CUR CrCtl_facACCECOnAFbUp3_CUR CrCtl_facACCECOnAFbUp4_CUR CrCtl_facACCECOnAFbUp5_CUR CrCtl_facACCECOnAResUp2_MAP CrCtl_facACCECOnAResUp3_MAP CrCtl_facACCECOnAResUp4_MAP CrCtl_facACCECOnAResUp5_MAP CrCtl_facAccnRed12_GCUR CrCtl_facACtrlECDecelCls_GCUR CrCtl_facACtrlECDecelOpn_GCUR CrCtl_facAPPRedRevi_GCUR CrCtl_facAPPReviX_AXIS CrCtl_facAPPReviY_AXIS CrCtl_facCmftAccnRed12_GCUR CrCtl_facCmftFdbkAccnVal0_C CrCtl_facCmftFdbkAccnVal1_C CrCtl_facCmftFdbkAccnVal2_C CrCtl_facCmftFdbkAccnVal3_C CrCtl_facCmftFdbkAccnVal4_C CrCtl_facCmftFdbkDReviVal0_C CrCtl_facCmftFdbkDReviVal1_C CrCtl_facCmftFdbkDReviVal2_C CrCtl_facCmftFdbkDReviVal3_C CrCtl_facCmftFdbkDReviVal4_C CrCtl_facCmftFdbkPReviVal0_C CrCtl_facCmftFdbkPReviVal1_C CrCtl_facCmftFdbkPReviVal2_C CrCtl_facCmftFdbkPReviVal3_C CrCtl_facCmftFdbkPReviVal4_C CrCtl_facContTapInitRevi_C CrCtl_facDecnRevi12_GCUR CrCtl_facDiffCoeffDR1ACCEL_CUR CrCtl_facDiffCoeffDR1FB_CUR CrCtl_facDiffCoeffDR1Resume_MAP CrCtl_facDiffCoeffDR2ACCEL_CUR CrCtl_facDiffCoeffDR2FB_CUR CrCtl_facDiffCoeffDR2Resume_MAP CrCtl_facDiffCoeffDR3ACCEL_CUR CrCtl_facDiffCoeffDR3FB_CUR CrCtl_facDiffCoeffDR3Resume_MAP CrCtl_facDiffCoeffDR4ACCEL_CUR CrCtl_facDiffCoeffDR4FB_CUR CrCtl_facDiffCoeffDR4Resume_MAP CrCtl_facDiffCoeffDR5ACCEL_CUR CrCtl_facDiffCoeffDR5FB_CUR CrCtl_facDiffCoeffDR5Resume_MAP CrCtl_facDiffCoeffDR6ACCEL_CUR CrCtl_facDiffCoeffDR6FB_CUR CrCtl_facDiffCoeffDR6Resume_MAP CrCtl_facDiffCoeffDR7ACCEL_CUR CrCtl_facDiffCoeffDR7FB_CUR CrCtl_facDiffCoeffDR7Resume_MAP CrCtl_facEC1LGAppDiffCls_GMAP CrCtl_facEC1LGAppDiff_GMAP CrCtl_facEC2LGAppDiffCls_GMAP CrCtl_facEC2LGAppDiff_GMAP CrCtl_facEC3LGAppDiffCls_GMAP CrCtl_facEC3LGAppDiff_GMAP CrCtl_facEC4LGAppDiffCls_GMAP CrCtl_facEC4LGAppDiff_GMAP CrCtl_facECAppInitCor_CUR CrCtl_facECDR1ResA_MAP CrCtl_facECDR2ResA_MAP CrCtl_facECDR3ResA_MAP CrCtl_facECDR4ResA_MAP CrCtl_facECDR5ResA_MAP CrCtl_facECDR6ResA_MAP CrCtl_facECDR7ResA_MAP CrCtl_facEcoFdbkAccnVal0_C CrCtl_facEcoFdbkAccnVal1_C CrCtl_facEcoFdbkAccnVal2_C CrCtl_facEcoFdbkAccnVal3_C CrCtl_facEcoFdbkAccnVal4_C CrCtl_facEcoFdbkDReviVal0_C CrCtl_facEcoFdbkDReviVal1_C CrCtl_facEcoFdbkDReviVal2_C CrCtl_facEcoFdbkDReviVal3_C CrCtl_facEcoFdbkDReviVal4_C CrCtl_facEcoFdbkPReviVal0_C CrCtl_facEcoFdbkPReviVal1_C CrCtl_facEcoFdbkPReviVal2_C CrCtl_facEcoFdbkPReviVal3_C CrCtl_facEcoFdbkPReviVal4_C CrCtl_facECOffAAppUp2_CUR CrCtl_facECOffAAppUp3_CUR CrCtl_facECOffAAppUp4_CUR CrCtl_facECOffAAppUp5_CUR CrCtl_facECOffAFbUp2_CUR CrCtl_facECOffAFbUp3_CUR CrCtl_facECOffAFbUp4_CUR CrCtl_facECOffAFbUp5_CUR CrCtl_facECOffAResUp2_MAP CrCtl_facECOffAResUp3_MAP CrCtl_facECOffAResUp4_MAP CrCtl_facECOffAResUp5_MAP CrCtl_facECOnAAppUp2_CUR CrCtl_facECOnAAppUp3_CUR CrCtl_facECOnAAppUp4_CUR CrCtl_facECOnAAppUp5_CUR CrCtl_facECOnAFbUp2_CUR CrCtl_facECOnAFbUp3_CUR CrCtl_facECOnAFbUp4_CUR CrCtl_facECOnAFbUp5_CUR CrCtl_facECOnAResUp2_MAP CrCtl_facECOnAResUp3_MAP CrCtl_facECOnAResUp4_MAP CrCtl_facECOnAResUp5_MAP CrCtl_facECTGAppDiffCls_GMAP CrCtl_facECTGAppDiff_GMAP CrCtl_facFbACmftD12_GMAP CrCtl_facFbACmftP12_GMAP CrCtl_facFbAD12_GMAP CrCtl_facFbAEcoD12_GMAP CrCtl_facFbAEcoP12_GMAP CrCtl_facFbAP12_GMAP CrCtl_facFbAreaX_AXIS CrCtl_facFbAreaY_AXIS CrCtl_facFbASptD12_GMAP CrCtl_facFbASptP12_GMAP CrCtl_facFbAX_AXIS CrCtl_facFbAY_AXIS CrCtl_facFbCmftD12_GMAP CrCtl_facFbCmftP12_GMAP CrCtl_facFbD12_GMAP CrCtl_facFbEcoD12_GMAP CrCtl_facFbEcoP12_GMAP CrCtl_facFbP12_GMAP CrCtl_facFbPlusRD12_GMAP CrCtl_facFbPlusRP12_GMAP CrCtl_facFbSptD12_GMAP CrCtl_facFbSptP12_GMAP CrCtl_facFdbkAccnP0Kmh_GCUR CrCtl_facFdbkAccnP0_GCUR CrCtl_facFdbkAccnP1Kmh_GCUR CrCtl_facFdbkAccnP1_GCUR CrCtl_facFdbkAccnP2Kmh_GCUR CrCtl_facFdbkAccnP2_GCUR CrCtl_facFdbkAccnP3Kmh_GCUR CrCtl_facFdbkAccnP3_GCUR CrCtl_facFdbkAccnP4Kmh_GCUR CrCtl_facFdbkAccnP4_GCUR CrCtl_facFdbkAccnVal0_C CrCtl_facFdbkAccnVal1_C CrCtl_facFdbkAccnVal2_C CrCtl_facFdbkAccnVal3_C CrCtl_facFdbkAccnVal4_C CrCtl_facFdbkDReviVal0_C CrCtl_facFdbkDReviVal1_C CrCtl_facFdbkDReviVal2_C CrCtl_facFdbkDReviVal3_C CrCtl_facFdbkDReviVal4_C CrCtl_facFdbkPReviVal0_C CrCtl_facFdbkPReviVal1_C CrCtl_facFdbkPReviVal2_C CrCtl_facFdbkPReviVal3_C CrCtl_facFdbkPReviVal4_C CrCtl_facFolFdbkGn12_GCUR CrCtl_facNeLimDCont_GCUR CrCtl_facNeLimPCont_GCUR CrCtl_facSpt1LGAppDiffCls_GMAP CrCtl_facSpt1LGAppDiff_GMAP CrCtl_facSpt2LGAppDiffCls_GMAP CrCtl_facSpt2LGAppDiff_GMAP CrCtl_facSpt3LGAppDiffCls_GMAP CrCtl_facSpt3LGAppDiff_GMAP CrCtl_facSpt4LGAppDiffCls_GMAP CrCtl_facSpt4LGAppDiff_GMAP CrCtl_facSptAccnRed12_GCUR CrCtl_facSptFdbkAccnP0_GCUR CrCtl_facSptFdbkAccnP1_GCUR CrCtl_facSptFdbkAccnP2_GCUR CrCtl_facSptFdbkAccnP3_GCUR CrCtl_facSptFdbkAccnP4_GCUR CrCtl_facSptFdbkAccnVal0_C CrCtl_facSptFdbkAccnVal1_C CrCtl_facSptFdbkAccnVal2_C CrCtl_facSptFdbkAccnVal3_C CrCtl_facSptFdbkAccnVal4_C CrCtl_facSptFdbkDReviVal0_C CrCtl_facSptFdbkDReviVal1_C CrCtl_facSptFdbkDReviVal2_C CrCtl_facSptFdbkDReviVal3_C CrCtl_facSptFdbkDReviVal4_C CrCtl_facSptFdbkPReviVal0_C CrCtl_facSptFdbkPReviVal1_C CrCtl_facSptFdbkPReviVal2_C CrCtl_facSptFdbkPReviVal3_C CrCtl_facSptFdbkPReviVal4_C CrCtl_facSptTGAppDiffCls_GMAP CrCtl_facSptTGAppDiff_GMAP CrCtl_facTGAppDiffCls_GMAP CrCtl_facTGAppDiff_GMAP CrCtl_facTrgAccnRateEcon_T CrCtl_facTrgAccnRateNrml_T CrCtl_facVehSpdFlt_C CrCtl_nAPPReqChng_AXIS CrCtl_nFlt_AXIS CrCtl_nTrqOffChkAdd_C CrCtl_nTrqOffReqChk_CUR CrCtl_numACCECAppLowrLim_C CrCtl_numATType_C CrCtl_numCCECAppLowrLim_C CrCtl_numDRPrmntCvtGearShiftMap_CA CrCtl_numTrqRat_C CrCtl_r10msAddVar_C CrCtl_r10msSubVar_C CrCtl_rACCBrkReqChng_CUR CrCtl_rACCECOffSlopDwn1_CUR CrCtl_rACCECOffSlopDwn2_CUR CrCtl_rACCECOffSlopDwn3_CUR CrCtl_rACCECOffSlopDwn4_CUR CrCtl_rACCECOnSlopDwn1_CUR CrCtl_rACCECOnSlopDwn2_CUR CrCtl_rACCECOnSlopDwn3_CUR CrCtl_rACCECOnSlopDwn4_CUR CrCtl_rACCFstTUTrgAccnFdbk_C CrCtl_rACCFstTUTrgAccnRed_C CrCtl_rAccOffNTG_GMAP CrCtl_rAccOffTG_GMAP CrCtl_rAccOffX_AXIS CrCtl_rAccOffY_AXIS CrCtl_rACCReqChngStrt_GCUR CrCtl_rACCTDInitNTG_GCUR CrCtl_rACCTDInitTG_GCUR CrCtl_rACCTUInitNTG_GCUR CrCtl_rACCTUInitTG_GCUR CrCtl_rAppACCFUEC_GCUR CrCtl_rAPPACCFUKmph_GCUR CrCtl_rAPPACCFUMph_GCUR CrCtl_rAPPOpnDR1CnclDwnSlp_CUR CrCtl_rAPPOpnDR2CnclDwnSlp_CUR CrCtl_rAPPOpnDR3CnclDwnSlp_CUR CrCtl_rAPPOpnDR4CnclDwnSlp_CUR CrCtl_rAPPOpnDR5CnclDwnSlp_CUR CrCtl_rAPPOpnDR6CnclDwnSlp_CUR CrCtl_rAPPOpnDR7CnclDwnSlp_CUR CrCtl_rClthOutLimVal_C CrCtl_rCmftAPPACCFUMph_GCUR CrCtl_rCmftLSFStrtAPP1_GCUR CrCtl_rCmftMaxAppCCEC_GCUR CrCtl_rCmftMaxAPPCCMph_GCUR CrCtl_rCmftMaxCC3LGMph_GCUR CrCtl_rCmftMaxCC4LGMph_GCUR CrCtl_rCmftMaxCC5LGMph_GCUR CrCtl_rCmftMaxCC6LGMph_GCUR CrCtl_rCmftMaxCCLGMph_GCUR CrCtl_rCmftMaxCCNGMph_GCUR CrCtl_rCmftMaxCCTGMph_GCUR CrCtl_rCmftTDInitNTG_GCUR CrCtl_rCmftTDInitTG_GCUR CrCtl_rCmftTUInitNTG_GCUR CrCtl_rCmftTUInitTG_GCUR CrCtl_rDRAppCnclDnSlp_C CrCtl_rDwn_AXIS CrCtl_rECAppAdd10ms_C CrCtl_rECAppSub10ms_C CrCtl_rEcoAccOffNTG_GMAP CrCtl_rEcoAccOffTG_GMAP CrCtl_rECOffAppLimNum1_MAP CrCtl_rECOffAppLimNum2_MAP CrCtl_rECOffAppLimNum3_MAP CrCtl_rECOffAppLimNum4_MAP CrCtl_rECOffAppLimNum5_MAP CrCtl_rECOffSlopDwn1_CUR CrCtl_rECOffSlopDwn2_CUR CrCtl_rECOffSlopDwn3_CUR CrCtl_rECOffSlopDwn4_CUR CrCtl_rEcoLSFStrtAPP1_GCUR CrCtl_rECOnAppLimNum1_MAP CrCtl_rECOnAppLimNum2_MAP CrCtl_rECOnAppLimNum3_MAP CrCtl_rECOnAppLimNum4_MAP CrCtl_rECOnAppLimNum5_MAP CrCtl_rECOnSlopDwn1_CUR CrCtl_rECOnSlopDwn2_CUR CrCtl_rECOnSlopDwn3_CUR CrCtl_rECOnSlopDwn4_CUR CrCtl_rEcoResOffNTG_GMAP CrCtl_rEcoResOffTG_GMAP CrCtl_rEcoTDInitNTG_GCUR CrCtl_rEcoTDInitTG_GCUR CrCtl_rEcoTUInitNTG_GCUR CrCtl_rEcoTUInitTG_GCUR CrCtl_rECShiftVal1_MAP CrCtl_rECShiftVal2_MAP CrCtl_rECShiftVal3_MAP CrCtl_rECShiftVal4_MAP CrCtl_rECShiftVal5_MAP CrCtl_rEstSlpValDR1Cncl_CUR CrCtl_rEstSlpValDR2Cncl_CUR CrCtl_rEstSlpValDR3Cncl_CUR CrCtl_rEstSlpValDR4Cncl_CUR CrCtl_rEstSlpValDR5Cncl_CUR CrCtl_rEstSlpValDR6Cncl_CUR CrCtl_rEstSlpValDR7Cncl_CUR CrCtl_rFstDwnCncl_GCUR CrCtl_rInitCmftReqNTG_GMAP CrCtl_rInitCmftReqTG_GMAP CrCtl_rInitEcoReqNTG_GMAP CrCtl_rInitEcoReqTG_GMAP CrCtl_rInitPlusRReqNTG_GMAP CrCtl_rInitPlusRReqTG_GMAP CrCtl_rInitReqNTG_GMAP CrCtl_rInitReqTG_GMAP CrCtl_rInitReqX_AXIS CrCtl_rInitReqY_AXIS CrCtl_rInitSptReqNTG_GMAP CrCtl_rInitSptReqTG_GMAP CrCtl_rLSFStrtAPP1_GCUR CrCtl_rMaxAppCCEC_GCUR CrCtl_rMaxAPPCCKmph_GCUR CrCtl_rMaxAPPCCMph_GCUR CrCtl_rMaxCC3LGEC_GCUR CrCtl_rMaxCC3LGMph_GCUR CrCtl_rMaxCC4LGEC_GCUR CrCtl_rMaxCC4LGMph_GCUR CrCtl_rMaxCC5LGEC_GCUR CrCtl_rMaxCC5LGMph_GCUR CrCtl_rMaxCC6LGEC_GCUR CrCtl_rMaxCC6LGMph_GCUR CrCtl_rMaxCCLGEC_GCUR CrCtl_rMaxCCLGKmph_GCUR CrCtl_rMaxCCLGMph_GCUR CrCtl_rMaxCCNGEC_GCUR CrCtl_rMaxCCNGKmph_GCUR CrCtl_rMaxCCNGMph_GCUR CrCtl_rMaxCCTGEC_GCUR CrCtl_rMaxCCTGKmph_GCUR CrCtl_rMaxCCTGMph_GCUR CrCtl_rMaxVal_C CrCtl_rReqChng_GCUR CrCtl_rResOffNTGKmh_GMAP CrCtl_rResOffNTG_GMAP CrCtl_rResOffTGKmh_GMAP CrCtl_rResOffTG_GMAP CrCtl_rSecDwnCncl_GCUR CrCtl_rSptAccOffNTG_GMAP CrCtl_rSptAccOffTG_GMAP CrCtl_rSptAPPACCFUMph_GCUR CrCtl_rSptLSFStrtAPP1_GCUR CrCtl_rSptMaxAppCCEC_GCUR CrCtl_rSptMaxAPPCCMph_GCUR CrCtl_rSptMaxCC3LGMph_GCUR CrCtl_rSptMaxCC4LGMph_GCUR CrCtl_rSptMaxCC5LGMph_GCUR CrCtl_rSptMaxCC6LGMph_GCUR CrCtl_rSptMaxCCLGMph_GCUR CrCtl_rSptMaxCCNGMph_GCUR CrCtl_rSptMaxCCTGMph_GCUR CrCtl_rSptReqChng_GCUR CrCtl_rSptResOffNTG_GMAP CrCtl_rSptResOffTG_GMAP CrCtl_rSptTDInitNTG_GCUR CrCtl_rSptTDInitTG_GCUR CrCtl_rSptTUInitNTG_GCUR CrCtl_rSptTUInitTG_GCUR CrCtl_rTDInitNTG_GCUR CrCtl_rTDInitTG_GCUR CrCtl_rTrgSub_CUR CrCtl_rTrqDflVal_C CrCtl_rTUInitDRlo_GCUR CrCtl_rTUInitNTG_GCUR CrCtl_rTUInitTG_GCUR CrCtl_stACCClthOutSel_C CrCtl_stACCECActv_C CrCtl_stACCUpLimCnclGDwnNr_C CrCtl_stCCECActv_C CrCtl_stCCMaxAPPGDwnNr_C CrCtl_stCCUpLimCnclGDwnNr_C CrCtl_stDisAPPInc_C CrCtl_stDR1AccnTmrDisbl_C CrCtl_stDR2AccnTmrDisbl_C CrCtl_stDR3AccnTmrDisbl_C CrCtl_stDR4AccnTmrDisbl_C CrCtl_stDR5AccnTmrDisbl_C CrCtl_stDR6AccnTmrDisbl_C CrCtl_stDR7AccnTmrDisbl_C CrCtl_stECAppLimSel_C CrCtl_stECAppUpprLim_C CrCtl_stECDesSelCdn_C CrCtl_stECDesSelProc_C CrCtl_stECDR1DwnSlpDi_C CrCtl_stECDR2DwnSlpDi_C CrCtl_stECDR3DwnSlpDi_C CrCtl_stGearMapNo_CA CrCtl_stNeLimSel_C CrCtl_stResOffEna_C CrCtl_stSwtPDCtrlEna_C CrCtl_stUpACC1LG_C CrCtl_stUpACC2LG_C CrCtl_stUpACCTG_C CrCtl_stUpCC1LG_C CrCtl_stUpCC2LG_C CrCtl_stUpCCTG_C CrCtl_stUpperGear_C CrCtl_stVehSpdSel_C CrCtl_swtACCTrgAccnSel_C CrCtl_SwtDRnrEna_C CrCtl_tiACCChngRes_C CrCtl_tiAccnDR1UpSlp_C CrCtl_tiAccnDR2UpSlp_C CrCtl_tiAccnDR3UpSlp_C CrCtl_tiAccnDR4UpSlp_C CrCtl_tiAccnDR5UpSlp_C CrCtl_tiAccnDR6UpSlp_C CrCtl_tiAccnDR7UpSlp_C CrCtl_tiCC1LGMaxRat_C CrCtl_tiCC2LGMaxRat_C CrCtl_tiCC3LGMaxRat_C CrCtl_tiCC4LGMaxRat_C CrCtl_tiCC5LGMaxRat_C CrCtl_tiCC6LGMaxRat_C CrCtl_tiCCMaxRat_C CrCtl_tiCCTGMaxRat_C CrCtl_tiClthOnContChng_C CrCtl_tiContnsErrChk_C CrCtl_tiDR1CnclHold_C CrCtl_tiDR1CnclMskDwnSlp_C CrCtl_tiDR1CnclUpSlp_C CrCtl_tiDR2CnclHold_C CrCtl_tiDR2CnclMskDwnSlp_C CrCtl_tiDR2CnclUpSlp_C CrCtl_tiDR3CnclHold_C CrCtl_tiDR3CnclMskDwnSlp_C CrCtl_tiDR3CnclUpSlp_C CrCtl_tiDR4CnclHold_C CrCtl_tiDR4CnclMskDwnSlp_C CrCtl_tiDR4CnclUpSlp_C CrCtl_tiDR5CnclHold_C CrCtl_tiDR5CnclMskDwnSlp_C CrCtl_tiDR5CnclUpSlp_C CrCtl_tiDR6CnclHold_C CrCtl_tiDR6CnclMskDwnSlp_C CrCtl_tiDR6CnclUpSlp_C CrCtl_tiDR7CnclHold_C CrCtl_tiDR7CnclMskDwnSlp_C CrCtl_tiDR7CnclUpSlp_C CrCtl_tiDRCnclPROSMADisbl_C CrCtl_tiDRMskB_C CrCtl_tiDRMskC_C CrCtl_tiDRMskD_C CrCtl_tiDRMskE_C CrCtl_tiDRMskF_C CrCtl_tiDwnReqDisbl_C CrCtl_tiECAppContns1_C CrCtl_tiECAppContns2_C CrCtl_tiECAppContns3_C CrCtl_tiECAppContns4_C CrCtl_tiECMaskAUp2_C CrCtl_tiECMaskAUp3_C CrCtl_tiECMaskAUp4_C CrCtl_tiECMaskAUp5_C CrCtl_tiECMaskDwn1_C CrCtl_tiECMaskDwn2_C CrCtl_tiECMaskDwn3_C CrCtl_tiECMaskDwn4_C CrCtl_tiECMaskNumUp_C CrCtl_tiExtCont_C CrCtl_tiGuidDispTime_C CrCtl_tiMskDR2DwnSlp_C CrCtl_tiMskDR2UpSlp_C CrCtl_tiMskDR3DwnSlp_C CrCtl_tiMskDR3UpSlp_C CrCtl_tiMskDR4DwnSlp_C CrCtl_tiMskDR4UpSlp_C CrCtl_tiMskDR5DwnSlp_C CrCtl_tiMskDR5UpSlp_C CrCtl_tiMskDR6DwnSlp_C CrCtl_tiMskDR6UpSlp_C CrCtl_tiMskDR7DwnSlp_C CrCtl_tiMskDR7UpSlp_C CrCtl_tiSpdCnclMskDR2DR1_C CrCtl_tiSpdCnclMskDR3DR2_C CrCtl_tiSpdCnclMskDR4DR3_C CrCtl_tiSpdCnclMskDR5DR4_C CrCtl_tiSpdCnclMskDR6DR5_C CrCtl_tiSpdCnclMskDR7DR6_C CrCtl_tiTrqIncReqDisbl_C CrCtl_tiWaitReqDR0DR1_C CrCtl_tiWaitReqDR1DR0_C CrCtl_tiWaitReqDR1DR2_C CrCtl_tiWaitReqDR2DR1_C CrCtl_tiWaitReqDR2DR3_C CrCtl_tiWaitReqDR3DR2_C CrCtl_tiWaitReqDR3DR4_C CrCtl_tiWaitReqDR4DR3_C CrCtl_tiWaitReqDR4DR5_C CrCtl_tiWaitReqDR5DR4_C CrCtl_tiWaitReqDR5DR6_C CrCtl_tiWaitReqDR6DR5_C CrCtl_tiWaitReqDR6DR7_C CrCtl_vACCECDvtDR1UpSlp_C CrCtl_vACCECDvtDR2UpSlp_C CrCtl_vACCECDvtDR3UpSlp_C CrCtl_vACCECDvtDR4UpSlp_C CrCtl_vACCECDvtDR5UpSlp_C CrCtl_vACCECDvtDR6UpSlp_C CrCtl_vACCECDvtDR7UpSlp_C CrCtl_vACCECOffDvtDwn1_C CrCtl_vACCECOffDvtDwn2_C CrCtl_vACCECOffDvtDwn3_C CrCtl_vACCECOffDvtDwn4_C CrCtl_vACCECOffDvtUp2_C CrCtl_vACCECOffDvtUp3_C CrCtl_vACCECOffDvtUp4_C CrCtl_vACCECOffDvtUp5_C CrCtl_vACCECOnDvtDwn1_C CrCtl_vACCECOnDvtDwn2_C CrCtl_vACCECOnDvtDwn3_C CrCtl_vACCECOnDvtDwn4_C CrCtl_vACCECOnDvtUp2_C CrCtl_vACCECOnDvtUp3_C CrCtl_vACCECOnDvtUp4_C CrCtl_vACCECOnDvtUp5_C CrCtl_vAccnBas_AX CrCtl_vAccnBas_AXIS CrCtl_vAccnCont_AX CrCtl_vAccnCont_AXIS CrCtl_vAccnDR1DwnSlpCoast_CUR CrCtl_vAccnDR1DwnSlp_CUR CrCtl_vAccnDR2DwnSlpCoast_CUR CrCtl_vAccnDR2DwnSlp_CUR CrCtl_vAccnDR3DwnSlpCoast_CUR CrCtl_vAccnDR3DwnSlp_CUR CrCtl_vAccnDR4DwnSlpCoast_CUR CrCtl_vAccnDR4DwnSlp_CUR CrCtl_vAccnDR5DwnSlpCoast_CUR CrCtl_vAccnDR5DwnSlp_CUR CrCtl_vAccnDR6DwnSlpCoast_CUR CrCtl_vAccnDR6DwnSlp_CUR /end DEF_CHARACTERISTIC
 FUNCTION_VERSION "6.3.0" /end FUNCTION
/begin COMPU_METHOD APPCrCtl1 "" RAT_FUNC "%6.4" "%" COEFFS 0 200 0 0 0 1 /end COMPU_METHOD
/begin COMPU_METHOD EngNCrCtl "" RAT_FUNC "%6.2" "rpm" COEFFS 0 1 0 0 0 1 /end COMPU_METHOD
/begin COMPU_METHOD Fact1 "" RAT_FUNC "%6.4" "-" COEFFS 0 128 0 0 0 1 /end COMPU_METHOD
/begin COMPU_METHOD Fact100 "" RAT_FUNC "%6.4" "-" COEFFS 0 100 0 0 0 1 /end COMPU_METHOD
/begin COMPU_METHOD Fact2 "" RAT_FUNC "%6.4" "-" COEFFS 0 16 0 0 0 1 /end COMPU_METHOD
/begin COMPU_METHOD Fact_CrCtl "" RAT_FUNC "%6.4" "-" COEFFS 0 256 0 0 0 1 /end COMPU_METHOD
/begin COMPU_METHOD Fact_CrCtl2 "" RAT_FUNC "%6.4" "-" COEFFS 0 64 0 0 0 1 /end COMPU_METHOD
/begin COMPU_METHOD Fact_CrCtl3 "" RAT_FUNC "%6.5" "-" COEFFS 0 1024 0 0 0 1 /end COMPU_METHOD
/begin COMPU_METHOD fak_q0p00392 "" RAT_FUNC "%6.4" "-" COEFFS 0 255 0 0 0 1 /end COMPU_METHOD
/begin COMPU_METHOD OneToOne "" RAT_FUNC "%6.2" "-" COEFFS 0 1 0 0 0 1 /end COMPU_METHOD
/begin COMPU_METHOD Prc_CrCtl "" RAT_FUNC "%6.2" "%" COEFFS 0 1 0 0 0 1 /end COMPU_METHOD
/begin COMPU_METHOD Prc_CrCtl2 "" RAT_FUNC "%6.3" "%" COEFFS 0 10 0 0 0 1 /end COMPU_METHOD
/begin COMPU_METHOD Prc_CrCtl4 "" RAT_FUNC "%6.4" "%" COEFFS 0 256 0 0 0 1 /end COMPU_METHOD
/begin COMPU_METHOD Time_ms "" RAT_FUNC "%6.1" "ms" COEFFS 0 0.1 0 0 0 1 /end COMPU_METHOD
/begin COMPU_METHOD Time_ms_100ms "" RAT_FUNC "%6.0" "ms" COEFFS 0 0.01 0 0 0 1 /end COMPU_METHOD
/begin COMPU_METHOD Vel_CrCtl "" RAT_FUNC "%6.4" "km/h" COEFFS 0 256 0 0 0 1 /end COMPU_METHOD
/begin COMPU_METHOD Vel_CrCtl1 "" RAT_FUNC "%6.2" "km/h" COEFFS 0 1 0 0 0 1 /end COMPU_METHOD
/*********** End of merged RECORD_LAYOUT blocks ***********/
/begin RECORD_LAYOUT Axis_Xs16 NO_AXIS_PTS_X 1 SWORD AXIS_PTS_X 2 SWORD INDEX_INCR DIRECT /end RECORD_LAYOUT
/begin RECORD_LAYOUT CurG_Ws16 FNC_VALUES 1 SWORD COLUMN_DIR DIRECT /end RECORD_LAYOUT
/begin RECORD_LAYOUT MapG_Ws16 FNC_VALUES 1 SWORD COLUMN_DIR DIRECT /end RECORD_LAYOUT
/begin RECORD_LAYOUT Map_Xs16Ys16Ws16 NO_AXIS_PTS_X 1 SWORD NO_AXIS_PTS_Y 2 SWORD AXIS_PTS_X 3 SWORD INDEX_INCR DIRECT AXIS_PTS_Y 4 SWORD INDEX_INCR DIRECT FNC_VALUES 5 SWORD COLUMN_DIR DIRECT /end RECORD_LAYOUT
/begin RECORD_LAYOUT RB_Curve_S16_U8_Static NO_AXIS_PTS_X 1 SWORD AXIS_PTS_X 2 SWORD INDEX_INCR DIRECT FNC_VALUES 3 UBYTE COLUMN_DIR DIRECT STATIC_RECORD_LAYOUT /end RECORD_LAYOUT
/begin RECORD_LAYOUT RB_Cur_Xs16Ws16 NO_AXIS_PTS_X 1 SWORD AXIS_PTS_X 2 SWORD INDEX_INCR DIRECT FNC_VALUES 3 SWORD COLUMN_DIR DIRECT /end RECORD_LAYOUT
/begin RECORD_LAYOUT ValA_Wu8 FNC_VALUES 1 UBYTE COLUMN_DIR DIRECT /end RECORD_LAYOUT
/begin RECORD_LAYOUT Val_Ws16 FNC_VALUES 1 SWORD COLUMN_DIR DIRECT /end RECORD_LAYOUT
/begin RECORD_LAYOUT Val_Ws8 FNC_VALUES 1 SBYTE COLUMN_DIR DIRECT /end RECORD_LAYOUT
/begin RECORD_LAYOUT Val_Wu8 FNC_VALUES 1 UBYTE COLUMN_DIR DIRECT /end RECORD_LAYOUT
/end MODULE
/end PROJECT
