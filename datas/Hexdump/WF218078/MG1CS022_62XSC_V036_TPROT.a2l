ASAP2_VERSION 1 60
/begin PROJECT MG1CS022 "MG1CS022"
/begin HEADER "" VERSION "MG1CS022_62XSC_V036_TPROT" PROJECT_NO MG1CS022 /end HEADER
/begin MODULE DIM ""
/begin MOD_COMMON "" BYTE_ORDER MSB_LAST ALIGNMENT_BYTE 1 ALIGNMENT_WORD 2 ALIGNMENT_LONG 4 ALIGNMENT_INT64 4 ALIGNMENT_FLOAT32_IEEE 4 ALIGNMENT_FLOAT64_IEEE 4 DATA_SIZE 32 /end MOD_COMMON
/begin CHARACTERISTIC CWDMDZAG "code word DMDZAG configuration" VALUE 0x80590F8C Val_Wu8 0.00 OneToOne 3.000 3.000 FORMAT "%5.3" EXTENDED_LIMITS 0.00 255.0 READ_ONLY /end CHARACTERISTIC
/begin CHARACTERISTIC DWMSVOMX "Maximal angle end of control MSV (opening)" VALUE 0x8057A5A0 RB_Val_Ws16 720.0000 kw_q0p1 -360.0000 360.0000 FORMAT "%8.4" EXTENDED_LIMITS -3276.800 3276.700 /end CHARACTERISTIC
/begin CHARACTERISTIC Mfpsdia_mskCtl_CW "Codeword used to switch off of MSV power stage diagnosis and healing." VALUE 0x8057A59A Val_Wu8 255.0 dez 0.00 255.0 FORMAT "%5.1" /end CHARACTERISTIC
/begin CHARACTERISTIC Mfpsdia_uMax_C "Maximum Battery voltage for MSV Diagnosis enable" VALUE 0x8057A59C Val_Ws16 1310700. Volt_Batt -655360.0 655340.0 FORMAT "%8.1" /end CHARACTERISTIC
/begin CHARACTERISTIC Mfpsdia_uMin_C "Minimum Battery voltage for MSV Diagnosis enable" VALUE 0x8057A59E Val_Ws16 1310700. Volt_Batt -655360.0 655340.0 FORMAT "%8.1" /end CHARACTERISTIC
/begin CHARACTERISTIC MfVDTypC_agHldgPh_CUR "Curve holding phase duration of MSV control in CrA" CURVE 0x8057A5A2 RB_Curve_S16_U16_Static 6553.500 kw_q0p1 0.00 6553.500 FORMAT "%8.3"
 /begin AXIS_DESCR STD_AXIS Epm_nEng EngN 6 -16384.00 16383.50 FORMAT "%8.2" DEPOSIT ABSOLUTE /end AXIS_DESCR
/end CHARACTERISTIC
/begin CHARACTERISTIC MfVDTypC_FacPullin_Map "Characteristic Map for the Correction Factor of Pullin-Phase dependant on engine speed and delivery duration." MAP 0x8057A5BC RB_Map_S16S16_U16 1.992188 fak_ub_b2 0.00 1.992188 FORMAT "%8.6" EXTENDED_LIMITS 0.00 511.9922
 /begin AXIS_DESCR STD_AXIS Epm_nEng EngN 6 -16384.00 16383.50 FORMAT "%8.2" DEPOSIT ABSOLUTE /end AXIS_DESCR
 /begin AXIS_DESCR STD_AXIS MfVDTypC_dwmsvd_w kw_q0p1 4 -3276.800 3276.700 FORMAT "%8.3" DEPOSIT ABSOLUTE /end AXIS_DESCR
/end CHARACTERISTIC
/begin CHARACTERISTIC MfVDTypC_iPullin_MAP "Lower limit for pickup current of mass flow valve" MAP 0x8057A604 RB_Map_S16S16_U16 10.20000 i_ub_q0p04 0.00 10.20000 FORMAT "%8.5" EXTENDED_LIMITS 0.00 2621.400
 /begin AXIS_DESCR STD_AXIS Epm_nEng EngN 6 -16384.00 16383.50 FORMAT "%8.2" DEPOSIT ABSOLUTE /end AXIS_DESCR
 /begin AXIS_DESCR STD_AXIS BattU_u Volt_Batt 5 -655360.0 655340.0 FORMAT "%8.1" DEPOSIT ABSOLUTE /end AXIS_DESCR
/end CHARACTERISTIC
/begin CHARACTERISTIC MfVDTypC_KLVZMSVUB "MSV delay time dependent on battery voltage" CURVE 0x8057A65A RB_Curve_S16_U16_Static 65.53500 t_q0p001_ms 0.00 65.53500 FORMAT "%8.5"
 /begin AXIS_DESCR STD_AXIS MfVDTypC_uBattFild Volt_Batt 5 -655360.0 655340.0 FORMAT "%8.1" DEPOSIT ABSOLUTE /end AXIS_DESCR
/end CHARACTERISTIC
/begin CHARACTERISTIC MfVDTypC_nEngMaxHot_C "Maximum engine speed at warm engine" VALUE 0x8057A670 RB_Val_Ws16 16383.50 EngN 0.00 16383.50 FORMAT "%8.2" EXTENDED_LIMITS -16384.00 16383.50 /end CHARACTERISTIC
/begin CHARACTERISTIC MfVDTypC_prdiffThd2_C "Threshold for pressure difference during drop in pressure" VALUE 0x8057A672 RB_Val_Wu16 131.0700 RBPtCel_p_0p002_1 0.00 131.0700 FORMAT "%8.4" /end CHARACTERISTIC
/begin CHARACTERISTIC MfVDTypC_prdiffThd_C "Threshold for pressure difference during pressure increase" VALUE 0x8057A674 RB_Val_Wu16 131.0700 RBPtCel_p_0p002_1 0.00 131.0700 FORMAT "%8.4" /end CHARACTERISTIC
/begin CHARACTERISTIC MfVDTypC_PRDIFRCURH "Pressure Deviation Limit for activation of Reduced Current Control" VALUE 0x8057A676 RB_Val_Ws16 131.0700 RBPtCel_p_0p002_1 -65.53600 65.53400 FORMAT "%8.5" /end CHARACTERISTIC
/begin CHARACTERISTIC MfVDTypC_PRDIFRECUR "Pressure threshold for activation of Reduced Current Control" VALUE 0x8057A678 RB_Val_Ws16 131.0700 RBPtCel_p_0p002_1 -65.53600 65.53400 FORMAT "%8.5" /end CHARACTERISTIC
/begin CHARACTERISTIC MfVDTypC_PRMINMSV "Minimum rail pressure to hold the MSV closed" VALUE 0x8057A67A RB_Val_Wu16 131.0700 RBPtCel_p_0p002_1 0.00 131.0700 FORMAT "%8.4" /end CHARACTERISTIC
/begin CHARACTERISTIC MfVDTypC_safHldCrntDtyCycl_MAP "Safety duty cycle at holding phase" MAP 0x8057A67C RB_Map_S16U16_U16 100.0000 rel_q0p392 0.00 100.0000 FORMAT "%8.4" EXTENDED_LIMITS 0.00 25700.00
 /begin AXIS_DESCR STD_AXIS MfVDTypC_uBattFild Volt_Batt 7 -655360.0 655340.0 FORMAT "%8.1" DEPOSIT ABSOLUTE /end AXIS_DESCR
 /begin AXIS_DESCR STD_AXIS MfVlv_rMsvGes r_q0p003906_Ohm 4 0.00 255.9961 FORMAT "%8.4" DEPOSIT ABSOLUTE /end AXIS_DESCR
/end CHARACTERISTIC
/begin CHARACTERISTIC MfVDTypC_tiPullinReCur_CUR "Pull in Time for Current Reduced Activation" CURVE 0x8057A6CE RB_Curve_S16_U16_Static 10.00000 t_q0p001_ms 0.00 10.00000 FORMAT "%8.5" EXTENDED_LIMITS 0.00 65.53500
 /begin AXIS_DESCR STD_AXIS MfVDTypC_uBattFild Volt_Batt 3 -655360.0 655340.0 FORMAT "%8.1" DEPOSIT ABSOLUTE /end AXIS_DESCR
/end CHARACTERISTIC
/begin CHARACTERISTIC MfVDTypC_tiWaitAftFrstStrtd_CUR "Waiting time after start until ReCur is enabled" CURVE 0x8057A6DC RB_Curve_S16_U16_Static 6553.500 t100msxs_uw_b6553p5 0.00 6553.500 FORMAT "%8.3"
 /begin AXIS_DESCR STD_AXIS CEngDsT_t Temp_Cels 3 -3549.940 3003.560 FORMAT "%8.3" DEPOSIT ABSOLUTE /end AXIS_DESCR
/end CHARACTERISTIC
/begin CHARACTERISTIC MfVDTypC_tiWaitAfttStrtd_CUR "Wait Time after Start, until Adaptation is allowed" CURVE 0x8057A6EA RB_Curve_S16_U16_Static 6553.500 t100msxs_uw_b6553p5 0.00 6553.500 FORMAT "%8.3"
 /begin AXIS_DESCR STD_AXIS CEngDsT_t Temp_Cels 3 -3549.940 3003.560 FORMAT "%8.3" DEPOSIT ABSOLUTE /end AXIS_DESCR
/end CHARACTERISTIC
/begin CHARACTERISTIC MfVDTypC_TMSVRECURO "Upper Threshold for engine temperature for activation of Reduced Current Control" VALUE 0x8057A6F8 RB_Val_Ws16 191.3000 Temp_Cels -48.0400 143.2600 FORMAT "%8.4" EXTENDED_LIMITS -3549.940 3003.560 /end CHARACTERISTIC
/begin CHARACTERISTIC MfVDTypC_TMSVRECURU "Lower Threshold for engine temperature for activation of Reduced Current Control" VALUE 0x8057A6FA RB_Val_Ws16 191.3000 Temp_Cels -48.0400 143.2600 FORMAT "%8.4" EXTENDED_LIMITS -3549.940 3003.560 /end CHARACTERISTIC
/begin CHARACTERISTIC MfVDTypC_vfzgMaxRecur_C "Maximum vehicle speed for current reduced Activation" VALUE 0x8057A6FC RB_Val_Ws16 655.3500 Vel -327.6800 327.6700 FORMAT "%8.4" /end CHARACTERISTIC
/begin CHARACTERISTIC MfVDTypC_vfzgMaxRedNumMsvDelta_C "Maximum change of vehicle speed for Activation with reduced number of Pumps" VALUE 0x8057A6FE RB_Val_Ws16 655.3500 Vel -327.6800 327.6700 FORMAT "%8.4" /end CHARACTERISTIC
/begin CHARACTERISTIC MfVDTypC_WrstDtyCycl_MAP "Duty cycle map for pullin in worst case senario" MAP 0x8057A700 RB_Map_S16U16_S16 100.0000 rel_q0p1953 0.00 100.0000 FORMAT "%8.4" EXTENDED_LIMITS -6400.000 6399.805
 /begin AXIS_DESCR STD_AXIS MfVDTypC_uBattFild Volt_Batt 7 -655360.0 655340.0 FORMAT "%8.1" DEPOSIT ABSOLUTE /end AXIS_DESCR
 /begin AXIS_DESCR STD_AXIS MfVlv_rMsvGes r_q0p003906_Ohm 4 0.00 255.9961 FORMAT "%8.4" DEPOSIT ABSOLUTE /end AXIS_DESCR
/end CHARACTERISTIC
/begin CHARACTERISTIC MfVD_NumStrtAftFirstFl_C "Number of Starts After First Fueling for which the pressure is raised and both MSVs are working in case of 2 MSVs" VALUE 0x8057A752 RB_Val_Wu8 255.0 dez 0.00 255.0 FORMAT "%5.1" /end CHARACTERISTIC
/begin CHARACTERISTIC MfVD_tdelReCur_C "Delay time Reur" VALUE 0x8057A754 RB_Val_Wu16 65.53500 t_q0p001_ms 0.00 65.53500 FORMAT "%8.5" /end CHARACTERISTIC
/begin CHARACTERISTIC MfVlv_dTpressure_tiDly_C "time delay pressure signal" VALUE 0x8057A758 RB_Val_Ws32 4294.96729500 Time_Dt -2147.48364800 2147.48364700 FORMAT "%13.8" /end CHARACTERISTIC
/begin CHARACTERISTIC MfVlv_dTtiUBattTnStrt "Time Constant for TP Filter of Battery Voltage" VALUE 0x8057A75C RB_Val_Ws32 4294.96729500 Time_Dt -2147.48364800 2147.48364700 FORMAT "%13.8" /end CHARACTERISTIC
/begin CHARACTERISTIC MfVlv_dTtiUBattTn_C "Time Constant for TP Filter of Battery Voltage" VALUE 0x8057A760 RB_Val_Ws32 4294.96729500 Time_Dt -2147.48364800 2147.48364700 FORMAT "%13.8" /end CHARACTERISTIC
/begin CHARACTERISTIC MfVlv_iHold_C "Lower limit for hold current of mass flow valve" VALUE 0x8057A764 RB_Val_Wu8 10.20 i_ub_q0p04 0.00 10.20 FORMAT "%5.2" /end CHARACTERISTIC
/begin CHARACTERISTIC MfVlv_iHysHld_C "Hysteresis of the hold current" VALUE 0x8057A765 RB_Val_Wu8 10.20 i_ub_q0p04 0.00 10.20 FORMAT "%5.2" /end CHARACTERISTIC
/begin CHARACTERISTIC MfVlv_iHysPu_C "Hysteresis for the pickup current" VALUE 0x8057A766 RB_Val_Wu8 10.20 i_ub_q0p04 0.00 10.20 FORMAT "%5.2" /end CHARACTERISTIC
/begin CHARACTERISTIC MfVlv_iPullinHyst_C "Difference limit for which the new local calculated pullin current is used" VALUE 0x8057A767 RB_Val_Wu8 10.20 i_ub_q0p04 0.00 10.20 FORMAT "%5.2" /end CHARACTERISTIC
/begin CHARACTERISTIC MfVlv_MfVDTypCNVHCfg_C "Configuration MfVDTypC" VALUE 0x8057A768 RB_Val_Wu16 65535.00 dez 0.00 65535.00 FORMAT "%8.2" /end CHARACTERISTIC
/begin CHARACTERISTIC MfVlv_RstnT0_C "Electrical resistance of mass flow valve at 20 degree Celsius" VALUE 0x8057A76A RB_Val_Wu16 255.9961 r_q0p003906_Ohm 0.00 255.9961 FORMAT "%8.4" /end CHARACTERISTIC
/begin CHARACTERISTIC Mfvlv_tiDelOffsetAdptRdy_C "Offset Time for Duty Cycle 1 after Closing of the Valve after Adaptation" VALUE 0x8057A76C RB_Val_Wu8 10.20 t_q0p04_ms 0.00 10.20 FORMAT "%5.2" /end CHARACTERISTIC
/begin CHARACTERISTIC MfVlv_uBattMinReCur_C "Minimum battery voltage for ReCur" VALUE 0x8057A76E RB_Val_Wu16 12760.00 Volt_Batt 6000.00 18760.00 FORMAT "%8.2" EXTENDED_LIMITS 0.00 1310700. /end CHARACTERISTIC
/begin CHARACTERISTIC MILLmp_stMILCfg_CW "configuration parameter for the MIL control" VALUE 0x80590F88 Val_Wu8 255.0 OneToOne 0.00 255.0 FORMAT "%5.1" /end CHARACTERISTIC
/begin CHARACTERISTIC MILLmp_tiAftStrt_C "time for MIL_ON after engine start" VALUE 0x80590F89 Val_Wu8 254.0 t1sxs_q1 1.0 255.0 FORMAT "%5.1" EXTENDED_LIMITS 0.00 255.0 /end CHARACTERISTIC
/begin CHARACTERISTIC MILLmp_tiRdnBln_C "time for Readiness-Blinking" VALUE 0x80590F8A Val_Wu8 5.000 t1sxs_q1 5.00 10.00 FORMAT "%5.2" EXTENDED_LIMITS 0.00 255.0 /end CHARACTERISTIC
/begin CHARACTERISTIC MILLmp_tiVisTst_C "time for function test of the MIL" VALUE 0x80590F8B Val_Wu8 5.000 t1sxs_q1 15.00 20.00 FORMAT "%5.2" EXTENDED_LIMITS 0.00 255.0 /end CHARACTERISTIC
/begin CHARACTERISTIC MisfDet_addrTrgVal_C "Adress for triggervalue" VALUE 0x8057A9E4 RB_Val_Wu32 4294967295.00 OneToOne 0.00 4294967295.00 FORMAT "%13.2" /end CHARACTERISTIC
/begin CHARACTERISTIC MisfDet_cntrIgnBlkDnAdpnStrt_C "Delay counter to block dn adaption in case of engine start" VALUE 0x8057AA44 RB_Val_Wu8 255.0 OneToOne 0.00 255.0 FORMAT "%5.1" /end CHARACTERISTIC
/begin CHARACTERISTIC MisfDet_cntrIgnBlkStcReStrt_C "Delay counter to block statistical function in case of engine restart" VALUE 0x8057AA45 RB_Val_Wu8 255.0 OneToOne 0.00 255.0 FORMAT "%5.1" /end CHARACTERISTIC
/begin CHARACTERISTIC MisfDet_cntrIgnBlkStcStrt_C "Delay counter to block statistical function in case of engine start" VALUE 0x8057AA46 RB_Val_Wu8 255.0 OneToOne 0.00 255.0 FORMAT "%5.1" /end CHARACTERISTIC
/begin CHARACTERISTIC MisfDet_cntrIgnFlreDwn_C "Counter to determine length of flare down phase during engine start" VALUE 0x8057AA48 RB_Val_Wu16 65535.00 OneToOne 0.00 65535.00 FORMAT "%8.2" /end CHARACTERISTIC
/begin CHARACTERISTIC MisfDet_cntrIgnRstrtHld_C "counter for turn off delay for state engine start during engine restart" VALUE 0x8057AA4A RB_Val_Wu8 255.0 OneToOne 0.00 255.0 FORMAT "%5.1" /end CHARACTERISTIC
/begin CHARACTERISTIC MisfDet_cntrIgnStrtHld_C "counter for turn off delay for state engine start" VALUE 0x8057AA4B RB_Val_Wu8 255.0 OneToOne 0.00 255.0 FORMAT "%5.1" /end CHARACTERISTIC
/begin CHARACTERISTIC MisfDet_dlyTiStrtLineEnd_T "Start delay time when EoL is active, engine temperature dependant" CURVE 0x8057AA4C RB_Curve_S16_U16_Static 6553.500 t_q0p1 0.00 6553.500 FORMAT "%8.3"
 /begin AXIS_DESCR STD_AXIS MisfDet_tEngStrt Temp_Cels 4 -3549.940 3003.560 FORMAT "%8.3" DEPOSIT ABSOLUTE /end AXIS_DESCR
/end CHARACTERISTIC
/begin CHARACTERISTIC MisfDet_dlyTiStrt_M "Start delay time, engine temperature dependant and ethanol ratio dependent" MAP 0x8057AA5E RB_Map_S16U16_U16 6553.500 t_q0p1 0.00 6553.500 FORMAT "%8.3"
 /begin AXIS_DESCR STD_AXIS MisfDet_tEngStrt Temp_Cels 4 -3549.940 3003.560 FORMAT "%8.3" DEPOSIT ABSOLUTE /end AXIS_DESCR
 /begin AXIS_DESCR STD_AXIS FfPrm_facEth fak_uw_b2 3 0.00 1.999969 FORMAT "%8.6" DEPOSIT ABSOLUTE /end AXIS_DESCR
/end CHARACTERISTIC
/begin CHARACTERISTIC MisfDet_dnAdpnFilFac_C "filter factor for continuous adaptation" VALUE 0x8057A780 Val_Wu16 0.9999847 fak_uw_b1 0.00 0.9999847 FORMAT "%9.7" /end CHARACTERISTIC
/begin CHARACTERISTIC MisfDet_dnAdpnFrzNEngDifMax_C "engine speed window to keep the values of the continuous adaptation" VALUE 0x8057A782 RB_Val_Wu16 25599.61 rel_win_ub_b100 0.00 25599.61 FORMAT "%8.2" /end CHARACTERISTIC
/begin CHARACTERISTIC MisfDet_dnAdpnFrzTqDifMax_C "torque window to keep the values of the continuous adaptation" VALUE 0x8057A784 RB_Val_Wu16 25599.61 rel_win_ub_b100 0.00 25599.61 FORMAT "%8.2" /end CHARACTERISTIC
/begin CHARACTERISTIC MisfDet_dnAdpnNrSampRdy_T "Number of working cycles to complete adaptation" CURVE 0x8057A786 RB_Curve_U16_U8_Static 255.0 OneToOne 0.00 255.0 FORMAT "%5.1"
 /begin AXIS_DESCR STD_AXIS MisfDet_tqBascSync rel_uw_b100 8 0.00 99.99847 FORMAT "%8.5" DEPOSIT ABSOLUTE /end AXIS_DESCR
/end CHARACTERISTIC
/begin CHARACTERISTIC MisfDet_dnAdpnNvDstBasPntFac_C "factor to distance of base point with unknown gradient" VALUE 0x8057A7A0 RB_Val_Wu16 7.999878 fak_uw_b8 0.00 7.999878 FORMAT "%8.6" /end CHARACTERISTIC
/begin CHARACTERISTIC MisfDet_dnAdpnNvDstMax_C "Limit of distance of interpolation points to set QlyFac = 1" VALUE 0x8057A7A2 RB_Val_Wu16 255.9961 fak_ub_b1 0.00 255.9961 FORMAT "%8.4" /end CHARACTERISTIC
/begin CHARACTERISTIC MisfDet_dnAdpnNvDstMin_C "Limit of distance of interpolation points to set QlyFac = 0" VALUE 0x8057A7A4 RB_Val_Wu16 255.9961 fak_ub_b1 0.00 255.9961 FORMAT "%8.4" /end CHARACTERISTIC
/begin CHARACTERISTIC MisfDet_dnAdpnNvFilFacMin_C "minimum filter factor used for NV adaptation" VALUE 0x8057A7A6 Val_Wu16 0.9999847 fak_uw_b1 0.00 0.9999847 FORMAT "%9.7" /end CHARACTERISTIC
/begin CHARACTERISTIC MisfDet_dnAdpnNvNrSampleMin_C "Minimum number of samples for transfer to NV values" VALUE 0x8057A7A8 RB_Val_Wu8 255.0 OneToOne 0.00 255.0 FORMAT "%5.1" /end CHARACTERISTIC
/begin CHARACTERISTIC MisfDet_dnAdpnNvPlausSumThd_C "threshold for DnAdpnNv sum plaus check" VALUE 0x8057A7AA RB_Val_Ws16 4095.938 dn_Compu -2048.000 2047.938 FORMAT "%8.3" /end CHARACTERISTIC
/begin CHARACTERISTIC MisfDet_dnAdpnPlausAbsThdDecMax_T "Limitation of negative gradient of plaus abs threshold" CURVE 0x8057A7AC RB_Curve_S16_S16 4095.938 dn_Compu -2048.000 2047.938 FORMAT "%8.3"
 /begin AXIS_DESCR STD_AXIS Epm_nEng EngN 4 -16384.00 16383.50 FORMAT "%8.2" DEPOSIT ABSOLUTE /end AXIS_DESCR
/end CHARACTERISTIC
/begin CHARACTERISTIC MisfDet_dnAdpnPlausAbsThdOffsCatHeat_C "threshold offset for DnAdpn absolut plaus check at cat heating" VALUE 0x8057A7BE RB_Val_Ws16 4095.938 dn_Compu -2048.000 2047.938 FORMAT "%8.3" /end CHARACTERISTIC
/begin CHARACTERISTIC MisfDet_dnAdpnPlausAbsThdTrsmTiLow_M "Threshold for DnAdpn absolute plaus check at cold drive train" MAP 0x8057A7C0 RB_Map_U16S16_S16 4095.938 dn_Compu -2048.000 2047.938 FORMAT "%8.3"
 /begin AXIS_DESCR STD_AXIS MisfDet_tqBascSync rel_uw_b100 6 0.00 99.99847 FORMAT "%8.5" DEPOSIT ABSOLUTE /end AXIS_DESCR
 /begin AXIS_DESCR STD_AXIS MisfDet_nEngSync EngN 6 -16384.00 16383.50 FORMAT "%8.2" DEPOSIT ABSOLUTE /end AXIS_DESCR
/end CHARACTERISTIC
/begin CHARACTERISTIC MisfDet_dnAdpnPlausAbsThd_M "Threshold for DnAdpn absolute plaus check" MAP 0x8057A824 RB_Map_U16S16_S16 4095.938 dn_Compu -2048.000 2047.938 FORMAT "%8.3"
 /begin AXIS_DESCR STD_AXIS MisfDet_tqBascSync rel_uw_b100 6 0.00 99.99847 FORMAT "%8.5" DEPOSIT ABSOLUTE /end AXIS_DESCR
 /begin AXIS_DESCR STD_AXIS MisfDet_nEngSync EngN 6 -16384.00 16383.50 FORMAT "%8.2" DEPOSIT ABSOLUTE /end AXIS_DESCR
/end CHARACTERISTIC
/begin CHARACTERISTIC MisfDet_dnAdpnPlausMinThdFacCatHeat_C "factor to misfire detection threshold for min plaus check during cat heating" VALUE 0x8057A888 RB_Val_Wu8 15.94 fak_ub_b16 0.00 15.94 FORMAT "%5.2" /end CHARACTERISTIC
/begin CHARACTERISTIC MisfDet_dnAdpnPlausMinThdFacTrsmTiLow_C "factor to misfire detection threshold for min plaus check at cold drive train" VALUE 0x8057A889 RB_Val_Wu8 15.94 fak_ub_b16 0.00 15.94 FORMAT "%5.2" /end CHARACTERISTIC
/begin CHARACTERISTIC MisfDet_dnAdpnPlausMinThdFac_C "factor to misfire detection threshold for min plaus check" VALUE 0x8057A88A RB_Val_Wu8 15.94 fak_ub_b16 0.00 15.94 FORMAT "%5.2" /end CHARACTERISTIC
/begin CHARACTERISTIC MisfDet_dnAdpnPlausRelCntrLim_C "maximum number of failed rlative plaus checks to inhibit adaptation" VALUE 0x8057A88B RB_Val_Wu8 255.0 OneToOne 0.00 255.0 FORMAT "%5.1" /end CHARACTERISTIC
/begin CHARACTERISTIC MisfDet_dnAdpnPlausRelThdFacAltvPosn_C "factor on detection threshold for relative plaus check while usage of alternative segment position" VALUE 0x8057A88C RB_Val_Wu8 3.984 fak_ub_b4 0.00 3.984 FORMAT "%5.3" /end CHARACTERISTIC
/begin CHARACTERISTIC MisfDet_dnAdpnPlausRelThdFacIdle_T "factor on detection threshold for relative plaus check at idle" CURVE 0x8057A88E RB_Curve_S16_U8_Static 3.984 fak_ub_b4 0.00 3.984 FORMAT "%5.3"
 /begin AXIS_DESCR STD_AXIS MisfDet_nEngSync EngN 6 0.00 16383.50 FORMAT "%8.2" EXTENDED_LIMITS -16384.00 16383.50 DEPOSIT ABSOLUTE /end AXIS_DESCR
/end CHARACTERISTIC
/begin CHARACTERISTIC MisfDet_dnAdpnPlausRelThdFacTrsmTiLow_M "factor on detection threshold for relative plaus check at cold drive train" MAP 0x8057A8A2 RB_Map_U16S16_U8 3.984 fak_ub_b4 0.00 3.984 FORMAT "%5.3"
 /begin AXIS_DESCR STD_AXIS MisfDet_tqBascSync rel_uw_b100 3 0.00 99.99847 FORMAT "%8.5" DEPOSIT ABSOLUTE /end AXIS_DESCR
 /begin AXIS_DESCR STD_AXIS MisfDet_nEngSync EngN 4 -16384.00 16383.50 FORMAT "%8.2" DEPOSIT ABSOLUTE /end AXIS_DESCR
/end CHARACTERISTIC
/begin CHARACTERISTIC MisfDet_dnAdpnPlausRelThdFac_M "factor on detection threshold for relative plaus check" MAP 0x8057A8C0 RB_Map_U16S16_U8 3.984 fak_ub_b4 0.00 3.984 FORMAT "%5.3"
 /begin AXIS_DESCR STD_AXIS MisfDet_tqBascSync rel_uw_b100 3 0.00 99.99847 FORMAT "%8.5" DEPOSIT ABSOLUTE /end AXIS_DESCR
 /begin AXIS_DESCR STD_AXIS MisfDet_nEngSync EngN 4 -16384.00 16383.50 FORMAT "%8.2" DEPOSIT ABSOLUTE /end AXIS_DESCR
/end CHARACTERISTIC
/begin CHARACTERISTIC MisfDet_dnAdpnRngChngActvnDly_C "delay of release after change of adaptation range" VALUE 0x8057A8DE Val_Wu8 255.0 OneToOne 0.00 255.0 FORMAT "%5.1" /end CHARACTERISTIC
/begin CHARACTERISTIC MisfDet_dnAdpnRngNEng.Cmn_CA "engine speed limits of adaptation map / all transmission types" VAL_BLK 0x8057A958 RB_ValA_Wu16 16383.50 EngN 0.00 16383.50 FORMAT "%8.2" EXTENDED_LIMITS 0.00 32767.50 NUMBER 9 /end CHARACTERISTIC
/begin CHARACTERISTIC MisfDet_dnAdpnRngTqInr_CA "inner load limits of adaptation map (perc of delta minmax)" VAL_BLK 0x8057A8E0 RB_ValA_Wu16 99.99847 rel_rng_uw_b100 0.00 99.99847 FORMAT "%8.5" NUMBER 2 /end CHARACTERISTIC
/begin CHARACTERISTIC MisfDet_dnAdpnRngTqLock_CA "locking area around inner load limits (in perc of adaptation window)" VAL_BLK 0x8057A8E4 RB_ValA_Wu8 99.61 rel_win_ub_b100 0.00 99.61 FORMAT "%5.2" NUMBER 2 /end CHARACTERISTIC
/begin CHARACTERISTIC MisfDet_dnAdpnRngTqMax_T "upper load limit of adaptation map" CURVE 0x8057A8E6 RB_Curve_S16_U16_Static 99.99847 rel_uw_b100 0.00 99.99847 FORMAT "%8.5"
 /begin AXIS_DESCR STD_AXIS MisfDet_nEngSync EngN 12 0.00 16383.50 FORMAT "%8.2" EXTENDED_LIMITS -16384.00 16383.50 DEPOSIT ABSOLUTE /end AXIS_DESCR
/end CHARACTERISTIC
/begin CHARACTERISTIC MisfDet_dnAdpnRngTqMin.Cmn_GT "lower load limit of adaptation map / all transmission types" CURVE 0x8057A96A RB_CurveGroup_U16 99.99847 rel_uw_b100 0.00 99.99847 FORMAT "%8.5"
 /begin AXIS_DESCR COM_AXIS MisfDet_nEngSync EngN 12 -16384.00 16383.50 FORMAT "%8.2" AXIS_PTS_REF MisfDet_dnAdpnTqMin_AX /end AXIS_DESCR
/end CHARACTERISTIC
/begin CHARACTERISTIC MisfDet_dnAdpnRngTqMinIdle.Cmn_GT "lower load limit of adaptation at idle / all transmission types" CURVE 0x8057A982 RB_CurveGroup_U16 99.99847 rel_uw_b100 0.00 99.99847 FORMAT "%8.5"
 /begin AXIS_DESCR COM_AXIS MisfDet_nEngSync EngN 8 -16384.00 16383.50 FORMAT "%8.2" AXIS_PTS_REF MisfDet_dnAdpnTqMinIdle_AX /end AXIS_DESCR
/end CHARACTERISTIC
/begin AXIS_PTS MisfDet_dnAdpnTqMinIdle_AX "distribution lower torque limit of adaptation idle" 0x8057A918 MisfDet_nEngSync RB_Axis_S16 32767.50 EngN 8 -16384.00 16383.50 FORMAT "%8.2" DEPOSIT ABSOLUTE /end AXIS_PTS
/begin CHARACTERISTIC MisfDet_dnAdpnTqMinStrtNrIgn_C "number of ignitions after start for usage of start minimum torque" VALUE 0x8057A92A RB_Val_Wu16 65535.00 OneToOne 0.00 65535.00 FORMAT "%8.2" /end CHARACTERISTIC
/begin CHARACTERISTIC MisfDet_dnAdpnTqMinStrt_C "minimum torque for adaptation after start" VALUE 0x8057A92C RB_Val_Wu16 99.99847 rel_uw_b100 0.00 99.99847 FORMAT "%8.5" /end CHARACTERISTIC
/begin AXIS_PTS MisfDet_dnAdpnTqMin_AX "distribution lower torque limit of adaptation" 0x8057A92E MisfDet_nEngSync RB_Axis_S16 32767.50 EngN 12 -16384.00 16383.50 FORMAT "%8.2" DEPOSIT ABSOLUTE /end AXIS_PTS
/begin CHARACTERISTIC MisfDet_dnAdpnValNvNZero_C "engine speed limit to not consider or ramp down adaptation value" VALUE 0x8057A948 RB_Val_Wu16 32767.50 EngN 0.00 32767.50 FORMAT "%8.2" /end CHARACTERISTIC
/begin CHARACTERISTIC MisfDet_dnCycMaxAdpn_M "Maximum allowed average engine running roughness over one working cycle" MAP 0x8057AA88 RB_Map_S8U16_S16 4095.938 dn_Compu -2048.000 2047.938 FORMAT "%8.3"
 /begin AXIS_DESCR STD_AXIS MisfDet_numGear OneToOne 11 -128.0 127.0 FORMAT "%5.1" DEPOSIT ABSOLUTE /end AXIS_DESCR
 /begin AXIS_DESCR STD_AXIS MisfDet_tqBasc rel_uw_b100 6 0.00 99.99847 FORMAT "%8.5" DEPOSIT ABSOLUTE /end AXIS_DESCR
/end CHARACTERISTIC
/begin CHARACTERISTIC MisfDet_dnCycMaxStc_M "Threshold for the maximum allowed average engine running roughness over one working cycle for the inhibiting condition of misfire statistical function" MAP 0x8057AB26 RB_Map_S8S16_S16 4095.938 dn_Compu -2048.000 2047.938 FORMAT "%8.3"
 /begin AXIS_DESCR STD_AXIS MisfDet_numGear OneToOne 11 -128.0 127.0 FORMAT "%5.1" DEPOSIT ABSOLUTE /end AXIS_DESCR
 /begin AXIS_DESCR STD_AXIS Epm_nEng EngN 8 -16384.00 16383.50 FORMAT "%8.2" DEPOSIT ABSOLUTE /end AXIS_DESCR
/end CHARACTERISTIC
/begin CHARACTERISTIC MisfDet_dnDifSelNMax_C "maximum engine speed for usage of dnDifXyz at incomplete adaptation" VALUE 0x8057A994 RB_Val_Ws16 32767.50 EngN -16384.00 16383.50 FORMAT "%8.2" /end CHARACTERISTIC
/begin CHARACTERISTIC MisfDet_dnFilFacMax_C "maximum filter factor for MisfDet_dnFltd" VALUE 0x8057A996 RB_Val_Wu16 0.9999847 fak_uw_b1 0.00 0.9999847 FORMAT "%9.7" /end CHARACTERISTIC
/begin CHARACTERISTIC MisfDet_dnFilFacMin_C "minimum filter factor for MisfDet_dnFltd" VALUE 0x8057A998 RB_Val_Wu16 0.9999847 fak_uw_b1 0.00 0.9999847 FORMAT "%9.7" /end CHARACTERISTIC
/begin CHARACTERISTIC MisfDet_dnFilFacRat_C "percentage of threshold to get maximum filter factor" VALUE 0x8057A99A RB_Val_Wu16 31.99951 fak_uw_b32 0.00 31.99951 FORMAT "%8.5" /end CHARACTERISTIC
/begin CHARACTERISTIC MisfDet_dnFilFacSlow_C "slow filter factor for MisfDet_dnFltd" VALUE 0x8057A99C RB_Val_Wu16 0.9999847 fak_uw_b1 0.00 0.9999847 FORMAT "%9.7" /end CHARACTERISTIC
/begin CHARACTERISTIC MisfDet_dnFltdAmplThdFacIdle_C "factor on detection trheshold for usage of dnDifXyz at idle" VALUE 0x8057A99E RB_Val_Wu8 0.9961 fak_ub_b1 0.00 0.9961 /end CHARACTERISTIC
/begin CHARACTERISTIC MisfDet_dnFltdAmplThdFac_C "factor on detection trheshold for usage of dnDifXyz" VALUE 0x8057A99F RB_Val_Wu8 0.9961 fak_ub_b1 0.00 0.9961 /end CHARACTERISTIC
/begin CHARACTERISTIC MisfDet_dnQnts_C "quantisation of MisfDet_dn" VALUE 0x8057A9A0 RB_Val_Wu8 63.75 fak_ub_b64 0.00 63.75 FORMAT "%5.2" /end CHARACTERISTIC
/begin AXIS_PTS MisfDet_dTqThdN_AX "Engine speed axes allowed torque gradient" 0x8057ABF4 MisfDet_nEngSync RB_Axis_S16 32767.50 EngN 8 -16384.00 16383.50 FORMAT "%8.2" DEPOSIT ABSOLUTE /end AXIS_PTS
/begin AXIS_PTS MisfDet_dTqThdTq_AX "torque axes allowed torque gradient" 0x8057AC06 MisfDet_tqBascSync RB_Axis_U16 99.99847 rel_uw_b100 8 0.00 99.99847 FORMAT "%8.5" DEPOSIT ABSOLUTE /end AXIS_PTS
/begin CHARACTERISTIC MisfDet_facDecTiTrsmAct_C "Factor for decrementing the active transmission time" VALUE 0x8057AC18 RB_Val_Wu8 2.550 fak_q0p01 0.00 2.550 FORMAT "%5.3" /end CHARACTERISTIC
/begin CHARACTERISTIC MisfDet_facEnvPMin_C "Minimal ratio ambient pressure to normal pressure" VALUE 0x8057AC19 RB_Val_Wu8 3.984 fak_ub_b4 0.00 3.984 FORMAT "%5.3" /end CHARACTERISTIC
/begin CHARACTERISTIC MisfDet_grdtPedlMax_M "max. gradient of the accelerator pedal position" MAP 0x8057AC1A RB_Map_U16S16_S16 3999.939 q0p06104_pc_DIV_s -2000.000 1999.939 FORMAT "%8.3"
 /begin AXIS_DESCR STD_AXIS MisfDet_tqBascSync rel_uw_b100 8 0.00 99.99847 FORMAT "%8.5" DEPOSIT ABSOLUTE /end AXIS_DESCR
 /begin AXIS_DESCR STD_AXIS MisfDet_nEngSync EngN 8 -16384.00 16383.50 FORMAT "%8.2" DEPOSIT ABSOLUTE /end AXIS_DESCR
/end CHARACTERISTIC
/begin CHARACTERISTIC MisfDet_grdtPedlMin_M "min. gradient of the accelerator pedal position" MAP 0x8057ACBE RB_Map_U16S16_S16 3999.939 q0p06104_pc_DIV_s -2000.000 1999.939 FORMAT "%8.3"
 /begin AXIS_DESCR STD_AXIS MisfDet_tqBascSync rel_uw_b100 8 0.00 99.99847 FORMAT "%8.5" DEPOSIT ABSOLUTE /end AXIS_DESCR
 /begin AXIS_DESCR STD_AXIS MisfDet_nEngSync EngN 8 -16384.00 16383.50 FORMAT "%8.2" DEPOSIT ABSOLUTE /end AXIS_DESCR
/end CHARACTERISTIC
/begin CHARACTERISTIC MisfDet_grdtTqMax.Cmn_GM "Maximum allowed torque gradient / all tranmissions" MAP 0x8057B030 RB_MapGroup_S16 3999.939 q0p06104_pc_DIV_s -2000.000 1999.939 FORMAT "%8.3"
 /begin AXIS_DESCR COM_AXIS MisfDet_tqBascSync rel_uw_b100 8 0.00 99.99847 FORMAT "%8.5" AXIS_PTS_REF MisfDet_dTqThdTq_AX /end AXIS_DESCR
 /begin AXIS_DESCR COM_AXIS MisfDet_nEngSync EngN 8 -16384.00 16383.50 FORMAT "%8.2" AXIS_PTS_REF MisfDet_dTqThdN_AX /end AXIS_DESCR
/end CHARACTERISTIC
/begin CHARACTERISTIC MisfDet_grdtTqMin.Cmn_GM "Minimum allowed torque gradient / all tranmissions" MAP 0x8057B0B0 RB_MapGroup_S16 3999.939 q0p06104_pc_DIV_s -2000.000 1999.939 FORMAT "%8.3"
 /begin AXIS_DESCR COM_AXIS MisfDet_tqBascSync rel_uw_b100 8 0.00 99.99847 FORMAT "%8.5" AXIS_PTS_REF MisfDet_dTqThdTq_AX /end AXIS_DESCR
 /begin AXIS_DESCR COM_AXIS MisfDet_nEngSync EngN 8 -16384.00 16383.50 FORMAT "%8.2" AXIS_PTS_REF MisfDet_dTqThdN_AX /end AXIS_DESCR
/end CHARACTERISTIC
/begin CHARACTERISTIC MisfDet_ignRndMax_C "range of combustions in which one misfire will be generated" VALUE 0x8057A9E8 RB_Val_Wu16 65535.00 OneToOne 0.00 65535.00 FORMAT "%8.2" /end CHARACTERISTIC
/begin CHARACTERISTIC MisfDet_maskACSel_C "Configuration of signal selection of climate control interface" VALUE 0x8057AD62 RB_Val_Wu8 255.0 OneToOne 0.00 255.0 FORMAT "%5.1" /end CHARACTERISTIC
/begin CHARACTERISTIC MisfDet_maskBlkGear_C "Bitmaske mit sperrenden Gangpositionen" VALUE 0x8057AD64 RB_Val_Wu16 65535.00 OneToOne 0.00 65535.00 FORMAT "%8.2" /end CHARACTERISTIC
/begin CHARACTERISTIC MisfDet_maskBlkOpMode_C "Bitmask with inhibiting GS operation modes" VALUE 0x8057AD66 RB_Val_Wu16 65535.00 OneToOne 0.00 65535.00 FORMAT "%8.2" /end CHARACTERISTIC
/begin CHARACTERISTIC MisfDet_maskCfgTrg_C "bitmask to configure trigger functionality" VALUE 0x8057A9EA RB_Val_Wu8 255.0 OneToOne 0.00 255.0 FORMAT "%5.1" /end CHARACTERISTIC
/begin CHARACTERISTIC MisfDet_maskDnAdpn.cntrHldNStrt_T "Mask with inhibiting conditions of temporary dN adaption No turn off delay / number of ignitions delay, engine speed dependent, at Engine start" CURVE 0x8057AF48 RB_Curve_S16_U8_Static 255.0 OneToOne 0.00 255.0 FORMAT "%5.1"
 /begin AXIS_DESCR STD_AXIS Epm_nEng EngN 4 -16384.00 16383.50 FORMAT "%8.2" DEPOSIT ABSOLUTE /end AXIS_DESCR
/end CHARACTERISTIC
/begin CHARACTERISTIC MisfDet_maskDnAdpn.cntrHldN_T "Mask with inhibiting conditions of temporary dN adaption No turn off delay / number of ignitions delay, engine speed dependent" CURVE 0x8057AF56 RB_Curve_S16_U8_Static 255.0 OneToOne 0.00 255.0 FORMAT "%5.1"
 /begin AXIS_DESCR STD_AXIS Epm_nEng EngN 4 -16384.00 16383.50 FORMAT "%8.2" DEPOSIT ABSOLUTE /end AXIS_DESCR
/end CHARACTERISTIC
/begin CHARACTERISTIC MisfDet_maskDnAdpn.cntrHldStrt_C "Mask with inhibiting conditions of temporary dN adaption No turn off delay / number of ignitions delay, at Engine start" VALUE 0x8057AF64 RB_Val_Wu8 255.0 OneToOne 0.00 255.0 FORMAT "%5.1" /end CHARACTERISTIC
/begin CHARACTERISTIC MisfDet_maskDnAdpn.cntrHld_C "Mask with inhibiting conditions of temporary dN adaption No turn off delay / number of ignitions delay" VALUE 0x8057AF65 RB_Val_Wu8 255.0 OneToOne 0.00 255.0 FORMAT "%5.1" /end CHARACTERISTIC
/begin CHARACTERISTIC MisfDet_maskDnAdpn.cntrStrtMax_C "Mask with inhibiting conditions of temporary dN adaption No turn off delay / Maximum ignition counter for engine start detection" VALUE 0x8057AF66 RB_Val_Wu16 65535.00 OneToOne 0.00 65535.00 FORMAT "%8.2" /end CHARACTERISTIC
/begin CHARACTERISTIC MisfDet_maskDnAdpn.CmbTyp.HldN_C "Mask with inhibiting conditions of temporary dN adaption No turn off delay / mask of selected disabling conditions, engine type specific / bit mask delayed conditions engine speed dependant" VALUE 0x8057AF6C RB_Val_Wu32 4294967295.00 OneToOne 0.00 4294967295.00 FORMAT "%13.2" /end CHARACTERISTIC
/begin CHARACTERISTIC MisfDet_maskDnAdpn.CmbTyp.Hld_C "Mask with inhibiting conditions of temporary dN adaption No turn off delay / mask of selected disabling conditions, engine type specific / bit mask delayed conditions" VALUE 0x8057AF70 RB_Val_Wu32 4294967295.00 OneToOne 0.00 4294967295.00 FORMAT "%13.2" /end CHARACTERISTIC
/begin CHARACTERISTIC MisfDet_maskDnAdpn.CmbTyp.Raw_C "Mask with inhibiting conditions of temporary dN adaption No turn off delay / mask of selected disabling conditions, engine type specific / bit mask not delayed conditions" VALUE 0x8057AF74 RB_Val_Wu32 4294967295.00 OneToOne 0.00 4294967295.00 FORMAT "%13.2" /end CHARACTERISTIC
/begin CHARACTERISTIC MisfDet_maskDnAdpn.Cmn.HldN_C "Mask with inhibiting conditions of temporary dN adaption No turn off delay / mask of selected disabling conditions / bit mask delayed conditions engine speed dependant" VALUE 0x8057AF7C RB_Val_Wu32 4294967295.00 OneToOne 0.00 4294967295.00 FORMAT "%13.2" /end CHARACTERISTIC
/begin CHARACTERISTIC MisfDet_maskDnAdpn.Cmn.Hld_C "Mask with inhibiting conditions of temporary dN adaption No turn off delay / mask of selected disabling conditions / bit mask delayed conditions" VALUE 0x8057AF80 RB_Val_Wu32 4294967295.00 OneToOne 0.00 4294967295.00 FORMAT "%13.2" /end CHARACTERISTIC
/begin CHARACTERISTIC MisfDet_maskDnAdpn.Cmn.Raw_C "Mask with inhibiting conditions of temporary dN adaption No turn off delay / mask of selected disabling conditions / bit mask not delayed conditions" VALUE 0x8057AF84 RB_Val_Wu32 4294967295.00 OneToOne 0.00 4294967295.00 FORMAT "%13.2" /end CHARACTERISTIC
/begin CHARACTERISTIC MisfDet_maskDnAdpnInitCmbTyp_C "Selection mask (combustion type dependent for initialisation of DnAdpnVal after stBlkDnAdpnNvCorrn was set" VALUE 0x8057A94C RB_Val_Wu32 4294967295.00 OneToOne 0.00 4294967295.00 FORMAT "%13.2" /end CHARACTERISTIC
/begin CHARACTERISTIC MisfDet_maskDnAdpnInit_C "Selection mask for initialisation of DnAdpnVal after stBlkDnAdpnNvCorrn was set" VALUE 0x8057A950 RB_Val_Wu32 4294967295.00 OneToOne 0.00 4294967295.00 FORMAT "%13.2" /end CHARACTERISTIC
/begin CHARACTERISTIC MisfDet_maskDnAdpnNv.cntrHldN_T "Mask with inhibiting conditions of storing dN adaption No turn off delay / number ignitions delay, engine speed dependant" CURVE 0x8057AFD8 RB_Curve_S16_U8_Static 255.0 OneToOne 0.00 255.0 FORMAT "%5.1"
 /begin AXIS_DESCR STD_AXIS Epm_nEng EngN 4 -16384.00 16383.50 FORMAT "%8.2" DEPOSIT ABSOLUTE /end AXIS_DESCR
/end CHARACTERISTIC
/begin CHARACTERISTIC MisfDet_maskDnAdpnNv.cntrHld_C "Mask with inhibiting conditions of storing dN adaption No turn off delay / number ignitions delay" VALUE 0x8057AFE6 RB_Val_Wu8 255.0 OneToOne 0.00 255.0 FORMAT "%5.1" /end CHARACTERISTIC
/begin CHARACTERISTIC MisfDet_maskDnAdpnNv.CmbTyp.HldN_C "Mask with inhibiting conditions of storing dN adaption No turn off delay / mask of selected disabling conditions, engine type specific / bit mask delayed conditions engine speed dependant" VALUE 0x8057AFEC RB_Val_Wu32 4294967295.00 OneToOne 0.00 4294967295.00 FORMAT "%13.2" /end CHARACTERISTIC
/begin CHARACTERISTIC MisfDet_maskDnAdpnNv.CmbTyp.Hld_C "Mask with inhibiting conditions of storing dN adaption No turn off delay / mask of selected disabling conditions, engine type specific / bit mask delayed conditions" VALUE 0x8057AFF0 RB_Val_Wu32 4294967295.00 OneToOne 0.00 4294967295.00 FORMAT "%13.2" /end CHARACTERISTIC
/begin CHARACTERISTIC MisfDet_maskDnAdpnNv.CmbTyp.Raw_C "Mask with inhibiting conditions of storing dN adaption No turn off delay / mask of selected disabling conditions, engine type specific / bit mask not delayed conditions" VALUE 0x8057AFF4 RB_Val_Wu32 4294967295.00 OneToOne 0.00 4294967295.00 FORMAT "%13.2" /end CHARACTERISTIC
/begin CHARACTERISTIC MisfDet_maskDnAdpnNv.CmbTyp2.HldN_C "Mask with inhibiting conditions of storing dN adaption No turn off delay / mask of selected disabling conditions, engine type specific / bit mask delayed conditions engine speed dependant" VALUE 0x8057AFFC RB_Val_Wu32 4294967295.00 OneToOne 0.00 4294967295.00 FORMAT "%13.2" /end CHARACTERISTIC
/begin CHARACTERISTIC MisfDet_maskDnAdpnNv.CmbTyp2.Hld_C "Mask with inhibiting conditions of storing dN adaption No turn off delay / mask of selected disabling conditions, engine type specific / bit mask delayed conditions" VALUE 0x8057B000 RB_Val_Wu32 4294967295.00 OneToOne 0.00 4294967295.00 FORMAT "%13.2" /end CHARACTERISTIC
/begin CHARACTERISTIC MisfDet_maskDnAdpnNv.CmbTyp2.Raw_C "Mask with inhibiting conditions of storing dN adaption No turn off delay / mask of selected disabling conditions, engine type specific / bit mask not delayed conditions" VALUE 0x8057B004 RB_Val_Wu32 4294967295.00 OneToOne 0.00 4294967295.00 FORMAT "%13.2" /end CHARACTERISTIC
/begin CHARACTERISTIC MisfDet_maskDnAdpnNv.Cmn.HldN_C "Mask with inhibiting conditions of storing dN adaption No turn off delay / mask of selected disabling conditions / bit mask delayed conditions engine speed dependant" VALUE 0x8057B00C RB_Val_Wu32 4294967295.00 OneToOne 0.00 4294967295.00 FORMAT "%13.2" /end CHARACTERISTIC
/begin CHARACTERISTIC MisfDet_maskDnAdpnNv.Cmn.Hld_C "Mask with inhibiting conditions of storing dN adaption No turn off delay / mask of selected disabling conditions / bit mask delayed conditions" VALUE 0x8057B010 RB_Val_Wu32 4294967295.00 OneToOne 0.00 4294967295.00 FORMAT "%13.2" /end CHARACTERISTIC
/begin CHARACTERISTIC MisfDet_maskDnAdpnNv.Cmn.Raw_C "Mask with inhibiting conditions of storing dN adaption No turn off delay / mask of selected disabling conditions / bit mask not delayed conditions" VALUE 0x8057B014 RB_Val_Wu32 4294967295.00 OneToOne 0.00 4294967295.00 FORMAT "%13.2" /end CHARACTERISTIC
/begin CHARACTERISTIC MisfDet_maskDnAdpnNvCorrn.cntrHld_C "Mask with inhibiting conditions for usage of stored dN adaption values / number ignitions delay" VALUE 0x8057AF8C RB_Val_Wu8 255.0 OneToOne 0.00 255.0 FORMAT "%5.1" /end CHARACTERISTIC
/begin CHARACTERISTIC MisfDet_maskDnAdpnNvCorrn.CmbTyp.Hld_C "Mask with inhibiting conditions for usage of stored dN adaption values / mask of selected disabling conditions, engine type specific / bit mask delayed conditions" VALUE 0x8057AF94 RB_Val_Wu32 4294967295.00 OneToOne 0.00 4294967295.00 FORMAT "%13.2" /end CHARACTERISTIC
/begin CHARACTERISTIC MisfDet_maskDnAdpnNvCorrn.CmbTyp.Raw_C "Mask with inhibiting conditions for usage of stored dN adaption values / mask of selected disabling conditions, engine type specific / bit mask not delayed conditions" VALUE 0x8057AF98 RB_Val_Wu32 4294967295.00 OneToOne 0.00 4294967295.00 FORMAT "%13.2" /end CHARACTERISTIC
/begin CHARACTERISTIC MisfDet_maskDnAdpnNvCorrn.Cmn.Hld_C "Mask with inhibiting conditions for usage of stored dN adaption values / mask of selected disabling conditions / bit mask delayed conditions" VALUE 0x8057AFA0 RB_Val_Wu32 4294967295.00 OneToOne 0.00 4294967295.00 FORMAT "%13.2" /end CHARACTERISTIC
/begin CHARACTERISTIC MisfDet_maskDnAdpnNvCorrn.Cmn.Raw_C "Mask with inhibiting conditions for usage of stored dN adaption values / mask of selected disabling conditions / bit mask not delayed conditions" VALUE 0x8057AFA4 RB_Val_Wu32 4294967295.00 OneToOne 0.00 4294967295.00 FORMAT "%13.2" /end CHARACTERISTIC
/begin CHARACTERISTIC MisfDet_maskDnAdpnPlaus.cntrHld_C "Mask with inhibiting conditions for plausibilisation of dn adaptation / number ignitions delay" VALUE 0x8057AFAC RB_Val_Wu8 255.0 OneToOne 0.00 255.0 FORMAT "%5.1" /end CHARACTERISTIC
/begin CHARACTERISTIC MisfDet_maskDnAdpnPlaus.CmbTyp.Hld_C "Mask with inhibiting conditions for plausibilisation of dn adaptation / mask of selected disabling conditions, engine type specific / bit mask delayed conditions" VALUE 0x8057AFB4 RB_Val_Wu32 4294967295.00 OneToOne 0.00 4294967295.00 FORMAT "%13.2" /end CHARACTERISTIC
/begin CHARACTERISTIC MisfDet_maskDnAdpnPlaus.CmbTyp.Raw_C "Mask with inhibiting conditions for plausibilisation of dn adaptation / mask of selected disabling conditions, engine type specific / bit mask not delayed conditions" VALUE 0x8057AFB8 RB_Val_Wu32 4294967295.00 OneToOne 0.00 4294967295.00 FORMAT "%13.2" /end CHARACTERISTIC
/begin CHARACTERISTIC MisfDet_maskDnAdpnPlaus.Cmn.Hld_C "Mask with inhibiting conditions for plausibilisation of dn adaptation / mask of selected disabling conditions / bit mask delayed conditions" VALUE 0x8057AFC0 RB_Val_Wu32 4294967295.00 OneToOne 0.00 4294967295.00 FORMAT "%13.2" /end CHARACTERISTIC
/begin CHARACTERISTIC MisfDet_maskDnAdpnPlaus.Cmn.Raw_C "Mask with inhibiting conditions for plausibilisation of dn adaptation / mask of selected disabling conditions / bit mask not delayed conditions" VALUE 0x8057AFC4 RB_Val_Wu32 4294967295.00 OneToOne 0.00 4294967295.00 FORMAT "%13.2" /end CHARACTERISTIC
/begin CHARACTERISTIC MisfDet_maskDnFltd.cntrHldN_T "Mask with inhibiting conditions of temporary dN adaption No turn off delay / number ignitions delay, engine speed dependant" CURVE 0x8057B168 RB_Curve_S16_U8_Static 255.0 OneToOne 0.00 255.0 FORMAT "%5.1"
 /begin AXIS_DESCR STD_AXIS Epm_nEng EngN 4 -16384.00 16383.50 FORMAT "%8.2" DEPOSIT ABSOLUTE /end AXIS_DESCR
/end CHARACTERISTIC
/begin CHARACTERISTIC MisfDet_maskDnFltd.cntrHld_C "Mask with inhibiting conditions of temporary dN adaption No turn off delay / number ignitions delay" VALUE 0x8057B176 RB_Val_Wu8 255.0 OneToOne 0.00 255.0 FORMAT "%5.1" /end CHARACTERISTIC
/begin CHARACTERISTIC MisfDet_maskDnFltd.CmbTyp.HldN_C "Mask with inhibiting conditions of temporary dN adaption No turn off delay / mask of selected disabling conditions, engine type specific / bit mask delayed conditions engine speed dependant" VALUE 0x8057B17C RB_Val_Wu32 4294967295.00 OneToOne 0.00 4294967295.00 FORMAT "%13.2" /end CHARACTERISTIC
/begin CHARACTERISTIC MisfDet_maskDnFltd.CmbTyp.Hld_C "Mask with inhibiting conditions of temporary dN adaption No turn off delay / mask of selected disabling conditions, engine type specific / bit mask delayed conditions" VALUE 0x8057B180 RB_Val_Wu32 4294967295.00 OneToOne 0.00 4294967295.00 FORMAT "%13.2" /end CHARACTERISTIC
/begin CHARACTERISTIC MisfDet_maskDnFltd.CmbTyp.Raw_C "Mask with inhibiting conditions of temporary dN adaption No turn off delay / mask of selected disabling conditions, engine type specific / bit mask not delayed conditions" VALUE 0x8057B184 RB_Val_Wu32 4294967295.00 OneToOne 0.00 4294967295.00 FORMAT "%13.2" /end CHARACTERISTIC
/begin CHARACTERISTIC MisfDet_maskDnFltd.Cmn.HldN_C "Mask with inhibiting conditions of temporary dN adaption No turn off delay / mask of selected disabling conditions / bit mask delayed conditions engine speed dependant" VALUE 0x8057B18C RB_Val_Wu32 4294967295.00 OneToOne 0.00 4294967295.00 FORMAT "%13.2" /end CHARACTERISTIC
/begin CHARACTERISTIC MisfDet_maskDnFltd.Cmn.Hld_C "Mask with inhibiting conditions of temporary dN adaption No turn off delay / mask of selected disabling conditions / bit mask delayed conditions" VALUE 0x8057B190 RB_Val_Wu32 4294967295.00 OneToOne 0.00 4294967295.00 FORMAT "%13.2" /end CHARACTERISTIC
/begin CHARACTERISTIC MisfDet_maskDnFltd.Cmn.Raw_C "Mask with inhibiting conditions of temporary dN adaption No turn off delay / mask of selected disabling conditions / bit mask not delayed conditions" VALUE 0x8057B194 RB_Val_Wu32 4294967295.00 OneToOne 0.00 4294967295.00 FORMAT "%13.2" /end CHARACTERISTIC
/begin CHARACTERISTIC MisfDet_maskMisfGenrCfg_C "bitmask to configure the misfire generator" VALUE 0x8057A9EB RB_Val_Wu8 255.0 OneToOne 0.00 255.0 FORMAT "%5.1" /end CHARACTERISTIC
/begin CHARACTERISTIC MisfDet_maskSegTiAdpn.CmbTyp.Raw_C "Mask with inhibiting conditions of segment time adaption during fuel on, no turn off delay / mask of selected disabling conditions, engine type specific / bit mask not delayed conditions" VALUE 0x8057B01C RB_Val_Wu32 4294967295.00 OneToOne 0.00 4294967295.00 FORMAT "%13.2" /end CHARACTERISTIC
/begin CHARACTERISTIC MisfDet_maskSegTiAdpn.CmbTyp2.Raw_C "Mask with inhibiting conditions of segment time adaption during fuel on, no turn off delay / mask of selected disabling conditions, engine type specific / bit mask not delayed conditions" VALUE 0x8057B024 RB_Val_Wu32 4294967295.00 OneToOne 0.00 4294967295.00 FORMAT "%13.2" /end CHARACTERISTIC
/begin CHARACTERISTIC MisfDet_maskSegTiAdpn.Cmn.Raw_C "Mask with inhibiting conditions of segment time adaption during fuel on, no turn off delay / mask of selected disabling conditions / bit mask not delayed conditions" VALUE 0x8057B02C RB_Val_Wu32 4294967295.00 OneToOne 0.00 4294967295.00 FORMAT "%13.2" /end CHARACTERISTIC
/begin CHARACTERISTIC MisfDet_maskSegTiAdpnFco.CmbTyp.Raw_C "Mask with inhibiting conditions of segment time adaption during fuel cut off / mask of selected disabling conditions, engine type specific / bit mask not delayed conditions" VALUE 0x8057AFCC RB_Val_Wu32 4294967295.00 OneToOne 0.00 4294967295.00 FORMAT "%13.2" /end CHARACTERISTIC
/begin CHARACTERISTIC MisfDet_maskSegTiAdpnFco.Cmn.Raw_C "Mask with inhibiting conditions of segment time adaption during fuel cut off / mask of selected disabling conditions / bit mask not delayed conditions" VALUE 0x8057AFD4 RB_Val_Wu32 4294967295.00 OneToOne 0.00 4294967295.00 FORMAT "%13.2" /end CHARACTERISTIC
/begin CHARACTERISTIC MisfDet_maskStc.cntrHldN_T "Mask with inhibiting conditions of statistical function, no turn off delay / number ignitions delay, engine speed dependant" CURVE 0x8057B198 RB_Curve_S16_U8_Static 255.0 OneToOne 0.00 255.0 FORMAT "%5.1"
 /begin AXIS_DESCR STD_AXIS Epm_nEng EngN 4 -16384.00 16383.50 FORMAT "%8.2" DEPOSIT ABSOLUTE /end AXIS_DESCR
/end CHARACTERISTIC
/begin CHARACTERISTIC MisfDet_maskStc.cntrHld_C "Mask with inhibiting conditions of statistical function, no turn off delay / number ignitions delay" VALUE 0x8057B1A6 RB_Val_Wu8 255.0 OneToOne 0.00 255.0 FORMAT "%5.1" /end CHARACTERISTIC
/begin CHARACTERISTIC MisfDet_maskStc.CmbTyp.HldN_C "Mask with inhibiting conditions of statistical function, no turn off delay / mask of selected disabling conditions, engine type specific / bit mask delayed conditions engine speed dependant" VALUE 0x8057B1AC RB_Val_Wu32 4294967295.00 OneToOne 0.00 4294967295.00 FORMAT "%13.2" /end CHARACTERISTIC
/begin CHARACTERISTIC MisfDet_maskStc.CmbTyp.Hld_C "Mask with inhibiting conditions of statistical function, no turn off delay / mask of selected disabling conditions, engine type specific / bit mask delayed conditions" VALUE 0x8057B1B0 RB_Val_Wu32 4294967295.00 OneToOne 0.00 4294967295.00 FORMAT "%13.2" /end CHARACTERISTIC
/begin CHARACTERISTIC MisfDet_maskStc.CmbTyp.Raw_C "Mask with inhibiting conditions of statistical function, no turn off delay / mask of selected disabling conditions, engine type specific / bit mask not delayed conditions" VALUE 0x8057B1B4 RB_Val_Wu32 4294967295.00 OneToOne 0.00 4294967295.00 FORMAT "%13.2" /end CHARACTERISTIC
/begin CHARACTERISTIC MisfDet_maskStc.Cmn.HldN_C "Mask with inhibiting conditions of statistical function, no turn off delay / mask of selected disabling conditionsmask of selected disabling conditions / bit mask delayed conditions engine speed dependant" VALUE 0x8057B1BC RB_Val_Wu32 4294967295.00 OneToOne 0.00 4294967295.00 FORMAT "%13.2" /end CHARACTERISTIC
/begin CHARACTERISTIC MisfDet_maskStc.Cmn.Hld_C "Mask with inhibiting conditions of statistical function, no turn off delay / mask of selected disabling conditionsmask of selected disabling conditions / bit mask delayed conditions" VALUE 0x8057B1C0 RB_Val_Wu32 4294967295.00 OneToOne 0.00 4294967295.00 FORMAT "%13.2" /end CHARACTERISTIC
/begin CHARACTERISTIC MisfDet_maskStc.Cmn.Raw_C "Mask with inhibiting conditions of statistical function, no turn off delay / mask of selected disabling conditionsmask of selected disabling conditions / bit mask not delayed conditions" VALUE 0x8057B1C4 RB_Val_Wu32 4294967295.00 OneToOne 0.00 4294967295.00 FORMAT "%13.2" /end CHARACTERISTIC
/begin AXIS_PTS MisfDet_n08TqZero_AX "grouped engine speed axis" 0x8057AD68 Epm_nEng RB_Axis_S16 32767.50 EngN 8 -16384.00 16383.50 FORMAT "%8.2" DEPOSIT ABSOLUTE /end AXIS_PTS
/begin CHARACTERISTIC MisfDet_nEngDnFltdZeroNoSegTiAdpn_C "Engine speed threshold to reset filtered engine roughness in case of incomplete segment time adaptation" VALUE 0x8057AD7A RB_Val_Ws16 32767.50 EngN -16384.00 16383.50 FORMAT "%8.2" /end CHARACTERISTIC
/begin CHARACTERISTIC MisfDet_nEngMax.Cmn_GT "Upper limit of allowed engine speed, gear dependant, / all transmission types" CURVE 0x8057B130 RB_CurveGroup_S16 32767.50 EngN -16384.00 16383.50 FORMAT "%8.2"
 /begin AXIS_DESCR COM_AXIS MisfDet_numGear OneToOne 11 -128.0 127.0 FORMAT "%5.1" AXIS_PTS_REF MisfDet_nEngMax_AX /end AXIS_DESCR
/end CHARACTERISTIC
/begin CHARACTERISTIC MisfDet_nEngMaxPedlEvln_C "max. engine speed for evaluation of the gradient of the accelerator pedal position" VALUE 0x8057AD7C RB_Val_Ws16 32767.50 EngN -16384.00 16383.50 FORMAT "%8.2" /end CHARACTERISTIC
/begin AXIS_PTS MisfDet_nEngMax_AX "distribution of upper limit of allowed engine speed" 0x8057AD7E MisfDet_numGear RB_Axis_S8 255.0 OneToOne 11 -128.0 127.0 FORMAT "%5.1" DEPOSIT ABSOLUTE /end AXIS_PTS
/begin CHARACTERISTIC MisfDet_nEngMin.Cmn_C "Lower limit of allowed engine speed / all transmission types" VALUE 0x8057B146 RB_Val_Ws16 32767.50 EngN -16384.00 16383.50 FORMAT "%8.2" /end CHARACTERISTIC
/begin CHARACTERISTIC MisfDet_nEngMinPedlEvln_C "min. engine speed for evaluation of the gradient of the accelerator pedal position" VALUE 0x8057AD8A RB_Val_Ws16 32767.50 EngN -16384.00 16383.50 FORMAT "%8.2" /end CHARACTERISTIC
/begin CHARACTERISTIC MisfDet_nrCmbDiCatHeat_C "number of ignitions for blank-out after a detected misfire under catalyst heat" VALUE 0x8057A9A4 RB_Val_Wu8 255.0 OneToOne 0.00 255.0 FORMAT "%5.1" /end CHARACTERISTIC
/begin CHARACTERISTIC MisfDet_nrCmbDi_M "number of ignitions of suppression after detected misfire" MAP 0x8057A9A6 RB_Map_U16S16_U8 255.0 OneToOne 0.00 255.0 FORMAT "%5.1"
 /begin AXIS_DESCR STD_AXIS MisfDet_tqBascSync rel_uw_b100 4 0.00 99.99847 FORMAT "%8.5" DEPOSIT ABSOLUTE /end AXIS_DESCR
 /begin AXIS_DESCR STD_AXIS MisfDet_nEngSync EngN 8 -16384.00 16383.50 FORMAT "%8.2" DEPOSIT ABSOLUTE /end AXIS_DESCR
/end CHARACTERISTIC
/begin CHARACTERISTIC MisfDet_nrCmbTest_C "duration of test-phase after detected misfire" VALUE 0x8057A9E2 RB_Val_Wu8 255.0 OneToOne 0.00 255.0 FORMAT "%5.1" /end CHARACTERISTIC
/begin CHARACTERISTIC MisfDet_nSetPLoDiffMax_C "maximum low idle control deviation for detection of open drivetrain" VALUE 0x8057A778 RB_Val_Ws16 32767.50 EngN -16384.00 16383.50 FORMAT "%8.2" /end CHARACTERISTIC
/begin CHARACTERISTIC MisfDet_offsNIdle_C "Offset to idle engine speed to activate zero torque condition" VALUE 0x8057AD8C RB_Val_Ws16 32767.50 EngN -16384.00 16383.50 FORMAT "%8.2" /end CHARACTERISTIC
/begin CHARACTERISTIC MisfDet_openPtDlyCntr_C "Debouncing for detection of open drive train" VALUE 0x8057A77A RB_Val_Wu8 255.0 OneToOne 0.00 255.0 FORMAT "%5.1" /end CHARACTERISTIC
/begin CHARACTERISTIC MisfDet_redStgDly_C "delay of informatino of reduction stage for calculation of torque" VALUE 0x8057A77B RB_Val_Wu8 4.000 OneToOne 0.00 4.000 FORMAT "%5.3" EXTENDED_LIMITS 0.00 255.0 /end CHARACTERISTIC
/begin CHARACTERISTIC MisfDet_stCfgOpenPt_C "configuration switch for detection of open drive train" VALUE 0x8057A77C RB_Val_Wu8 255.0 OneToOne 0.00 255.0 FORMAT "%5.1" /end CHARACTERISTIC
/begin CHARACTERISTIC MisfDet_stCmnMiscCfg_C "configuration switch CmnMisc" VALUE 0x8057A77D RB_Val_Wu8 255.0 OneToOne 0.00 255.0 FORMAT "%5.1" /end CHARACTERISTIC
/begin CHARACTERISTIC MisfDet_stDnAdpnCfgCal_C "configuration switch for calibration features" VALUE 0x8057A954 RB_Val_Wu8 255.0 OneToOne 0.00 255.0 FORMAT "%5.1" /end CHARACTERISTIC
/begin CHARACTERISTIC MisfDet_stDnAdpnCfg_C "configuration switch DnAdpn" VALUE 0x8057A955 RB_Val_Wu8 255.0 OneToOne 0.00 255.0 FORMAT "%5.1" /end CHARACTERISTIC
/begin CHARACTERISTIC MisfDet_stDnAdpnPlausCfg_C "configuration switch plaus checks" VALUE 0x8057A956 RB_Val_Wu8 255.0 OneToOne 0.00 255.0 FORMAT "%5.1" /end CHARACTERISTIC
/begin CHARACTERISTIC MisfDet_stDnCalcnCfg_C "configuration switch DnCalcn" VALUE 0x8057A9A2 RB_Val_Wu16 65535.00 OneToOne 0.00 65535.00 FORMAT "%8.2" /end CHARACTERISTIC
/begin CHARACTERISTIC MisfDet_stDnEvlnCfg_C "configuration switch DnEvln" VALUE 0x8057A9E3 RB_Val_Wu8 255.0 OneToOne 0.00 255.0 FORMAT "%5.1" /end CHARACTERISTIC
/begin CHARACTERISTIC MisfDet_stRelsCdnCfg_C "bit mask for selection of release condition" VALUE 0x8057AD8E RB_Val_Wu8 255.0 OneToOne 0.00 255.0 FORMAT "%5.1" /end CHARACTERISTIC
/begin CHARACTERISTIC MisfDet_strtMisfGenr_C "start of misfire generator" VALUE 0x8057A9EC RB_Val_Wu8 255.0 OneToOne 0.00 255.0 FORMAT "%5.1" /end CHARACTERISTIC
/begin CHARACTERISTIC MisfDet_stTqZeroIdleCfg_C "Configuration of switching from zero torque curve to zero" VALUE 0x8057AD8F RB_Val_Wu8 255.0 OneToOne 0.00 255.0 FORMAT "%5.1" /end CHARACTERISTIC
/begin CHARACTERISTIC MisfDet_swtOn_C "Switch to enable misfire detection" VALUE 0x8057AD90 RB_Val_Wu8 255.0 OneToOne 0.00 255.0 FORMAT "%5.1" /end CHARACTERISTIC
/begin CHARACTERISTIC MisfDet_tblMisfPat_FM "table for definition of misfire mode and pattern" MAP 0x8057A9EE RB_FixMap_S16S16_S16 65535.00 OneToOne -32768.00 32767.00 FORMAT "%8.2"
 /begin AXIS_DESCR FIX_AXIS MisfDet_idxMisfPat OneToOne 4 0.00 3.000 FORMAT "%5.3" FIX_AXIS_PAR 0 0 4 /end AXIS_DESCR
 /begin AXIS_DESCR FIX_AXIS MisfDet_idxMisfPat OneToOne 10 0.00 9.000 FORMAT "%5.3" FIX_AXIS_PAR 0 0 10 /end AXIS_DESCR
/end CHARACTERISTIC
/begin CHARACTERISTIC MisfDet_tEngDnAdpnMin_C "Temperature threshold for release of dN adaption function" VALUE 0x8057AD92 RB_Val_Ws16 6553.500 Temp_Cels -3549.940 3003.560 FORMAT "%8.3" /end CHARACTERISTIC
/begin CHARACTERISTIC MisfDet_tEngSegTiAdpnMin_C "Temperature threshold for release of segment time adaption functionality, fuel off" VALUE 0x8057AD94 RB_Val_Ws16 6553.500 Temp_Cels -3549.940 3003.560 FORMAT "%8.3" /end CHARACTERISTIC
/begin CHARACTERISTIC Misfdet_thdAgKnkCtrl_C "threshold maximum ignition-timing retardation" VALUE 0x8057AD96 RB_Val_Ws8 95.25 kw_q0p75 0.00 95.25 FORMAT "%5.2" EXTENDED_LIMITS -96.00 95.25 /end CHARACTERISTIC
/begin CHARACTERISTIC Misfdet_thdDeltaAgIgnBas_M "Threshold delta ignition angle to bas ignition angle" MAP 0x8057AD98 RB_Map_U16S16_S8 191.3 kw_q0p75 -96.00 95.25 FORMAT "%5.2"
 /begin AXIS_DESCR STD_AXIS MisfDet_tqBasc rel_uw_b100 8 0.00 99.99847 FORMAT "%8.5" DEPOSIT ABSOLUTE /end AXIS_DESCR
 /begin AXIS_DESCR STD_AXIS Epm_nEng EngN 8 -16384.00 16383.50 FORMAT "%8.2" DEPOSIT ABSOLUTE /end AXIS_DESCR
/end CHARACTERISTIC
/begin CHARACTERISTIC MisfDet_thdNEngStrt_C "Threshold of engine speed to detect engine start" VALUE 0x8057ADFC RB_Val_Ws16 32767.50 EngN -16384.00 16383.50 FORMAT "%8.2" /end CHARACTERISTIC
/begin CHARACTERISTIC Misfdet_thdrLamS1B_C "Threshold for lambda actual value from sensor 1 of bank 1 and 2" VALUE 0x8057ADFE RB_Val_Wu16 15.99976 fak_uw_b16 0.00 15.99976 FORMAT "%8.5" /end CHARACTERISTIC
/begin CHARACTERISTIC MisfDet_thdTEngDetnEna_C "Temperature threshold for release of statistics and adaption functions" VALUE 0x8057AE00 RB_Val_Ws16 6553.500 Temp_Cels -3549.940 3003.560 FORMAT "%8.3" /end CHARACTERISTIC
/begin CHARACTERISTIC MisfDet_thdTEngDetnStrt_C "Temperature threshold for release of statistics and adaption functions" VALUE 0x8057AE02 RB_Val_Ws16 6553.500 Temp_Cels -3549.940 3003.560 FORMAT "%8.3" /end CHARACTERISTIC
/begin CHARACTERISTIC MisfDet_thdTqZeroDrv.Cmn_GT "Threshold zero torque at crankshaft driving state / all transmission types" CURVE 0x8057B148 RB_CurveGroup_U16 99.99847 rel_uw_b100 0.00 99.99847 FORMAT "%8.5"
 /begin AXIS_DESCR COM_AXIS Epm_nEng EngN 8 -16384.00 16383.50 FORMAT "%8.2" AXIS_PTS_REF MisfDet_n08TqZero_AX /end AXIS_DESCR
/end CHARACTERISTIC
/begin CHARACTERISTIC MisfDet_thdTqZeroFlreDwn_C "Threshold zero torque at crankshaft, during flare down phase of engine speed" VALUE 0x8057AE04 RB_Val_Wu16 99.99847 rel_uw_b100 0.00 99.99847 FORMAT "%8.5" /end CHARACTERISTIC
/begin CHARACTERISTIC MisfDet_thdTqZeroIdle.Cmn_GT "Threshold zero torque at crankshaft idle state / all transmission types" CURVE 0x8057B158 RB_CurveGroup_U16 99.99847 rel_uw_b100 0.00 99.99847 FORMAT "%8.5"
 /begin AXIS_DESCR COM_AXIS Epm_nEng EngN 8 -16384.00 16383.50 FORMAT "%8.2" AXIS_PTS_REF MisfDet_n08TqZero_AX /end AXIS_DESCR
/end CHARACTERISTIC
/begin CHARACTERISTIC MisfDet_thdTrgVal_C "threshold value for trigger functionality" VALUE 0x8057AA40 RB_Val_Wu32 4294967295.00 OneToOne 0.00 4294967295.00 FORMAT "%13.2" /end CHARACTERISTIC
/begin CHARACTERISTIC MisfDet_tiTrsmCorr_M "Correction map for initialisation of the drivetrain temperature model" MAP 0x8057AE06 RB_Map_S16U16_U16 65535.00 Time_sec_q1_COMPU 0.00 65535.00 FORMAT "%8.2"
 /begin AXIS_DESCR STD_AXIS EnvT_t Temp_Cels 6 -3549.940 3003.560 FORMAT "%8.3" DEPOSIT ABSOLUTE /end AXIS_DESCR
 /begin AXIS_DESCR STD_AXIS MisfDet_tiEngOff Time_sec_q1_COMPU 6 0.00 65535.00 FORMAT "%8.2" DEPOSIT ABSOLUTE /end AXIS_DESCR
/end CHARACTERISTIC
/begin CHARACTERISTIC MisfDet_tiTrsmMax_C "Saturation of the modelled activation time for transmission line" VALUE 0x8057AE6A RB_Val_Wu16 65535.00 Time_sec_q1_COMPU 0.00 65535.00 FORMAT "%8.2" /end CHARACTERISTIC
/begin CHARACTERISTIC MisfDet_tiTrsmMin_T "Threshold for time in which transmission is in heat up conditions" CURVE 0x8057AE6C RB_Curve_S16_U16_Static 10485.60 TimeRed 0.00 10485.60 FORMAT "%8.2"
 /begin AXIS_DESCR STD_AXIS EnvT_t Temp_Cels 4 -3549.940 3003.560 FORMAT "%8.3" DEPOSIT ABSOLUTE /end AXIS_DESCR
/end CHARACTERISTIC
/begin CHARACTERISTIC MisfDet_tqNrm_C "normalisation torque" VALUE 0x8057A77E RB_Val_Ws16 6553.500 Trq -3276.800 3276.700 FORMAT "%8.3" /end CHARACTERISTIC
/begin CHARACTERISTIC MisfDet_tqTrsmMin_C "minimum engine torque, to rise transmission temperature" VALUE 0x8057AE7E RB_Val_Wu16 99.99847 rel_uw_b100 0.00 99.99847 FORMAT "%8.5" /end CHARACTERISTIC
/begin CHARACTERISTIC MisfDet_tqZeroCorrnAlti_M "Map for zero torque correction, engine speed and altitude dependant" MAP 0x8057AE80 RB_Map_S16U8_S16 99.99847 rel_uw_b100 -50.00000 49.99847 FORMAT "%8.5"
 /begin AXIS_DESCR STD_AXIS Epm_nEng EngN 5 -16384.00 16383.50 FORMAT "%8.2" DEPOSIT ABSOLUTE /end AXIS_DESCR
 /begin AXIS_DESCR STD_AXIS MisfDet_facEnvP fak_ub_b4 2 0.00 3.984 FORMAT "%5.3" DEPOSIT ABSOLUTE /end AXIS_DESCR
/end CHARACTERISTIC
/begin CHARACTERISTIC MisfDet_tqZeroCorrnTEng_M "Map for zero torque correction, engine speed and engine temperature dependant" MAP 0x8057AEA4 RB_Map_S16S16_U16 99.99847 rel_uw_b100 0.00 99.99847 FORMAT "%8.5"
 /begin AXIS_DESCR STD_AXIS Epm_nEng EngN 8 -16384.00 16383.50 FORMAT "%8.2" DEPOSIT ABSOLUTE /end AXIS_DESCR
 /begin AXIS_DESCR STD_AXIS MisfDet_tEng Temp_Cels 8 -3549.940 3003.560 FORMAT "%8.3" DEPOSIT ABSOLUTE /end AXIS_DESCR
/end CHARACTERISTIC
/begin CHARACTERISTIC NENGMSVRECURH "Engine Speed Deviation limit for activation of Reduced Current Control" VALUE 0x8057A770 RB_Val_Ws16 320.0000 EngN 0.00 320.0000 FORMAT "%8.4" EXTENDED_LIMITS -16384.00 16383.50 /end CHARACTERISTIC
/begin CHARACTERISTIC NENGMSVRECURS "Engine Speed Threshold for activation of Reduced Current Control" VALUE 0x8057A772 RB_Val_Ws16 1800.000 EngN 0.00 1800.000 FORMAT "%8.3" EXTENDED_LIMITS -16384.00 16383.50 /end CHARACTERISTIC
/begin CHARACTERISTIC TPRMNMSVMX "Max. time for extending holding phase of mass flow valve at low rail pressures" VALUE 0x8057A774 RB_Val_Ws32 4294.96729500 Time_Dt -2147.48364800 2147.48364700 FORMAT "%13.8" /end CHARACTERISTIC
/begin MEASUREMENT B_abgien_msg "condition end of 1000 CR interval" UBYTE B_TRUE 1 100 0.00 1.00000000000 BIT_MASK 0x1 FORMAT "%13.11" ECU_ADDRESS 0x6000F8F0 /end MEASUREMENT
/begin MEASUREMENT B_cntmde_msg "Conditions for incrementing failure counters for a detected misfire." UBYTE B_TRUE 1 100 0.00 1.00000000000 BIT_MASK 0x1 FORMAT "%13.11" ECU_ADDRESS 0x70005485 /end MEASUREMENT
/begin MEASUREMENT B_dlutsk_msg "difference engine roughness exceeds threshold in current operation area" UBYTE B_TRUE 1 100 0.00 1.00000000000 BIT_MASK 0x1 FORMAT "%13.11" ECU_ADDRESS 0x50005FFD /end MEASUREMENT
/begin MEASUREMENT B_dmddiszg_msg "DMD disable condition for cylinder fuel imbalance adaptation in homogenous mode" UBYTE B_TRUE 1 100 0.00 1.00000000000 BIT_MASK 0x1 FORMAT "%13.11" ECU_ADDRESS 0x70005486 /end MEASUREMENT
/begin MEASUREMENT B_fofadpen_msg "condition fuel-off adaptation is enabled" UBYTE B_TRUE 1 100 0.00 1.00000000000 BIT_MASK 0x1 FORMAT "%13.11" ECU_ADDRESS 0x70005487 /end MEASUREMENT
/begin MEASUREMENT B_fofresf_msg "Reset of Fuel-Off-Adaptation performed" UBYTE B_TRUE 1 100 0.00 1.00000000000 BIT_MASK 0x1 FORMAT "%13.11" ECU_ADDRESS 0x6000F8EF /end MEASUREMENT
/begin MEASUREMENT B_fofrkh_msg "cond. fuel-off adaptation for catalyst heating ready" UBYTE B_TRUE 1 100 0.00 1.00000000000 BIT_MASK 0x1 FORMAT "%13.11" ECU_ADDRESS 0x6000F8EE /end MEASUREMENT
/begin MEASUREMENT B_fofrun_msg "state fuel-off adaptation active" UBYTE B_TRUE 1 100 0.00 1.00000000000 BIT_MASK 0x1 FORMAT "%13.11" ECU_ADDRESS 0x70005489 /end MEASUREMENT
/begin MEASUREMENT B_fofr_msg "cond. fuel-off adaptation in actual speed range ready" UBYTE B_TRUE 1 100 0.00 1.00000000000 BIT_MASK 0x1 FORMAT "%13.11" ECU_ADDRESS 0x70005488 /end MEASUREMENT
/begin MEASUREMENT B_fonr_msg "condition fuel-on adaptation actual ready" UBYTE B_TRUE 1 100 0.00 1.00000000000 BIT_MASK 0x1 FORMAT "%13.11" ECU_ADDRESS 0x7000548A /end MEASUREMENT
/begin MEASUREMENT B_forun_msg "state fuel-on/-off adaptation active" UBYTE B_TRUE 1 100 0.00 1.00000000000 BIT_MASK 0x1 FORMAT "%13.11" ECU_ADDRESS 0x6000F8ED /end MEASUREMENT
/begin MEASUREMENT B_lutsk_msg "engine roughness exceeds threshold in current operation area" UBYTE B_TRUE 1 100 0.00 1.00000000000 BIT_MASK 0x1 FORMAT "%13.11" ECU_ADDRESS 0x50005FFE /end MEASUREMENT
/begin MEASUREMENT B_mdarv_msg "critical misfire rate detected" UBYTE B_TRUE 1 100 0.00 1.00000000000 BIT_MASK 0x1 FORMAT "%13.11" ECU_ADDRESS 0x60014106 /end MEASUREMENT
/begin MEASUREMENT B_mderk_msg "misfiring detected from multiple functions" UBYTE B_TRUE 1 100 0.00 1.00000000000 BIT_MASK 0x1 FORMAT "%13.11" ECU_ADDRESS 0x50006000 /end MEASUREMENT
/begin MEASUREMENT B_mdkat_msg "cat. damaging misfire rate exceeded (for deactivation of other functions)" UBYTE B_TRUE 1 100 0.00 1.00000000000 BIT_MASK 0x1 FORMAT "%13.11" ECU_ADDRESS 0x60014107 /end MEASUREMENT
/begin MEASUREMENT B_mdmi_msg "Condition misfire detection low load-threshold" UBYTE B_TRUE 1 100 0.00 1.00000000000 BIT_MASK 0x1 FORMAT "%13.11" ECU_ADDRESS 0x6000F8EC /end MEASUREMENT
/begin MEASUREMENT B_mdstop_msg "misfire detection stop" UBYTE B_TRUE 1 100 0.00 1.00000000000 BIT_MASK 0x1 FORMAT "%13.11" ECU_ADDRESS 0x50006001 /end MEASUREMENT
/begin MEASUREMENT B_milstp_msg "statistic of misfire detection (DMDMIL) stop" UBYTE B_TRUE 1 100 0.00 1.00000000000 BIT_MASK 0x1 FORMAT "%13.11" ECU_ADDRESS 0x60014108 /end MEASUREMENT
/begin MEASUREMENT B_MisfCont_msg "Misfire in several consecutive working cycles detected" UBYTE B_TRUE 1 100 0.00 1.00000000000 BIT_MASK 0x1 FORMAT "%13.11" ECU_ADDRESS 0x6000F8F1 /end MEASUREMENT
/begin MEASUREMENT B_msvrecur_msg "Condition: Reduced Current control active" UBYTE B_TRUE 1 100 0.00 1.00000000000 BIT_MASK 0x1 FORMAT "%13.11" ECU_ADDRESS 0x70000B63 /end MEASUREMENT
/begin MEASUREMENT B_swe_msg "Condition rough road detected" UBYTE B_TRUE 1 100 0.00 1.00000000000 BIT_MASK 0x1 FORMAT "%13.11" ECU_ADDRESS 0x50006004 /end MEASUREMENT
/begin MEASUREMENT B_tsbready_msg "condition segment duration plausible" UBYTE B_TRUE 1 100 0.00 1.00000000000 BIT_MASK 0x1 FORMAT "%13.11" ECU_ADDRESS 0x6000F8EB /end MEASUREMENT
/begin MEASUREMENT B_tsroov_msg "condition segment duration word overflow" UBYTE B_TRUE 1 100 0.00 1.00000000000 BIT_MASK 0x1 FORMAT "%13.11" ECU_ADDRESS 0x6000F8EA /end MEASUREMENT
/begin MEASUREMENT dwmsvo_w_msg "angle end of control MSV (opening)" SWORD kw_q0p1 1 100 -3276.800 3276.700 FORMAT "%8.3" ECU_ADDRESS 0x60008D9E /end MEASUREMENT
/begin MEASUREMENT dwmsvs_w_msg "angle begin of control MSV including pick-up delay (closing)" UWORD kw_q0p1 1 100 0.00 6553.500 FORMAT "%8.3" ECU_ADDRESS 0x60008B2E /end MEASUREMENT
/begin MEASUREMENT ErrLmp_stMIL "MIL status indicator" UBYTE OneToOne 1 100 0.00 255.0 FORMAT "%5.1" ECU_ADDRESS 0x60014134 /end MEASUREMENT
/begin MEASUREMENT flgmdkatbnk_msg "exhaust bank individual statusbyte for cat. damaging misfire rate exceeded" UBYTE dez 1 100 0.00 255.0 FORMAT "%5.1" ECU_ADDRESS 0x6000F2F8 /end MEASUREMENT
/begin MEASUREMENT flgstign_w_msg "flagword for stimulated ignition misfires" UWORD dez 1 100 0.00 65535.00 FORMAT "%8.2" ECU_ADDRESS 0x500008C8 /end MEASUREMENT
/begin MEASUREMENT flgstinj_w_msg "flagword for stimulated injection misfires" UWORD dez 1 100 0.00 65535.00 FORMAT "%8.2" ECU_ADDRESS 0x500008CA /end MEASUREMENT
/begin MEASUREMENT flgtiab_msg "state flag fuel cutoff by catalyst damaging misfiring rates" UBYTE dez 1 100 0.00 255.0 FORMAT "%5.1" ECU_ADDRESS 0x6000099E /end MEASUREMENT
/begin MEASUREMENT fofstat_msg "state of fuel-off adaptation in actual map range" UBYTE dez 1 100 0.00 255.0 FORMAT "%5.1" ECU_ADDRESS 0x500009BC /end MEASUREMENT
/begin MEASUREMENT fonstat_msg "state of fuel-on adaptation in actual map range" UBYTE dez 1 100 0.00 255.0 FORMAT "%5.1" ECU_ADDRESS 0x7000365D /end MEASUREMENT
/begin MEASUREMENT fsr_w_msg "array of adaptation values for all cylinders" SWORD lu_MEx 1 100 -232.8306 232.8235 FORMAT "%8.4" ARRAY_SIZE 4 ECU_ADDRESS 0x70003A12 /end MEASUREMENT
/begin MEASUREMENT fzabgs_w_msg "fault counter, summary, counts emission relevant misfirings of all cylinders" UWORD dez 1 100 0.00 65535.00 FORMAT "%8.2" ECU_ADDRESS 0x600007BA /end MEASUREMENT
/begin MEASUREMENT fzabgzyl_w_msg "DMD counter in exhaust intervall" UWORD dez 1 100 0.00 65535.00 FORMAT "%8.2" ARRAY_SIZE 4 ECU_ADDRESS 0x500006B8 /end MEASUREMENT
/begin MEASUREMENT fzkatsb_w_msg "counter for catalyst damaging misfire per cylinder bank" UWORD dez 1 100 0.00 65535.00 FORMAT "%8.2" ARRAY_SIZE 1 ECU_ADDRESS 0x7000379C /end MEASUREMENT
/begin MEASUREMENT fzkats_w_msg "fault counter, summary, counts catalyst damaging misfirings of all cylinders for message" UWORD dez 1 100 0.00 65535.00 FORMAT "%8.2" ECU_ADDRESS 0x7000379E /end MEASUREMENT
/begin MEASUREMENT fzkatzyl_w_msg "weighted misfire counter for determination of catalyst damage" UWORD dez 1 100 0.00 65535.00 FORMAT "%8.2" ARRAY_SIZE 4 ECU_ADDRESS 0x500006C0 /end MEASUREMENT
/begin MEASUREMENT fzmdzyl_w_msg "array for number of misfire per cylinder" UWORD dez 1 100 0.00 65535.00 FORMAT "%8.2" ARRAY_SIZE 4 ECU_ADDRESS 0x70003794 /end MEASUREMENT
/begin MEASUREMENT ivzabg_w_msg "interval counter for emission relevant faults (0 - 1000 crankshaft revolutions)" UWORD dez 1 100 0.00 65535.00 FORMAT "%8.2" ECU_ADDRESS 0x70003792 /end MEASUREMENT
/begin MEASUREMENT ivzkat_w_msg "interval counter for catalyst damaging misfirings (0 - 200 crankshaft revs.)" UWORD dez 1 100 0.00 65535.00 FORMAT "%8.2" ECU_ADDRESS 0x70003790 /end MEASUREMENT
/begin MEASUREMENT lutsinvala_l_msg "bit-structure for delayed condition luts-signal invalid" ULONG dez 1 100 0.00 4294967295.00 FORMAT "%13.2" ECU_ADDRESS 0x60000560 /end MEASUREMENT
/begin MEASUREMENT lutsinvala_msg "bit-structure for delayed condition luts-signal invalid" UWORD dez 1 100 0.00 65535.00 FORMAT "%8.2" ECU_ADDRESS 0x7000378A /end MEASUREMENT
/begin MEASUREMENT lutskzyl_w_msg "engine roughness test value, corrected, array with all cylinders" SWORD lu_MEx 1 100 -232.8306 232.8235 FORMAT "%8.4" ARRAY_SIZE 4 ECU_ADDRESS 0x700039E8 /end MEASUREMENT
/begin MEASUREMENT lutsk_w_msg "engine roughness test value, corrected" SWORD lu_MEx 1 100 -232.8306 232.8235 FORMAT "%8.4" ECU_ADDRESS 0x700039F0 /end MEASUREMENT
/begin MEASUREMENT lutszyl_w_msg "engine roughness test value, array with all cylinders" SWORD lu_MEx 1 100 -232.8306 232.8235 FORMAT "%8.4" ARRAY_SIZE 4 ECU_ADDRESS 0x700039E0 /end MEASUREMENT
/begin MEASUREMENT luts_w_msg "engine roughness test value" SWORD lu_MEx 1 100 -232.8306 232.8235 FORMAT "%8.4" ECU_ADDRESS 0x500008DE /end MEASUREMENT
/begin MEASUREMENT mfh_angleEnd "End angle" ULONG dez 1 100 0.00 4294967295.00 FORMAT "%13.2" ECU_ADDRESS 0x60002710 /end MEASUREMENT
/begin MEASUREMENT mfh_angleEndPhase3 "Debug information: end angle phase 3" ULONG dez 1 100 0.00 4294967295.00 FORMAT "%13.2" ECU_ADDRESS 0x6000270C /end MEASUREMENT
/begin MEASUREMENT mfh_angleNextTDCEndOfCntrl "Next calculated TDC at end of control" ULONG dez 1 100 0.00 4294967295.00 FORMAT "%13.2" ECU_ADDRESS 0x60002708 /end MEASUREMENT
/begin MEASUREMENT mfh_angleNextTDCLead "Next calculated TDC at Lead" ULONG dez 1 100 0.00 4294967295.00 FORMAT "%13.2" ECU_ADDRESS 0x60002704 /end MEASUREMENT
/begin MEASUREMENT mfh_angleStart "Start angle" ULONG dez 1 100 0.00 4294967295.00 FORMAT "%13.2" ECU_ADDRESS 0x60002700 /end MEASUREMENT
/begin MEASUREMENT mfh_angleStartLead "Start angle lead" ULONG dez 1 100 0.00 4294967295.00 FORMAT "%13.2" ECU_ADDRESS 0x600026FC /end MEASUREMENT
/begin MEASUREMENT Mfh_CntrChlFinshdActd "Counter of finished mass flow valve control actuations" UWORD OneToOne 1 100 0.00 65535.00 FORMAT "%8.2" ECU_ADDRESS 0x60006A56 /end MEASUREMENT
/begin MEASUREMENT mfh_currentAngle "Current angle" ULONG dez 1 100 0.00 4294967295.00 FORMAT "%13.2" ECU_ADDRESS 0x600026F8 /end MEASUREMENT
/begin MEASUREMENT mfh_currentAnglePre "Current angle lead" ULONG dez 1 100 0.00 4294967295.00 FORMAT "%13.2" ECU_ADDRESS 0x600026F4 /end MEASUREMENT
/begin MEASUREMENT mfh_currentTime "Current time" ULONG dez 1 100 0.00 4294967295.00 FORMAT "%13.2" ECU_ADDRESS 0x600026F0 /end MEASUREMENT
/begin MEASUREMENT mfh_currentTimePre "Current time lead" ULONG dez 1 100 0.00 4294967295.00 FORMAT "%13.2" ECU_ADDRESS 0x600026EC /end MEASUREMENT
/begin MEASUREMENT mfh_deltaAngle "Delta angle" ULONG dez 1 100 0.00 4294967295.00 FORMAT "%13.2" ECU_ADDRESS 0x600026E8 /end MEASUREMENT
/begin MEASUREMENT mfh_deltaTime "Delta time" ULONG dez 1 100 0.00 4294967295.00 FORMAT "%13.2" ECU_ADDRESS 0x600026E4 /end MEASUREMENT
/begin MEASUREMENT mfh_initCnt "Counter init" UBYTE dez 1 100 0.00 255.0 FORMAT "%5.1" ECU_ADDRESS 0x6000AEF8 /end MEASUREMENT
/begin MEASUREMENT mfh_lobeNr "Lobe number" UBYTE dez 1 100 0.00 255.0 FORMAT "%5.1" ARRAY_SIZE 1 ECU_ADDRESS 0x6000AEF7 /end MEASUREMENT
/begin MEASUREMENT mfh_numCamReal "number of cams that is used to control the high pressure pump (HDP)" UBYTE dez 1 100 0.00 255.0 FORMAT "%5.1" ECU_ADDRESS 0x6000AEF6 /end MEASUREMENT
/begin MEASUREMENT mfh_setupFuture "Setup future" UBYTE dez 1 100 0.00 255.0 FORMAT "%5.1" ECU_ADDRESS 0x6000AEF5 /end MEASUREMENT
/begin MEASUREMENT mfh_setupPast "Setup past" UBYTE dez 1 100 0.00 255.0 FORMAT "%5.1" ECU_ADDRESS 0x6000AEF4 /end MEASUREMENT
/begin MEASUREMENT mfh_startCnt "Counter start" UBYTE dez 1 100 0.00 255.0 FORMAT "%5.1" ARRAY_SIZE 1 ECU_ADDRESS 0x6000AEF3 /end MEASUREMENT
/begin MEASUREMENT mfh_stopCnt "Counter stop" UBYTE dez 1 100 0.00 255.0 FORMAT "%5.1" ARRAY_SIZE 1 ECU_ADDRESS 0x6000AEF2 /end MEASUREMENT
/begin MEASUREMENT mfh_stopHardCnt "Counter stop hard" UBYTE dez 1 100 0.00 255.0 FORMAT "%5.1" ARRAY_SIZE 1 ECU_ADDRESS 0x6000AEF1 /end MEASUREMENT
/begin MEASUREMENT mfh_timeEnd "endtime" ULONG dez 1 100 0.00 4294967295.00 FORMAT "%13.2" ARRAY_SIZE 1 ECU_ADDRESS 0x600026E0 /end MEASUREMENT
/begin MEASUREMENT mfh_timeStart "Time start" ULONG dez 1 100 0.00 4294967295.00 FORMAT "%13.2" ECU_ADDRESS 0x600026DC /end MEASUREMENT
/begin MEASUREMENT mfh_timeSwitch "Time switch" ULONG dez 1 100 0.00 4294967295.00 FORMAT "%13.2" ECU_ADDRESS 0x600026D8 /end MEASUREMENT
/begin MEASUREMENT MfPsDia_bstClockOk_msg "Clock mass flow valve powerstage OK" UBYTE B_TRUE 1 100 0.00 1.00000000000 BIT_MASK 0x1 FORMAT "%13.11" ECU_ADDRESS 0x7000081F /end MEASUREMENT
/begin MEASUREMENT MfPsDia_ctrErr_Clock_u8 "Mass flow valve powerstage error counter clock" UBYTE dez 1 100 0.00 255.0 FORMAT "%5.1" ARRAY_SIZE 1 ECU_ADDRESS 0x6000AEF0 /end MEASUREMENT
/begin MEASUREMENT MfPsDia_ctrErr_SpiInit_u8 "Mass flow valve powerstage error counter SPI Ini" UBYTE dez 1 100 0.00 255.0 FORMAT "%5.1" ARRAY_SIZE 1 ECU_ADDRESS 0x6000AEEF /end MEASUREMENT
/begin MEASUREMENT MfPsDia_ctrErr_SpiReq_u8 "Mass flow valve powerstage error counter SPI request denied (queue full)" UBYTE dez 1 100 0.00 255.0 FORMAT "%5.1" ARRAY_SIZE 1 ECU_ADDRESS 0x6000AEEE /end MEASUREMENT
/begin MEASUREMENT MfPsDia_ctrErr_SpiTx_u8 "Mass flow valve powerstage error counter SPI Tx" UBYTE dez 1 100 0.00 255.0 FORMAT "%5.1" ARRAY_SIZE 1 ECU_ADDRESS 0x6000AEED /end MEASUREMENT
/begin MEASUREMENT MfPsDia_ctrOlDsmDef "Mass flow valve powerstage error counter Open Load" UBYTE dez 1 100 0.00 255.0 FORMAT "%5.1" ARRAY_SIZE 1 ECU_ADDRESS 0x6000AEEC /end MEASUREMENT
/begin MEASUREMENT MfPsDia_ctrOlDsmOk "Mass flow valve powerstage OK counter Open Load" UBYTE dez 1 100 0.00 255.0 FORMAT "%5.1" ARRAY_SIZE 1 ECU_ADDRESS 0x6000AEEB /end MEASUREMENT
/begin MEASUREMENT MfPsDia_ctrScBatBankDsmDef "Mass flow valve powerstage error counter sc. battery bank" UBYTE dez 1 100 0.00 255.0 FORMAT "%5.1" ARRAY_SIZE 1 ECU_ADDRESS 0x6000AEEA /end MEASUREMENT
/begin MEASUREMENT MfPsDia_ctrScBatHiSDsmDef "Mass flow valve powerstage error counter sc. battery High-Side" UBYTE dez 1 100 0.00 255.0 FORMAT "%5.1" ARRAY_SIZE 1 ECU_ADDRESS 0x6000AEE9 /end MEASUREMENT
/begin MEASUREMENT MfPsDia_ctrScBatHiSDsmOk "Mass flow valve powerstage OK counter sc. battery High-Side" UBYTE dez 1 100 0.00 255.0 FORMAT "%5.1" ARRAY_SIZE 1 ECU_ADDRESS 0x6000AEE8 /end MEASUREMENT
/begin MEASUREMENT MfPsDia_ctrScBatLoSDsmDef "Mass flow valve powerstage error counter sc. battery Low-Side" UBYTE dez 1 100 0.00 255.0 FORMAT "%5.1" ARRAY_SIZE 1 ECU_ADDRESS 0x6000AEE7 /end MEASUREMENT
/begin MEASUREMENT MfPsDia_ctrScBatLoSDsmOk "Mass flow valve powerstage OK counter sc. battery Low-Side" UBYTE dez 1 100 0.00 255.0 FORMAT "%5.1" ARRAY_SIZE 1 ECU_ADDRESS 0x6000AEE6 /end MEASUREMENT
/begin MEASUREMENT MfPsDia_ctrScGndBankDsmDef "Mass flow valve powerstage error counter sc. ground bank" UBYTE dez 1 100 0.00 255.0 FORMAT "%5.1" ARRAY_SIZE 1 ECU_ADDRESS 0x6000AEE5 /end MEASUREMENT
/begin MEASUREMENT MfPsDia_ctrScGndHiSDsmDef "Mass flow valve powerstage error counter sc. ground High-Side" UBYTE dez 1 100 0.00 255.0 FORMAT "%5.1" ARRAY_SIZE 1 ECU_ADDRESS 0x6000AEE4 /end MEASUREMENT
/begin MEASUREMENT MfPsDia_ctrScGndHiSDsmOk "Mass flow valve powerstage OK counter sc. ground High-Side" UBYTE dez 1 100 0.00 255.0 FORMAT "%5.1" ARRAY_SIZE 1 ECU_ADDRESS 0x6000AEE3 /end MEASUREMENT
/begin MEASUREMENT MfPsDia_ctrScGndLoSDsmDef "Mass flow valve powerstage error counter sc. ground Low-Side" UBYTE dez 1 100 0.00 255.0 FORMAT "%5.1" ARRAY_SIZE 1 ECU_ADDRESS 0x6000AEE2 /end MEASUREMENT
/begin MEASUREMENT MfPsDia_ctrScGndLoSDsmOk "Mass flow valve powerstage OK counter sc. ground Low-Side" UBYTE dez 1 100 0.00 255.0 FORMAT "%5.1" ARRAY_SIZE 1 ECU_ADDRESS 0x6000AEE1 /end MEASUREMENT
/begin MEASUREMENT MfPsDia_ctrScHiSLoSDsmDef "Mass flow valve powerstage error counter sc. High-Side to Low-Side" UBYTE dez 1 100 0.00 255.0 FORMAT "%5.1" ARRAY_SIZE 1 ECU_ADDRESS 0x6000AEE0 /end MEASUREMENT
/begin MEASUREMENT MfPsDia_ctrScHiSLoSDsmOk "Mass flow valve powerstage OK counter sc. High-Side to Low-Side" UBYTE dez 1 100 0.00 255.0 FORMAT "%5.1" ARRAY_SIZE 1 ECU_ADDRESS 0x6000AEDF /end MEASUREMENT
/begin MEASUREMENT MfPsDia_DiagFId "FId mass flow valve powerstage" UBYTE OneToOne 1 100 0.00 255.0 FORMAT "%5.1" ARRAY_SIZE 1 ECU_ADDRESS 0x6000AEDE /end MEASUREMENT
/begin MEASUREMENT MfPsDia_DiagInfo "Error bits mass flow valve powerstage" ULONG dez 1 100 0.00 4294967295.00 FORMAT "%13.2" ARRAY_SIZE 1 ECU_ADDRESS 0x600026D4 /end MEASUREMENT
/begin MEASUREMENT MfPsDia_DiagInfoCerr "Common error bits mass flow valve powerstage" ULONG dez 1 100 0.00 4294967295.00 FORMAT "%13.2" ARRAY_SIZE 1 ECU_ADDRESS 0x600026D0 /end MEASUREMENT
/begin MEASUREMENT mfpsdia_efMsv_u8_msg "MSV Error Channel specific" UBYTE dez 1 100 0.00 255.0 FORMAT "%5.1" ECU_ADDRESS 0x6000F2F2 /end MEASUREMENT
/begin MEASUREMENT MfPsDia_stClockErr "Mass flow valve powerstage state clock bit coded" UBYTE dez 1 100 0.00 255.0 FORMAT "%5.1" ECU_ADDRESS 0x6000AEDD /end MEASUREMENT
/begin MEASUREMENT MfPsDia_stOn "Mass flow valve powerstage diagnosis enabled" UBYTE dez 1 100 0.00 255.0 FORMAT "%5.1" ECU_ADDRESS 0x6000AEDC /end MEASUREMENT
/begin MEASUREMENT MfPs_moduloCounter "counter modulo operation Mass Flow configuration" UBYTE dez 1 100 0.00 255.0 FORMAT "%5.1" ECU_ADDRESS 0x6000AEDB /end MEASUREMENT
/begin MEASUREMENT MfPs_Normcounter "Counter for sending of mass flow valve paramters in normal mode" ULONG dez 1 100 0.00 4294967295.00 FORMAT "%13.2" ECU_ADDRESS 0x600026CC /end MEASUREMENT
/begin MEASUREMENT MfPs_spiErrorCounterAsync "SPI error counter Mass Flow Valve Noise reduction" ULONG dez 1 100 0.00 4294967295.00 FORMAT "%13.2" ARRAY_SIZE 1 ECU_ADDRESS 0x70002164 /end MEASUREMENT
/begin MEASUREMENT MfPs_spiErrorCounterNorm "error counter SPI of mass flow valve in normal mode" ULONG dez 1 100 0.00 4294967295.00 FORMAT "%13.2" ARRAY_SIZE 1 ECU_ADDRESS 0x600026C8 /end MEASUREMENT
/begin MEASUREMENT MfPs_synccounter "counter mass flow valve noise reduction" ULONG dez 1 100 0.00 4294967295.00 FORMAT "%13.2" ECU_ADDRESS 0x70002160 /end MEASUREMENT
/begin MEASUREMENT MfVDTypC_bReCur "General control for reduced current control" UBYTE B_TRUE 1 100 0.00 1.00000000000 BIT_MASK 0x1 FORMAT "%13.11" ECU_ADDRESS 0x70000190 /end MEASUREMENT
/begin MEASUREMENT MfVDTypC_bSpPrDyn "Recognition set pressure dynamics" UBYTE B_TRUE 1 100 0.00 1.00000000000 BIT_MASK 0x1 FORMAT "%13.11" ECU_ADDRESS 0x7000018F /end MEASUREMENT
/begin MEASUREMENT MfVDTypC_B_stendes "Condition end of start also for injection" UBYTE B_TRUE 1 100 0.00 1.00000000000 BIT_MASK 0x1 FORMAT "%13.11" ECU_ADDRESS 0x7000018E /end MEASUREMENT
/begin MEASUREMENT MfVDTypC_B_tmsvmg "MSV temperature from model valid" UBYTE B_TRUE 1 100 0.00 1.00000000000 BIT_MASK 0x1 FORMAT "%13.11" ECU_ADDRESS 0x7000018D /end MEASUREMENT
/begin MEASUREMENT MfVDTypC_dwmsvd_w "delivery duration of MSV in degrees crankshaft" SWORD kw_q0p1 1 100 -3276.800 3276.700 FORMAT "%8.3" ECU_ADDRESS 0x60006A54 /end MEASUREMENT
/begin MEASUREMENT MfVDTypC_EngStrtCnt_loc "Number of starts in a driving cycle" UWORD dez 1 100 0.00 65535.00 FORMAT "%8.2" ECU_ADDRESS 0x60006A52 /end MEASUREMENT
/begin MEASUREMENT MfVDTypC_MfPsDia_bstClockOk "Clock mass flow valve powerstage OK" UBYTE B_TRUE 1 100 0.00 1.00000000000 BIT_MASK 0x1 FORMAT "%13.11" ECU_ADDRESS 0x7000018C /end MEASUREMENT
/begin MEASUREMENT MfVDTypC_MfVlv_DtyCycl1 "Duty cycle pull in current" UWORD rel_q1p525902em3 1 100 0.00 100.0000 FORMAT "%8.4" ARRAY_SIZE 1 ECU_ADDRESS 0x60006A50 /end MEASUREMENT
/begin MEASUREMENT MfVDTypC_MfVlv_DtyCycl2 "Duty cycle hold current" UWORD rel_q1p525902em3 1 100 0.00 100.0000 FORMAT "%8.4" ARRAY_SIZE 1 ECU_ADDRESS 0x60006A4E /end MEASUREMENT
/begin MEASUREMENT MfVDTypC_MfVlv_tiDlyMfvOpn "Delay Time from Begin of Activation until Closing of the Valve" UWORD t_q0p001_ms 1 100 0.00 65.53500 FORMAT "%8.5" ARRAY_SIZE 1 ECU_ADDRESS 0x60006A4C /end MEASUREMENT
/begin MEASUREMENT MfVDTypC_MfVlv_tvzmsv "Pull-in time" UWORD t_q0p001_ms 1 100 0.00 10.00000 FORMAT "%8.5" ARRAY_SIZE 1 ECU_ADDRESS 0x60006A4A /end MEASUREMENT
/begin MEASUREMENT mfvdtypc_prdiff_loc "local value deviation of rail pressure control" SWORD RBPtCel_p_0p002_1 1 100 -65.53600 65.53400 FORMAT "%8.5" ECU_ADDRESS 0x60006A48 /end MEASUREMENT
/begin MEASUREMENT mfvdtypc_prist_loc "Local value rail pressure" UWORD RBPtCel_p_0p002_1 1 100 0.00 131.0700 FORMAT "%8.4" ECU_ADDRESS 0x60006A46 /end MEASUREMENT
/begin MEASUREMENT mfvdtypc_prsollu_loc "rail pressure setpoint before filtering" UWORD RBPtCel_p_0p002_1 1 100 0.00 131.0700 FORMAT "%8.4" ECU_ADDRESS 0x60006A44 /end MEASUREMENT
/begin MEASUREMENT mfvdtypc_prsoll_loc "rail pressure setpoint" UWORD RBPtCel_p_0p002_1 1 100 0.00 131.0700 FORMAT "%8.4" ECU_ADDRESS 0x60006A42 /end MEASUREMENT
/begin MEASUREMENT MfVDTypC_prsoll_switch "Stored pressure setpoint at pressure variation" UWORD RBPtCel_p_0p002_1 1 100 0.00 131.0700 FORMAT "%8.4" ECU_ADDRESS 0x60006A40 /end MEASUREMENT
/begin MEASUREMENT MfVDTypC_tdelmfvCrksftDeg "Delay time QCV in crank angle" ULONG kw_q0p1 1 100 0.00 6553.50000000 FORMAT "%13.8" ECU_ADDRESS 0x600026C4 /end MEASUREMENT
/begin MEASUREMENT MfVDTypC_TiDlyOffsCrksftDeg "Safety offset in crank angle for higher safety of closing QCV (pull-in phase)" ULONG kw_q0p1 1 100 0.00 6553.50000000 FORMAT "%13.8" ECU_ADDRESS 0x600026C0 /end MEASUREMENT
/begin MEASUREMENT MfVDTypC_tnse_w "time counter at end of start (16 bit)" UWORD t100msxs_uw_b6553p5 1 100 0.00 6553.500 FORMAT "%8.3" ECU_ADDRESS 0x60006A3E /end MEASUREMENT
/begin MEASUREMENT MfVDTypC_uBattFild "Low pass filtered battery voltage" SWORD Volt_Batt 1 100 -655360.0 655340.0 FORMAT "%8.1" ECU_ADDRESS 0x60006A3C /end MEASUREMENT
/begin MEASUREMENT MfVDTypC_uBattFildLoResl "Low pass filtered battery voltage, low resolution" SWORD Volt_Batt 1 100 6000.00 18760.00 FORMAT "%8.2" ECU_ADDRESS 0x60006A3A /end MEASUREMENT
/begin MEASUREMENT MfVD_bPrDiffCond "alternative enable condition reduced current mode" UBYTE B_TRUE 1 100 0.00 1.00000000000 BIT_MASK 0x1 FORMAT "%13.11" ECU_ADDRESS 0x7000018B /end MEASUREMENT
/begin MEASUREMENT MfVD_CntStrtAftFirstFl "Counter for stable number of Starts After First Fueling" UBYTE dez 1 100 0.00 255.0 FORMAT "%5.1" ECU_ADDRESS 0x60038D1E /end MEASUREMENT
/begin MEASUREMENT MfVD_CntStrtAftFirstFl_Old "Counter for stable number of Starts After First Fueling till the previous driving cycle" UBYTE dez 1 100 0.00 255.0 FORMAT "%5.1" ECU_ADDRESS 0x6000AEDA /end MEASUREMENT
/begin MEASUREMENT MfVD_flgCntStrtAftFirstFl "Flag for stable number of Starts After First Fueling for which the pressure is raised and both MSVs are working in case of 2 MSVs" UBYTE B_TRUE 1 100 0.00 1.00000000000 BIT_MASK 0x1 FORMAT "%13.11" ECU_ADDRESS 0x7000081E /end MEASUREMENT
/begin MEASUREMENT MfVD_iPickupLoc "Local calculated pickup current." UBYTE i_ub_q0p04 1 100 0.00 10.20 FORMAT "%5.2" ECU_ADDRESS 0x6000AED9 /end MEASUREMENT
/begin MEASUREMENT MfVD_iPickupLowOld_msg "Old value of pickup current." UBYTE i_ub_q0p04 1 100 0.00 10.20 FORMAT "%5.2" ECU_ADDRESS 0x6000F39B /end MEASUREMENT
/begin MEASUREMENT MfVD_state_msg "current state of the state machine" UBYTE dez 1 100 0.00 255.0 FORMAT "%5.1" ECU_ADDRESS 0x6000F39A /end MEASUREMENT
/begin MEASUREMENT MfVD_sycStSubOld10ms "Old SyC_stSub for MfVD to detect state transition (10ms Raster)" UBYTE ExeCon_State_02 1 100 0.00 6.00000000000 FORMAT "%13.11" ECU_ADDRESS 0x6000AED8 /end MEASUREMENT
/begin MEASUREMENT MfVD_sycStSubOldcalc "Old SyC_stSub for MfVD to detect state transition (HDP-Synchro1 Raster)" UBYTE ExeCon_State_02 1 100 0.00 6.00000000000 FORMAT "%13.11" ECU_ADDRESS 0x6000AED7 /end MEASUREMENT
/begin MEASUREMENT MfVD_tdelmfv "Delay time MSV" UWORD t_q0p001_ms 1 100 0.00 65.53500 FORMAT "%8.5" ECU_ADDRESS 0x60006A38 /end MEASUREMENT
/begin MEASUREMENT MfVD_TV1 "Duty cycle 1 pull-in current" UWORD rel_q1p525902em3 1 100 0.00 100.0000 FORMAT "%8.4" ECU_ADDRESS 0x60006A36 /end MEASUREMENT
/begin MEASUREMENT MfVD_TV2 "Duty cycle 2 holding current" UWORD rel_q1p525902em3 1 100 0.00 100.0000 FORMAT "%8.4" ECU_ADDRESS 0x60006A34 /end MEASUREMENT
/begin MEASUREMENT MfVlv_bReCurEnbl "Reduced current mode is allowed" UBYTE B_TRUE 1 100 0.00 1.00000000000 BIT_MASK 0x1 FORMAT "%13.11" ECU_ADDRESS 0x7000018A /end MEASUREMENT
/begin MEASUREMENT MfVlv_DtyCycl1_msg "Duty cycle pull in current" UWORD rel_q1p525902em3 1 100 0.00 100.0000 FORMAT "%8.4" ARRAY_SIZE 1 ECU_ADDRESS 0x60008BBA /end MEASUREMENT
/begin MEASUREMENT MfVlv_DtyCycl2_msg "Duty cycle hold current" UWORD rel_q1p525902em3 1 100 0.00 100.0000 FORMAT "%8.4" ARRAY_SIZE 1 ECU_ADDRESS 0x60008BB8 /end MEASUREMENT
/begin MEASUREMENT MfVlv_iHoldHigh_msg "Upper limit for hold current of mass flow valve" UBYTE i_ub_q0p04 1 100 0.00 10.20 FORMAT "%5.2" ARRAY_SIZE 1 ECU_ADDRESS 0x6000F398 /end MEASUREMENT
/begin MEASUREMENT MfVlv_iHoldLow_msg "Lower limit for hold current of mass flow valve" UBYTE i_ub_q0p04 1 100 0.00 10.20 FORMAT "%5.2" ARRAY_SIZE 1 ECU_ADDRESS 0x6000F397 /end MEASUREMENT
/begin MEASUREMENT MfVlv_iPickupHigh_msg "Upper limit for pickup current of mass flow valve" UBYTE i_ub_q0p04 1 100 0.00 10.20 FORMAT "%5.2" ARRAY_SIZE 1 ECU_ADDRESS 0x6000F396 /end MEASUREMENT
/begin MEASUREMENT MfVlv_iPickupLow_msg "Lower limit for pickup current of mass flow valve" UBYTE i_ub_q0p04 1 100 0.00 10.20 FORMAT "%5.2" ARRAY_SIZE 1 ECU_ADDRESS 0x6000F395 /end MEASUREMENT
/begin MEASUREMENT MfVlv_rMsvGes "Electric resistance of mass flow valve" UWORD r_q0p003906_Ohm 1 100 0.00 255.9961 FORMAT "%8.4" ECU_ADDRESS 0x60006A32 /end MEASUREMENT
/begin MEASUREMENT MfVlv_tDelayOffset_msg "Offset Time for Duty Cycle1 after closing of the valve" UWORD t_q0p001_ms 1 100 0.00 65.53500 FORMAT "%8.5" ECU_ADDRESS 0x60008BB4 /end MEASUREMENT
/begin MEASUREMENT MfVlv_tiDlyMfvOpn_msg "Delay Time from Begin of Activation until Closing of the Valve" UWORD t_q0p001_ms 1 100 0.00 65.53500 FORMAT "%8.5" ARRAY_SIZE 1 ECU_ADDRESS 0x60008BB2 /end MEASUREMENT
/begin MEASUREMENT MfVlv_TvzMsvTiBasd "Pullin time (QCV) for time based control" UWORD t_q0p001_ms 1 100 0.00 65.53500 FORMAT "%8.5" ARRAY_SIZE 1 ECU_ADDRESS 0x60008BB6 /end MEASUREMENT
/begin MEASUREMENT MfVlv_tvzmsv_msg "Pull-in time" UWORD t_q0p001_ms 1 100 0.00 10.00000 FORMAT "%8.5" ARRAY_SIZE 1 ECU_ADDRESS 0x60008BB0 /end MEASUREMENT
/begin MEASUREMENT midmd_msg "reference moment for misfire detection" UBYTE rel_ub_b99p6 1 100 0.00 99.61 FORMAT "%5.2" ECU_ADDRESS 0x7000365A /end MEASUREMENT
/begin MEASUREMENT midmd_w_msg "reference moment for misfire detection" UWORD rel_uw_b100 1 100 0.00 99.99847 FORMAT "%8.5" ECU_ADDRESS 0x70003786 /end MEASUREMENT
/begin MEASUREMENT MILLmp_stMIL "MIL status (permanently illuminated, off, blink frequency)" UBYTE OneToOne 1 100 0.00 255.0 FORMAT "%5.1" ECU_ADDRESS 0x6000F8B0 /end MEASUREMENT
/begin MEASUREMENT MILLmp_stMILWoTstr "MIL status without tester intervention" UBYTE OneToOne 1 100 0.00 255.0 FORMAT "%5.1" ECU_ADDRESS 0x60014177 /end MEASUREMENT
/begin MEASUREMENT MILLmp_stPs "status of the MIL lamp (on, off)" UBYTE OneToOne 1 100 0.00 255.0 BIT_MASK 0x1 FORMAT "%5.1" ECU_ADDRESS 0x6000F8AE /end MEASUREMENT
/begin MEASUREMENT MILLmp_stReqBln "MIL request register for blinking MIL requests" UBYTE MILLmp_ReqVerb 1 100 0.00 255.000000000 FORMAT "%13.9" ECU_ADDRESS 0x600388E8 /end MEASUREMENT
/begin MEASUREMENT MILLmp_stReqOn "MIL request register for continuous MIL requests" UBYTE MILLmp_ReqVerb 1 100 0.00 255.000000000 FORMAT "%13.9" ECU_ADDRESS 0x600388E9 /end MEASUREMENT
/begin MEASUREMENT MILLmp_stSt "state of the MIL's state machine" UBYTE MILLmp_StVerb 1 100 0.00 129.000000000 FORMAT "%13.9" ECU_ADDRESS 0x60014178 /end MEASUREMENT
/begin MEASUREMENT MILLmp_tiRmnBln "remaining time for MIL trigger during MIL_BLINK" UBYTE t50msxs_q0p05 1 100 0.00 12.75 FORMAT "%5.2" ECU_ADDRESS 0x60010FEE /end MEASUREMENT
/begin MEASUREMENT MILLmp_tiRmnSt "remaining state time for states with time trigger" UBYTE t1sxs_q1 1 100 0.00 255.0 FORMAT "%5.1" ECU_ADDRESS 0x6001098B /end MEASUREMENT
/begin MEASUREMENT miofof_w_msg "upper torque limit to enable DMDFOF adaptation" SWORD md_q0p1 1 100 -3276.800 3276.700 FORMAT "%8.3" ECU_ADDRESS 0x700039DE /end MEASUREMENT
/begin MEASUREMENT MisfDet_agKnkCtrlMax "maximum ignition-timing retardation during one working cycle" SBYTE kw_q0p75 1 100 -96.00 95.25 FORMAT "%5.2" ECU_ADDRESS 0x600008F1 /end MEASUREMENT
/begin MEASUREMENT MisfDet_cntrIniTrsmTi "Counter for state of initialisation of the drivetrain temperature model" UBYTE OneToOne 1 100 0.00 255.0 FORMAT "%5.1" ECU_ADDRESS 0x6000AECF /end MEASUREMENT
/begin MEASUREMENT MisfDet_cntrMisf "counter for misfire events" UWORD OneToOne 1 100 0.00 65535.00 FORMAT "%8.2" ECU_ADDRESS 0x600005BE /end MEASUREMENT
/begin MEASUREMENT MisfDet_cylCntr "cylinder counter misfire detection according to MisfDet_dn (Engine roughness signal)" UBYTE OneToOne 1 100 0.00 255.0 FORMAT "%5.1" ECU_ADDRESS 0x5000099C /end MEASUREMENT
/begin MEASUREMENT MisfDet_cylCntrMisfGenr "cylinder counter for misfire generator" UBYTE OneToOne 1 100 0.00 255.0 FORMAT "%5.1" ECU_ADDRESS 0x7000210C /end MEASUREMENT
/begin MEASUREMENT MisfDet_dn "angular acceleration" SWORD dn_Compu 1 100 -2048.000 2047.938 FORMAT "%8.3" ECU_ADDRESS 0x500007FC /end MEASUREMENT
/begin MEASUREMENT MisfDet_dnAdpnFilFac "filter factor for continuous adaptation" UWORD fak_uw_b1 1 100 0.00 0.9999847 FORMAT "%9.7" ECU_ADDRESS 0x50000712 /end MEASUREMENT
/begin MEASUREMENT MisfDet_dnAdpnFrzNEng "engine speed at stopping continuous adaptation" UWORD fak_ub_b1 1 100 0.00 255.9961 FORMAT "%8.4" ECU_ADDRESS 0x600005C4 /end MEASUREMENT
/begin MEASUREMENT MisfDet_dnAdpnFrzTq "torque at stopping continuous adaptation" UWORD fak_ub_b1 1 100 0.00 255.9961 FORMAT "%8.4" ECU_ADDRESS 0x600005C6 /end MEASUREMENT
/begin MEASUREMENT MisfDet_dnAdpnNEngRel "Relative engine speed of dn adaptation (index and position inside adaptation nrange" UWORD fak_ub_b1 1 100 0.00 255.9961 FORMAT "%8.4" ECU_ADDRESS 0x500007FE /end MEASUREMENT
/begin MEASUREMENT MisfDet_dnAdpnNvCoeff "coefficients used for interpolatio nof NV adaptation" FLOAT32_IEEE OneToOne 1 100 -1.00000000E+037 1.00000000E+037 FORMAT "%13.3" ARRAY_SIZE 2 ECU_ADDRESS 0x50001B14 /end MEASUREMENT
/begin MEASUREMENT MisfDet_dnAdpnNvDst "Harmonic mean of the working point to the adaptation points" UWORD fak_ub_b1 1 100 0.00 255.9961 FORMAT "%8.4" ECU_ADDRESS 0x600005C8 /end MEASUREMENT
/begin MEASUREMENT MisfDet_dnAdpnNvDstSng "Single distances of base points for interpolation" UWORD fak_ub_b1 1 100 0.00 255.9961 FORMAT "%8.4" ARRAY_SIZE 2 ECU_ADDRESS 0x6000042C /end MEASUREMENT
/begin MEASUREMENT MisfDet_dnAdpnNvFilFac "filter factor used for NV adaptation" UWORD fak_uw_b1 1 100 0.00 0.9999847 FORMAT "%9.7" ECU_ADDRESS 0x600005CA /end MEASUREMENT
/begin MEASUREMENT MisfDet_dnAdpnNvIdx "array element of curent adaptation range" UBYTE OneToOne 1 100 0.00 255.0 FORMAT "%5.1" ECU_ADDRESS 0x5000096B /end MEASUREMENT
/begin MEASUREMENT MisfDet_dnAdpnNvIdxCmbn "Combined index of adaptation range (engine speed and load)" UWORD OneToOne 1 100 0.00 65535.00 FORMAT "%8.2" ECU_ADDRESS 0x50000714 /end MEASUREMENT
/begin MEASUREMENT MisfDet_dnAdpnNvInterpnTyp "type for interpolation in NV map" UBYTE OneToOne 1 100 0.00 255.0 FORMAT "%5.1" ECU_ADDRESS 0x6000AED6 /end MEASUREMENT
/begin MEASUREMENT MisfDet_dnAdpnNvNEngSum "cumulated speed after entering adaptation range" UWORD fak_ub_b1 1 100 0.00 255.9961 FORMAT "%8.4" ECU_ADDRESS 0x7000215A /end MEASUREMENT
/begin MEASUREMENT MisfDet_dnAdpnNvNrSampleCurr "Number of samples after entering adaptation range" UBYTE OneToOne 1 100 0.00 255.0 FORMAT "%5.1" ECU_ADDRESS 0x70002158 /end MEASUREMENT
/begin MEASUREMENT MisfDet_dnAdpnNvObsvrIdx "indices of adaptation base points for interpolation" UWORD OneToOne 1 100 0.00 65535.00 FORMAT "%8.2" ARRAY_SIZE 3 ECU_ADDRESS 0x5000570C /end MEASUREMENT
/begin MEASUREMENT MisfDet_dnAdpnNvObsvrIdxNEng "Engine speed index of read out value" UBYTE OneToOne 1 100 0.00 255.0 FORMAT "%5.1" ECU_ADDRESS 0x6000AED5 /end MEASUREMENT
/begin MEASUREMENT MisfDet_dnAdpnNvObsvrIdxTq "load index of read out value" UBYTE OneToOne 1 100 0.00 255.0 FORMAT "%5.1" ECU_ADDRESS 0x6000AED4 /end MEASUREMENT
/begin MEASUREMENT MisfDet_dnAdpnNvObsvrNEng "engine speed read out of NV map" UBYTE fak_ub_b1 1 100 0.00 0.9961 ECU_ADDRESS 0x6000AED3 /end MEASUREMENT
/begin MEASUREMENT MisfDet_dnAdpnNvObsvrNrSample "number samples read put of NV map" UBYTE OneToOne 1 100 0.00 255.0 FORMAT "%5.1" ECU_ADDRESS 0x6000AED2 /end MEASUREMENT
/begin MEASUREMENT MisfDet_dnAdpnNvObsvrTq "load read out of NV map" UBYTE fak_ub_b1 1 100 0.00 0.9961 ECU_ADDRESS 0x6000AED1 /end MEASUREMENT
/begin MEASUREMENT MisfDet_dnAdpnNvObsvrVal "adaptation cvalue read out of NV map" SWORD dn_Compu 1 100 -2048.000 2047.938 FORMAT "%8.3" ARRAY_SIZE 4 ECU_ADDRESS 0x50005712 /end MEASUREMENT
/begin MEASUREMENT MisfDet_dnAdpnNvPlausAbsCntr "counter for failed DnAdpnNv absolute plaus checks" UBYTE OneToOne 1 100 0.00 255.0 FORMAT "%5.1" ECU_ADDRESS 0x600008F2 /end MEASUREMENT
/begin MEASUREMENT MisfDet_dnAdpnNvPlausAbsCyl "cylinder with maximum amplitude for DnAdpnNv absolute plaus check" UBYTE OneToOne 1 100 0.00 255.0 FORMAT "%5.1" ECU_ADDRESS 0x600008F3 /end MEASUREMENT
/begin MEASUREMENT MisfDet_dnAdpnNvPlausAbsValMax "maximum amplitude for DnAdpnNv absolute plaus check" SWORD dn_Compu 1 100 -2048.000 2047.938 FORMAT "%8.3" ECU_ADDRESS 0x70002156 /end MEASUREMENT
/begin MEASUREMENT MisfDet_dnAdpnNvPlausSumCntr "counter for failed DnAdpnNv sum plaus checks" UBYTE OneToOne 1 100 0.00 255.0 FORMAT "%5.1" ECU_ADDRESS 0x60038D1D /end MEASUREMENT
/begin MEASUREMENT MisfDet_dnAdpnNvPlausSumIdx "index of adaptation range of last DnAdpnNv sum plaus check" UBYTE OneToOne 1 100 0.00 255.0 FORMAT "%5.1" ECU_ADDRESS 0x60038D1C /end MEASUREMENT
/begin MEASUREMENT MisfDet_dnAdpnNvQlyFac "factor for theshold offset based on confidence of DnAdpn" UWORD fak_uw_b1 1 100 0.00 0.9999847 FORMAT "%9.7" ECU_ADDRESS 0x50000802 /end MEASUREMENT
/begin MEASUREMENT MisfDet_dnAdpnNvStruct.nrSample "NV adaptation map / number of samples in adaptation range" UBYTE OneToOne 1 100 0.00 255.0 FORMAT "%5.1" ARRAY_SIZE 24 ECU_ADDRESS 0x60038C0C /end MEASUREMENT
/begin MEASUREMENT MisfDet_dnAdpnNvStruct.nEng "NV adaptation map / adaptation barycenter concerning engine speed inside adaptation range" UBYTE fak_ub_b1 1 100 0.00 0.9961 ARRAY_SIZE 24 ECU_ADDRESS 0x60038C24 /end MEASUREMENT
/begin MEASUREMENT MisfDet_dnAdpnNvStruct.tq "NV adaptation map / adaptation barycenter concerning torque inside adaptation range" UBYTE fak_ub_b1 1 100 0.00 0.9961 ARRAY_SIZE 24 ECU_ADDRESS 0x60038C3C /end MEASUREMENT
/begin MEASUREMENT MisfDet_dnAdpnNvStruct.val "NV adaptation map / adaptation value of adaptation range" SWORD dn_Compu 1 100 -2048.000 2047.938 FORMAT "%8.3" ARRAY_SIZE 96 ECU_ADDRESS 0x60038C54 /end MEASUREMENT
/begin MEASUREMENT MisfDet_dnAdpnNvSum "sum of single distances to base points of interpolation" SWORD dn_Compu 1 100 -2048.000 2047.938 FORMAT "%8.3" ECU_ADDRESS 0x60006A2E /end MEASUREMENT
/begin MEASUREMENT MisfDet_dnAdpnNvTqSum "cumulated load after entering adaptation range" UWORD fak_ub_b1 1 100 0.00 255.9961 FORMAT "%8.4" ECU_ADDRESS 0x70002154 /end MEASUREMENT
/begin MEASUREMENT MisfDet_dnAdpnNvValSum "cumulated adaptation value after entering adaptation range" SLONG dn_Compu 1 100 -134217728.000 134217727.938 FORMAT "%13.3" ARRAY_SIZE 4 ECU_ADDRESS 0x70002144 /end MEASUREMENT
/begin MEASUREMENT MisfDet_dnAdpnPlausAbsCntr "counter for failed DnAdpn absolute plaus checks" UBYTE OneToOne 1 100 0.00 255.0 FORMAT "%5.1" ECU_ADDRESS 0x60000977 /end MEASUREMENT
/begin MEASUREMENT MisfDet_dnAdpnPlausAbsCyl "cylinder with maximum amplitude for DnAdpn plaus check" UBYTE OneToOne 1 100 0.00 255.0 FORMAT "%5.1" ECU_ADDRESS 0x600008F4 /end MEASUREMENT
/begin MEASUREMENT MisfDet_dnAdpnPlausAbsThd "Threshold for DnAdpn(Nv) absolute plaus checks" SWORD dn_Compu 1 100 -2048.000 2047.938 FORMAT "%8.3" ECU_ADDRESS 0x600005CC /end MEASUREMENT
/begin MEASUREMENT MisfDet_dnAdpnPlausAbsValMax "maximum amplitude of DnAdpn absolute plaus check" SWORD dn_Compu 1 100 -2048.000 2047.938 FORMAT "%8.3" ECU_ADDRESS 0x70002142 /end MEASUREMENT
/begin MEASUREMENT MisfDet_dnAdpnPlausMinCntr "counter for failed DnAdpn min plaus checks" UBYTE OneToOne 1 100 0.00 255.0 FORMAT "%5.1" ECU_ADDRESS 0x600008F5 /end MEASUREMENT
/begin MEASUREMENT MisfDet_dnAdpnPlausMinCntrMax "maximum counter value for failed DnAdpn min plaus checks" UBYTE OneToOne 1 100 0.00 255.0 FORMAT "%5.1" ECU_ADDRESS 0x60038D1B /end MEASUREMENT
/begin MEASUREMENT MisfDet_dnAdpnPlausMinRat "ratio of difference of sums to threshold of relative min plaus check" UBYTE rel_ub_b200 1 100 0.00 199.2 FORMAT "%5.1" ECU_ADDRESS 0x600008F6 /end MEASUREMENT
/begin MEASUREMENT MisfDet_dnAdpnPlausMinRatMax "maximum ratio of difference of sums to threshold of relative min plaus check" UBYTE rel_ub_b200 1 100 0.00 199.2 FORMAT "%5.1" ECU_ADDRESS 0x60038D1A /end MEASUREMENT
/begin MEASUREMENT MisfDet_dnAdpnPlausMinSum "sum of absolute values of dnCyl for Min plaus check" SLONG dn_Compu 1 100 -134217728.000 134217727.938 FORMAT "%13.3" ECU_ADDRESS 0x60000430 /end MEASUREMENT
/begin MEASUREMENT MisfDet_dnAdpnPlausMinSumDif "difference of sum of absolute values of DnCyl if DnAdpnVal and DnAdpnValNv for Min plaus check" SWORD dn_Compu 1 100 -2048.000 2047.938 FORMAT "%8.3" ECU_ADDRESS 0x600005CE /end MEASUREMENT
/begin MEASUREMENT MisfDet_dnAdpnPlausMinSumNv "sum of absolute values of dnCyl if DnAdpnValNv would have been used for Min plaus check" SLONG dn_Compu 1 100 -134217728.000 134217727.938 FORMAT "%13.3" ECU_ADDRESS 0x50000334 /end MEASUREMENT
/begin MEASUREMENT MisfDet_dnAdpnPlausMinThdFac "factor to misfire detection threshold for min plaus" UBYTE fak_ub_b16 1 100 0.00 15.94 FORMAT "%5.2" ECU_ADDRESS 0x600008F7 /end MEASUREMENT
/begin MEASUREMENT MisfDet_dnAdpnPlausRelCntr "counter for failed raltive plaus checks" UBYTE OneToOne 1 100 0.00 255.0 FORMAT "%5.1" ECU_ADDRESS 0x60000978 /end MEASUREMENT
/begin MEASUREMENT MisfDet_dnAdpnPlausRelCntrMax "maximum reached number of failed relative plaus checks whithin one driving cycle" UBYTE OneToOne 1 100 0.00 255.0 FORMAT "%5.1" ECU_ADDRESS 0x60038D19 /end MEASUREMENT
/begin MEASUREMENT MisfDet_dnAdpnPlausRelCyl "cylinder with maximum amplitude for relative plaus check" UBYTE OneToOne 1 100 0.00 255.0 FORMAT "%5.1" ECU_ADDRESS 0x600008F8 /end MEASUREMENT
/begin MEASUREMENT MisfDet_dnAdpnPlausRelRat "ratio of maximum amplitude to threshold of relative plaus check" UBYTE rel_ub_b200 1 100 0.00 199.2 FORMAT "%5.1" ECU_ADDRESS 0x600008F9 /end MEASUREMENT
/begin MEASUREMENT MisfDet_dnAdpnPlausRelRatMax "maximum amplitude for relative plaus check" UBYTE rel_ub_b200 1 100 0.00 199.2 FORMAT "%5.1" ECU_ADDRESS 0x60038D18 /end MEASUREMENT
/begin MEASUREMENT MisfDet_dnAdpnPlausRelRatMaxIdx "index of adaptation range of last faild relative plaus check" UBYTE OneToOne 1 100 0.00 255.0 FORMAT "%5.1" ECU_ADDRESS 0x60038D17 /end MEASUREMENT
/begin MEASUREMENT MisfDet_dnAdpnPlausRelThd "threshold of relative plaus check" SWORD dn_Compu 1 100 -2048.000 2047.938 FORMAT "%8.3" ECU_ADDRESS 0x600005D0 /end MEASUREMENT
/begin MEASUREMENT MisfDet_dnAdpnPlausRelValMax "maximum amplitude for relative plaus check" SWORD dn_Compu 1 100 -2048.000 2047.938 FORMAT "%8.3" ECU_ADDRESS 0x70002140 /end MEASUREMENT
/begin MEASUREMENT MisfDet_dnAdpnQlyFac "Factor to threshold offset dependent on adaptation quality" UWORD fak_uw_b1 1 100 0.00 0.9999847 FORMAT "%9.7" ECU_ADDRESS 0x50000804 /end MEASUREMENT
/begin MEASUREMENT MisfDet_dnAdpnQlyFacAry "Array factor to threshold offset dependent on adaptation quality (per segment position)" UWORD fak_uw_b1 1 100 0.00 0.9999847 FORMAT "%9.7" ARRAY_SIZE 2 ECU_ADDRESS 0x7000213C /end MEASUREMENT
/begin MEASUREMENT MisfDet_dnAdpnRngChngActvnDly "delay of release after change of adaptation range" UBYTE OneToOne 1 100 0.00 255.0 FORMAT "%5.1" ECU_ADDRESS 0x5000096C /end MEASUREMENT
/begin MEASUREMENT MisfDet_dnAdpnRngTq "load limits of adaptation map" UWORD rel_uw_b100 1 100 0.00 99.99847 FORMAT "%8.5" ARRAY_SIZE 4 ECU_ADDRESS 0x50000338 /end MEASUREMENT
/begin MEASUREMENT MisfDet_dnAdpnStrtCntr "Number ignitions after start" UWORD OneToOne 1 100 0.00 65535.00 FORMAT "%8.2" ECU_ADDRESS 0x50000806 /end MEASUREMENT
/begin MEASUREMENT MisfDet_dnAdpnTqMin "lower torque limit of adaptation" UWORD rel_uw_b100 1 100 0.00 99.99847 FORMAT "%8.5" ECU_ADDRESS 0x50000716 /end MEASUREMENT
/begin MEASUREMENT MisfDet_dnAdpnTqRel "relative load for adaptation" UWORD fak_ub_b1 1 100 0.00 255.9961 FORMAT "%8.4" ECU_ADDRESS 0x50000808 /end MEASUREMENT
/begin MEASUREMENT MisfDet_dnAdpnVal "adaptation value for MisfDet_dn" SWORD dn_Compu 1 100 -2048.000 2047.938 FORMAT "%8.3" ARRAY_SIZE 4 ECU_ADDRESS 0x50000640 /end MEASUREMENT
/begin MEASUREMENT MisfDet_dnAdpnValAltv "adaptation value for MisfDet_dn alternative segment position" SWORD dn_Compu 1 100 -2048.000 2047.938 FORMAT "%8.3" ARRAY_SIZE 4 ECU_ADDRESS 0x70002134 /end MEASUREMENT
/begin MEASUREMENT MisfDet_dnAdpnValCurr "adaptation value for MisfDet_dn current cylinder" SWORD dn_Compu 1 100 -2048.000 2047.938 FORMAT "%8.3" ECU_ADDRESS 0x70003A78 /end MEASUREMENT
/begin MEASUREMENT MisfDet_dnAdpnValNv "adaptation value from NV map for MisfDet_dn" SWORD dn_Compu 1 100 -2048.000 2047.938 FORMAT "%8.3" ARRAY_SIZE 4 ECU_ADDRESS 0x50000648 /end MEASUREMENT
/begin MEASUREMENT MisfDet_dnAdpnValNvFac "Factor to adaptation value in case of ramp down at low engine speed" UWORD fak_uw_b1 1 100 0.00 0.9999847 FORMAT "%9.7" ECU_ADDRESS 0x70003820 /end MEASUREMENT
/begin MEASUREMENT MisfDet_dnAdpnValStd "adaptation value for MisfDet_dn standard segment position" SWORD dn_Compu 1 100 -2048.000 2047.938 FORMAT "%8.3" ARRAY_SIZE 4 ECU_ADDRESS 0x7000212C /end MEASUREMENT
/begin MEASUREMENT MisfDet_dnCyc "Engine speed gradient during one working cycle" SWORD dn_Compu 1 100 -2048.000 2047.938 FORMAT "%8.3" ECU_ADDRESS 0x70003A76 /end MEASUREMENT
/begin MEASUREMENT MisfDet_dnCyl "cylinder individual angular acceleration" SWORD dn_Compu 1 100 -2048.000 2047.938 FORMAT "%8.3" ARRAY_SIZE 4 ECU_ADDRESS 0x50000658 /end MEASUREMENT
/begin MEASUREMENT MisfDet_dnDif "difference of current dn to last dn of same segment" SWORD dn_Compu 1 100 -2048.000 2047.938 FORMAT "%8.3" ECU_ADDRESS 0x5000080C /end MEASUREMENT
/begin MEASUREMENT MisfDet_dnDifMin "difference current dn to minimum dnCyl" SWORD dn_Compu 1 100 -2048.000 2047.938 FORMAT "%8.3" ECU_ADDRESS 0x70003A74 /end MEASUREMENT
/begin MEASUREMENT MisfDet_dnDifNxt "difference of angular acceleration to the successive cylinder" SWORD dn_Compu 1 100 -2048.000 2047.938 FORMAT "%8.3" ECU_ADDRESS 0x70003A72 /end MEASUREMENT
/begin MEASUREMENT MisfDet_dnDly "delay of angular acceleration" UBYTE OneToOne 1 100 0.00 255.0 FORMAT "%5.1" ECU_ADDRESS 0x5000099E /end MEASUREMENT
/begin MEASUREMENT MisfDet_dnFilFac "filter factor for MisfDet_dnFltd" UWORD fak_uw_b1 1 100 0.00 0.9999847 FORMAT "%9.7" ARRAY_SIZE 4 ECU_ADDRESS 0x50000660 /end MEASUREMENT
/begin MEASUREMENT MisfDet_dnFltd "filtered angular acceleration of crankshaft" SWORD dn_Compu 1 100 -2048.000 2047.938 FORMAT "%8.3" ECU_ADDRESS 0x5000080E /end MEASUREMENT
/begin MEASUREMENT MisfDet_dnFltdCyl "cylinder individual filtered angular acceleration" SWORD dn_Compu 1 100 -2048.000 2047.938 FORMAT "%8.3" ARRAY_SIZE 4 ECU_ADDRESS 0x50000668 /end MEASUREMENT
/begin MEASUREMENT MisfDet_dnQnts "quantisation of MisfDet_dn" UBYTE fak_ub_b64 1 100 0.00 63.75 FORMAT "%5.2" ECU_ADDRESS 0x6000EF4C /end MEASUREMENT
/begin MEASUREMENT MisfDet_dnRaw "not corrected angular acceleration" SWORD dn_Compu 1 100 -2048.000 2047.938 FORMAT "%8.3" ECU_ADDRESS 0x50000810 /end MEASUREMENT
/begin MEASUREMENT MisfDet_dnRawAry "array of not corrected angular acceleration (per segment position)" SWORD dn_Compu 1 100 -2048.000 2047.938 FORMAT "%8.3" ARRAY_SIZE 2 ECU_ADDRESS 0x70003A6E /end MEASUREMENT
/begin MEASUREMENT MisfDet_dnRawCyl "cylinder individual not corrected angular acceleration" SWORD dn_Compu 1 100 -2048.000 2047.938 FORMAT "%8.3" ARRAY_SIZE 4 ECU_ADDRESS 0x50000670 /end MEASUREMENT
/begin MEASUREMENT MisfDet_dPedlPosn "gradient of the accelerator pedal position" SWORD q0p06104_pc_DIV_s 1 100 -2000.000 1999.939 FORMAT "%8.3" ECU_ADDRESS 0x600005C0 /end MEASUREMENT
/begin MEASUREMENT MisfDet_dTq "Gradient of engine torque" SWORD q0p06104_pc_DIV_s 1 100 -2000.000 1999.939 FORMAT "%8.3" ECU_ADDRESS 0x600005C2 /end MEASUREMENT
/begin MEASUREMENT MisfDet_facEnvP "Correction factor for zero load depending on ambient pressure" UBYTE fak_ub_b4 1 100 0.00 3.984 FORMAT "%5.3" ECU_ADDRESS 0x600008FA /end MEASUREMENT
/begin MEASUREMENT MisfDet_idxMisfPat "index in misfire pattern table" UBYTE OneToOne 1 100 0.00 255.0 FORMAT "%5.1" ECU_ADDRESS 0x600008FB /end MEASUREMENT
/begin MEASUREMENT MisfDet_ignWaitBtwMisf "number of ignitions between cylinderindividual misfire patterns in single or permanent mode" UWORD OneToOne 1 100 0.00 65535.00 FORMAT "%8.2" ECU_ADDRESS 0x600005D2 /end MEASUREMENT
/begin MEASUREMENT MisfDet_ignWaitBtwMisfMod "number of ignitions between misfire modes" UWORD OneToOne 1 100 0.00 65535.00 FORMAT "%8.2" ECU_ADDRESS 0x600005D4 /end MEASUREMENT
/begin MEASUREMENT MisfDet_maskDlyBlkDnAdpnNvCorrn "Shifiting mask with inhibiting bits for application of adapted and stored engine running roughness values" ULONG OneToOne 1 100 0.00 4294967295.00 FORMAT "%13.2" ECU_ADDRESS 0x700020FC /end MEASUREMENT
/begin MEASUREMENT Misfdet_maskDlyBlkDnFltd "Shifiting mask with inhibiting bits for dN calculation" ULONG OneToOne 1 100 0.00 4294967295.00 FORMAT "%13.2" ECU_ADDRESS 0x70002108 /end MEASUREMENT
/begin MEASUREMENT Misfdet_maskDlyBlkStc "Shifiting mask with inhibiting bits for statistical function" ULONG OneToOne 1 100 0.00 4294967295.00 FORMAT "%13.2" ECU_ADDRESS 0x70002104 /end MEASUREMENT
/begin MEASUREMENT MisfDet_maskDnAdpn.cntrStrt "Mask with inhibiting conditions of temporary dN adaption No turn off delay / Ignition counter since Engine start" UWORD OneToOne 1 100 0.00 65535.00 FORMAT "%8.2" ECU_ADDRESS 0x50000418 /end MEASUREMENT
/begin MEASUREMENT MisfDet_maskDnAdpn.CmbTyp.Hld "Mask with inhibiting conditions of temporary dN adaption No turn off delay / mask of selected disabling conditions, engine type specific / bit mask delayed conditions" ULONG OneToOne 1 100 0.00 4294967295.00 FORMAT "%13.2" ECU_ADDRESS 0x5000041C /end MEASUREMENT
/begin MEASUREMENT MisfDet_maskDnAdpn.CmbTyp.HldN "Mask with inhibiting conditions of temporary dN adaption No turn off delay / mask of selected disabling conditions, engine type specific / bit mask delayed conditions engine speed dependant" ULONG OneToOne 1 100 0.00 4294967295.00 FORMAT "%13.2" ECU_ADDRESS 0x50000420 /end MEASUREMENT
/begin MEASUREMENT MisfDet_maskDnAdpn.CmbTyp.Raw "Mask with inhibiting conditions of temporary dN adaption No turn off delay / mask of selected disabling conditions, engine type specific / bit mask not delayed conditions" ULONG OneToOne 1 100 0.00 4294967295.00 FORMAT "%13.2" ECU_ADDRESS 0x50000424 /end MEASUREMENT
/begin MEASUREMENT MisfDet_maskDnAdpn.Cmn.Hld "Mask with inhibiting conditions of temporary dN adaption No turn off delay / mask of selected disabling conditions / bit mask delayed conditions" ULONG OneToOne 1 100 0.00 4294967295.00 FORMAT "%13.2" ECU_ADDRESS 0x50000428 /end MEASUREMENT
/begin MEASUREMENT MisfDet_maskDnAdpn.Cmn.HldN "Mask with inhibiting conditions of temporary dN adaption No turn off delay / mask of selected disabling conditions / bit mask delayed conditions engine speed dependant" ULONG OneToOne 1 100 0.00 4294967295.00 FORMAT "%13.2" ECU_ADDRESS 0x5000042C /end MEASUREMENT
/begin MEASUREMENT MisfDet_maskDnAdpn.Cmn.Raw "Mask with inhibiting conditions of temporary dN adaption No turn off delay / mask of selected disabling conditions / bit mask not delayed conditions" ULONG OneToOne 1 100 0.00 4294967295.00 FORMAT "%13.2" ECU_ADDRESS 0x50000430 /end MEASUREMENT
/begin MEASUREMENT MisfDet_maskDnAdpnNv.CmbTyp.Hld "Mask with inhibiting conditions of storing dN adaption No turn off delay / mask of selected disabling conditions, engine type specific / bit mask delayed conditions" ULONG OneToOne 1 100 0.00 4294967295.00 FORMAT "%13.2" ECU_ADDRESS 0x500003DC /end MEASUREMENT
/begin MEASUREMENT MisfDet_maskDnAdpnNv.CmbTyp.HldN "Mask with inhibiting conditions of storing dN adaption No turn off delay / mask of selected disabling conditions, engine type specific / bit mask delayed conditions engine speed dependant" ULONG OneToOne 1 100 0.00 4294967295.00 FORMAT "%13.2" ECU_ADDRESS 0x500003E0 /end MEASUREMENT
/begin MEASUREMENT MisfDet_maskDnAdpnNv.CmbTyp.Raw "Mask with inhibiting conditions of storing dN adaption No turn off delay / mask of selected disabling conditions, engine type specific / bit mask not delayed conditions" ULONG OneToOne 1 100 0.00 4294967295.00 FORMAT "%13.2" ECU_ADDRESS 0x500003E4 /end MEASUREMENT
/begin MEASUREMENT MisfDet_maskDnAdpnNv.CmbTyp2.Hld "Mask with inhibiting conditions of storing dN adaption No turn off delay / mask of selected disabling conditions, engine type specific / bit mask delayed conditions" ULONG OneToOne 1 100 0.00 4294967295.00 FORMAT "%13.2" ECU_ADDRESS 0x500003E8 /end MEASUREMENT
/begin MEASUREMENT MisfDet_maskDnAdpnNv.CmbTyp2.HldN "Mask with inhibiting conditions of storing dN adaption No turn off delay / mask of selected disabling conditions, engine type specific / bit mask delayed conditions engine speed dependant" ULONG OneToOne 1 100 0.00 4294967295.00 FORMAT "%13.2" ECU_ADDRESS 0x500003EC /end MEASUREMENT
/begin MEASUREMENT MisfDet_maskDnAdpnNv.CmbTyp2.Raw "Mask with inhibiting conditions of storing dN adaption No turn off delay / mask of selected disabling conditions, engine type specific / bit mask not delayed conditions" ULONG OneToOne 1 100 0.00 4294967295.00 FORMAT "%13.2" ECU_ADDRESS 0x500003F0 /end MEASUREMENT
/begin MEASUREMENT MisfDet_maskDnAdpnNv.Cmn.Hld "Mask with inhibiting conditions of storing dN adaption No turn off delay / mask of selected disabling conditions / bit mask delayed conditions" ULONG OneToOne 1 100 0.00 4294967295.00 FORMAT "%13.2" ECU_ADDRESS 0x500003F4 /end MEASUREMENT
/begin MEASUREMENT MisfDet_maskDnAdpnNv.Cmn.HldN "Mask with inhibiting conditions of storing dN adaption No turn off delay / mask of selected disabling conditions / bit mask delayed conditions engine speed dependant" ULONG OneToOne 1 100 0.00 4294967295.00 FORMAT "%13.2" ECU_ADDRESS 0x500003F8 /end MEASUREMENT
/begin MEASUREMENT MisfDet_maskDnAdpnNv.Cmn.Raw "Mask with inhibiting conditions of storing dN adaption No turn off delay / mask of selected disabling conditions / bit mask not delayed conditions" ULONG OneToOne 1 100 0.00 4294967295.00 FORMAT "%13.2" ECU_ADDRESS 0x500003FC /end MEASUREMENT
/begin MEASUREMENT MisfDet_maskDnAdpnNvCmbd "Bit mask with inhibiting conditions of storing dN adaption combined" ULONG OneToOne 1 100 0.00 4294967295.00 FORMAT "%13.2" ECU_ADDRESS 0x600004F4 /end MEASUREMENT
/begin MEASUREMENT MisfDet_maskDnAdpnNvCorrn.CmbTyp.Hld "Mask with inhibiting conditions for usage of stored dN adaption values / mask of selected disabling conditions, engine type specific / bit mask delayed conditions" ULONG OneToOne 1 100 0.00 4294967295.00 FORMAT "%13.2" ECU_ADDRESS 0x500003C8 /end MEASUREMENT
/begin MEASUREMENT MisfDet_maskDnAdpnNvCorrn.CmbTyp.Raw "Mask with inhibiting conditions for usage of stored dN adaption values / mask of selected disabling conditions, engine type specific / bit mask not delayed conditions" ULONG OneToOne 1 100 0.00 4294967295.00 FORMAT "%13.2" ECU_ADDRESS 0x500003CC /end MEASUREMENT
/begin MEASUREMENT MisfDet_maskDnAdpnNvCorrn.Cmn.Hld "Mask with inhibiting conditions for usage of stored dN adaption values / mask of selected disabling conditions / bit mask delayed conditions" ULONG OneToOne 1 100 0.00 4294967295.00 FORMAT "%13.2" ECU_ADDRESS 0x500003D0 /end MEASUREMENT
/begin MEASUREMENT MisfDet_maskDnAdpnNvCorrn.Cmn.Raw "Mask with inhibiting conditions for usage of stored dN adaption values / mask of selected disabling conditions / bit mask not delayed conditions" ULONG OneToOne 1 100 0.00 4294967295.00 FORMAT "%13.2" ECU_ADDRESS 0x500003D4 /end MEASUREMENT
/begin MEASUREMENT MisfDet_maskDnAdpnNvCorrnCmbd "Mask with selected inhibiting conditions for usage of stored dN adaption values" ULONG OneToOne 1 100 0.00 4294967295.00 FORMAT "%13.2" ECU_ADDRESS 0x50000678 /end MEASUREMENT
/begin MEASUREMENT MisfDet_maskDnAdpnNvCorrnCmbdCmbTyp "Mask with selected inhibiting conditions for usage of stored dN adaption values engine type specific" ULONG OneToOne 1 100 0.00 4294967295.00 FORMAT "%13.2" ECU_ADDRESS 0x5000067C /end MEASUREMENT
/begin MEASUREMENT MisfDet_maskDnAdpnPlaus.CmbTyp.Hld "Mask with inhibiting conditions for plausibilisation of dn adaptation / mask of selected disabling conditions, engine type specific / bit mask delayed conditions" ULONG OneToOne 1 100 0.00 4294967295.00 FORMAT "%13.2" ECU_ADDRESS 0x50000404 /end MEASUREMENT
/begin MEASUREMENT MisfDet_maskDnAdpnPlaus.CmbTyp.Raw "Mask with inhibiting conditions for plausibilisation of dn adaptation / mask of selected disabling conditions, engine type specific / bit mask not delayed conditions" ULONG OneToOne 1 100 0.00 4294967295.00 FORMAT "%13.2" ECU_ADDRESS 0x50000408 /end MEASUREMENT
/begin MEASUREMENT MisfDet_maskDnAdpnPlaus.Cmn.Hld "Mask with inhibiting conditions for plausibilisation of dn adaptation / mask of selected disabling conditions / bit mask delayed conditions" ULONG OneToOne 1 100 0.00 4294967295.00 FORMAT "%13.2" ECU_ADDRESS 0x5000040C /end MEASUREMENT
/begin MEASUREMENT MisfDet_maskDnAdpnPlaus.Cmn.Raw "Mask with inhibiting conditions for plausibilisation of dn adaptation / mask of selected disabling conditions / bit mask not delayed conditions" ULONG OneToOne 1 100 0.00 4294967295.00 FORMAT "%13.2" ECU_ADDRESS 0x50000410 /end MEASUREMENT
/begin MEASUREMENT MisfDet_maskDnDet "bitmask with cylinders which are detected as misfiring by the Dn-Evaluation procedure" UWORD OneToOne 1 100 0.00 65535.00 FORMAT "%8.2" ECU_ADDRESS 0x5000082E /end MEASUREMENT
/begin MEASUREMENT MisfDet_maskDnFltd.CmbTyp.Hld "Mask with inhibiting conditions of temporary dN adaption No turn off delay / mask of selected disabling conditions, engine type specific / bit mask delayed conditions" ULONG OneToOne 1 100 0.00 4294967295.00 FORMAT "%13.2" ECU_ADDRESS 0x50000438 /end MEASUREMENT
/begin MEASUREMENT MisfDet_maskDnFltd.CmbTyp.HldN "Mask with inhibiting conditions of temporary dN adaption No turn off delay / mask of selected disabling conditions, engine type specific / bit mask delayed conditions engine speed dependant" ULONG OneToOne 1 100 0.00 4294967295.00 FORMAT "%13.2" ECU_ADDRESS 0x5000043C /end MEASUREMENT
/begin MEASUREMENT MisfDet_maskDnFltd.CmbTyp.Raw "Mask with inhibiting conditions of temporary dN adaption No turn off delay / mask of selected disabling conditions, engine type specific / bit mask not delayed conditions" ULONG OneToOne 1 100 0.00 4294967295.00 FORMAT "%13.2" ECU_ADDRESS 0x50000440 /end MEASUREMENT
/begin MEASUREMENT MisfDet_maskDnFltd.Cmn.Hld "Mask with inhibiting conditions of temporary dN adaption No turn off delay / mask of selected disabling conditions / bit mask delayed conditions" ULONG OneToOne 1 100 0.00 4294967295.00 FORMAT "%13.2" ECU_ADDRESS 0x50000444 /end MEASUREMENT
/begin MEASUREMENT MisfDet_maskDnFltd.Cmn.HldN "Mask with inhibiting conditions of temporary dN adaption No turn off delay / mask of selected disabling conditions / bit mask delayed conditions engine speed dependant" ULONG OneToOne 1 100 0.00 4294967295.00 FORMAT "%13.2" ECU_ADDRESS 0x50000448 /end MEASUREMENT
/begin MEASUREMENT MisfDet_maskDnFltd.Cmn.Raw "Mask with inhibiting conditions of temporary dN adaption No turn off delay / mask of selected disabling conditions / bit mask not delayed conditions" ULONG OneToOne 1 100 0.00 4294967295.00 FORMAT "%13.2" ECU_ADDRESS 0x5000044C /end MEASUREMENT
/begin MEASUREMENT MisfDet_maskDnVld "Validity of engine roughness of the respective segment position" UBYTE OneToOne 1 100 0.00 255.0 FORMAT "%5.1" ECU_ADDRESS 0x5000099F /end MEASUREMENT
/begin MEASUREMENT MisfDet_maskMisfSti "flagword for stimulated misfire" UWORD OneToOne 1 100 0.00 65535.00 FORMAT "%8.2" ECU_ADDRESS 0x50000830 /end MEASUREMENT
/begin MEASUREMENT MisfDet_maskMisfStiIgn "flagword for stimulated ignition misfires" UWORD OneToOne 1 100 0.00 65535.00 FORMAT "%8.2" ECU_ADDRESS 0x50000832 /end MEASUREMENT
/begin MEASUREMENT MisfDet_maskMisfStiInj "flagword for stimulated injection misfires" UWORD OneToOne 1 100 0.00 65535.00 FORMAT "%8.2" ECU_ADDRESS 0x50000834 /end MEASUREMENT
/begin MEASUREMENT MisfDet_maskRelsDnAdpn "mask with inhibiting conditions of temporary dN adaption" ULONG OneToOne 1 100 0.00 4294967295.00 FORMAT "%13.2" ECU_ADDRESS 0x50000454 /end MEASUREMENT
/begin MEASUREMENT MisfDet_maskRelsDnAdpnCmbTyp "mask with inhibiting conditions of temporary dN adaption, depending on diesel- or gasoline engine" ULONG OneToOne 1 100 0.00 4294967295.00 FORMAT "%13.2" ECU_ADDRESS 0x60000438 /end MEASUREMENT
/begin MEASUREMENT MisfDet_maskRelsDnAdpnNv "mask with inhibiting conditions of storing dN adaption" ULONG OneToOne 1 100 0.00 4294967295.00 FORMAT "%13.2" ECU_ADDRESS 0x50000680 /end MEASUREMENT
/begin MEASUREMENT MisfDet_maskRelsDnAdpnNvCmbTyp "mask with inhibiting conditions of storing dN adaption, depending on diesel- or gasoline engine" ULONG OneToOne 1 100 0.00 4294967295.00 FORMAT "%13.2" ECU_ADDRESS 0x6000043C /end MEASUREMENT
/begin MEASUREMENT MisfDet_maskRelsDnAdpnNvCmbTyp2 "mask with inhibiting conditions of storing dN adaption, depending on diesel- or gasoline engine" ULONG OneToOne 1 100 0.00 4294967295.00 FORMAT "%13.2" ECU_ADDRESS 0x60000440 /end MEASUREMENT
/begin MEASUREMENT MisfDet_maskRelsDnAdpnNvCorrn "mask with inhibiting conditions for usage of stored dN adaptation values" UWORD OneToOne 1 100 0.00 65535.00 FORMAT "%8.2" ECU_ADDRESS 0x600005D6 /end MEASUREMENT
/begin MEASUREMENT MisfDet_maskRelsDnAdpnNvCorrnCmbTyp "mask with inhibiting conditions for usage of stored dN adaptation values, depending on diesel- or gasoline engine" ULONG OneToOne 1 100 0.00 4294967295.00 FORMAT "%13.2" ECU_ADDRESS 0x50000458 /end MEASUREMENT
/begin MEASUREMENT MisfDet_maskRelsDnAdpnPlaus "Bitmask with inhibiting conditions for plausibilisation of temporary dN adaption" ULONG OneToOne 1 100 0.00 4294967295.00 FORMAT "%13.2" ECU_ADDRESS 0x5000045C /end MEASUREMENT
/begin MEASUREMENT MisfDet_maskRelsDnAdpnPlausCmbTyp "mask with inhibiting conditions for plausibilisation of dN adaption, depending on diesel- or gasoline engine" ULONG OneToOne 1 100 0.00 4294967295.00 FORMAT "%13.2" ECU_ADDRESS 0x60000444 /end MEASUREMENT
/begin MEASUREMENT MisfDet_maskRelsSegTiAdpnFco "mask with inhibiting conditions of segment time adaption during fuel off" ULONG OneToOne 1 100 0.00 4294967295.00 FORMAT "%13.2" ECU_ADDRESS 0x600004F8 /end MEASUREMENT
/begin MEASUREMENT MisfDet_maskRelsSegTiAdpnFcoCmbTyp "mask with inhibiting conditions of segment time adaption during fuel off, depending on diesel- or gasoline engine" ULONG OneToOne 1 100 0.00 4294967295.00 FORMAT "%13.2" ECU_ADDRESS 0x60000448 /end MEASUREMENT
/begin MEASUREMENT MisfDet_maskRelsStc "mask with inhibiting conditions of statistical function" ULONG OneToOne 1 100 0.00 4294967295.00 FORMAT "%13.2" ECU_ADDRESS 0x600004FC /end MEASUREMENT
/begin MEASUREMENT MisfDet_maskRelsStcCmbTyp "mask with inhibiting conditions of statistical function, depending on diesel- or gasoline engine" ULONG OneToOne 1 100 0.00 4294967295.00 FORMAT "%13.2" ECU_ADDRESS 0x60000500 /end MEASUREMENT
/begin MEASUREMENT MisfDet_maskSegTiAdpn.CmbTyp.Raw "Mask with inhibiting conditions of segment time adaption during fuel on, no turn off delay / mask of selected disabling conditions, engine type specific / bit mask not delayed conditions" ULONG OneToOne 1 100 0.00 4294967295.00 FORMAT "%13.2" ECU_ADDRESS 0x50000468 /end MEASUREMENT
/begin MEASUREMENT MisfDet_maskSegTiAdpn.CmbTyp2.Raw "Mask with inhibiting conditions of segment time adaption during fuel on, no turn off delay / mask of selected disabling conditions, engine type specific / bit mask not delayed conditions" ULONG OneToOne 1 100 0.00 4294967295.00 FORMAT "%13.2" ECU_ADDRESS 0x5000046C /end MEASUREMENT
/begin MEASUREMENT MisfDet_maskSegTiAdpn.Cmn.Raw "Mask with inhibiting conditions of segment time adaption during fuel on, no turn off delay / mask of selected disabling conditions / bit mask not delayed conditions" ULONG OneToOne 1 100 0.00 4294967295.00 FORMAT "%13.2" ECU_ADDRESS 0x50000470 /end MEASUREMENT
/begin MEASUREMENT MisfDet_maskSegTiAdpnFco.CmbTyp.Raw "Mask with inhibiting conditions of segment time adaption during fuel cut off / mask of selected disabling conditions, engine type specific / bit mask not delayed conditions" ULONG OneToOne 1 100 0.00 4294967295.00 FORMAT "%13.2" ECU_ADDRESS 0x50000460 /end MEASUREMENT
/begin MEASUREMENT MisfDet_maskSegTiAdpnFco.Cmn.Raw "Mask with inhibiting conditions of segment time adaption during fuel cut off / mask of selected disabling conditions / bit mask not delayed conditions" ULONG OneToOne 1 100 0.00 4294967295.00 FORMAT "%13.2" ECU_ADDRESS 0x50000464 /end MEASUREMENT
/begin MEASUREMENT MisfDet_maskStc.CmbTyp.Hld "Mask with inhibiting conditions of statistical function, no turn off delay / mask of selected disabling conditions, engine type specific / bit mask delayed conditions" ULONG OneToOne 1 100 0.00 4294967295.00 FORMAT "%13.2" ECU_ADDRESS 0x50000478 /end MEASUREMENT
/begin MEASUREMENT MisfDet_maskStc.CmbTyp.HldN "Mask with inhibiting conditions of statistical function, no turn off delay / mask of selected disabling conditions, engine type specific / bit mask delayed conditions engine speed dependant" ULONG OneToOne 1 100 0.00 4294967295.00 FORMAT "%13.2" ECU_ADDRESS 0x5000047C /end MEASUREMENT
/begin MEASUREMENT MisfDet_maskStc.CmbTyp.Raw "Mask with inhibiting conditions of statistical function, no turn off delay / mask of selected disabling conditions, engine type specific / bit mask not delayed conditions" ULONG OneToOne 1 100 0.00 4294967295.00 FORMAT "%13.2" ECU_ADDRESS 0x50000480 /end MEASUREMENT
/begin MEASUREMENT MisfDet_maskStc.Cmn.Hld "Mask with inhibiting conditions of statistical function, no turn off delay / mask of selected disabling conditionsmask of selected disabling conditions / bit mask delayed conditions" ULONG OneToOne 1 100 0.00 4294967295.00 FORMAT "%13.2" ECU_ADDRESS 0x50000484 /end MEASUREMENT
/begin MEASUREMENT MisfDet_maskStc.Cmn.HldN "Mask with inhibiting conditions of statistical function, no turn off delay / mask of selected disabling conditionsmask of selected disabling conditions / bit mask delayed conditions engine speed dependant" ULONG OneToOne 1 100 0.00 4294967295.00 FORMAT "%13.2" ECU_ADDRESS 0x50000488 /end MEASUREMENT
/begin MEASUREMENT MisfDet_maskStc.Cmn.Raw "Mask with inhibiting conditions of statistical function, no turn off delay / mask of selected disabling conditionsmask of selected disabling conditions / bit mask not delayed conditions" ULONG OneToOne 1 100 0.00 4294967295.00 FORMAT "%13.2" ECU_ADDRESS 0x5000048C /end MEASUREMENT
/begin MEASUREMENT MisfDet_misfMod "actual misfire mode" SWORD OneToOne 1 100 -32768.00 32767.00 FORMAT "%8.2" ECU_ADDRESS 0x600005DA /end MEASUREMENT
/begin MEASUREMENT MisfDet_nEngSync "engine speed synchronised" SWORD EngN 1 100 -16384.00 16383.50 FORMAT "%8.2" ECU_ADDRESS 0x600006FA /end MEASUREMENT
/begin MEASUREMENT MisfDet_nrCmbDi "Number of ignitions for blank-out after a detecte misfire." UBYTE OneToOne 1 100 0.00 255.0 FORMAT "%5.1" ECU_ADDRESS 0x500009A2 /end MEASUREMENT
/begin MEASUREMENT MisfDet_nSetPLoDiff "low idle control deviation" SWORD EngN 1 100 -16384.00 16383.50 FORMAT "%8.2" ECU_ADDRESS 0x600006FE /end MEASUREMENT
/begin MEASUREMENT MisfDet_numGear "Variable to indicate the gear number for MisfDet" SBYTE OneToOne 1 100 -128.0 127.0 FORMAT "%5.1" ECU_ADDRESS 0x600008FC /end MEASUREMENT
/begin MEASUREMENT MisfDet_openPtDlyCntr "Debounce counter for detection of open drive train" UBYTE OneToOne 1 100 0.00 255.0 FORMAT "%5.1" ECU_ADDRESS 0x7000215C /end MEASUREMENT
/begin MEASUREMENT MisfDet_segPosnDn "segment position engine roughness" UBYTE Compu_SegPosnInt_VERB 1 100 0.00 259.000000000 FORMAT "%13.9" ECU_ADDRESS 0x500009A3 /end MEASUREMENT
/begin MEASUREMENT MisfDet_stAcCtlChng "State of air climate compressor changed" UBYTE B_TRUE 1 100 0.00 1.00000000000 BIT_MASK 0x1 FORMAT "%13.11" ECU_ADDRESS 0x7000081C /end MEASUREMENT
/begin MEASUREMENT MisfDet_stAgKnkCtrl "Condition maximum ignition-timing retardation is over threshold" UBYTE B_TRUE 1 100 0.00 1.00000000000 BIT_MASK 0x1 FORMAT "%13.11" ECU_ADDRESS 0x70000178 /end MEASUREMENT
/begin MEASUREMENT MisfDet_stAsr "Torque intervention by road handling control" UBYTE B_TRUE 1 100 0.00 1.00000000000 BIT_MASK 0x1 FORMAT "%13.11" ECU_ADDRESS 0x6000F8DE /end MEASUREMENT
/begin MEASUREMENT MisfDet_stBlkAftDetn "Suppresion after detected misfire" UBYTE B_TRUE 1 100 0.00 1.00000000000 BIT_MASK 0x1 FORMAT "%13.11" ECU_ADDRESS 0x7000081B /end MEASUREMENT
/begin MEASUREMENT MisfDet_stBlkAftDetnTest "test phase after detected misfire" UBYTE B_TRUE 1 100 0.00 1.00000000000 BIT_MASK 0x1 FORMAT "%13.11" ECU_ADDRESS 0x7000081A /end MEASUREMENT
/begin MEASUREMENT MisfDet_stBlkDnAdpn "Inhibiting condition for temporary dN adaption" UBYTE B_TRUE 1 100 0.00 1.00000000000 BIT_MASK 0x1 FORMAT "%13.11" ECU_ADDRESS 0x70000819 /end MEASUREMENT
/begin MEASUREMENT MisfDet_stBlkDnAdpnNv "Inhibiting condition for storing dN adaption" UBYTE B_TRUE 1 100 0.00 1.00000000000 BIT_MASK 0x1 FORMAT "%13.11" ECU_ADDRESS 0x70000818 /end MEASUREMENT
/begin MEASUREMENT MisfDet_stBlkDnAdpnNvCorrn "Inhibiting condition for usage of adapdted dN values" UBYTE B_TRUE 1 100 0.00 1.00000000000 BIT_MASK 0x1 FORMAT "%13.11" ECU_ADDRESS 0x70000817 /end MEASUREMENT
/begin MEASUREMENT MisfDet_stBlkDnAdpnNvCorrnTyp "Inhibiting condition for usage of adapdted dN values no turn off delay, with and without delay (bit mask)" UBYTE OneToOne 1 100 0.00 255.0 FORMAT "%5.1" ECU_ADDRESS 0x60000900 /end MEASUREMENT
/begin MEASUREMENT MisfDet_stBlkDnAdpnNvTyp "Inhibiting condition for storing dN adaption, with and without delay (bit mask)" UBYTE OneToOne 1 100 0.00 255.0 FORMAT "%5.1" ECU_ADDRESS 0x60000901 /end MEASUREMENT
/begin MEASUREMENT MisfDet_stBlkDnAdpnPlaus "Inhibiting conditions for plausibilisation of temporary dN adaption" UBYTE B_TRUE 1 100 0.00 1.00000000000 BIT_MASK 0x1 FORMAT "%13.11" ECU_ADDRESS 0x70000816 /end MEASUREMENT
/begin MEASUREMENT MisfDet_stBlkDnAdpnPlausTyp "Inhibiting conditions for plausibilisation of temporary dN adaption, with and without delay (bit mask)" UBYTE OneToOne 1 100 0.00 255.0 FORMAT "%5.1" ECU_ADDRESS 0x60000902 /end MEASUREMENT
/begin MEASUREMENT MisfDet_stBlkDnAdpnTyp "Inhibiting condition for temporary dN adaption, with and without delay (bit mask)" UBYTE OneToOne 1 100 0.00 255.0 FORMAT "%5.1" ECU_ADDRESS 0x60000903 /end MEASUREMENT
/begin MEASUREMENT MisfDet_stBlkDnFltd "Inhibiting condition for dN calculation" UBYTE B_TRUE 1 100 0.00 1.00000000000 BIT_MASK 0x1 FORMAT "%13.11" ECU_ADDRESS 0x70000815 /end MEASUREMENT
/begin MEASUREMENT MisfDet_stBlkDnFltdTyp "Inhibiting condition for dN calculation, with and without delay (bit mask)" UBYTE OneToOne 1 100 0.00 255.0 FORMAT "%5.1" ECU_ADDRESS 0x60000904 /end MEASUREMENT
/begin MEASUREMENT MisfDet_stBlkSegTiAdpn "Inhibiting condition for segment time adaption, fuel on" UBYTE B_TRUE 1 100 0.00 1.00000000000 BIT_MASK 0x1 FORMAT "%13.11" ECU_ADDRESS 0x70000814 /end MEASUREMENT
/begin MEASUREMENT MisfDet_stBlkSegTiAdpnFco "Inhibiting condition for segment time adaption, fuel off" UBYTE B_TRUE 1 100 0.00 1.00000000000 BIT_MASK 0x1 FORMAT "%13.11" ECU_ADDRESS 0x70000813 /end MEASUREMENT
/begin MEASUREMENT MisfDet_stBlkSegTiAdpnFcoTyp "Inhibiting condition for segment time adaption during fuel cut off, with and without delay (bit mask)" UBYTE B_TRUE 1 100 0.00 1.00000000000 BIT_MASK 0x1 FORMAT "%13.11" ECU_ADDRESS 0x70000177 /end MEASUREMENT
/begin MEASUREMENT MisfDet_stBlkSegTiAdpnTyp "Inhibiting condition for segment time adaption during fuel onInhibiting condition statistical function" UBYTE B_TRUE 1 100 0.00 1.00000000000 BIT_MASK 0x1 FORMAT "%13.11" ECU_ADDRESS 0x70000176 /end MEASUREMENT
/begin MEASUREMENT MisfDet_stBlkStc "Inhibiting condition statistical function" UBYTE B_TRUE 1 100 0.00 1.00000000000 BIT_MASK 0x1 FORMAT "%13.11" ECU_ADDRESS 0x70000812 /end MEASUREMENT
/begin MEASUREMENT MisfDet_stBlkStcTyp "Inhibiting condition statistical function, with and without delay (bit mask)" UBYTE OneToOne 1 100 0.00 255.0 FORMAT "%5.1" ECU_ADDRESS 0x60000905 /end MEASUREMENT
/begin MEASUREMENT MisfDet_stCamsftDiagActv "Inhibition due to condition function request diagnosis high pressure injection valve by tester." UBYTE B_TRUE 1 100 0.00 1.00000000000 BIT_MASK 0x1 FORMAT "%13.11" ECU_ADDRESS 0x70000171 /end MEASUREMENT
/begin MEASUREMENT MisfDet_stCatHeat "Condition catalyst heating for misfire detection" UBYTE B_TRUE 1 100 0.00 1.00000000000 BIT_MASK 0x1 FORMAT "%13.11" ECU_ADDRESS 0x50006026 /end MEASUREMENT
/begin MEASUREMENT MisfDet_stClthChng "clutch pedal pressed" UBYTE B_TRUE 1 100 0.00 1.00000000000 BIT_MASK 0x1 FORMAT "%13.11" ECU_ADDRESS 0x70000811 /end MEASUREMENT
/begin MEASUREMENT MisfDet_stCpvActv "Condition canister purge control active" UBYTE B_TRUE 1 100 0.00 1.00000000000 BIT_MASK 0x1 FORMAT "%13.11" ECU_ADDRESS 0x70000170 /end MEASUREMENT
/begin MEASUREMENT MisfDet_stDeltaAgIgnBas "Condition delta ignition angle to base ignition angle exceeds threshold" UBYTE B_TRUE 1 100 0.00 1.00000000000 BIT_MASK 0x1 FORMAT "%13.11" ECU_ADDRESS 0x70000175 /end MEASUREMENT
/begin MEASUREMENT MisfDet_stDet "state misfire detected" UBYTE B_TRUE 1 100 0.00 1.00000000000 BIT_MASK 0x1 FORMAT "%13.11" ECU_ADDRESS 0x7000080D /end MEASUREMENT
/begin MEASUREMENT MisfDet_stDlyDnAdpn "Delay condition after start for releasing statistical function" UBYTE B_TRUE 1 100 0.00 1.00000000000 BIT_MASK 0x1 FORMAT "%13.11" ECU_ADDRESS 0x7000016F /end MEASUREMENT
/begin MEASUREMENT MisfDet_stDlyStrtStc "Delay condition after start for releasing statistical function" UBYTE B_TRUE 1 100 0.00 1.00000000000 BIT_MASK 0x1 FORMAT "%13.11" ECU_ADDRESS 0x70000174 /end MEASUREMENT
/begin MEASUREMENT MisfDet_stDlyTiStrt "state delay time after start is active" UBYTE B_TRUE 1 100 0.00 1.00000000000 BIT_MASK 0x1 FORMAT "%13.11" ECU_ADDRESS 0x7000080C /end MEASUREMENT
/begin MEASUREMENT MisfDet_stDnAdpnCalc "Adaptation currently calculated" UBYTE B_TRUE 1 100 0.00 1.00000000000 BIT_MASK 0x1 FORMAT "%13.11" ECU_ADDRESS 0x70000189 /end MEASUREMENT
/begin MEASUREMENT MisfDet_stDnAdpnInit "Status initialisation of DnAdpnVal at discontinuation of MisfDet_stBlkDnAdpnNvCorrn" UBYTE B_TRUE 1 100 0.00 1.00000000000 BIT_MASK 0x1 FORMAT "%13.11" ECU_ADDRESS 0x70000188 /end MEASUREMENT
/begin MEASUREMENT MisfDet_stDnAdpnNvCalc "NV adaptation currently calculated" UBYTE B_TRUE 1 100 0.00 1.00000000000 BIT_MASK 0x1 FORMAT "%13.11" ECU_ADDRESS 0x50006028 /end MEASUREMENT
/begin MEASUREMENT MisfDet_stDnAdpnNvPlausAbsFail "absolute plaus check of NV adaptation values failed" UBYTE B_TRUE 1 100 0.00 1.00000000000 BIT_MASK 0x1 FORMAT "%13.11" ECU_ADDRESS 0x6000F8D8 /end MEASUREMENT
/begin MEASUREMENT MisfDet_stDnAdpnNvPlausSumFail "sum plaus check of NV adaptation values failed" UBYTE B_TRUE 1 100 0.00 1.00000000000 BIT_MASK 0x1 FORMAT "%13.11" ECU_ADDRESS 0x6000F8D7 /end MEASUREMENT
/begin MEASUREMENT MisfDet_stDnAdpnNvRdy "Displaying the adapted ranges" UBYTE OneToOne 1 100 0.00 255.0 FORMAT "%5.1" ARRAY_SIZE 3 ECU_ADDRESS 0x60038D14 /end MEASUREMENT
/begin MEASUREMENT MisfDet_stDnAdpnNvRdyCurr "current range adapted" UBYTE B_TRUE 1 100 0.00 1.00000000000 BIT_MASK 0x1 FORMAT "%13.11" ECU_ADDRESS 0x50006029 /end MEASUREMENT
/begin MEASUREMENT MisfDet_stDnAdpnNvUsd "non volatile adaptation values used" UBYTE B_TRUE 1 100 0.00 1.00000000000 BIT_MASK 0x1 FORMAT "%13.11" ECU_ADDRESS 0x70000187 /end MEASUREMENT
/begin MEASUREMENT MisfDet_stDnAdpnPlausAbsFail "absolute plaus check of adaptation values failed" UBYTE B_TRUE 1 100 0.00 1.00000000000 BIT_MASK 0x1 FORMAT "%13.11" ECU_ADDRESS 0x6000F8D6 /end MEASUREMENT
/begin MEASUREMENT MisfDet_stDnAdpnPlausMinFail "status DnAdpn Min-plaus check failed" UBYTE B_TRUE 1 100 0.00 1.00000000000 BIT_MASK 0x1 FORMAT "%13.11" ECU_ADDRESS 0x70000186 /end MEASUREMENT
/begin MEASUREMENT MisfDet_stDnAdpnPlausRelCntrLim "maximum number of allowed failed relative plaus checks reached" UBYTE B_TRUE 1 100 0.00 1.00000000000 BIT_MASK 0x1 FORMAT "%13.11" ECU_ADDRESS 0x7000017F /end MEASUREMENT
/begin MEASUREMENT MisfDet_stDnAdpnPlausRelFail "relative plaus check of adaptation values failed" UBYTE B_TRUE 1 100 0.00 1.00000000000 BIT_MASK 0x1 FORMAT "%13.11" ECU_ADDRESS 0x6000F8D5 /end MEASUREMENT
/begin MEASUREMENT MisfDet_stDnAdpnRngChng "Change of adaptation range" UBYTE B_TRUE 1 100 0.00 1.00000000000 BIT_MASK 0x1 FORMAT "%13.11" ECU_ADDRESS 0x70000185 /end MEASUREMENT
/begin MEASUREMENT MisfDet_stDnAdpnRngLock "Current load is inside lock range" UBYTE B_TRUE 1 100 0.00 1.00000000000 BIT_MASK 0x1 FORMAT "%13.11" ECU_ADDRESS 0x70000184 /end MEASUREMENT
/begin MEASUREMENT MisfDet_stDnAdpnRngOutd "current working point is outside adaptation range" UBYTE B_TRUE 1 100 0.00 1.00000000000 BIT_MASK 0x1 FORMAT "%13.11" ECU_ADDRESS 0x70000183 /end MEASUREMENT
/begin MEASUREMENT MisfDet_stDnAdpnRngOutdNEng "current engine speed outside adaptation range" UBYTE B_TRUE 1 100 0.00 1.00000000000 BIT_MASK 0x1 FORMAT "%13.11" ECU_ADDRESS 0x70000182 /end MEASUREMENT
/begin MEASUREMENT MisfDet_stDnAdpnRngOutdTq "current load outside adaptation range" UBYTE B_TRUE 1 100 0.00 1.00000000000 BIT_MASK 0x1 FORMAT "%13.11" ECU_ADDRESS 0x7000017E /end MEASUREMENT
/begin MEASUREMENT MisfDet_stDnAdpnRngTq "minimum load limit exceeded for coninuous dn adaptation" UBYTE B_TRUE 1 100 0.00 1.00000000000 BIT_MASK 0x1 FORMAT "%13.11" ECU_ADDRESS 0x70000181 /end MEASUREMENT
/begin MEASUREMENT MisfDet_stDnAdpnRstCfm "confirmatino of reset DnAdpn" UBYTE B_TRUE 1 100 0.00 1.00000000000 BIT_MASK 0x1 FORMAT "%13.11" ECU_ADDRESS 0x6000F8D4 /end MEASUREMENT
/begin MEASUREMENT MisfDet_stDnAdpnRstReqAvs "Reset request Dn-adaptation via AVS" UBYTE B_TRUE 1 100 0.00 1.00000000000 BIT_MASK 0x1 FORMAT "%13.11" ECU_ADDRESS 0x6000F8D2 /end MEASUREMENT
/begin MEASUREMENT MisfDet_stDnAdpnUsd "adaptation values of continuous adaptation used" UBYTE B_TRUE 1 100 0.00 1.00000000000 BIT_MASK 0x1 FORMAT "%13.11" ECU_ADDRESS 0x70000180 /end MEASUREMENT
/begin MEASUREMENT MisfDet_stDnCycMaxAdpn "status of average engine running roughness of one working cycle exceeded its threshold" UBYTE B_TRUE 1 100 0.00 1.00000000000 BIT_MASK 0x1 FORMAT "%13.11" ECU_ADDRESS 0x7000080B /end MEASUREMENT
/begin MEASUREMENT MisfDet_stDnDet "state misfiring thresholds exceeded" UBYTE OneToOne 1 100 0.00 255.0 FORMAT "%5.1" ECU_ADDRESS 0x500009A9 /end MEASUREMENT
/begin MEASUREMENT MisfDet_stDnDifSelActv "Usage of MisfDet_dnDifNxt or MisfDet_dnDifMin as filter input possible" UBYTE B_TRUE 1 100 0.00 1.00000000000 BIT_MASK 0x1 FORMAT "%13.11" ECU_ADDRESS 0x5000602A /end MEASUREMENT
/begin MEASUREMENT MisfDet_stDnDifSelActvCurr "MisfDet_dnDifNxt or MisfDet_dnDifMin is used as filter input for current sample" UBYTE B_TRUE 1 100 0.00 1.00000000000 BIT_MASK 0x1 FORMAT "%13.11" ECU_ADDRESS 0x6000F8D1 /end MEASUREMENT
/begin MEASUREMENT MisfDet_stDnFltdZeroNoSegTiAdpn "state reset correction of dn threshold" UBYTE B_TRUE 1 100 0.00 1.00000000000 BIT_MASK 0x1 FORMAT "%13.11" ECU_ADDRESS 0x70000173 /end MEASUREMENT
/begin MEASUREMENT MisfDet_stDPedlPosnOutOfRng "Status gradient of the accelerator pedal position is out of the allowed range" UBYTE B_TRUE 1 100 0.00 1.00000000000 BIT_MASK 0x1 FORMAT "%13.11" ECU_ADDRESS 0x7000080F /end MEASUREMENT
/begin MEASUREMENT MisfDet_stDTqOutOfRng "state torque gradient out of range" UBYTE B_TRUE 1 100 0.00 1.00000000000 BIT_MASK 0x1 FORMAT "%13.11" ECU_ADDRESS 0x7000080E /end MEASUREMENT
/begin MEASUREMENT MisfDet_stDynCmpOptmzd "Status optimized dynamic compensation" UBYTE B_TRUE 1 100 0.00 1.00000000000 BIT_MASK 0x1 FORMAT "%13.11" ECU_ADDRESS 0x7000017D /end MEASUREMENT
/begin MEASUREMENT MisfDet_stEngReStrt "condition engine has restarted, start stop vehicle" UBYTE B_TRUE 1 100 0.00 1.00000000000 BIT_MASK 0x1 FORMAT "%13.11" ECU_ADDRESS 0x70000172 /end MEASUREMENT
/begin MEASUREMENT MisfDet_stEngStrt "state engine is in starting condition" UBYTE B_TRUE 1 100 0.00 1.00000000000 BIT_MASK 0x1 FORMAT "%13.11" ECU_ADDRESS 0x70000809 /end MEASUREMENT
/begin MEASUREMENT MisfDet_stFcmClr "falg staus to request the fault memory clear" UBYTE B_TRUE 1 100 0.00 1.00000000000 BIT_MASK 0x1 FORMAT "%13.11" ECU_ADDRESS 0x5000602C /end MEASUREMENT
/begin MEASUREMENT MisfDet_stFcmClr1000ms "Condition clear fault code memory (for 1000ms process)" UBYTE B_TRUE 1 100 0.00 1.00000000000 BIT_MASK 0x1 FORMAT "%13.11" ECU_ADDRESS 0x6000F8CF /end MEASUREMENT
/begin MEASUREMENT MisfDet_stFcmClr100ms "Condition clear fault code memory (for 100ms process)" UBYTE B_TRUE 1 100 0.00 1.00000000000 BIT_MASK 0x1 FORMAT "%13.11" ECU_ADDRESS 0x6000F8CE /end MEASUREMENT
/begin MEASUREMENT MisfDet_stFcmClr10ms "Condition clear fault code memory (for 10ms process)" UBYTE B_TRUE 1 100 0.00 1.00000000000 BIT_MASK 0x1 FORMAT "%13.11" ECU_ADDRESS 0x6000F8CD /end MEASUREMENT
/begin MEASUREMENT MisfDet_stFcmClr200ms "Condition clear fault code memory (for 200ms process)" UBYTE B_TRUE 1 100 0.00 1.00000000000 BIT_MASK 0x1 FORMAT "%13.11" ECU_ADDRESS 0x6000F8CC /end MEASUREMENT
/begin MEASUREMENT MisfDet_stFcmClr20ms "Condition clear fault code memory (for 20ms process)" UBYTE B_TRUE 1 100 0.00 1.00000000000 BIT_MASK 0x1 FORMAT "%13.11" ECU_ADDRESS 0x6000F8CB /end MEASUREMENT
/begin MEASUREMENT MisfDet_stFlreDwn "state engine is in flare down condition" UBYTE B_TRUE 1 100 0.00 1.00000000000 BIT_MASK 0x1 FORMAT "%13.11" ECU_ADDRESS 0x70000808 /end MEASUREMENT
/begin MEASUREMENT MisfDet_stGripChngPt "state grip conditions at clutch has changed" UBYTE B_TRUE 1 100 0.00 1.00000000000 BIT_MASK 0x1 FORMAT "%13.11" ECU_ADDRESS 0x70000807 /end MEASUREMENT
/begin MEASUREMENT MisfDet_stIdle "engine is in idle state" UBYTE B_TRUE 1 100 0.00 1.00000000000 BIT_MASK 0x1 FORMAT "%13.11" ECU_ADDRESS 0x5000602D /end MEASUREMENT
/begin MEASUREMENT MisfDet_stIdleChng "engine enters or exits idle state" UBYTE B_TRUE 1 100 0.00 1.00000000000 BIT_MASK 0x1 FORMAT "%13.11" ECU_ADDRESS 0x70000806 /end MEASUREMENT
/begin MEASUREMENT MisfDet_stLineEnd "Status indicting detection of line-end" UBYTE B_TRUE 1 100 0.00 1.00000000000 BIT_MASK 0x1 FORMAT "%13.11" ECU_ADDRESS 0x7000016E /end MEASUREMENT
/begin MEASUREMENT MisfDet_stMisfGenrEna "state of enabling misfire generator" UBYTE B_TRUE 1 100 0.00 1.00000000000 BIT_MASK 0x1 FORMAT "%13.11" ECU_ADDRESS 0x7000017C /end MEASUREMENT
/begin MEASUREMENT MisfDet_stMisfGenrEnaTrg "state of enabling trigger of misfire generator" UBYTE B_TRUE 1 100 0.00 1.00000000000 BIT_MASK 0x1 FORMAT "%13.11" ECU_ADDRESS 0x7000017B /end MEASUREMENT
/begin MEASUREMENT MisfDet_stMisfGenrRun "state misfire generator running" UBYTE B_TRUE 1 100 0.00 1.00000000000 BIT_MASK 0x1 FORMAT "%13.11" ECU_ADDRESS 0x70000804 /end MEASUREMENT
/begin MEASUREMENT MisfDet_stMisfGenrRunIgn "misfire generator running via ignition cut off" UBYTE B_TRUE 1 100 0.00 1.00000000000 BIT_MASK 0x1 FORMAT "%13.11" ECU_ADDRESS 0x70000803 /end MEASUREMENT
/begin MEASUREMENT MisfDet_stMisfModActv "state misfire mode in progress" UBYTE B_TRUE 1 100 0.00 1.00000000000 BIT_MASK 0x1 FORMAT "%13.11" ECU_ADDRESS 0x7000017A /end MEASUREMENT
/begin MEASUREMENT MisfDet_stMisfSti "cond. for misfire demanded, stimuli signal from software misfiring generator" UBYTE B_TRUE 1 100 0.00 1.00000000000 BIT_MASK 0x1 FORMAT "%13.11" ECU_ADDRESS 0x5000602F /end MEASUREMENT
/begin MEASUREMENT MisfDet_stMisfStiSync "state misfire was stimulated by misfire generator, synchronised" UBYTE B_TRUE 1 100 0.00 1.00000000000 BIT_MASK 0x1 FORMAT "%13.11" ECU_ADDRESS 0x6000F8CA /end MEASUREMENT
/begin MEASUREMENT MisfDet_stMsr "condition MSR" UBYTE B_TRUE 1 100 0.00 1.00000000000 BIT_MASK 0x1 FORMAT "%13.11" ECU_ADDRESS 0x6000F8C9 /end MEASUREMENT
/begin MEASUREMENT MisfDet_stNEngOutOfRng "state engine speed out of limits for misfire detection" UBYTE B_TRUE 1 100 0.00 1.00000000000 BIT_MASK 0x1 FORMAT "%13.11" ECU_ADDRESS 0x70000802 /end MEASUREMENT
/begin MEASUREMENT MisfDet_stNmax "condition engine speed limitation is active" UBYTE B_TRUE 1 100 0.00 1.00000000000 BIT_MASK 0x1 FORMAT "%13.11" ECU_ADDRESS 0x70000801 /end MEASUREMENT
/begin MEASUREMENT MisfDet_stNoInj "Status no injection" UBYTE B_TRUE 1 100 0.00 1.00000000000 BIT_MASK 0x1 FORMAT "%13.11" ECU_ADDRESS 0x6000F8C8 /end MEASUREMENT
/begin MEASUREMENT MisfDet_stNoInjSync "no injection synchronised" UBYTE B_TRUE 1 100 0.00 1.00000000000 BIT_MASK 0x1 FORMAT "%13.11" ECU_ADDRESS 0x50006030 /end MEASUREMENT
/begin MEASUREMENT MisfDet_stOpenPt "status drive train open" UBYTE B_TRUE 1 100 0.00 1.00000000000 BIT_MASK 0x1 FORMAT "%13.11" ECU_ADDRESS 0x50006031 /end MEASUREMENT
/begin MEASUREMENT MisfDet_stRedStgTrqSyncSegTi "no injection cutoff request active synchronized with segment time" UBYTE B_TRUE 1 100 0.00 1.00000000000 BIT_MASK 0x1 FORMAT "%13.11" ECU_ADDRESS 0x6000F8C4 /end MEASUREMENT
/begin MEASUREMENT MisfDet_stReIni "Condition - ECU is in state Re-Initialization (Used in synchronous task)" UBYTE B_TRUE 1 100 0.00 1.00000000000 BIT_MASK 0x1 FORMAT "%13.11" ECU_ADDRESS 0x50006033 /end MEASUREMENT
/begin MEASUREMENT MisfDet_stReIni100ms "Condition ECU is in state ReIni (for 100ms process)" UBYTE B_TRUE 1 100 0.00 1.00000000000 BIT_MASK 0x1 FORMAT "%13.11" ECU_ADDRESS 0x6000F8C7 /end MEASUREMENT
/begin MEASUREMENT MisfDet_stReIni200ms "Condition ECU is in state ReIni (for 200ms process)" UBYTE B_TRUE 1 100 0.00 1.00000000000 BIT_MASK 0x1 FORMAT "%13.11" ECU_ADDRESS 0x6000F8C6 /end MEASUREMENT
/begin MEASUREMENT MisfDet_stReIni20ms "Condition ECU is in state ReIni (for 20ms process)" UBYTE B_TRUE 1 100 0.00 1.00000000000 BIT_MASK 0x1 FORMAT "%13.11" ECU_ADDRESS 0x6000F8C5 /end MEASUREMENT
/begin MEASUREMENT MisfDet_stSecCamsftAftStrt "state 2nd working cycle after start passed" UBYTE B_TRUE 1 100 0.00 1.00000000000 BIT_MASK 0x1 FORMAT "%13.11" ECU_ADDRESS 0x70000179 /end MEASUREMENT
/begin MEASUREMENT MisfDet_stSegPosnAltv "status alternative segment position" UBYTE B_TRUE 1 100 0.00 1.00000000000 BIT_MASK 0x2 FORMAT "%13.11" ECU_ADDRESS 0x6000AED0 /end MEASUREMENT
/begin MEASUREMENT MisfDet_stSegTiAdpnRstReq "Reset request to segment time adaptation" UBYTE B_TRUE 1 100 0.00 1.00000000000 BIT_MASK 0x1 FORMAT "%13.11" ECU_ADDRESS 0x6000F8BB /end MEASUREMENT
/begin MEASUREMENT MisfDet_stSetZeroTq "state zero torque threshold is set to zero" UBYTE B_TRUE 1 100 0.00 1.00000000000 BIT_MASK 0x1 FORMAT "%13.11" ECU_ADDRESS 0x70000800 /end MEASUREMENT
/begin MEASUREMENT MisfDet_stStrtDeb "state engine is in starting conditions, debounced" UBYTE B_TRUE 1 100 0.00 1.00000000000 BIT_MASK 0x1 FORMAT "%13.11" ECU_ADDRESS 0x700007FF /end MEASUREMENT
/begin MEASUREMENT MisfDet_stTEngLow "state engine temperature low" UBYTE B_TRUE 1 100 0.00 1.00000000000 BIT_MASK 0x1 FORMAT "%13.11" ECU_ADDRESS 0x700007FE /end MEASUREMENT
/begin MEASUREMENT MisfDet_stTEngLowDnAdpn "state engine temperature low for dN Adaption" UBYTE B_TRUE 1 100 0.00 1.00000000000 BIT_MASK 0x1 FORMAT "%13.11" ECU_ADDRESS 0x700007FD /end MEASUREMENT
/begin MEASUREMENT MisfDet_stTqZero "state engine torque is under threshold for zero torque at crankshaft" UBYTE B_TRUE 1 100 0.00 1.00000000000 BIT_MASK 0x1 FORMAT "%13.11" ECU_ADDRESS 0x700007FC /end MEASUREMENT
/begin MEASUREMENT MisfDet_stTrsmTiLow "state active time of transmission is under threshold" UBYTE B_TRUE 1 100 0.00 1.00000000000 BIT_MASK 0x1 FORMAT "%13.11" ECU_ADDRESS 0x700007FB /end MEASUREMENT
/begin MEASUREMENT MisfDet_tEng "engine temperature for MisfDet" SWORD Temp_Cels 1 100 -3549.940 3003.560 FORMAT "%8.3" ECU_ADDRESS 0x50005DB2 /end MEASUREMENT
/begin MEASUREMENT MisfDet_tEngStrt "Engine temperature at start" SWORD Temp_Cels 1 100 -3549.940 3003.560 FORMAT "%8.3" ECU_ADDRESS 0x50005DB4 /end MEASUREMENT
/begin MEASUREMENT MisfDet_thdTqZero "threshold for zero torque output at crankshaft" UWORD rel_uw_b100 1 100 0.00 99.99847 FORMAT "%8.5" ECU_ADDRESS 0x6000070E /end MEASUREMENT
/begin MEASUREMENT MisfDet_thdTqZeroRaw "threshold for uncorrected zero torque output at crankshaft" UWORD rel_uw_b100 1 100 0.00 99.99847 FORMAT "%8.5" ECU_ADDRESS 0x600005E4 /end MEASUREMENT
/begin MEASUREMENT MisfDet_tiEngOff "Engine off time for drivetrain temperature model for Misfire detection" UWORD Time_sec_q1_COMPU 1 100 0.00 65535.00 FORMAT "%8.2" ECU_ADDRESS 0x60006A2C /end MEASUREMENT
/begin MEASUREMENT MisfDet_tiEngRun "engine running time" UWORD t_q0p1 1 100 0.00 6553.500 FORMAT "%8.3" ECU_ADDRESS 0x60000712 /end MEASUREMENT
/begin MEASUREMENT MisfDet_tiEngRunSum "accumulated engine running time" UWORD t_q0p1 1 100 0.00 6553.500 FORMAT "%8.3" ECU_ADDRESS 0x60000714 /end MEASUREMENT
/begin MEASUREMENT MisfDet_tiTrsmAct "time in which transmission was active" SLONG Time_Dt 1 100 0.00 2147.48364700 FORMAT "%13.8" ECU_ADDRESS 0x500006A4 /end MEASUREMENT
/begin MEASUREMENT MisfDet_tiTrsmCorr "Correction value for initialisation of the drivetrain temperature model" UWORD Time_sec_q1_COMPU 1 100 0.00 65535.00 FORMAT "%8.2" ECU_ADDRESS 0x70002100 /end MEASUREMENT
/begin MEASUREMENT MisfDet_tqAct "normed engine torque for misfire detection" UWORD rel_uw_b100 1 100 0.00 99.99847 FORMAT "%8.5" ECU_ADDRESS 0x60000716 /end MEASUREMENT
/begin MEASUREMENT MisfDet_tqBasc "base torque" UWORD rel_uw_b100 1 100 0.00 99.99847 FORMAT "%8.5" ECU_ADDRESS 0x50000860 /end MEASUREMENT
/begin MEASUREMENT MisfDet_tqBascSync "synchronised base torque" UWORD rel_uw_b100 1 100 0.00 99.99847 FORMAT "%8.5" ECU_ADDRESS 0x6000071A /end MEASUREMENT
/begin MEASUREMENT MisfDet_tqZeroCorrnAlti "correction value for threshold of zero torque output at crankshaft, altitude dependant" SWORD rel_uw_b100 1 100 -50.00000 49.99847 FORMAT "%8.5" ECU_ADDRESS 0x60000722 /end MEASUREMENT
/begin MEASUREMENT MisfDet_tqZeroCorrnTEng "correction value for threshold of zero torque output at crankshaft, engine temperature dependant" UWORD rel_uw_b100 1 100 0.00 99.99847 FORMAT "%8.5" ECU_ADDRESS 0x60000726 /end MEASUREMENT
/begin MEASUREMENT miufof_w_msg "lower torque limit to enable DMDFOF adaptation" SWORD md_q0p1 1 100 -3276.800 3276.700 FORMAT "%8.3" ECU_ADDRESS 0x700039DC /end MEASUREMENT
/begin MEASUREMENT nofof_w_msg "upper engine speed limit to enable DMDFOF adaptation" UBYTE EngN_LRes 1 100 0.00 10200. FORMAT "%5.0" ECU_ADDRESS 0x70003658 /end MEASUREMENT
/begin MEASUREMENT nufof_w_msg "lower engine speed limit to enable DMDFOF adaptation" UBYTE EngN_LRes 1 100 0.00 10200. FORMAT "%5.0" ECU_ADDRESS 0x70003657 /end MEASUREMENT
/begin MEASUREMENT tsroh_l_msg "segment duration (DMD) uncorrected" ULONG tsquant_l 1 100 0.00 214748364.750 FORMAT "%13.3" ECU_ADDRESS 0x500006C8 /end MEASUREMENT
/begin MEASUREMENT whzmsv_w "angle holding phase duration of MSV control in CrA" UWORD kw_q0p1 1 100 0.00 6553.500 FORMAT "%8.3" ECU_ADDRESS 0x60006A30 /end MEASUREMENT
/begin MEASUREMENT zzyldmd_msg "SW-cylinder counter for DMD" UBYTE OneToOne 1 100 0.00 255.0 FORMAT "%5.1" ECU_ADDRESS 0x500009C4 /end MEASUREMENT
/begin MEASUREMENT zzyllfb_msg "SW-cylinder counter for DMD" UBYTE dez 1 100 0.00 255.0 FORMAT "%5.1" ECU_ADDRESS 0x500009C5 /end MEASUREMENT
/begin FUNCTION MfH "1000.29.0 Hardwaredriver for massflow valve"
 /begin LOC_MEASUREMENT mfh_angleEnd mfh_angleEndPhase3 mfh_angleNextTDCEndOfCntrl mfh_angleNextTDCLead mfh_angleStart mfh_angleStartLead Mfh_CntrChlFinshdActd mfh_currentAngle mfh_currentAnglePre mfh_currentTime mfh_currentTimePre mfh_deltaAngle mfh_deltaTime mfh_initCnt mfh_lobeNr mfh_numCamReal mfh_setupFuture mfh_setupPast mfh_startCnt mfh_stopCnt mfh_stopHardCnt mfh_timeEnd mfh_timeStart mfh_timeSwitch /end LOC_MEASUREMENT
 FUNCTION_VERSION "1000.29.0" /end FUNCTION
/begin FUNCTION MfPsDia "1000.10.0 MSV PowerStage Diagnosis" /begin DEF_CHARACTERISTIC Mfpsdia_mskCtl_CW Mfpsdia_uMax_C Mfpsdia_uMin_C /end DEF_CHARACTERISTIC /begin IN_MEASUREMENT BattU_u SyC_stSub /end IN_MEASUREMENT /begin OUT_MEASUREMENT MfPsDia_bstClockOk_msg mfpsdia_efMsv_u8_msg /end OUT_MEASUREMENT
 /begin LOC_MEASUREMENT MfPsDia_ctrErr_Clock_u8 MfPsDia_ctrErr_SpiInit_u8 MfPsDia_ctrErr_SpiReq_u8 MfPsDia_ctrErr_SpiTx_u8 MfPsDia_ctrOlDsmDef MfPsDia_ctrOlDsmOk MfPsDia_ctrScBatBankDsmDef MfPsDia_ctrScBatHiSDsmDef MfPsDia_ctrScBatHiSDsmOk MfPsDia_ctrScBatLoSDsmDef MfPsDia_ctrScBatLoSDsmOk MfPsDia_ctrScGndBankDsmDef MfPsDia_ctrScGndHiSDsmDef MfPsDia_ctrScGndHiSDsmOk MfPsDia_ctrScGndLoSDsmDef MfPsDia_ctrScGndLoSDsmOk MfPsDia_ctrScHiSLoSDsmDef MfPsDia_ctrScHiSLoSDsmOk MfPsDia_DiagFId MfPsDia_DiagInfo MfPsDia_DiagInfoCerr MfPsDia_stClockErr MfPsDia_stOn /end LOC_MEASUREMENT
 FUNCTION_VERSION "1000.10.0" /end FUNCTION
/begin FUNCTION MfPs_ConCY "1000.18.1 Mass Flow Valve Powerstage Driver for CYxxx IC"
 /begin IN_MEASUREMENT MfVlv_DtyCycl1_msg MfVlv_DtyCycl2_msg MfVlv_iHoldHigh_msg MfVlv_iHoldLow_msg MfVlv_iPickupHigh_msg MfVlv_iPickupLow_msg SyC_stSub /end IN_MEASUREMENT
 /begin LOC_MEASUREMENT MfPs_moduloCounter MfPs_Normcounter MfPs_spiErrorCounterAsync MfPs_spiErrorCounterNorm MfPs_synccounter /end LOC_MEASUREMENT
 FUNCTION_VERSION "1000.18.1" /end FUNCTION
/begin FUNCTION MfVDTypC "1000.15.0 Mass Flow Valve Virtual Device Driver for pump TYPE C"
 /begin DEF_CHARACTERISTIC DWMSVOMX MfVDTypC_agHldgPh_CUR MfVDTypC_FacPullin_Map MfVDTypC_iPullin_MAP MfVDTypC_KLVZMSVUB MfVDTypC_nEngMaxHot_C MfVDTypC_prdiffThd2_C MfVDTypC_prdiffThd_C MfVDTypC_PRDIFRCURH MfVDTypC_PRDIFRECUR MfVDTypC_PRMINMSV MfVDTypC_safHldCrntDtyCycl_MAP MfVDTypC_tiPullinReCur_CUR MfVDTypC_tiWaitAftFrstStrtd_CUR MfVDTypC_tiWaitAfttStrtd_CUR MfVDTypC_TMSVRECURO MfVDTypC_TMSVRECURU MfVDTypC_vfzgMaxRecur_C MfVDTypC_vfzgMaxRedNumMsvDelta_C MfVDTypC_WrstDtyCycl_MAP MfVD_NumStrtAftFirstFl_C MfVD_tdelReCur_C MfVlv_dTpressure_tiDly_C MfVlv_dTtiUBattTnStrt MfVlv_dTtiUBattTn_C MfVlv_iHold_C MfVlv_iHysHld_C MfVlv_iHysPu_C MfVlv_iPullinHyst_C MfVlv_MfVDTypCNVHCfg_C MfVlv_RstnT0_C Mfvlv_tiDelOffsetAdptRdy_C MfVlv_uBattMinReCur_C NENGMSVRECURH NENGMSVRECURS TPRMNMSVMX /end DEF_CHARACTERISTIC
 /begin IN_MEASUREMENT BattU_u B_ebfmod_msg B_msvact_msg B_stendes_msg B_tmsvmg_msg CEngDsT_t dwmsvd_w_msg EngStrt_bFrstStrtEnd Epm_nEng MfPsDia_bstClockOk_msg mfpsdia_efMsv_u8_msg prdiff_w_msg prist_w_msg prsollu_w_msg prsoll_w_msg SyC_stSub tmsvm_msg tnse_w_msg VehV_v /end IN_MEASUREMENT
 /begin OUT_MEASUREMENT B_msvrecur_msg dwmsvo_w_msg dwmsvs_w_msg MfVD_flgCntStrtAftFirstFl MfVD_iPickupLowOld_msg MfVD_state_msg MfVlv_DtyCycl1_msg MfVlv_DtyCycl2_msg MfVlv_iHoldHigh_msg MfVlv_iHoldLow_msg MfVlv_iPickupHigh_msg MfVlv_iPickupLow_msg MfVlv_tDelayOffset_msg MfVlv_tiDlyMfvOpn_msg MfVlv_TvzMsvTiBasd MfVlv_tvzmsv_msg /end OUT_MEASUREMENT
 /begin LOC_MEASUREMENT MfVDTypC_bReCur MfVDTypC_bSpPrDyn MfVDTypC_B_stendes MfVDTypC_B_tmsvmg MfVDTypC_dwmsvd_w MfVDTypC_EngStrtCnt_loc MfVDTypC_MfPsDia_bstClockOk MfVDTypC_MfVlv_DtyCycl1 MfVDTypC_MfVlv_DtyCycl2 MfVDTypC_MfVlv_tiDlyMfvOpn MfVDTypC_MfVlv_tvzmsv mfvdtypc_prdiff_loc mfvdtypc_prist_loc mfvdtypc_prsollu_loc mfvdtypc_prsoll_loc MfVDTypC_prsoll_switch MfVDTypC_tdelmfvCrksftDeg MfVDTypC_TiDlyOffsCrksftDeg MfVDTypC_tnse_w MfVDTypC_uBattFild MfVDTypC_uBattFildLoResl MfVD_bPrDiffCond MfVD_CntStrtAftFirstFl MfVD_CntStrtAftFirstFl_Old MfVD_iPickupLoc MfVD_sycStSubOld10ms MfVD_sycStSubOldcalc MfVD_tdelmfv MfVD_TV1 MfVD_TV2 MfVlv_bReCurEnbl MfVlv_rMsvGes whzmsv_w /end LOC_MEASUREMENT
 FUNCTION_VERSION "1000.15.0" /end FUNCTION
/begin FUNCTION MILLmp_DD "1.10.0    Device Driver for the MIL Control" /begin IN_MEASUREMENT MILLmp_stReqBln MILLmp_stReqOn SyC_stSub /end IN_MEASUREMENT /begin OUT_MEASUREMENT ErrLmp_stMIL MILLmp_stMIL MILLmp_stPs /end OUT_MEASUREMENT /begin LOC_MEASUREMENT MILLmp_tiRmnBln /end LOC_MEASUREMENT FUNCTION_VERSION "1.10.0" /end FUNCTION
/begin FUNCTION MILLmp_VD "1.19.0    Virtual Device for the MIL Control"
 /begin DEF_CHARACTERISTIC MILLmp_stMILCfg_CW MILLmp_tiAftStrt_C MILLmp_tiRdnBln_C MILLmp_tiVisTst_C /end DEF_CHARACTERISTIC
 /begin OUT_MEASUREMENT MILLmp_stReqBln MILLmp_stReqOn /end OUT_MEASUREMENT
 /begin LOC_MEASUREMENT MILLmp_stMILWoTstr MILLmp_stSt MILLmp_tiRmnSt /end LOC_MEASUREMENT
 FUNCTION_VERSION "1.19.0" /end FUNCTION
/begin FUNCTION MisfDet_AdpPrj "100.22.0  Softwareadapter Misfire Detection" /begin DEF_CHARACTERISTIC CWDMDZAG /end DEF_CHARACTERISTIC
 /begin IN_MEASUREMENT Clth_st MisfDet_cylCntr MisfDet_cylCntrSegTi MisfDet_dn MisfDet_dnAdpnQlyFac MisfDet_dnAdpnVal MisfDet_dnCyl MisfDet_dnDly MisfDet_dnRaw MisfDet_dnRawCyl MisfDet_flgRoughRoad MisfDet_maskMisfStiIgn MisfDet_maskMisfStiInj MisfDet_misfCntrCyl MisfDet_segTiAdpnNMax MisfDet_segTiAdpnNMin MisfDet_segTiAdpnTqMax MisfDet_segTiAdpnTqMin MisfDet_segTiRawAry MisfDet_stBlkStc MisfDet_stCatDmg MisfDet_stCatDmgBnk MisfDet_stCatDmgFcoCyl MisfDet_stcCatIgnCntr MisfDet_stcCatMisfCntrBnk MisfDet_stcCatMisfCntrCyl MisfDet_stcEmiIgnCntr MisfDet_stcEmiMisfCntrCyl MisfDet_stcEmiMisfCntrSum MisfDet_stCntMisf MisfDet_stDet MisfDet_stDnAdpnNvCalc MisfDet_stDnAdpnNvRdyCurr MisfDet_stDnDet MisfDet_stExhDmgSuspc MisfDet_stMisfCont MisfDet_stSegTiAdpnActv MisfDet_stSegTiAdpnEna MisfDet_stSegTiAdpnRdy MisfDet_stSegTiAdpnRdyPosn MisfDet_stSegTiVld MisfDet_stTqZero MisfDet_tqBasc MisfDet_tqBascSync /end IN_MEASUREMENT
 /begin OUT_MEASUREMENT B_abgien_msg B_cntmde_msg B_dlutsk_msg B_dmddiszg_msg B_fofadpen_msg B_fofresf_msg B_fofrkh_msg B_fofrun_msg B_fofr_msg B_fonr_msg B_forun_msg B_lutsk_msg B_mdarv_msg B_mderk_msg B_mdkat_msg B_mdmi_msg B_mdstop_msg B_milstp_msg B_MisfCont_msg B_swe_msg B_tsbready_msg B_tsroov_msg flgmdkatbnk_msg flgstign_w_msg flgstinj_w_msg flgtiab_msg fofstat_msg fonstat_msg fsr_w_msg fzabgs_w_msg fzabgzyl_w_msg fzkatsb_w_msg fzkats_w_msg fzkatzyl_w_msg fzmdzyl_w_msg ivzabg_w_msg ivzkat_w_msg lutsinvala_l_msg lutsinvala_msg lutskzyl_w_msg lutsk_w_msg lutszyl_w_msg luts_w_msg midmd_msg midmd_w_msg miofof_w_msg miufof_w_msg nofof_w_msg nufof_w_msg tsroh_l_msg zzyldmd_msg zzyllfb_msg /end OUT_MEASUREMENT
 FUNCTION_VERSION "100.22.0" /end FUNCTION
/begin FUNCTION MisfDet_CmnMisc "1.42.0    Misfire detection, Common functions and encapsulation of variables"
 /begin DEF_CHARACTERISTIC MisfDet_nSetPLoDiffMax_C MisfDet_openPtDlyCntr_C MisfDet_redStgDly_C MisfDet_stCfgOpenPt_C MisfDet_stCmnMiscCfg_C MisfDet_tqNrm_C /end DEF_CHARACTERISTIC
 /begin REF_CHARACTERISTIC MisfDet_thdNEngStrt_C /end REF_CHARACTERISTIC
 /begin IN_MEASUREMENT ActMod_trqInr B_asr_msg B_evasldel_msg B_khakt_msg B_kh_msg B_ll_msg B_msr_msg CEngDsT_t Epm_nEng HLSDem_nSetPLoDiff InjSys_flgNoInjReq InjSys_stActRedStg MisfDet_dnDly MisfDet_segTiDly MisfDet_stDnAdpnRstCfm MisfDet_stMisfSti MisfDet_stSegTiAdpnRstCfm SyC_stSub Tra_numGear VehV_v /end IN_MEASUREMENT
 /begin OUT_MEASUREMENT MisfDet_nEngSync MisfDet_nSetPLoDiff MisfDet_stAsr MisfDet_stCatHeat MisfDet_stDnAdpnRstReqAvs MisfDet_stFcmClr MisfDet_stFcmClr1000ms MisfDet_stFcmClr100ms MisfDet_stFcmClr10ms MisfDet_stFcmClr200ms MisfDet_stFcmClr20ms MisfDet_stIdle MisfDet_stMisfStiSync MisfDet_stMsr MisfDet_stNoInj MisfDet_stNoInjSync MisfDet_stOpenPt MisfDet_stRedStgTrqSyncSegTi MisfDet_stReIni MisfDet_stReIni100ms MisfDet_stReIni200ms MisfDet_stReIni20ms MisfDet_stSegTiAdpnRstReq MisfDet_tEng MisfDet_tEngStrt MisfDet_tiEngRun MisfDet_tiEngRunSum MisfDet_tqAct MisfDet_tqBasc MisfDet_tqBascSync /end OUT_MEASUREMENT
 /begin LOC_MEASUREMENT MisfDet_openPtDlyCntr /end LOC_MEASUREMENT
 FUNCTION_VERSION "1.42.0" /end FUNCTION
/begin FUNCTION MisfDet_DnAdpn "1.34.1    Adaptation of engine speed deceleration of misfire detection"
 /begin DEF_CHARACTERISTIC MisfDet_dnAdpnFilFac_C MisfDet_dnAdpnFrzNEngDifMax_C MisfDet_dnAdpnFrzTqDifMax_C MisfDet_dnAdpnNrSampRdy_T MisfDet_dnAdpnNvDstBasPntFac_C MisfDet_dnAdpnNvDstMax_C MisfDet_dnAdpnNvDstMin_C MisfDet_dnAdpnNvFilFacMin_C MisfDet_dnAdpnNvNrSampleMin_C MisfDet_dnAdpnNvPlausSumThd_C MisfDet_dnAdpnPlausAbsThdDecMax_T MisfDet_dnAdpnPlausAbsThdOffsCatHeat_C MisfDet_dnAdpnPlausAbsThdTrsmTiLow_M MisfDet_dnAdpnPlausAbsThd_M MisfDet_dnAdpnPlausMinThdFacCatHeat_C MisfDet_dnAdpnPlausMinThdFacTrsmTiLow_C MisfDet_dnAdpnPlausMinThdFac_C MisfDet_dnAdpnPlausRelCntrLim_C MisfDet_dnAdpnPlausRelThdFacAltvPosn_C MisfDet_dnAdpnPlausRelThdFacIdle_T MisfDet_dnAdpnPlausRelThdFacTrsmTiLow_M MisfDet_dnAdpnPlausRelThdFac_M MisfDet_dnAdpnRngChngActvnDly_C MisfDet_dnAdpnRngNEng.Cmn_CA MisfDet_dnAdpnRngTqInr_CA MisfDet_dnAdpnRngTqLock_CA MisfDet_dnAdpnRngTqMax_T MisfDet_dnAdpnRngTqMin.Cmn_GT MisfDet_dnAdpnRngTqMinIdle.Cmn_GT MisfDet_dnAdpnTqMinIdle_AX MisfDet_dnAdpnTqMinStrtNrIgn_C MisfDet_dnAdpnTqMinStrt_C MisfDet_dnAdpnTqMin_AX MisfDet_dnAdpnValNvNZero_C MisfDet_maskDnAdpnInitCmbTyp_C MisfDet_maskDnAdpnInit_C MisfDet_stDnAdpnCfgCal_C MisfDet_stDnAdpnCfg_C MisfDet_stDnAdpnPlausCfg_C /end DEF_CHARACTERISTIC
 /begin IN_MEASUREMENT Epm_nEng MisfDet_cylCntr MisfDet_dnCyl MisfDet_dnRawCyl MisfDet_dnThd MisfDet_dnThdOffsT MisfDet_maskDnAdpnNvCorrnCmbd MisfDet_maskDnAdpnNvCorrnCmbdCmbTyp MisfDet_maskDnVld MisfDet_nEngSync MisfDet_segPosnDn MisfDet_stBlkDnAdpn MisfDet_stBlkDnAdpnNv MisfDet_stBlkDnAdpnNvCorrn MisfDet_stBlkDnAdpnPlaus MisfDet_stCatHeat MisfDet_stDnAdpnRstReq MisfDet_stDnAdpnRstReqAvs MisfDet_stFcmClr20ms MisfDet_stIdle MisfDet_stMisfCont MisfDet_stOpenPt MisfDet_stReIni MisfDet_stSegShift MisfDet_stSegTiAdpn MisfDet_stSetZeroTq MisfDet_stTrsmTiLow MisfDet_tqBascSync MisfDet_tqZeroCorrnAlti MisfDet_tqZeroCorrnTEng /end IN_MEASUREMENT
 /begin OUT_MEASUREMENT MisfDet_dnAdpnNvQlyFac MisfDet_dnAdpnNvStruct.nrSample MisfDet_dnAdpnNvStruct.nEng MisfDet_dnAdpnNvStruct.tq MisfDet_dnAdpnNvStruct.val MisfDet_dnAdpnPlausAbsCntr MisfDet_dnAdpnPlausRelCntr MisfDet_dnAdpnQlyFac MisfDet_dnAdpnVal MisfDet_dnAdpnValCurr MisfDet_dnAdpnValNv MisfDet_dnAdpnValNvFac MisfDet_stDnAdpnNvCalc MisfDet_stDnAdpnNvPlausAbsFail MisfDet_stDnAdpnNvPlausSumFail MisfDet_stDnAdpnNvRdy MisfDet_stDnAdpnNvRdyCurr MisfDet_stDnAdpnPlausAbsFail MisfDet_stDnAdpnPlausRelCntrLim MisfDet_stDnAdpnPlausRelFail MisfDet_stDnAdpnRngOutdTq MisfDet_stDnAdpnRstCfm /end OUT_MEASUREMENT
 /begin LOC_MEASUREMENT MisfDet_dnAdpnFilFac MisfDet_dnAdpnFrzNEng MisfDet_dnAdpnFrzTq MisfDet_dnAdpnNEngRel MisfDet_dnAdpnNvCoeff MisfDet_dnAdpnNvDst MisfDet_dnAdpnNvDstSng MisfDet_dnAdpnNvFilFac MisfDet_dnAdpnNvIdx MisfDet_dnAdpnNvIdxCmbn MisfDet_dnAdpnNvInterpnTyp MisfDet_dnAdpnNvNEngSum MisfDet_dnAdpnNvNrSampleCurr MisfDet_dnAdpnNvObsvrIdx MisfDet_dnAdpnNvObsvrIdxNEng MisfDet_dnAdpnNvObsvrIdxTq MisfDet_dnAdpnNvObsvrNEng MisfDet_dnAdpnNvObsvrNrSample MisfDet_dnAdpnNvObsvrTq MisfDet_dnAdpnNvObsvrVal MisfDet_dnAdpnNvPlausAbsCntr MisfDet_dnAdpnNvPlausAbsCyl MisfDet_dnAdpnNvPlausAbsValMax MisfDet_dnAdpnNvPlausSumCntr MisfDet_dnAdpnNvPlausSumIdx MisfDet_dnAdpnNvSum MisfDet_dnAdpnNvTqSum MisfDet_dnAdpnNvValSum MisfDet_dnAdpnPlausAbsCyl MisfDet_dnAdpnPlausAbsThd MisfDet_dnAdpnPlausAbsValMax MisfDet_dnAdpnPlausMinCntr MisfDet_dnAdpnPlausMinCntrMax MisfDet_dnAdpnPlausMinRat MisfDet_dnAdpnPlausMinRatMax MisfDet_dnAdpnPlausMinSum MisfDet_dnAdpnPlausMinSumDif MisfDet_dnAdpnPlausMinSumNv MisfDet_dnAdpnPlausMinThdFac MisfDet_dnAdpnPlausRelCntrMax MisfDet_dnAdpnPlausRelCyl MisfDet_dnAdpnPlausRelRat MisfDet_dnAdpnPlausRelRatMax MisfDet_dnAdpnPlausRelRatMaxIdx MisfDet_dnAdpnPlausRelThd MisfDet_dnAdpnPlausRelValMax MisfDet_dnAdpnQlyFacAry MisfDet_dnAdpnRngChngActvnDly MisfDet_dnAdpnRngTq MisfDet_dnAdpnStrtCntr MisfDet_dnAdpnTqMin MisfDet_dnAdpnTqRel MisfDet_dnAdpnValAltv MisfDet_dnAdpnValStd MisfDet_stDnAdpnCalc MisfDet_stDnAdpnInit MisfDet_stDnAdpnNvUsd MisfDet_stDnAdpnPlausMinFail MisfDet_stDnAdpnRngChng MisfDet_stDnAdpnRngLock MisfDet_stDnAdpnRngOutd MisfDet_stDnAdpnRngOutdNEng MisfDet_stDnAdpnRngTq MisfDet_stDnAdpnUsd /end LOC_MEASUREMENT
 FUNCTION_VERSION "1.34.1" /end FUNCTION
/begin FUNCTION MisfDet_DnCalcn "1.19.0    Calculation of engine speed deceleration of misfire detection"
 /begin DEF_CHARACTERISTIC MisfDet_dnDifSelNMax_C MisfDet_dnFilFacMax_C MisfDet_dnFilFacMin_C MisfDet_dnFilFacRat_C MisfDet_dnFilFacSlow_C MisfDet_dnFltdAmplThdFacIdle_C MisfDet_dnFltdAmplThdFac_C MisfDet_dnQnts_C MisfDet_stDnCalcnCfg_C /end DEF_CHARACTERISTIC
 /begin IN_MEASUREMENT Epm_nEng MisfDet_cylCntrSegTi MisfDet_dnAdpnQlyFac MisfDet_dnAdpnVal MisfDet_dnThd MisfDet_maskSegPosnDnCalc MisfDet_maskSegTiVld MisfDet_nEngSync MisfDet_nrMisfConsc MisfDet_segPosnSegTi MisfDet_segTi MisfDet_segTiAry MisfDet_segTiDly MisfDet_stBlkDnFltd MisfDet_stCatHeat MisfDet_stIdle MisfDet_stMisfCont MisfDet_stNoInjSync MisfDet_stOpenPt MisfDet_stSegTiAdpn MisfDet_stSegTiAdpnRdy MisfDet_stStrtDeb /end IN_MEASUREMENT
 /begin OUT_MEASUREMENT MisfDet_cylCntr MisfDet_dn MisfDet_dnCyc MisfDet_dnCyl MisfDet_dnDif MisfDet_dnDifMin MisfDet_dnDifNxt MisfDet_dnDly MisfDet_dnFilFac MisfDet_dnFltd MisfDet_dnFltdCyl MisfDet_dnQnts MisfDet_dnRaw MisfDet_dnRawAry MisfDet_dnRawCyl MisfDet_maskDnVld MisfDet_segPosnDn MisfDet_stDnDifSelActv MisfDet_stDnDifSelActvCurr /end OUT_MEASUREMENT
 /begin LOC_MEASUREMENT MisfDet_stDynCmpOptmzd MisfDet_stSegPosnAltv /end LOC_MEASUREMENT
 FUNCTION_VERSION "1.19.0" /end FUNCTION
/begin FUNCTION MisfDet_DnEvln "1.11.0    Misfire detection, Evaluation of engine speed acceleration"
 /begin DEF_CHARACTERISTIC MisfDet_nrCmbDiCatHeat_C MisfDet_nrCmbDi_M MisfDet_nrCmbTest_C MisfDet_stDnEvlnCfg_C /end DEF_CHARACTERISTIC
 /begin IN_MEASUREMENT MisfDet_cylCntr MisfDet_dn MisfDet_dnDif MisfDet_dnFltd MisfDet_dnThd MisfDet_dnThdCont MisfDet_dnThdDif MisfDet_nEngSync MisfDet_stBlkStc MisfDet_stCatHeat MisfDet_stReIni MisfDet_stSegShift MisfDet_stStrtDeb MisfDet_tqBascSync SyC_stSub /end IN_MEASUREMENT
 /begin OUT_MEASUREMENT MisfDet_maskDnDet MisfDet_nrCmbDi MisfDet_stBlkAftDetn MisfDet_stBlkAftDetnTest MisfDet_stDet MisfDet_stDnDet /end OUT_MEASUREMENT
 FUNCTION_VERSION "1.11.0" /end FUNCTION
/begin FUNCTION MisfDet_GlbDef "100.27.0  MisfDet Global Definitions inside package" FUNCTION_VERSION "100.27.0" /end FUNCTION
/begin FUNCTION MisfDet_Lib "1.6.0     Function library of misfire detection" /begin IN_MEASUREMENT MisfDet_cylCntr /end IN_MEASUREMENT FUNCTION_VERSION "1.6.0" /end FUNCTION
/begin FUNCTION MisfDet_MisfGenr "1.10.0    Misfire detection, Misfire generator"
 /begin DEF_CHARACTERISTIC MisfDet_addrTrgVal_C MisfDet_ignRndMax_C MisfDet_maskCfgTrg_C MisfDet_maskMisfGenrCfg_C MisfDet_strtMisfGenr_C MisfDet_tblMisfPat_FM MisfDet_thdTrgVal_C /end DEF_CHARACTERISTIC
 /begin IN_MEASUREMENT Epm_ctCyl MisfDet_stBlkStc MisfDet_stCatDmg MisfDet_stReIni zzylh_msg /end IN_MEASUREMENT
 /begin OUT_MEASUREMENT MisfDet_maskMisfSti MisfDet_maskMisfStiIgn MisfDet_maskMisfStiInj MisfDet_stMisfGenrRun MisfDet_stMisfGenrRunIgn MisfDet_stMisfSti /end OUT_MEASUREMENT
 /begin LOC_MEASUREMENT MisfDet_cntrMisf MisfDet_cylCntrMisfGenr MisfDet_idxMisfPat MisfDet_ignWaitBtwMisf MisfDet_ignWaitBtwMisfMod MisfDet_misfMod MisfDet_stMisfGenrEna MisfDet_stMisfGenrEnaTrg MisfDet_stMisfModActv MisfDet_stSecCamsftAftStrt /end LOC_MEASUREMENT
 FUNCTION_VERSION "1.10.0" /end FUNCTION
/begin FUNCTION MisfDet_RelsCdn "1.52.0_1.0.0Release of misfire detection"
 /begin DEF_CHARACTERISTIC MisfDet_cntrIgnBlkDnAdpnStrt_C MisfDet_cntrIgnBlkStcReStrt_C MisfDet_cntrIgnBlkStcStrt_C MisfDet_cntrIgnFlreDwn_C MisfDet_cntrIgnRstrtHld_C MisfDet_cntrIgnStrtHld_C MisfDet_dlyTiStrtLineEnd_T MisfDet_dlyTiStrt_M MisfDet_dnCycMaxAdpn_M MisfDet_dnCycMaxStc_M MisfDet_dTqThdN_AX MisfDet_dTqThdTq_AX MisfDet_facDecTiTrsmAct_C MisfDet_facEnvPMin_C MisfDet_grdtPedlMax_M MisfDet_grdtPedlMin_M MisfDet_grdtTqMax.Cmn_GM MisfDet_grdtTqMin.Cmn_GM MisfDet_maskACSel_C MisfDet_maskBlkGear_C MisfDet_maskBlkOpMode_C MisfDet_maskDnAdpn.cntrHldNStrt_T MisfDet_maskDnAdpn.cntrHldN_T MisfDet_maskDnAdpn.cntrHldStrt_C MisfDet_maskDnAdpn.cntrHld_C MisfDet_maskDnAdpn.cntrStrtMax_C MisfDet_maskDnAdpn.CmbTyp.HldN_C MisfDet_maskDnAdpn.CmbTyp.Hld_C MisfDet_maskDnAdpn.CmbTyp.Raw_C MisfDet_maskDnAdpn.Cmn.HldN_C MisfDet_maskDnAdpn.Cmn.Hld_C MisfDet_maskDnAdpn.Cmn.Raw_C MisfDet_maskDnAdpnNv.cntrHldN_T MisfDet_maskDnAdpnNv.cntrHld_C MisfDet_maskDnAdpnNv.CmbTyp.HldN_C MisfDet_maskDnAdpnNv.CmbTyp.Hld_C MisfDet_maskDnAdpnNv.CmbTyp.Raw_C MisfDet_maskDnAdpnNv.CmbTyp2.HldN_C MisfDet_maskDnAdpnNv.CmbTyp2.Hld_C MisfDet_maskDnAdpnNv.CmbTyp2.Raw_C MisfDet_maskDnAdpnNv.Cmn.HldN_C MisfDet_maskDnAdpnNv.Cmn.Hld_C MisfDet_maskDnAdpnNv.Cmn.Raw_C MisfDet_maskDnAdpnNvCorrn.cntrHld_C MisfDet_maskDnAdpnNvCorrn.CmbTyp.Hld_C MisfDet_maskDnAdpnNvCorrn.CmbTyp.Raw_C MisfDet_maskDnAdpnNvCorrn.Cmn.Hld_C MisfDet_maskDnAdpnNvCorrn.Cmn.Raw_C MisfDet_maskDnAdpnPlaus.cntrHld_C MisfDet_maskDnAdpnPlaus.CmbTyp.Hld_C MisfDet_maskDnAdpnPlaus.CmbTyp.Raw_C MisfDet_maskDnAdpnPlaus.Cmn.Hld_C MisfDet_maskDnAdpnPlaus.Cmn.Raw_C MisfDet_maskDnFltd.cntrHldN_T MisfDet_maskDnFltd.cntrHld_C MisfDet_maskDnFltd.CmbTyp.HldN_C MisfDet_maskDnFltd.CmbTyp.Hld_C MisfDet_maskDnFltd.CmbTyp.Raw_C MisfDet_maskDnFltd.Cmn.HldN_C MisfDet_maskDnFltd.Cmn.Hld_C MisfDet_maskDnFltd.Cmn.Raw_C MisfDet_maskSegTiAdpn.CmbTyp.Raw_C MisfDet_maskSegTiAdpn.CmbTyp2.Raw_C MisfDet_maskSegTiAdpn.Cmn.Raw_C MisfDet_maskSegTiAdpnFco.CmbTyp.Raw_C MisfDet_maskSegTiAdpnFco.Cmn.Raw_C MisfDet_maskStc.cntrHldN_T MisfDet_maskStc.cntrHld_C MisfDet_maskStc.CmbTyp.HldN_C MisfDet_maskStc.CmbTyp.Hld_C MisfDet_maskStc.CmbTyp.Raw_C MisfDet_maskStc.Cmn.HldN_C MisfDet_maskStc.Cmn.Hld_C MisfDet_maskStc.Cmn.Raw_C MisfDet_n08TqZero_AX MisfDet_nEngDnFltdZeroNoSegTiAdpn_C MisfDet_nEngMax.Cmn_GT MisfDet_nEngMaxPedlEvln_C MisfDet_nEngMax_AX MisfDet_nEngMin.Cmn_C MisfDet_nEngMinPedlEvln_C MisfDet_offsNIdle_C MisfDet_stRelsCdnCfg_C MisfDet_stTqZeroIdleCfg_C MisfDet_swtOn_C MisfDet_tEngDnAdpnMin_C MisfDet_tEngSegTiAdpnMin_C Misfdet_thdAgKnkCtrl_C Misfdet_thdDeltaAgIgnBas_M MisfDet_thdNEngStrt_C Misfdet_thdrLamS1B_C MisfDet_thdTEngDetnEna_C MisfDet_thdTEngDetnStrt_C MisfDet_thdTqZeroDrv.Cmn_GT MisfDet_thdTqZeroFlreDwn_C MisfDet_thdTqZeroIdle.Cmn_GT MisfDet_tiTrsmCorr_M MisfDet_tiTrsmMax_C MisfDet_tiTrsmMin_T MisfDet_tqTrsmMin_C MisfDet_tqZeroCorrnAlti_M MisfDet_tqZeroCorrnTEng_M /end DEF_CHARACTERISTIC
 /begin REF_CHARACTERISTIC MisfDet_stDnAdpnCfgCal_C /end REF_CHARACTERISTIC
 /begin IN_MEASUREMENT ACCtl_stOut APP_r Brk_st B_dtest_msg B_evasldel_msg B_nmax_msg B_zesync_msg Clth_st CoEOM_stOpMAct Com_stMisfDetLineEnd EngStrt_bFrstStrtEnd EnvP_p EnvT_t Epm_ctCyl Epm_nEng Epm_stSync FfPrm_facEth FfPrm_flgEthAdpn GEVCtl_flgPhaActvnSpActrTstrIntk Ign_iaBas_s8 Ign_iacalc_s8 IKCtl_agKnkRtdt_s8 InjSys_flgCvoBascEna MisfDet_cylCntr MisfDet_dnCyc MisfDet_dnDly MisfDet_flgRoughRoad MisfDet_nEngSync MisfDet_nrMisfConsc MisfDet_nSetPLoDiff MisfDet_stAsr MisfDet_stCatHeat MisfDet_stDet MisfDet_stDnAdpnNvPlausAbsFail MisfDet_stDnAdpnPlausAbsFail MisfDet_stDnAdpnPlausRelCntrLim MisfDet_stDnAdpnPlausRelFail MisfDet_stIdle MisfDet_stMisfCont MisfDet_stMisfStiSync MisfDet_stNoInj MisfDet_stNoInjSync MisfDet_stOpenPt MisfDet_stReIni MisfDet_stSegShift MisfDet_stSegTiAdpnRdy MisfDet_stSegTiVld MisfDet_tEng MisfDet_tEngStrt MisfDet_tiEngRunSum MisfDet_tqAct MisfDet_tqBasc MisfDet_tqBascSync msntetev_w_msg PthSet_stOvrRun PT_rGrip SyC_stSub ThrVlv_flgLimpModeB1 ThrVlv_flgReqFuCutOffB1 ThrVlv_flgSngSensErrB1 TiEngOff_stTiFirstStrt TiEngOff_ti Tra_numGear TS_stMnSwtAC UEGO_rLamS1B1 VehV_v zzaehl_msg /end IN_MEASUREMENT
 /begin OUT_MEASUREMENT MisfDet_maskDlyBlkDnAdpnNvCorrn MisfDet_maskDnAdpnNvCmbd MisfDet_maskDnAdpnNvCorrnCmbd MisfDet_maskDnAdpnNvCorrnCmbdCmbTyp MisfDet_maskRelsDnAdpn MisfDet_maskRelsDnAdpnCmbTyp MisfDet_maskRelsDnAdpnNv MisfDet_maskRelsDnAdpnNvCmbTyp MisfDet_maskRelsDnAdpnNvCmbTyp2 MisfDet_maskRelsDnAdpnNvCorrn MisfDet_maskRelsDnAdpnNvCorrnCmbTyp MisfDet_maskRelsDnAdpnPlaus MisfDet_maskRelsDnAdpnPlausCmbTyp MisfDet_maskRelsSegTiAdpnFco MisfDet_maskRelsSegTiAdpnFcoCmbTyp MisfDet_maskRelsStc MisfDet_maskRelsStcCmbTyp MisfDet_stAcCtlChng MisfDet_stBlkDnAdpn MisfDet_stBlkDnAdpnNv MisfDet_stBlkDnAdpnNvCorrn MisfDet_stBlkDnAdpnPlaus MisfDet_stBlkDnFltd MisfDet_stBlkSegTiAdpn MisfDet_stBlkSegTiAdpnFco MisfDet_stBlkStc MisfDet_stCamsftDiagActv MisfDet_stCpvActv MisfDet_stDlyDnAdpn MisfDet_stDnCycMaxAdpn MisfDet_stDTqOutOfRng MisfDet_stIdleChng MisfDet_stLineEnd MisfDet_stNEngOutOfRng MisfDet_stNmax MisfDet_stSetZeroTq MisfDet_stStrtDeb MisfDet_stTEngLowDnAdpn MisfDet_stTqZero MisfDet_stTrsmTiLow MisfDet_thdTqZero MisfDet_tiTrsmAct MisfDet_tqZeroCorrnAlti MisfDet_tqZeroCorrnTEng /end OUT_MEASUREMENT
 /begin LOC_MEASUREMENT MisfDet_agKnkCtrlMax MisfDet_cntrIniTrsmTi MisfDet_dPedlPosn MisfDet_dTq MisfDet_facEnvP Misfdet_maskDlyBlkDnFltd Misfdet_maskDlyBlkStc MisfDet_maskDnAdpn.cntrStrt MisfDet_maskDnAdpn.CmbTyp.Hld MisfDet_maskDnAdpn.CmbTyp.HldN MisfDet_maskDnAdpn.CmbTyp.Raw MisfDet_maskDnAdpn.Cmn.Hld MisfDet_maskDnAdpn.Cmn.HldN MisfDet_maskDnAdpn.Cmn.Raw MisfDet_maskDnAdpnNv.CmbTyp.Hld MisfDet_maskDnAdpnNv.CmbTyp.HldN MisfDet_maskDnAdpnNv.CmbTyp.Raw MisfDet_maskDnAdpnNv.CmbTyp2.Hld MisfDet_maskDnAdpnNv.CmbTyp2.HldN MisfDet_maskDnAdpnNv.CmbTyp2.Raw MisfDet_maskDnAdpnNv.Cmn.Hld MisfDet_maskDnAdpnNv.Cmn.HldN MisfDet_maskDnAdpnNv.Cmn.Raw MisfDet_maskDnAdpnNvCorrn.CmbTyp.Hld MisfDet_maskDnAdpnNvCorrn.CmbTyp.Raw MisfDet_maskDnAdpnNvCorrn.Cmn.Hld MisfDet_maskDnAdpnNvCorrn.Cmn.Raw MisfDet_maskDnAdpnPlaus.CmbTyp.Hld MisfDet_maskDnAdpnPlaus.CmbTyp.Raw MisfDet_maskDnAdpnPlaus.Cmn.Hld MisfDet_maskDnAdpnPlaus.Cmn.Raw MisfDet_maskDnFltd.CmbTyp.Hld MisfDet_maskDnFltd.CmbTyp.HldN MisfDet_maskDnFltd.CmbTyp.Raw MisfDet_maskDnFltd.Cmn.Hld MisfDet_maskDnFltd.Cmn.HldN MisfDet_maskDnFltd.Cmn.Raw MisfDet_maskSegTiAdpn.CmbTyp.Raw MisfDet_maskSegTiAdpn.CmbTyp2.Raw MisfDet_maskSegTiAdpn.Cmn.Raw MisfDet_maskSegTiAdpnFco.CmbTyp.Raw MisfDet_maskSegTiAdpnFco.Cmn.Raw MisfDet_maskStc.CmbTyp.Hld MisfDet_maskStc.CmbTyp.HldN MisfDet_maskStc.CmbTyp.Raw MisfDet_maskStc.Cmn.Hld MisfDet_maskStc.Cmn.HldN MisfDet_maskStc.Cmn.Raw MisfDet_numGear MisfDet_stAgKnkCtrl MisfDet_stBlkDnAdpnNvCorrnTyp MisfDet_stBlkDnAdpnNvTyp MisfDet_stBlkDnAdpnPlausTyp MisfDet_stBlkDnAdpnTyp MisfDet_stBlkDnFltdTyp MisfDet_stBlkSegTiAdpnFcoTyp MisfDet_stBlkSegTiAdpnTyp MisfDet_stBlkStcTyp MisfDet_stClthChng MisfDet_stDeltaAgIgnBas MisfDet_stDlyStrtStc MisfDet_stDlyTiStrt MisfDet_stDnFltdZeroNoSegTiAdpn MisfDet_stDPedlPosnOutOfRng MisfDet_stEngReStrt MisfDet_stEngStrt MisfDet_stFlreDwn MisfDet_stGripChngPt MisfDet_stTEngLow MisfDet_thdTqZeroRaw MisfDet_tiEngOff MisfDet_tiTrsmCorr /end LOC_MEASUREMENT
 FUNCTION_VERSION "1.52.0_1.0.0" /end FUNCTION
/begin COMPU_METHOD B_TRUE "" TAB_VERB "%6.3" "" COMPU_TAB_REF B_TRUE /end COMPU_METHOD
/begin COMPU_VTAB B_TRUE "" TAB_VERB 2 0 "FALSE" 1 "TRUE" /end COMPU_VTAB
/begin COMPU_METHOD Compu_SegPosnInt_VERB "" TAB_VERB "%6.3" "" COMPU_TAB_REF Compu_SegPosnInt_VERB /end COMPU_METHOD
/begin COMPU_VTAB Compu_SegPosnInt_VERB "" TAB_VERB 4 0 "Std" 1 "Altv" 258 "Idle" 259 "PfltRgn" /end COMPU_VTAB
/begin COMPU_METHOD dez "" RAT_FUNC "%6.2" "" COEFFS 0 1 0 0 0 1 /end COMPU_METHOD
/begin COMPU_METHOD dn_Compu "" RAT_FUNC "%6.4" "rad/s^2" COEFFS 0 16 0 0 0 1 /end COMPU_METHOD
/begin COMPU_METHOD EngN "" RAT_FUNC "%6.3" "rpm" COEFFS 0 2 0 0 0 1 /end COMPU_METHOD
/begin COMPU_METHOD EngN_LRes "" RAT_FUNC "%6.1" "rpm" COEFFS 0 0.025 0 0 0 1 /end COMPU_METHOD
/begin COMPU_METHOD ExeCon_State_02 "" TAB_VERB "%6.3" "" COMPU_TAB_REF ExeCon_State_02 /end COMPU_METHOD
/begin COMPU_VTAB ExeCon_State_02 "" TAB_VERB 7 0 "SYC_INI" 1 "SYC_INISYN" 2 "SYC_INIEND" 3 "SYC_PREDRIVE" 4 "SYC_DRIVE" 5 "SYC_POSTDRIVE" 6 "SYC_POST_OS_EXIT" /end COMPU_VTAB
/begin COMPU_METHOD fak_q0p01 "" RAT_FUNC "%6.4" "" COEFFS 0 100 0 0 0 1 /end COMPU_METHOD
/begin COMPU_METHOD fak_ub_b1 "" RAT_FUNC "%6.4" "-" COEFFS 0 256 0 0 0 1 /end COMPU_METHOD
/begin COMPU_METHOD fak_ub_b16 "" RAT_FUNC "%6.4" "-" COEFFS 0 256 0 0 0 16 /end COMPU_METHOD
/begin COMPU_METHOD fak_ub_b2 "" RAT_FUNC "%8.5" "-" COEFFS 0 256 0 0 0 2 /end COMPU_METHOD
/begin COMPU_METHOD fak_ub_b4 "" RAT_FUNC "%6.4" "-" COEFFS 0 256 0 0 0 4 /end COMPU_METHOD
/begin COMPU_METHOD fak_ub_b64 "" RAT_FUNC "%6.3" "-" COEFFS 0 256 0 0 0 64 /end COMPU_METHOD
/begin COMPU_METHOD fak_uw_b1 "" RAT_FUNC "%7.6" "-" COEFFS 0 65536 0 0 0 1 /end COMPU_METHOD
/begin COMPU_METHOD fak_uw_b16 "" RAT_FUNC "%6.5" "-" COEFFS 0 65536 0 0 0 16 /end COMPU_METHOD
/begin COMPU_METHOD fak_uw_b2 "" RAT_FUNC "%7.6" "-" COEFFS 0 65536 0 0 0 2 /end COMPU_METHOD
/begin COMPU_METHOD fak_uw_b32 "" RAT_FUNC "%6.5" "-" COEFFS 0 65536 0 0 0 32 /end COMPU_METHOD
/begin COMPU_METHOD fak_uw_b8 "" RAT_FUNC "%6.5" "-" COEFFS 0 65536 0 0 0 8 /end COMPU_METHOD
/begin COMPU_METHOD i_ub_q0p04 "" RAT_FUNC "%6.4" "A" COEFFS 0 1 0 0 0 0.04 /end COMPU_METHOD
/begin COMPU_METHOD kw_q0p1 "" RAT_FUNC "%6.3" "Grad KW" COEFFS 0 10 0 0 0 1 /end COMPU_METHOD
/begin COMPU_METHOD kw_q0p75 "" RAT_FUNC "%6.3" "Grad KW" COEFFS 0 4 0 0 0 3 /end COMPU_METHOD
/begin COMPU_METHOD lu_MEx "" RAT_FUNC "%6.4" "(Umdr./sec)^2" COEFFS 0 140.7374884 0 0 0 1 /end COMPU_METHOD
/begin COMPU_METHOD md_q0p1 "" RAT_FUNC "%6.3" "Nm" COEFFS 0 10 0 0 0 1 /end COMPU_METHOD
/begin COMPU_METHOD MILLmp_ReqVerb "" TAB_VERB "%6.3" "" COMPU_TAB_REF MILLmp_ReqVerb /end COMPU_METHOD
/begin COMPU_VTAB MILLmp_ReqVerb "" TAB_VERB 256 0 "---|---|---|---|---|---|---|---" 1 "---|---|---|---|---|---|---|FES" 2 "---|---|---|---|---|---|DMD|---" 3 "---|---|---|---|---|---|DMD|FES" 4 "---|---|---|---|---|TRA|---|---" 5 "---|---|---|---|---|TRA|---|FES" 6 "---|---|---|---|---|TRA|DMD|---" 7 "---|---|---|---|---|TRA|DMD|FES" 8 "---|---|---|---|ECU1|---|---|---" 9 "---|---|---|---|ECU1|---|---|FES" 10 "---|---|---|---|ECU1|---|DMD|---" 11 "---|---|---|---|ECU1|---|DMD|FES" 12 "---|---|---|---|ECU1|TRA|---|---" 13 "---|---|---|---|ECU1|TRA|---|FES" 14 "---|---|---|---|ECU1|TRA|DMD|---" 15 "---|---|---|---|ECU1|TRA|DMD|FES" 16 "---|---|---|ECU2|---|---|---|---" 17 "---|---|---|ECU2|---|---|---|FES" 18 "---|---|---|ECU2|---|---|DMD|---" 19 "---|---|---|ECU2|---|---|DMD|FES" 20 "---|---|---|ECU2|---|TRA|---|---" 21 "---|---|---|ECU2|---|TRA|---|FES" 22 "---|---|---|ECU2|---|TRA|DMD|---" 23 "---|---|---|ECU2|---|TRA|DMD|FES" 24 "---|---|---|ECU2|ECU1|---|---|---" 25 "---|---|---|ECU2|ECU1|---|---|FES" 26 "---|---|---|ECU2|ECU1|---|DMD|---" 27 "---|---|---|ECU2|ECU1|---|DMD|FES" 28 "---|---|---|ECU2|ECU1|TRA|---|---" 29 "---|---|---|ECU2|ECU1|TRA|---|FES" 30 "---|---|---|ECU2|ECU1|TRA|DMD|---" 31 "---|---|---|ECU2|ECU1|TRA|DMD|FES" 32 "---|---|ECU3|---|---|---|---|---" 33 "---|---|ECU3|---|---|---|---|FES" 34 "---|---|ECU3|---|---|---|DMD|---" 35 "---|---|ECU3|---|---|---|DMD|FES" 36 "---|---|ECU3|---|---|TRA|---|---" 37 "---|---|ECU3|---|---|TRA|---|FES" 38 "---|---|ECU3|---|---|TRA|DMD|---" 39 "---|---|ECU3|---|---|TRA|DMD|FES" 40 "---|---|ECU3|---|ECU1|---|---|---" 41 "---|---|ECU3|---|ECU1|---|---|FES" 42 "---|---|ECU3|---|ECU1|---|DMD|---" 43 "---|---|ECU3|---|ECU1|---|DMD|FES" 44 "---|---|ECU3|---|ECU1|TRA|---|---" 45 "---|---|ECU3|---|ECU1|TRA|---|FES" 46 "---|---|ECU3|---|ECU1|TRA|DMD|---" 47 "---|---|ECU3|---|ECU1|TRA|DMD|FES" 48 "---|---|ECU3|ECU2|---|---|---|---" 49 "---|---|ECU3|ECU2|---|---|---|FES" 50 "---|---|ECU3|ECU2|---|---|DMD|---" 51 "---|---|ECU3|ECU2|---|---|DMD|FES" 52 "---|---|ECU3|ECU2|---|TRA|---|---" 53 "---|---|ECU3|ECU2|---|TRA|---|FES" 54 "---|---|ECU3|ECU2|---|TRA|DMD|---" 55 "---|---|ECU3|ECU2|---|TRA|DMD|FES" 56 "---|---|ECU3|ECU2|ECU1|---|---|---" 57 "---|---|ECU3|ECU2|ECU1|---|---|FES" 58 "---|---|ECU3|ECU2|ECU1|---|DMD|---" 59 "---|---|ECU3|ECU2|ECU1|---|DMD|FES" 60 "---|---|ECU3|ECU2|ECU1|TRA|---|---" 61 "---|---|ECU3|ECU2|ECU1|TRA|---|FES" 62 "---|---|ECU3|ECU2|ECU1|TRA|DMD|---" 63 "---|---|ECU3|ECU2|ECU1|TRA|DMD|FES" 64 "---|ECU4|---|---|---|---|---|---" 65 "---|ECU4|---|---|---|---|---|FES" 66 "---|ECU4|---|---|---|---|DMD|---" 67 "---|ECU4|---|---|---|---|DMD|FES" 68 "---|ECU4|---|---|---|TRA|---|---" 69 "---|ECU4|---|---|---|TRA|---|FES" 70 "---|ECU4|---|---|---|TRA|DMD|---" 71 "---|ECU4|---|---|---|TRA|DMD|FES" 72 "---|ECU4|---|---|ECU1|---|---|---" 73 "---|ECU4|---|---|ECU1|---|---|FES" 74 "---|ECU4|---|---|ECU1|---|DMD|---" 75 "---|ECU4|---|---|ECU1|---|DMD|FES" 76 "---|ECU4|---|---|ECU1|TRA|---|---" 77 "---|ECU4|---|---|ECU1|TRA|---|FES" 78 "---|ECU4|---|---|ECU1|TRA|DMD|---" 79 "---|ECU4|---|---|ECU1|TRA|DMD|FES" 80 "---|ECU4|---|ECU2|---|---|---|---" 81 "---|ECU4|---|ECU2|---|---|---|FES" 82 "---|ECU4|---|ECU2|---|---|DMD|---" 83 "---|ECU4|---|ECU2|---|---|DMD|FES" 84 "---|ECU4|---|ECU2|---|TRA|---|---" 85 "---|ECU4|---|ECU2|---|TRA|---|FES" 86 "---|ECU4|---|ECU2|---|TRA|DMD|---" 87 "---|ECU4|---|ECU2|---|TRA|DMD|FES" 88 "---|ECU4|---|ECU2|ECU1|---|---|---" 89 "---|ECU4|---|ECU2|ECU1|---|---|FES" 90 "---|ECU4|---|ECU2|ECU1|---|DMD|---" 91 "---|ECU4|---|ECU2|ECU1|---|DMD|FES" 92 "---|ECU4|---|ECU2|ECU1|TRA|---|---" 93 "---|ECU4|---|ECU2|ECU1|TRA|---|FES" 94 "---|ECU4|---|ECU2|ECU1|TRA|DMD|---" 95 "---|ECU4|---|ECU2|ECU1|TRA|DMD|FES" 96 "---|ECU4|ECU3|---|---|---|---|---" 97 "---|ECU4|ECU3|---|---|---|---|FES" 98 "---|ECU4|ECU3|---|---|---|DMD|---" 99 "---|ECU4|ECU3|---|---|---|DMD|FES" 100 "---|ECU4|ECU3|---|---|TRA|---|---" 101 "---|ECU4|ECU3|---|---|TRA|---|FES" 102 "---|ECU4|ECU3|---|---|TRA|DMD|---" 103 "---|ECU4|ECU3|---|---|TRA|DMD|FES" 104 "---|ECU4|ECU3|---|ECU1|---|---|---" 105 "---|ECU4|ECU3|---|ECU1|---|---|FES" 106 "---|ECU4|ECU3|---|ECU1|---|DMD|---" 107 "---|ECU4|ECU3|---|ECU1|---|DMD|FES" 108 "---|ECU4|ECU3|---|ECU1|TRA|---|---" 109 "---|ECU4|ECU3|---|ECU1|TRA|---|FES" 110 "---|ECU4|ECU3|---|ECU1|TRA|DMD|---" 111 "---|ECU4|ECU3|---|ECU1|TRA|DMD|FES" 112 "---|ECU4|ECU3|ECU2|---|---|---|---" 113 "---|ECU4|ECU3|ECU2|---|---|---|FES" 114 "---|ECU4|ECU3|ECU2|---|---|DMD|---" 115 "---|ECU4|ECU3|ECU2|---|---|DMD|FES" 116 "---|ECU4|ECU3|ECU2|---|TRA|---|---" 117 "---|ECU4|ECU3|ECU2|---|TRA|---|FES" 118 "---|ECU4|ECU3|ECU2|---|TRA|DMD|---" 119 "---|ECU4|ECU3|ECU2|---|TRA|DMD|FES" 120 "---|ECU4|ECU3|ECU2|ECU1|---|---|---" 121 "---|ECU4|ECU3|ECU2|ECU1|---|---|FES" 122 "---|ECU4|ECU3|ECU2|ECU1|---|DMD|---" 123 "---|ECU4|ECU3|ECU2|ECU1|---|DMD|FES" 124 "---|ECU4|ECU3|ECU2|ECU1|TRA|---|---" 125 "---|ECU4|ECU3|ECU2|ECU1|TRA|---|FES" 126 "---|ECU4|ECU3|ECU2|ECU1|TRA|DMD|---" 127 "---|ECU4|ECU3|ECU2|ECU1|TRA|DMD|FES" 128 "SLV|---|---|---|---|---|---|---" 129 "SLV|---|---|---|---|---|---|FES" 130 "SLV|---|---|---|---|---|DMD|---" 131 "SLV|---|---|---|---|---|DMD|FES" 132 "SLV|---|---|---|---|TRA|---|---" 133 "SLV|---|---|---|---|TRA|---|FES" 134 "SLV|---|---|---|---|TRA|DMD|---" 135 "SLV|---|---|---|---|TRA|DMD|FES" 136 "SLV|---|---|---|ECU1|---|---|---" 137 "SLV|---|---|---|ECU1|---|---|FES" 138 "SLV|---|---|---|ECU1|---|DMD|---" 139 "SLV|---|---|---|ECU1|---|DMD|FES" 140 "SLV|---|---|---|ECU1|TRA|---|---" 141 "SLV|---|---|---|ECU1|TRA|---|FES" 142 "SLV|---|---|---|ECU1|TRA|DMD|---" 143 "SLV|---|---|---|ECU1|TRA|DMD|FES" 144 "SLV|---|---|ECU2|---|---|---|---" 145 "SLV|---|---|ECU2|---|---|---|FES" 146 "SLV|---|---|ECU2|---|---|DMD|---" 147 "SLV|---|---|ECU2|---|---|DMD|FES" 148 "SLV|---|---|ECU2|---|TRA|---|---" 149 "SLV|---|---|ECU2|---|TRA|---|FES" 150 "SLV|---|---|ECU2|---|TRA|DMD|---" 151 "SLV|---|---|ECU2|---|TRA|DMD|FES" 152 "SLV|---|---|ECU2|ECU1|---|---|---" 153 "SLV|---|---|ECU2|ECU1|---|---|FES" 154 "SLV|---|---|ECU2|ECU1|---|DMD|---" 155 "SLV|---|---|ECU2|ECU1|---|DMD|FES" 156 "SLV|---|---|ECU2|ECU1|TRA|---|---" 157 "SLV|---|---|ECU2|ECU1|TRA|---|FES" 158 "SLV|---|---|ECU2|ECU1|TRA|DMD|---" 159 "SLV|---|---|ECU2|ECU1|TRA|DMD|FES" 160 "SLV|---|ECU3|---|---|---|---|---" 161 "SLV|---|ECU3|---|---|---|---|FES" 162 "SLV|---|ECU3|---|---|---|DMD|---" 163 "SLV|---|ECU3|---|---|---|DMD|FES" 164 "SLV|---|ECU3|---|---|TRA|---|---" 165 "SLV|---|ECU3|---|---|TRA|---|FES" 166 "SLV|---|ECU3|---|---|TRA|DMD|---" 167 "SLV|---|ECU3|---|---|TRA|DMD|FES" 168 "SLV|---|ECU3|---|ECU1|---|---|---" 169 "SLV|---|ECU3|---|ECU1|---|---|FES" 170 "SLV|---|ECU3|---|ECU1|---|DMD|---" 171 "SLV|---|ECU3|---|ECU1|---|DMD|FES" 172 "SLV|---|ECU3|---|ECU1|TRA|---|---" 173 "SLV|---|ECU3|---|ECU1|TRA|---|FES" 174 "SLV|---|ECU3|---|ECU1|TRA|DMD|---" 175 "SLV|---|ECU3|---|ECU1|TRA|DMD|FES" 176 "SLV|---|ECU3|ECU2|---|---|---|---" 177 "SLV|---|ECU3|ECU2|---|---|---|FES" 178 "SLV|---|ECU3|ECU2|---|---|DMD|---" 179 "SLV|---|ECU3|ECU2|---|---|DMD|FES" 180 "SLV|---|ECU3|ECU2|---|TRA|---|---" 181 "SLV|---|ECU3|ECU2|---|TRA|---|FES" 182 "SLV|---|ECU3|ECU2|---|TRA|DMD|---" 183 "SLV|---|ECU3|ECU2|---|TRA|DMD|FES" 184 "SLV|---|ECU3|ECU2|ECU1|---|---|---" 185 "SLV|---|ECU3|ECU2|ECU1|---|---|FES" 186 "SLV|---|ECU3|ECU2|ECU1|---|DMD|---" 187 "SLV|---|ECU3|ECU2|ECU1|---|DMD|FES" 188 "SLV|---|ECU3|ECU2|ECU1|TRA|---|---" 189 "SLV|---|ECU3|ECU2|ECU1|TRA|---|FES" 190 "SLV|---|ECU3|ECU2|ECU1|TRA|DMD|---" 191 "SLV|---|ECU3|ECU2|ECU1|TRA|DMD|FES" 192 "SLV|ECU4|---|---|---|---|---|---" 193 "SLV|ECU4|---|---|---|---|---|FES" 194 "SLV|ECU4|---|---|---|---|DMD|---" 195 "SLV|ECU4|---|---|---|---|DMD|FES" 196 "SLV|ECU4|---|---|---|TRA|---|---" 197 "SLV|ECU4|---|---|---|TRA|---|FES" 198 "SLV|ECU4|---|---|---|TRA|DMD|---" 199 "SLV|ECU4|---|---|---|TRA|DMD|FES" 200 "SLV|ECU4|---|---|ECU1|---|---|---" 201 "SLV|ECU4|---|---|ECU1|---|---|FES" 202 "SLV|ECU4|---|---|ECU1|---|DMD|---" 203 "SLV|ECU4|---|---|ECU1|---|DMD|FES" 204 "SLV|ECU4|---|---|ECU1|TRA|---|---" 205 "SLV|ECU4|---|---|ECU1|TRA|---|FES" 206 "SLV|ECU4|---|---|ECU1|TRA|DMD|---" 207 "SLV|ECU4|---|---|ECU1|TRA|DMD|FES" 208 "SLV|ECU4|---|ECU2|---|---|---|---" 209 "SLV|ECU4|---|ECU2|---|---|---|FES" 210 "SLV|ECU4|---|ECU2|---|---|DMD|---" 211 "SLV|ECU4|---|ECU2|---|---|DMD|FES" 212 "SLV|ECU4|---|ECU2|---|TRA|---|---" 213 "SLV|ECU4|---|ECU2|---|TRA|---|FES" 214 "SLV|ECU4|---|ECU2|---|TRA|DMD|---" 215 "SLV|ECU4|---|ECU2|---|TRA|DMD|FES" 216 "SLV|ECU4|---|ECU2|ECU1|---|---|---" 217 "SLV|ECU4|---|ECU2|ECU1|---|---|FES" 218 "SLV|ECU4|---|ECU2|ECU1|---|DMD|---" 219 "SLV|ECU4|---|ECU2|ECU1|---|DMD|FES" 220 "SLV|ECU4|---|ECU2|ECU1|TRA|---|---" 221 "SLV|ECU4|---|ECU2|ECU1|TRA|---|FES" 222 "SLV|ECU4|---|ECU2|ECU1|TRA|DMD|---" 223 "SLV|ECU4|---|ECU2|ECU1|TRA|DMD|FES" 224 "SLV|ECU4|ECU3|---|---|---|---|---" 225 "SLV|ECU4|ECU3|---|---|---|---|FES" 226 "SLV|ECU4|ECU3|---|---|---|DMD|---" 227 "SLV|ECU4|ECU3|---|---|---|DMD|FES" 228 "SLV|ECU4|ECU3|---|---|TRA|---|---" 229 "SLV|ECU4|ECU3|---|---|TRA|---|FES" 230 "SLV|ECU4|ECU3|---|---|TRA|DMD|---" 231 "SLV|ECU4|ECU3|---|---|TRA|DMD|FES" 232 "SLV|ECU4|ECU3|---|ECU1|---|---|---" 233 "SLV|ECU4|ECU3|---|ECU1|---|---|FES" 234 "SLV|ECU4|ECU3|---|ECU1|---|DMD|---" 235 "SLV|ECU4|ECU3|---|ECU1|---|DMD|FES" 236 "SLV|ECU4|ECU3|---|ECU1|TRA|---|---" 237 "SLV|ECU4|ECU3|---|ECU1|TRA|---|FES" 238 "SLV|ECU4|ECU3|---|ECU1|TRA|DMD|---" 239 "SLV|ECU4|ECU3|---|ECU1|TRA|DMD|FES" 240 "SLV|ECU4|ECU3|ECU2|---|---|---|---" 241 "SLV|ECU4|ECU3|ECU2|---|---|---|FES" 242 "SLV|ECU4|ECU3|ECU2|---|---|DMD|---" 243 "SLV|ECU4|ECU3|ECU2|---|---|DMD|FES" 244 "SLV|ECU4|ECU3|ECU2|---|TRA|---|---" 245 "SLV|ECU4|ECU3|ECU2|---|TRA|---|FES" 246 "SLV|ECU4|ECU3|ECU2|---|TRA|DMD|---" 247 "SLV|ECU4|ECU3|ECU2|---|TRA|DMD|FES" 248 "SLV|ECU4|ECU3|ECU2|ECU1|---|---|---" 249 "SLV|ECU4|ECU3|ECU2|ECU1|---|---|FES" 250 "SLV|ECU4|ECU3|ECU2|ECU1|---|DMD|---" 251 "SLV|ECU4|ECU3|ECU2|ECU1|---|DMD|FES" 252 "SLV|ECU4|ECU3|ECU2|ECU1|TRA|---|---" 253 "SLV|ECU4|ECU3|ECU2|ECU1|TRA|---|FES" 254 "SLV|ECU4|ECU3|ECU2|ECU1|TRA|DMD|---" 255 "SLV|ECU4|ECU3|ECU2|ECU1|TRA|DMD|FES" /end COMPU_VTAB
/begin COMPU_METHOD MILLmp_StVerb "" TAB_VERB "%6.3" "" COMPU_TAB_REF MILLmp_StVerb /end COMPU_METHOD
/begin COMPU_VTAB MILLmp_StVerb "" TAB_VERB 7 0 "Init_State" 17 "PreStart_VisTest" 33 "PreStart_RdnBln" 65 "PreStart_WaitForStart" 129 "PreStart_WaitForStart_MILON" 2 "AfterStart" 4 "Cruising" /end COMPU_VTAB
/begin COMPU_METHOD OneToOne "" RAT_FUNC "%6.2" "-" COEFFS 0 1 0 0 0 1 /end COMPU_METHOD
/begin COMPU_METHOD q0p06104_pc_DIV_s "" RAT_FUNC "%6.4" "%/s" COEFFS 0 65536 0 0 0 4000 /end COMPU_METHOD
/begin COMPU_METHOD RBPtCel_p_0p002_1 "" RAT_FUNC "%6.4" "MPa" COEFFS 0 1000 0 0 0 2 /end COMPU_METHOD
/begin COMPU_METHOD rel_q0p1953 "" RAT_FUNC "%6.3" "%" COEFFS 0 256 0 0 0 50 /end COMPU_METHOD
/begin COMPU_METHOD rel_q0p392 "" RAT_FUNC "%6.3" "%" COEFFS 0 255 0 0 0 100 /end COMPU_METHOD
/begin COMPU_METHOD rel_q1p525902em3 "" RAT_FUNC "%6.4" "%" COEFFS 0 65535 0 0 0 100 /end COMPU_METHOD
/begin COMPU_METHOD rel_rng_uw_b100 "" RAT_FUNC "%6.4" "% Rng" COEFFS 0 65536 0 0 0 100 /end COMPU_METHOD
/begin COMPU_METHOD rel_ub_b200 "" RAT_FUNC "%6.3" "%" COEFFS 0 256 0 0 0 200 /end COMPU_METHOD
/begin COMPU_METHOD rel_ub_b99p6 "" RAT_FUNC "%6.3" "%" COEFFS 0 256 0 0 0 100 /end COMPU_METHOD
/begin COMPU_METHOD rel_uw_b100 "" RAT_FUNC "%6.4" "%" COEFFS 0 65536 0 0 0 100 /end COMPU_METHOD
/begin COMPU_METHOD rel_win_ub_b100 "" RAT_FUNC "%6.3" "% Win" COEFFS 0 256 0 0 0 100 /end COMPU_METHOD
/begin COMPU_METHOD r_q0p003906_Ohm "" RAT_FUNC "%6.4" "Ohm" COEFFS 0 256 0 0 0 1 /end COMPU_METHOD
/begin COMPU_METHOD SY_DSVDK2_Compu "" TAB_VERB "%6.3" "" COMPU_TAB_REF SY_DSVDK2_Compu /end COMPU_METHOD
/begin COMPU_VTAB SY_DSVDK2_Compu "" TAB_VERB 2 0 "kein zweiter Drucksensor vor Drosselklappe verbaut" 1 "zweiter Drucksensor vor Drosselklappe verbaut" /end COMPU_VTAB
/begin COMPU_METHOD SY_DSVDK_Compu "" TAB_VERB "%6.3" "" COMPU_TAB_REF SY_DSVDK_Compu /end COMPU_METHOD
/begin COMPU_VTAB SY_DSVDK_Compu "" TAB_VERB 2 0 "FALSE" 1 "TRUE" /end COMPU_VTAB
/begin COMPU_METHOD SY_DSVV_Compu "" TAB_VERB "%6.3" "" COMPU_TAB_REF SY_DSVV_Compu /end COMPU_METHOD
/begin COMPU_VTAB SY_DSVV_Compu "" TAB_VERB 2 0 "kein Drucksensor vor Verdichter vorhanden" 1 "Drucksensor vor Verdichter vorhanden" /end COMPU_VTAB
/begin COMPU_METHOD SY_DTANKL_Compu "" TAB_VERB "%6.3" "" COMPU_TAB_REF SY_DTANKL_Compu /end COMPU_METHOD
/begin COMPU_VTAB SY_DTANKL_Compu "" TAB_VERB 2 0 "FALSE" 1 "TRUE" /end COMPU_VTAB
/begin COMPU_METHOD SY_DTCWCS_Compu "" TAB_VERB "%6.3" "" COMPU_TAB_REF SY_DTCWCS_Compu /end COMPU_METHOD
/begin COMPU_VTAB SY_DTCWCS_Compu "" TAB_VERB 3 0 "DISABL" 1 "NO_TABST_COUNT" 2 "TABST_COUNT" /end COMPU_VTAB
/begin COMPU_METHOD SY_DTCWHSC_Compu "" TAB_VERB "%6.3" "" COMPU_TAB_REF SY_DTCWHSC_Compu /end COMPU_METHOD
/begin COMPU_VTAB SY_DTCWHSC_Compu "" TAB_VERB 2 0 "False" 1 "True" /end COMPU_VTAB
/begin COMPU_METHOD SY_DTHM_Compu "" TAB_VERB "%6.3" "" COMPU_TAB_REF SY_DTHM_Compu /end COMPU_METHOD
/begin COMPU_VTAB SY_DTHM_Compu "" TAB_VERB 2 0 "False" 1 "True" /end COMPU_VTAB
/begin COMPU_METHOD SY_DVEADA_Compu "" TAB_VERB "%6.3" "" COMPU_TAB_REF SY_DVEADA_Compu /end COMPU_METHOD
/begin COMPU_VTAB SY_DVEADA_Compu "" TAB_VERB 2 0 "kein Sperren der Einspritzung durch DVE Adaptio er" 1 "Sperren der Einspritzung durch DVE Adaptio erlaubt" /end COMPU_VTAB
/begin COMPU_METHOD SY_DVEAMP_Compu "" TAB_VERB "%6.3" "" COMPU_TAB_REF SY_DVEAMP_Compu /end COMPU_METHOD
/begin COMPU_VTAB SY_DVEAMP_Compu "" TAB_VERB 2 0 "= kein Verstärker vorhanden" 1 "= Verstärker vorhanden" /end COMPU_VTAB
/begin COMPU_METHOD SY_DVEANZ_Compu "" RAT_FUNC "%6.2" "" COEFFS 0 1 0 0 0 1 /end COMPU_METHOD
/begin COMPU_METHOD SY_DVEFO_Compu "" TAB_VERB "%6.3" "" COMPU_TAB_REF SY_DVEFO_Compu /end COMPU_METHOD
/begin COMPU_VTAB SY_DVEFO_Compu "" TAB_VERB 2 0 "0 = DVE öffnede Federprüfung nicht vorhanden" 1 "1 = DVE öffnede Federprüfung kann eingeschaltet we" /end COMPU_VTAB
/begin COMPU_METHOD SY_DVEKOMP_Compu "" TAB_VERB "%6.3" "" COMPU_TAB_REF SY_DVEKOMP_Compu /end COMPU_METHOD
/begin COMPU_VTAB SY_DVEKOMP_Compu "" TAB_VERB 4 1 "Limp home position in control range (DV-E5)" 2 "Limp home position out of ctrl range (DV-E8.1nc)" 3 "Limp home position out of control range (DV-E8.1c)" 4 "Like 1, but programmed sensor" /end COMPU_VTAB
/begin COMPU_METHOD SY_DVEKOOR_Compu "" TAB_VERB "%6.3" "" COMPU_TAB_REF SY_DVEKOOR_Compu /end COMPU_METHOD
/begin COMPU_VTAB SY_DVEKOOR_Compu "" TAB_VERB 2 0 "kein eigenes DVE-Koordinatensystem" 1 "eigenes DVE-Koordinatensystem" /end COMPU_VTAB
/begin COMPU_METHOD SY_DYCOP_Compu "" TAB_VERB "%6.3" "" COMPU_TAB_REF SY_DYCOP_Compu /end COMPU_METHOD
/begin COMPU_VTAB SY_DYCOP_Compu "" TAB_VERB 2 0 "disabled" 1 "enabled" /end COMPU_VTAB
/begin COMPU_METHOD SY_DYLSEVAL_Compu "" TAB_VERB "%6.3" "" COMPU_TAB_REF SY_DYLSEVAL_Compu /end COMPU_METHOD
/begin COMPU_VTAB SY_DYLSEVAL_Compu "" TAB_VERB 2 0 "False" 1 "True" /end COMPU_VTAB
/begin COMPU_METHOD SY_DYLSF_Compu "" TAB_VERB "%6.3" "" COMPU_TAB_REF SY_DYLSF_Compu /end COMPU_METHOD
/begin COMPU_VTAB SY_DYLSF_Compu "" TAB_VERB 2 0 "False" 1 "True" /end COMPU_VTAB
/begin COMPU_METHOD SY_DYLSH_Compu "" TAB_VERB "%6.3" "" COMPU_TAB_REF SY_DYLSH_Compu /end COMPU_METHOD
/begin COMPU_VTAB SY_DYLSH_Compu "" TAB_VERB 2 0 "False" 1 "True" /end COMPU_VTAB
/begin COMPU_METHOD SY_DZWB2_Compu "" TAB_VERB "%6.3" "" COMPU_TAB_REF SY_DZWB2_Compu /end COMPU_METHOD
/begin COMPU_VTAB SY_DZWB2_Compu "" TAB_VERB 3 0 "no" 1 "earliest possible" 2 "output" /end COMPU_VTAB
/begin COMPU_METHOD SY_DZWKS_Compu "" TAB_VERB "%6.3" "" COMPU_TAB_REF SY_DZWKS_Compu /end COMPU_METHOD
/begin COMPU_VTAB SY_DZWKS_Compu "" TAB_VERB 2 0 "false" 1 "true" /end COMPU_VTAB
/begin COMPU_METHOD SY_EAOMSDK_Compu "" TAB_VERB "%6.3" "" COMPU_TAB_REF SY_EAOMSDK_Compu /end COMPU_METHOD
/begin COMPU_VTAB SY_EAOMSDK_Compu "" TAB_VERB 2 0 "first adaptation disabled" 1 "first adaptation enabled" /end COMPU_VTAB
/begin COMPU_METHOD SY_EBFMOD_Compu "" TAB_VERB "%6.3" "" COMPU_TAB_REF SY_EBFMOD_Compu /end COMPU_METHOD
/begin COMPU_VTAB SY_EBFMOD_Compu "" TAB_VERB 4 0 "Kein Erstbefüllungsmodus des Kraftstoffsystems" 1 "Erstbefüllung ohne Berücksichtigung Urstartsperre" 2 "Erstbefüllung mit Berücksichtigung Urstartsperre" 3 "Automatische Erstbefüllung" /end COMPU_VTAB
/begin COMPU_METHOD SY_ECTPS1_Compu "" TAB_VERB "%6.3" "" COMPU_TAB_REF SY_ECTPS1_Compu /end COMPU_METHOD
/begin COMPU_VTAB SY_ECTPS1_Compu "" TAB_VERB 5 0 "no_sensor" 1 "CEngDsT" 2 "CHdT" 3 "CEngUsT" 4 "CEngBlkT" /end COMPU_VTAB
/begin COMPU_METHOD SY_ECTPS2_Compu "" TAB_VERB "%6.3" "" COMPU_TAB_REF SY_ECTPS2_Compu /end COMPU_METHOD
/begin COMPU_VTAB SY_ECTPS2_Compu "" TAB_VERB 5 0 "no_sensor" 1 "CEngDsT" 2 "CHdT" 3 "CEngUsT" 4 "CEngBlkT" /end COMPU_VTAB
/begin COMPU_METHOD SY_EDMMILA_Compu "" RAT_FUNC "%6.2" "" COEFFS 0 1 0 0 0 1 /end COMPU_METHOD
/begin COMPU_METHOD SY_EGAS_Compu "" TAB_VERB "%6.3" "" COMPU_TAB_REF SY_EGAS_Compu /end COMPU_METHOD
/begin COMPU_VTAB SY_EGAS_Compu "" TAB_VERB 2 0 "kein E-GAS System" 1 "E-GAS System" /end COMPU_VTAB
/begin COMPU_METHOD SY_EOLT_Compu "" TAB_VERB "%6.3" "" COMPU_TAB_REF SY_EOLT_Compu /end COMPU_METHOD
/begin COMPU_VTAB SY_EOLT_Compu "" TAB_VERB 2 0 "keine Klopfsensordiagnose am Bandende" 1 "Klopfsensordiagnose am Bandende" /end COMPU_VTAB
/begin COMPU_METHOD SY_ESIM_Compu "" TAB_VERB "%6.3" "" COMPU_TAB_REF SY_ESIM_Compu /end COMPU_METHOD
/begin COMPU_VTAB SY_ESIM_Compu "" TAB_VERB 2 0 "False" 1 "True" /end COMPU_VTAB
/begin COMPU_METHOD SY_ETADZWF_Compu "" TAB_VERB "%6.3" "" COMPU_TAB_REF SY_ETADZWF_Compu /end COMPU_METHOD
/begin COMPU_VTAB SY_ETADZWF_Compu "" TAB_VERB 2 0 "False" 1 "True" /end COMPU_VTAB
/begin COMPU_METHOD SY_ETAKHSV_Compu "" TAB_VERB "%6.3" "" COMPU_TAB_REF SY_ETAKHSV_Compu /end COMPU_METHOD
/begin COMPU_VTAB SY_ETAKHSV_Compu "" TAB_VERB 3 0 "SY_ETAKHSV_ZERO" 1 "SY_ETAKHSV_ONE" 2 "SY_ETAKHSV_TWO" /end COMPU_VTAB
/begin COMPU_METHOD SY_ETAKHZW_Compu "" TAB_VERB "%6.3" "" COMPU_TAB_REF SY_ETAKHZW_Compu /end COMPU_METHOD
/begin COMPU_VTAB SY_ETAKHZW_Compu "" TAB_VERB 2 0 "SY_ETAKHZW=0" 1 "SY_ETAKHZW=1" /end COMPU_VTAB
/begin COMPU_METHOD SY_ETHSENS_Compu "" TAB_VERB "%6.3" "" COMPU_TAB_REF SY_ETHSENS_Compu /end COMPU_METHOD
/begin COMPU_VTAB SY_ETHSENS_Compu "" TAB_VERB 2 0 "false" 1 "true" /end COMPU_VTAB
/begin COMPU_METHOD SY_EWS_Compu "" TAB_VERB "%6.3" "" COMPU_TAB_REF SY_EWS_Compu /end COMPU_METHOD
/begin COMPU_VTAB SY_EWS_Compu "" TAB_VERB 2 0 "EWS_inactive" 1 "EWS_active" /end COMPU_VTAB
/begin COMPU_METHOD SY_FABE_Compu "" TAB_VERB "%6.3" "" COMPU_TAB_REF SY_FABE_Compu /end COMPU_METHOD
/begin COMPU_VTAB SY_FABE_Compu "" TAB_VERB 2 0 "shortened EOL-test unavailable" 1 "shortened EOL-test available" /end COMPU_VTAB
/begin COMPU_METHOD SY_FAEVZUE_Compu "" TAB_VERB "%6.3" "" COMPU_TAB_REF SY_FAEVZUE_Compu /end COMPU_METHOD
/begin COMPU_VTAB SY_FAEVZUE_Compu "" TAB_VERB 2 0 "False" 1 "True" /end COMPU_VTAB
/begin COMPU_METHOD SY_FAFSTKH_Compu "" TAB_VERB "%6.3" "" COMPU_TAB_REF SY_FAFSTKH_Compu /end COMPU_METHOD
/begin COMPU_VTAB SY_FAFSTKH_Compu "" TAB_VERB 2 0 "FAFSTKH_NO" 1 "FAFSTKH_ONE" /end COMPU_VTAB
/begin COMPU_METHOD SY_FAGALS_Compu "" TAB_VERB "%6.3" "" COMPU_TAB_REF SY_FAGALS_Compu /end COMPU_METHOD
/begin COMPU_VTAB SY_FAGALS_Compu "" TAB_VERB 2 0 "False" 1 "True" /end COMPU_VTAB
/begin COMPU_METHOD SY_FANT_Compu "" TAB_VERB "%6.3" "" COMPU_TAB_REF SY_FANT_Compu /end COMPU_METHOD
/begin COMPU_VTAB SY_FANT_Compu "" TAB_VERB 2 0 "keine Anhebung Schubabschaltedrehzahl über Testere" 1 "Anhebung Schubabschaltedrehzahl über Testereingrif" /end COMPU_VTAB
/begin COMPU_METHOD SY_FAPAFG_Compu "" TAB_VERB "%6.3" "" COMPU_TAB_REF SY_FAPAFG_Compu /end COMPU_METHOD
/begin COMPU_VTAB SY_FAPAFG_Compu "" TAB_VERB 2 0 "FALSE" 1 "TRUE" /end COMPU_VTAB
/begin COMPU_METHOD SY_FAWULA_Compu "" TAB_VERB "%6.3" "" COMPU_TAB_REF SY_FAWULA_Compu /end COMPU_METHOD
/begin COMPU_VTAB SY_FAWULA_Compu "" TAB_VERB 3 0 "Anfettung Fahrerwunsch nicht möglich" 1 "Anfettung über mrfa/nmot möglich" 2 "Enchmt_rl" /end COMPU_VTAB
/begin COMPU_METHOD t100msxs_uw_b6553p5 "" RAT_FUNC "%6.3" "s" COEFFS 0 1 0 0 0 0.1 /end COMPU_METHOD
/begin COMPU_METHOD t1sxs_q1 "" RAT_FUNC "%6.2" "s" COEFFS 0 1 0 0 0 1 /end COMPU_METHOD
/begin COMPU_METHOD t50msxs_q0p05 "" RAT_FUNC "%6.4" "s" COEFFS 0 1 0 0 0 0.05 /end COMPU_METHOD
/begin COMPU_METHOD Temp_Cels "" RAT_FUNC "%6.1" "deg C" COEFFS 0 10 2731.4 0 0 1 /end COMPU_METHOD
/begin COMPU_METHOD TimeRed "" RAT_FUNC "%6.3" "s" COEFFS 0 6.25 0 0 0 1 /end COMPU_METHOD
/begin COMPU_METHOD Time_Dt "" RAT_FUNC "%9.8" "s" COEFFS 0 1000000 0 0 0 1 /end COMPU_METHOD
/begin COMPU_METHOD Time_sec_q1_COMPU "" RAT_FUNC "%6.2" "s" COEFFS 0 1 0 0 0 1 /end COMPU_METHOD
/begin COMPU_METHOD Trq "" RAT_FUNC "%6.3" "Nm" COEFFS 0 10 0 0 0 1 /end COMPU_METHOD
/begin COMPU_METHOD tsquant_l "" RAT_FUNC "%6.4" "us" COEFFS 0 20 0 0 0 1 /end COMPU_METHOD
/begin COMPU_METHOD t_q0p001_ms "" RAT_FUNC "%6.5" "ms" COEFFS 0 1 0 0 0 0.001 /end COMPU_METHOD
/begin COMPU_METHOD t_q0p04_ms "" RAT_FUNC "%6.4" "ms" COEFFS 0 1 0 0 0 0.04 /end COMPU_METHOD
/begin COMPU_METHOD t_q0p1 "" RAT_FUNC "%6.3" "s" COEFFS 0 10 0 0 0 1 /end COMPU_METHOD
/begin COMPU_METHOD Vel "" RAT_FUNC "%6.4" "km/h" COEFFS 0 100 0 0 0 1 /end COMPU_METHOD
/begin COMPU_METHOD Volt_Batt "" RAT_FUNC "%6.1" "mV" COEFFS 0 0.05 0 0 0 1 /end COMPU_METHOD
/begin RECORD_LAYOUT RB_Axis_S16 NO_AXIS_PTS_X 1 SWORD AXIS_PTS_X 2 SWORD INDEX_INCR DIRECT /end RECORD_LAYOUT
/begin RECORD_LAYOUT RB_Axis_S8 NO_AXIS_PTS_X 1 SBYTE AXIS_PTS_X 2 SBYTE INDEX_INCR DIRECT /end RECORD_LAYOUT
/begin RECORD_LAYOUT RB_Axis_U16 NO_AXIS_PTS_X 1 UWORD AXIS_PTS_X 2 UWORD INDEX_INCR DIRECT /end RECORD_LAYOUT
/begin RECORD_LAYOUT RB_CurveGroup_S16 FNC_VALUES 1 SWORD COLUMN_DIR DIRECT /end RECORD_LAYOUT
/begin RECORD_LAYOUT RB_CurveGroup_U16 FNC_VALUES 1 UWORD COLUMN_DIR DIRECT /end RECORD_LAYOUT
/begin RECORD_LAYOUT RB_Curve_S16_S16 NO_AXIS_PTS_X 1 SWORD AXIS_PTS_X 2 SWORD INDEX_INCR DIRECT FNC_VALUES 3 SWORD COLUMN_DIR DIRECT /end RECORD_LAYOUT
/begin RECORD_LAYOUT RB_Curve_S16_U16_Static NO_AXIS_PTS_X 1 SWORD AXIS_PTS_X 2 SWORD INDEX_INCR DIRECT FNC_VALUES 3 UWORD COLUMN_DIR DIRECT STATIC_RECORD_LAYOUT /end RECORD_LAYOUT
/begin RECORD_LAYOUT RB_Curve_S16_U8_Static NO_AXIS_PTS_X 1 SWORD AXIS_PTS_X 2 SWORD INDEX_INCR DIRECT FNC_VALUES 3 UBYTE COLUMN_DIR DIRECT STATIC_RECORD_LAYOUT /end RECORD_LAYOUT
/begin RECORD_LAYOUT RB_Curve_U16_U8_Static NO_AXIS_PTS_X 1 UWORD AXIS_PTS_X 2 UWORD INDEX_INCR DIRECT FNC_VALUES 3 UBYTE COLUMN_DIR DIRECT STATIC_RECORD_LAYOUT /end RECORD_LAYOUT
/begin RECORD_LAYOUT RB_FixMap_S16S16_S16 FNC_VALUES 1 SWORD COLUMN_DIR DIRECT /end RECORD_LAYOUT
/begin RECORD_LAYOUT RB_MapGroup_S16 FNC_VALUES 1 SWORD COLUMN_DIR DIRECT /end RECORD_LAYOUT
/begin RECORD_LAYOUT RB_Map_S16S16_U16 NO_AXIS_PTS_X 1 SWORD NO_AXIS_PTS_Y 2 SWORD AXIS_PTS_X 3 SWORD INDEX_INCR DIRECT AXIS_PTS_Y 4 SWORD INDEX_INCR DIRECT FNC_VALUES 5 UWORD COLUMN_DIR DIRECT /end RECORD_LAYOUT
/begin RECORD_LAYOUT RB_Map_S16U16_S16 NO_AXIS_PTS_X 1 SWORD NO_AXIS_PTS_Y 2 SWORD AXIS_PTS_X 3 SWORD INDEX_INCR DIRECT AXIS_PTS_Y 4 UWORD INDEX_INCR DIRECT FNC_VALUES 5 SWORD ROW_DIR DIRECT /end RECORD_LAYOUT
/begin RECORD_LAYOUT RB_Map_S16U16_U16 NO_AXIS_PTS_X 1 SWORD NO_AXIS_PTS_Y 2 SWORD AXIS_PTS_X 3 SWORD INDEX_INCR DIRECT AXIS_PTS_Y 4 UWORD INDEX_INCR DIRECT FNC_VALUES 5 UWORD ROW_DIR DIRECT /end RECORD_LAYOUT
/begin RECORD_LAYOUT RB_Map_S16U8_S16 NO_AXIS_PTS_X 1 SWORD NO_AXIS_PTS_Y 2 SWORD AXIS_PTS_X 3 SWORD INDEX_INCR DIRECT AXIS_PTS_Y 4 UBYTE INDEX_INCR DIRECT FNC_VALUES 5 SWORD COLUMN_DIR DIRECT /end RECORD_LAYOUT
/begin RECORD_LAYOUT RB_Map_S8S16_S16 NO_AXIS_PTS_X 1 SBYTE NO_AXIS_PTS_Y 2 SBYTE AXIS_PTS_X 3 SBYTE INDEX_INCR DIRECT AXIS_PTS_Y 4 SWORD INDEX_INCR DIRECT FNC_VALUES 5 SWORD ROW_DIR DIRECT /end RECORD_LAYOUT
/begin RECORD_LAYOUT RB_Map_S8U16_S16 NO_AXIS_PTS_X 1 SBYTE NO_AXIS_PTS_Y 2 SBYTE AXIS_PTS_X 3 SBYTE INDEX_INCR DIRECT AXIS_PTS_Y 4 UWORD INDEX_INCR DIRECT FNC_VALUES 5 SWORD ROW_DIR DIRECT /end RECORD_LAYOUT
/begin RECORD_LAYOUT RB_Map_U16S16_S16 NO_AXIS_PTS_X 1 UWORD NO_AXIS_PTS_Y 2 UWORD AXIS_PTS_X 3 UWORD INDEX_INCR DIRECT AXIS_PTS_Y 4 SWORD INDEX_INCR DIRECT FNC_VALUES 5 SWORD COLUMN_DIR DIRECT /end RECORD_LAYOUT
/begin RECORD_LAYOUT RB_Map_U16S16_S8 NO_AXIS_PTS_X 1 UWORD NO_AXIS_PTS_Y 2 UWORD AXIS_PTS_X 3 UWORD INDEX_INCR DIRECT AXIS_PTS_Y 4 SWORD INDEX_INCR DIRECT FNC_VALUES 5 SBYTE COLUMN_DIR DIRECT /end RECORD_LAYOUT
/begin RECORD_LAYOUT RB_Map_U16S16_U8 NO_AXIS_PTS_X 1 UWORD NO_AXIS_PTS_Y 2 UWORD AXIS_PTS_X 3 UWORD INDEX_INCR DIRECT AXIS_PTS_Y 4 SWORD INDEX_INCR DIRECT FNC_VALUES 5 UBYTE COLUMN_DIR DIRECT /end RECORD_LAYOUT
/begin RECORD_LAYOUT RB_ValA_Wu16 FNC_VALUES 1 UWORD COLUMN_DIR DIRECT /end RECORD_LAYOUT
/begin RECORD_LAYOUT RB_ValA_Wu8 FNC_VALUES 1 UBYTE COLUMN_DIR DIRECT /end RECORD_LAYOUT
/begin RECORD_LAYOUT RB_Val_Ws16 FNC_VALUES 1 SWORD COLUMN_DIR DIRECT /end RECORD_LAYOUT
/begin RECORD_LAYOUT RB_Val_Ws32 FNC_VALUES 1 SLONG COLUMN_DIR DIRECT /end RECORD_LAYOUT
/begin RECORD_LAYOUT RB_Val_Ws8 FNC_VALUES 1 SBYTE COLUMN_DIR DIRECT /end RECORD_LAYOUT
/begin RECORD_LAYOUT RB_Val_Wu16 FNC_VALUES 1 UWORD COLUMN_DIR DIRECT /end RECORD_LAYOUT
/begin RECORD_LAYOUT RB_Val_Wu32 FNC_VALUES 1 ULONG COLUMN_DIR DIRECT /end RECORD_LAYOUT
/begin RECORD_LAYOUT RB_Val_Wu8 FNC_VALUES 1 UBYTE COLUMN_DIR DIRECT /end RECORD_LAYOUT
/begin RECORD_LAYOUT Val_Ws16 FNC_VALUES 1 SWORD COLUMN_DIR DIRECT /end RECORD_LAYOUT
/begin RECORD_LAYOUT Val_Wu16 FNC_VALUES 1 UWORD COLUMN_DIR DIRECT /end RECORD_LAYOUT
/begin RECORD_LAYOUT Val_Wu8 FNC_VALUES 1 UBYTE COLUMN_DIR DIRECT /end RECORD_LAYOUT
/end MODULE
/end PROJECT
