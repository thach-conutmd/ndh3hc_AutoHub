ASAP2_VERSION 1 60
/begin PROJECT MG1CS022 "MG1CS022"
/begin HEADER "" VERSION "MG1CS022_62XSC_V036_TPROT" PROJECT_NO MG1CS022 /end HEADER
/begin MODULE DIM ""
/begin MOD_COMMON "" BYTE_ORDER MSB_LAST ALIGNMENT_BYTE 1 ALIGNMENT_WORD 2 ALIGNMENT_LONG 4 ALIGNMENT_INT64 4 ALIGNMENT_FLOAT32_IEEE 4 ALIGNMENT_FLOAT64_IEEE 4 DATA_SIZE 32 /end MOD_COMMON
/begin CHARACTERISTIC AltIO_tiLR_C "default for load response time" VALUE 0x8051B918 RB_Val_Ws16 655.3500 Time_s -327.6800 327.6700 FORMAT "%8.4" /end CHARACTERISTIC
/begin CHARACTERISTIC Alt_aDecLoadMinHi_C "Upper limit of vehicle deceleration for DECLOAD mode" VALUE 0x8051C558 RB_Val_Ws16 65.53500 Acc -32.76800 32.76700 FORMAT "%8.5" /end CHARACTERISTIC
/begin CHARACTERISTIC Alt_aDecLoadMinLo_C "Lower limit of vehicle deceleration for DECLOAD mode" VALUE 0x8051C55A RB_Val_Ws16 65.53500 Acc -32.76800 32.76700 FORMAT "%8.5" /end CHARACTERISTIC
/begin CHARACTERISTIC Alt_chBattSoc_CUR "Curve representing relationship between battery SOC and current" CURVE 0x8051B4D8 RB_Curve_S16_S16 65535.00 AmpHr -32768.00 32767.00 FORMAT "%8.2"
 /begin AXIS_DESCR STD_AXIS Ebs_ratSocFild RBPtCel_Perc_0p5_1 10 0.00 127.5000 FORMAT "%8.4" EXTENDED_LIMITS -16384.00 16383.50 DEPOSIT ABSOLUTE /end AXIS_DESCR
/end CHARACTERISTIC
/begin CHARACTERISTIC Alt_cntBattRExcddThd_C "Maximum allowable number of times the battery resistance can exceed the threshold so that the special range is not disabled." VALUE 0x8051B502 RB_Val_Wu8 255.0 OneToOne 0.00 255.0 FORMAT "%5.1" /end CHARACTERISTIC
/begin CHARACTERISTIC Alt_cntFastPeakHld_C "Fast path battery voltage peak hold count threshold" VALUE 0x8051B91A RB_Val_Wu8 255.0 OneToOne 0.00 255.0 FORMAT "%5.1" /end CHARACTERISTIC
/begin CHARACTERISTIC Alt_cntrAltLoadPastPosnFast_C "Fast path amount of past position of battery current" VALUE 0x8051B91B RB_Val_Wu8 49.00 OneToOne 0.00 49.00 FORMAT "%5.2" EXTENDED_LIMITS 0.00 255.0 /end CHARACTERISTIC
/begin CHARACTERISTIC Alt_cntrAltLoadPastPosn_C "Amount of past position of battery current" VALUE 0x8051B91C RB_Val_Wu8 49.00 OneToOne 0.00 49.00 FORMAT "%5.2" EXTENDED_LIMITS 0.00 255.0 /end CHARACTERISTIC
/begin CHARACTERISTIC Alt_cntRed_C "Voltage up scale restriction counter decrement factor" VALUE 0x8051B504 RB_Val_Wu16 655.3500 Fact100 0.00 655.3500 FORMAT "%8.4" /end CHARACTERISTIC
/begin CHARACTERISTIC Alt_cntrUpScaRstrct_C "Count threshold to allow voltage up scale restriction" VALUE 0x8051B506 RB_Val_Wu16 32767.00 OneToOne 0.00 32767.00 FORMAT "%8.2" EXTENDED_LIMITS 0.00 65535.00 /end CHARACTERISTIC
/begin CHARACTERISTIC Alt_cntUpScaRstrctACGDisblThd_C "ACG Voltage up scale restriction disabling counter threshold" VALUE 0x8051B508 RB_Val_Wu16 655.3500 Fact100 0.00 655.3500 FORMAT "%8.4" /end CHARACTERISTIC
/begin CHARACTERISTIC Alt_cntUpScaRstrctACGThd_C "ACG Voltage up scale restriction counter threshold" VALUE 0x8051B50A RB_Val_Wu16 655.3500 Fact100 0.00 655.3500 FORMAT "%8.4" /end CHARACTERISTIC
/begin CHARACTERISTIC Alt_duAntiFlickSlop_C "Slope to ramp the ACG voltage for avoiding Flickering of headlight" VALUE 0x8051B50C RB_Val_Ws16 19999.69 RmpVoltBatt -10000.00 9999.69 FORMAT "%8.2" EXTENDED_LIMITS -10000.00 9999.695 READ_ONLY /end CHARACTERISTIC
/begin CHARACTERISTIC Alt_facAltCmpByBattU_C "Compensation factor for alternator according to battery voltage" VALUE 0x8051B91E RB_Val_Ws16 15.99976 fak_sw_b8 -8.000000 7.999756 FORMAT "%8.6" /end CHARACTERISTIC
/begin CHARACTERISTIC Alt_facBattUFildMax_C "Max factor value of filled battery voltage" VALUE 0x8051B920 RB_Val_Ws16 15.99976 fak_sw_b8 -8.000000 7.999756 FORMAT "%8.6" /end CHARACTERISTIC
/begin CHARACTERISTIC Alt_facBattUFildMin_C "Min factor value of filled battery voltage" VALUE 0x8051B922 RB_Val_Ws16 15.99976 fak_sw_b8 -8.000000 7.999756 FORMAT "%8.6" /end CHARACTERISTIC
/begin CHARACTERISTIC Alt_facCorrnTTqDes_T "Calibration Curve for temperature correction for alternator desired torque" CURVE 0x8051B924 RB_Curve_S16_S16 511.9922 Fact1 -256.0000 255.9922 FORMAT "%8.4"
 /begin AXIS_DESCR STD_AXIS EngDa_tEng Temp_Cels 8 -3549.940 3003.560 FORMAT "%8.3" DEPOSIT ABSOLUTE /end AXIS_DESCR
/end CHARACTERISTIC
/begin CHARACTERISTIC Alt_facCorrnTTqResv_T "Calibration Curve for temperature correction for alternator torque reserve" CURVE 0x8051B946 RB_Curve_S16_S16 511.9922 Fact1 -256.0000 255.9922 FORMAT "%8.4"
 /begin AXIS_DESCR STD_AXIS EngDa_tEng Temp_Cels 8 -3549.940 3003.560 FORMAT "%8.3" DEPOSIT ABSOLUTE /end AXIS_DESCR
/end CHARACTERISTIC
/begin CHARACTERISTIC Alt_facCorTemp_CUR "Alternator torque correction by coolant temperature" CURVE 0x8051B968 RB_Curve_S16_S16 511.9922 Fact1 -256.0000 255.9922 FORMAT "%8.4"
 /begin AXIS_DESCR STD_AXIS EngDa_tEng Temp_Cels 4 -3549.940 3003.560 FORMAT "%8.3" DEPOSIT ABSOLUTE /end AXIS_DESCR
/end CHARACTERISTIC
/begin CHARACTERISTIC Alt_facCorT_CUR "Alternator torque time correction since engine is at normal state" CURVE 0x8051B97A RB_Curve_S16_S16 511.9922 Fact1 -256.0000 255.9922 FORMAT "%8.4"
 /begin AXIS_DESCR STD_AXIS CoEng_tiNormalRed TimeRed 4 -5242.880 5242.720 FORMAT "%8.3" DEPOSIT ABSOLUTE /end AXIS_DESCR
/end CHARACTERISTIC
/begin CHARACTERISTIC Alt_facFastBattDecHi_C "Fast path multiplication decrease judgement high threshold" VALUE 0x8051B98C RB_Val_Ws32 429496.729500 Fact_10000 -214748.364800 214748.364700 FORMAT "%13.6" /end CHARACTERISTIC
/begin CHARACTERISTIC Alt_facFastBattDecLo_C "Fast path multiplication decrease judgement low threshold" VALUE 0x8051B990 RB_Val_Ws32 429496.729500 Fact_10000 -214748.364800 214748.364700 FORMAT "%13.6" /end CHARACTERISTIC
/begin CHARACTERISTIC Alt_facFastBattIncHi_C "Fast path multiplication increase judgement high threshold" VALUE 0x8051B994 RB_Val_Ws32 429496.729500 Fact_10000 -214748.364800 214748.364700 FORMAT "%13.6" /end CHARACTERISTIC
/begin CHARACTERISTIC Alt_facFastBattIncLo_C "Fast path multiplication increase judgement low threshold" VALUE 0x8051B998 RB_Val_Ws32 429496.729500 Fact_10000 -214748.364800 214748.364700 FORMAT "%13.6" /end CHARACTERISTIC
/begin CHARACTERISTIC Alt_facIDecHi_C "Higher Factor for decrement of setpoint alternator voltage depending on the difference between measured and setpoint battery current when alternator speed is high" VALUE 0x8051B50E RB_Val_Wu16 7.999878 Fact 0.00 7.999878 FORMAT "%8.6" /end CHARACTERISTIC
/begin CHARACTERISTIC Alt_facIDecLo_C "Lower Factor for decrement of setpoint alternator voltage depending on the difference between measured and setpoint battery current when alternator speed is not high" VALUE 0x8051B510 RB_Val_Wu16 7.999878 Fact 0.00 7.999878 FORMAT "%8.6" /end CHARACTERISTIC
/begin CHARACTERISTIC Alt_facIIncHi_C "Higher Factor for increment of setpoint alternator voltage depending on the difference between measured and setpoint battery current when alternator speed is high" VALUE 0x8051B512 RB_Val_Wu16 7.999878 Fact 0.00 7.999878 FORMAT "%8.6" /end CHARACTERISTIC
/begin CHARACTERISTIC Alt_facIIncLo_C "Lower Factor for increment of setpoint alternator voltage depending on the difference between measured and setpoint battery current when alternator speed is not high" VALUE 0x8051B514 RB_Val_Wu16 7.999878 Fact 0.00 7.999878 FORMAT "%8.6" /end CHARACTERISTIC
/begin CHARACTERISTIC Alt_facRGenr_C "Calibration Specifying the pulley ration between Engine and alternator" VALUE 0x8051B516 RB_Val_Wu16 7.999878 Fact 0.00 7.999878 FORMAT "%8.6" /end CHARACTERISTIC
/begin CHARACTERISTIC Alt_facUDecHi_C "Higher Factor for decrement of setpoint alternator voltage depending on the difference between measured and maximum battery voltage when alternator speed is high" VALUE 0x8051B518 RB_Val_Wu16 7.999878 Fact 0.00 7.999878 FORMAT "%8.6" /end CHARACTERISTIC
/begin CHARACTERISTIC Alt_facUDecLo_C "Lower Factor for decrement of setpoint alternator voltage depending on the difference between measured and maximum battery voltage when alternator speed is not high" VALUE 0x8051B51A RB_Val_Wu16 7.999878 Fact 0.00 7.999878 FORMAT "%8.6" /end CHARACTERISTIC
/begin CHARACTERISTIC Alt_facUIncHi_C "Higher Factor for increment of setpoint alternator voltage depending on the difference between measured and minimum battery voltage when alternator speed is high" VALUE 0x8051B51C RB_Val_Wu16 7.999878 Fact 0.00 7.999878 FORMAT "%8.6" /end CHARACTERISTIC
/begin CHARACTERISTIC Alt_facUIncLo_C "Lower Factor for increment of setpoint alternator voltage depending on the difference between measured and minimum battery voltage when alternator speed is not high" VALUE 0x8051B51E RB_Val_Wu16 7.999878 Fact 0.00 7.999878 FORMAT "%8.6" /end CHARACTERISTIC
/begin CHARACTERISTIC Alt_flgAltLoadFastResv_C "Toque reserve enable switch" VALUE 0x8051B99C RB_Val_Wboolean 1.00000000000 B_TRUE 0.00 1.00000000000 FORMAT "%13.11" /end CHARACTERISTIC
/begin CHARACTERISTIC Alt_flgAltLoadSlowResv_C "Toque reserve enable switch" VALUE 0x8051B99D RB_Val_Wboolean 1.00000000000 B_TRUE 0.00 1.00000000000 FORMAT "%13.11" /end CHARACTERISTIC
/begin CHARACTERISTIC Alt_flgErrModActv_C "Parameter to enable ERROR mode in the state machine" VALUE 0x8051C55C RB_Val_Wu8 1.00000000000 B_TRUE 0.00 1.00000000000 FORMAT "%13.11" /end CHARACTERISTIC
/begin CHARACTERISTIC Alt_flgSwtBattSetIn_C "Switch to select the input battery SOC for determining the setpoint battery current" VALUE 0x8051B520 RB_Val_Wboolean 1.00000000000 B_TRUE 0.00 1.00000000000 FORMAT "%13.11" /end CHARACTERISTIC
/begin CHARACTERISTIC Alt_flgSwtEngSpd_C "Switch to select engine speed source" VALUE 0x8051B99E RB_Val_Wboolean 1.00000000000 B_TRUE 0.00 1.00000000000 FORMAT "%13.11" /end CHARACTERISTIC
/begin CHARACTERISTIC Alt_flgSwtSelACGBattDgrt_C "Switch to select ACG voltage during battery degradation" VALUE 0x8051B521 RB_Val_Wu8 255.0 OneToOne 0.00 255.0 FORMAT "%5.1" /end CHARACTERISTIC
/begin CHARACTERISTIC Alt_flgSwtSelACGWipr_C "Switch to select ACG voltage when the wiper is active" VALUE 0x8051B522 RB_Val_Wu8 255.0 OneToOne 0.00 255.0 FORMAT "%5.1" /end CHARACTERISTIC
/begin CHARACTERISTIC Alt_flgSwtSelReqACGHdLi_C "Switch to select whether to request ACG voltage by headlights" VALUE 0x8051B523 RB_Val_Wu8 255.0 OneToOne 0.00 255.0 FORMAT "%5.1" /end CHARACTERISTIC
/begin CHARACTERISTIC Alt_iBattFildFastHi_C "Fast path high threshold for battery current delta" VALUE 0x8051B9A0 RB_Val_Ws16 655.3500 Curr_A -327.6800 327.6700 FORMAT "%8.4" /end CHARACTERISTIC
/begin CHARACTERISTIC Alt_iBattFildFastLo_C "Fast path low threshold for battery current delta" VALUE 0x8051B9A2 RB_Val_Ws16 655.3500 Curr_A -327.6800 327.6700 FORMAT "%8.4" /end CHARACTERISTIC
/begin CHARACTERISTIC Alt_iBattFildSlowHi_C "Slow path high threshold for battery current delta" VALUE 0x8051B9A4 RB_Val_Ws16 655.3500 Curr_A -327.6800 327.6700 FORMAT "%8.4" /end CHARACTERISTIC
/begin CHARACTERISTIC Alt_iBattFildSlowLo_C "Slow path low threshold for battery current delta" VALUE 0x8051B9A6 RB_Val_Ws16 655.3500 Curr_A -327.6800 327.6700 FORMAT "%8.4" /end CHARACTERISTIC
/begin CHARACTERISTIC Alt_iBattFildSlowResvHi_C "Slow path torque reserve high threshold for battery current delta" VALUE 0x8051B9A8 RB_Val_Ws16 655.3500 Curr_A -327.6800 327.6700 FORMAT "%8.4" /end CHARACTERISTIC
/begin CHARACTERISTIC Alt_iBattFildSlowResvLo_C "Slow path torque reserve low threshold for battery current delta" VALUE 0x8051B9AA RB_Val_Ws16 655.3500 Curr_A -327.6800 327.6700 FORMAT "%8.4" /end CHARACTERISTIC
/begin CHARACTERISTIC Alt_iBattMax_GCUR "Map for maximum battery current limit" CURVE 0x8051B524 RB_CurveGroup_S16 655.3500 Curr_A -327.6800 327.6700 FORMAT "%8.4"
 /begin AXIS_DESCR COM_AXIS Ebs_tBattFild SCR_TEMP_CELS_float 8 -32768.00 32767.00 FORMAT "%8.2" AXIS_PTS_REF Alt_tBatt_AXIS /end AXIS_DESCR
/end CHARACTERISTIC
/begin CHARACTERISTIC Alt_iBattMin_GCUR "Map for minimum battery current limit" CURVE 0x8051B534 RB_CurveGroup_S16 655.3500 Curr_A -327.6800 327.6700 FORMAT "%8.4"
 /begin AXIS_DESCR COM_AXIS Ebs_tBattFild SCR_TEMP_CELS_float 8 -32768.00 32767.00 FORMAT "%8.2" AXIS_PTS_REF Alt_tBatt_AXIS /end AXIS_DESCR
/end CHARACTERISTIC
/begin CHARACTERISTIC Alt_iBattSetTst_C "Test value of setpoint battery current in controller" VALUE 0x8051B544 RB_Val_Ws16 655.3500 Curr_A -327.6800 327.6700 FORMAT "%8.4" /end CHARACTERISTIC
/begin CHARACTERISTIC Alt_iBattSet_CUR "Battery current depending on delta state of charge" CURVE 0x8051B546 RB_Curve_S16_S16 655.3500 Curr_A -327.6800 327.6700 FORMAT "%8.4"
 /begin AXIS_DESCR STD_AXIS s_ratAdjSoc Prc 10 -400.0000 399.9878 FORMAT "%8.4" DEPOSIT ABSOLUTE /end AXIS_DESCR
/end CHARACTERISTIC
/begin CHARACTERISTIC Alt_iBattSOCSet_T "Curve to select the battery charging current based on calculated Battery SOC" CURVE 0x8051B570 RB_Curve_S16_S16 655.3500 Curr_A -327.6800 327.6700 FORMAT "%8.4"
 /begin AXIS_DESCR STD_AXIS NO_INPUT_QUANTITY Ampsec100 10 -3276800. 3276700. FORMAT "%8.0" DEPOSIT ABSOLUTE /end AXIS_DESCR
/end CHARACTERISTIC
/begin CHARACTERISTIC Alt_iBattThdSpclRngDi_C "Battery current threshold for disabling the special range" VALUE 0x8051B59A RB_Val_Ws16 655.3500 Curr_A -327.6800 327.6700 FORMAT "%8.4" /end CHARACTERISTIC
/begin CHARACTERISTIC Alt_iEPS1ElecLdThd_C "Electrical load current threshold of EPS" VALUE 0x8051B9AC RB_Val_Ws16 655.3500 Curr_A -327.6800 327.6700 FORMAT "%8.4" /end CHARACTERISTIC
/begin CHARACTERISTIC Alt_iExctLim_C "Alternator excitation limitation" VALUE 0x8051B59C RB_Val_Ws16 655.3500 Curr_A -327.6800 327.6700 FORMAT "%8.4" /end CHARACTERISTIC
/begin CHARACTERISTIC Alt_iExctLim_T "TAble for excitation current limit" CURVE 0x8051B59E RB_Curve_S16_S16 655.3500 Curr_A -327.6800 327.6700 FORMAT "%8.4"
 /begin AXIS_DESCR STD_AXIS Epm_nEng EngN 5 -16384.00 16383.50 FORMAT "%8.2" DEPOSIT ABSOLUTE /end AXIS_DESCR
/end CHARACTERISTIC
/begin CHARACTERISTIC Alt_iMaxDiffNoDecI_C "Maximum allowed difference between measured and setpoint battery current to allow decrement of setpoint alternator voltage" VALUE 0x8051B5B4 RB_Val_Ws16 655.3500 Curr_A -327.6800 327.6700 FORMAT "%8.4" /end CHARACTERISTIC
/begin CHARACTERISTIC Alt_iMaxDiffNoIncI_C "Maximum allowed difference between measured and setpoint battery current to allow increment of setpoint alternator voltage" VALUE 0x8051B5B6 RB_Val_Ws16 655.3500 Curr_A -327.6800 327.6700 FORMAT "%8.4" /end CHARACTERISTIC
/begin CHARACTERISTIC Alt_nAltEngSpdLim_C "Limit for target idle engine speed" VALUE 0x8051B9AE RB_Val_Ws16 32767.50 nmot_sw_q0p5 -16384.00 16383.50 FORMAT "%8.2" /end CHARACTERISTIC
/begin CHARACTERISTIC Alt_nAltFastTqCmpHi_C "Fast path high threshold engine speed deviation from target speed for torque compensation" VALUE 0x8051B9B0 RB_Val_Ws16 32767.50 EngN -16384.00 16383.50 FORMAT "%8.2" /end CHARACTERISTIC
/begin CHARACTERISTIC Alt_nAltFastTqCmpLo_C "Fast path low threshold engine speed deviation from target speed for torque compensation" VALUE 0x8051B9B2 RB_Val_Ws16 32767.50 EngN -16384.00 16383.50 FORMAT "%8.2" /end CHARACTERISTIC
/begin CHARACTERISTIC Alt_nAltFastTqResvHi_C "Slow path torque reserve engine speed deviation high threshold from target speed" VALUE 0x8051B9B4 RB_Val_Ws16 32767.50 EngN -16384.00 16383.50 FORMAT "%8.2" /end CHARACTERISTIC
/begin CHARACTERISTIC Alt_nAltFastTqResvLo_C "Slow path torque reserve engine speed deviation low threshold from target speed" VALUE 0x8051B9B6 RB_Val_Ws16 32767.50 EngN -16384.00 16383.50 FORMAT "%8.2" /end CHARACTERISTIC
/begin CHARACTERISTIC Alt_nAltSlowEngResvHi_C "Slow path torque reserve engine speed deviation high threshold from target speed" VALUE 0x8051B9B8 RB_Val_Ws16 32767.50 EngN -16384.00 16383.50 FORMAT "%8.2" /end CHARACTERISTIC
/begin CHARACTERISTIC Alt_nAltSlowEngResvLo_C "Slow path torque reserve engine speed deviation low threshold from target speed" VALUE 0x8051B9BA RB_Val_Ws16 32767.50 EngN -16384.00 16383.50 FORMAT "%8.2" /end CHARACTERISTIC
/begin CHARACTERISTIC Alt_nCutOffHiVehSpd_C "Alternator High vehicle speed cutoff calibration" VALUE 0x8051B5B8 RB_Val_Ws16 32767.50 EngN -16384.00 16383.50 FORMAT "%8.2" /end CHARACTERISTIC
/begin CHARACTERISTIC Alt_nCutOff_C "Alternator load response cutoff speed" VALUE 0x8051B5BA RB_Val_Ws16 32767.50 EngN -16384.00 16383.50 FORMAT "%8.2" /end CHARACTERISTIC
/begin CHARACTERISTIC Alt_nEngDeltaSlowHi_C "Slow path high threshold engine speed deviation from target speed" VALUE 0x8051B9BC RB_Val_Ws16 32767.50 EngN -16384.00 16383.50 FORMAT "%8.2" /end CHARACTERISTIC
/begin CHARACTERISTIC Alt_nEngDeltaSlowLo_C "Slow path low threshold engine speed deviation from target speed" VALUE 0x8051B9BE RB_Val_Ws16 32767.50 EngN -16384.00 16383.50 FORMAT "%8.2" /end CHARACTERISTIC
/begin CHARACTERISTIC Alt_nEngHi_C "High engine speed threshold to request high voltage incase of fuel vapor lock suspected" VALUE 0x8051B9C0 RB_Val_Ws16 32767.50 EngN -16384.00 16383.50 FORMAT "%8.2" /end CHARACTERISTIC
/begin CHARACTERISTIC Alt_nEngLow_C "Low engine speed threshold to cancel high voltage incase of fuel vapor lock suspected" VALUE 0x8051B9C2 RB_Val_Ws16 32767.50 EngN -16384.00 16383.50 FORMAT "%8.2" /end CHARACTERISTIC
/begin CHARACTERISTIC Alt_nEngSpdExctLimHi_C "Higher limit for engine speed to limit excitation current" VALUE 0x8051B5BC RB_Val_Ws16 32767.50 EngN -16384.00 16383.50 FORMAT "%8.2" /end CHARACTERISTIC
/begin CHARACTERISTIC Alt_nEngSpdExctLimLo_C "Lower limit for engine speed to limit excitation current" VALUE 0x8051B5BE RB_Val_Ws16 32767.50 EngN -16384.00 16383.50 FORMAT "%8.2" /end CHARACTERISTIC
/begin CHARACTERISTIC Alt_nFastEngSpdStab_C "Fast path engine speed stable threshold for offset correction release" VALUE 0x8051B9C4 RB_Val_Ws16 32767.50 EngN -16384.00 16383.50 FORMAT "%8.2" /end CHARACTERISTIC
/begin CHARACTERISTIC Alt_nFastMaxIdleSpd_C "Fast path maximum target idle speed for offset correction release" VALUE 0x8051B9C6 RB_Val_Ws16 32767.50 EngN -16384.00 16383.50 FORMAT "%8.2" /end CHARACTERISTIC
/begin CHARACTERISTIC Alt_nGenrHiHi_C "Maximum alternator speed limit" VALUE 0x8051B5C0 RB_Val_Ws16 32767.50 EngN -16384.00 16383.50 FORMAT "%8.2" /end CHARACTERISTIC
/begin CHARACTERISTIC Alt_nGenrHiLo_C "Minimum alternator speed limit" VALUE 0x8051B5C2 RB_Val_Ws16 32767.50 EngN -16384.00 16383.50 FORMAT "%8.2" /end CHARACTERISTIC
/begin CHARACTERISTIC Alt_nIdleMinHi_C "Upper threshold of Engine speed for IDLE mode." VALUE 0x8051C55E RB_Val_Ws16 32767.50 EngN -16384.00 16383.50 FORMAT "%8.2" /end CHARACTERISTIC
/begin CHARACTERISTIC Alt_nIdleMinLo_C "Lower threshold of Engine speed for IDLE mode." VALUE 0x8051C560 RB_Val_Ws16 32767.50 EngN -16384.00 16383.50 FORMAT "%8.2" /end CHARACTERISTIC
/begin CHARACTERISTIC Alt_nrActPtcActv_C "AMx number of PTC activated for limiting excitation current" VALUE 0x8051B5C4 RB_Val_Wu8 255.0 OneToOne 0.00 255.0 FORMAT "%5.1" /end CHARACTERISTIC
/begin CHARACTERISTIC Alt_nRecupDiThdHi_C "Upper limit of engine speed to disable Recuperation mode" VALUE 0x8051C562 RB_Val_Ws16 32767.50 EngN -16384.00 16383.50 FORMAT "%8.2" /end CHARACTERISTIC
/begin CHARACTERISTIC Alt_nRecupDiThdLo_C "Lower limit of engine speed to disable Recuperation mode" VALUE 0x8051C564 RB_Val_Ws16 32767.50 EngN -16384.00 16383.50 FORMAT "%8.2" /end CHARACTERISTIC
/begin CHARACTERISTIC Alt_nrIdAltMnfc_C "ID of alternator supplier" VALUE 0x8051B5C5 RB_Val_Wu8 255.0 OneToOne 0.00 255.0 FORMAT "%5.1" /end CHARACTERISTIC
/begin CHARACTERISTIC Alt_nrIdAlt_C "ID of alternator" VALUE 0x8051B5C6 RB_Val_Wu8 255.0 OneToOne 0.00 255.0 FORMAT "%5.1" /end CHARACTERISTIC
/begin CHARACTERISTIC Alt_nrIdChp_C "ID of regulator used on alternator" VALUE 0x8051B5C7 RB_Val_Wu8 255.0 OneToOne 0.00 255.0 FORMAT "%5.1" /end CHARACTERISTIC
/begin CHARACTERISTIC Alt_nThres_C "Engine speed threshold for alternator shut-off" VALUE 0x8051B9C8 RB_Val_Ws16 32767.50 EngN -16384.00 16383.50 FORMAT "%8.2" /end CHARACTERISTIC
/begin CHARACTERISTIC Alt_nWESThd_C "Working engine Speed Threshold" VALUE 0x8051B9CA RB_Val_Ws16 32767.50 EngN -16384.00 16383.50 FORMAT "%8.2" /end CHARACTERISTIC
/begin CHARACTERISTIC Alt_qBattFildNegThd_C "Fast path judgment threshold of Battery current negative deviation integration value" VALUE 0x8051B9CC RB_Val_Ws32 4294967.29500 q0p001_A_s_1 -2147483.64800 2147483.64700 FORMAT "%13.5" /end CHARACTERISTIC
/begin CHARACTERISTIC Alt_qSOCHdLiHiThd_C "SOC Hysterisis upper threshold for battery voltage limitation by battery temperature" VALUE 0x8051B5C8 RB_Val_Ws32 4294967.29500 RBPtCel_q_0p001_1 -2147483.64800 2147483.64700 FORMAT "%13.5" /end CHARACTERISTIC
/begin CHARACTERISTIC Alt_qSOCHdLiLoThd_C "SOC Hysterisis Lower threshold for battery voltage limitation by battery temperature" VALUE 0x8051B5CC RB_Val_Ws32 4294967.29500 RBPtCel_q_0p001_1 -2147483.64800 2147483.64700 FORMAT "%13.5" /end CHARACTERISTIC
/begin CHARACTERISTIC Alt_qUpScaEnaThdHi_C "Hysteresis upper threshold for allowing the voltage up scaling based on Battery SOC during Fuel cut" VALUE 0x8051B5D0 RB_Val_Ws32 4294967.29500 RBPtCel_q_0p001_1 -2147483.64800 2147483.64700 FORMAT "%13.5" /end CHARACTERISTIC
/begin CHARACTERISTIC Alt_qUpScaEnaThdLo_C "Hysteresis lower threshold for allowing the voltage up scaling based on Battery SOC during Fuel cut" VALUE 0x8051B5D4 RB_Val_Ws32 4294967.29500 RBPtCel_q_0p001_1 -2147483.64800 2147483.64700 FORMAT "%13.5" /end CHARACTERISTIC
/begin CHARACTERISTIC Alt_rAltLoadBlowrFanThd_C "Alternator load threshold of blower fan" VALUE 0x8051B9D0 RB_Val_Ws16 655.3500 DtyCyc -327.6800 327.6700 FORMAT "%8.4" /end CHARACTERISTIC
/begin CHARACTERISTIC Alt_rAltLoadDFogThd_C "Alternator load threshold of defogger" VALUE 0x8051B9D2 RB_Val_Ws16 655.3500 DtyCyc -327.6800 327.6700 FORMAT "%8.4" /end CHARACTERISTIC
/begin CHARACTERISTIC Alt_rAltLoadEPSThd_C "Parameter to set the Alternator raw threshold value for EPS" VALUE 0x8051B9D4 RB_Val_Ws16 655.3500 DtyCyc -327.6800 327.6700 FORMAT "%8.4" /end CHARACTERISTIC
/begin CHARACTERISTIC Alt_rAltLoadFrntFogThd_C "Alternator load threshold of front fog lamp" VALUE 0x8051B9D6 RB_Val_Ws16 655.3500 DtyCyc -327.6800 327.6700 FORMAT "%8.4" /end CHARACTERISTIC
/begin CHARACTERISTIC Alt_rAltLoadLiSwtInfoThd_C "Alternator load threshold of light switch" VALUE 0x8051B9D8 RB_Val_Ws16 655.3500 DtyCyc -327.6800 327.6700 FORMAT "%8.4" /end CHARACTERISTIC
/begin CHARACTERISTIC Alt_rAltLoadRadioFanThd_C "Alternator load threshold of radio fan" VALUE 0x8051B9DA RB_Val_Ws16 655.3500 DtyCyc -327.6800 327.6700 FORMAT "%8.4" /end CHARACTERISTIC
/begin CHARACTERISTIC Alt_rAltLoadRrFogThd_C "Alternator load threshold of rear fog lamp" VALUE 0x8051B9DC RB_Val_Ws16 655.3500 DtyCyc -327.6800 327.6700 FORMAT "%8.4" /end CHARACTERISTIC
/begin CHARACTERISTIC Alt_rAltLoadWiprThd_C "Alternator load threshold of wiper" VALUE 0x8051B9DE RB_Val_Ws16 655.3500 DtyCyc -327.6800 327.6700 FORMAT "%8.4" /end CHARACTERISTIC
/begin CHARACTERISTIC Alt_ratAltEngSpd_C "Ratio of alternator speed and engine speed" VALUE 0x8051B9E0 RB_Val_Ws16 15.99976 fak_sw_b8 -8.000000 7.999756 FORMAT "%8.6" /end CHARACTERISTIC
/begin CHARACTERISTIC Alt_ratDfHiHi_C "Maximum alternator duty cycle" VALUE 0x8051B5D8 RB_Val_Ws16 655.3500 DtyCyc -327.6800 327.6700 FORMAT "%8.4" /end CHARACTERISTIC
/begin CHARACTERISTIC Alt_ratDfHiLo_C "Minimum alternator duty cycle" VALUE 0x8051B5DA RB_Val_Ws16 655.3500 DtyCyc -327.6800 327.6700 FORMAT "%8.4" /end CHARACTERISTIC
/begin CHARACTERISTIC Alt_ratHdLiHiThd_C "High SOC threshold for headlight activity" VALUE 0x8051B5DC RB_Val_Wu8 127.5 RBPtCel_Perc_0p5_1 0.00 127.5 FORMAT "%5.1" /end CHARACTERISTIC
/begin CHARACTERISTIC Alt_ratHdLiLoThd_C "Low SOC threshold for headlight activity" VALUE 0x8051B5DD RB_Val_Wu8 127.5 RBPtCel_Perc_0p5_1 0.00 127.5 FORMAT "%5.1" /end CHARACTERISTIC
/begin CHARACTERISTIC Alt_ratSocAdj_CUR "Map providing the relation between charge and State of charge" CURVE 0x8051B5DE RB_Curve_S16_S16 799.9878 Prc -400.0000 399.9878 FORMAT "%8.4"
 /begin AXIS_DESCR STD_AXIS Ebs_qSohFild ElecChrg_Ah_q0p125_COMPU 10 -4096.000 4095.875 FORMAT "%8.3" DEPOSIT ABSOLUTE /end AXIS_DESCR
/end CHARACTERISTIC
/begin CHARACTERISTIC Alt_ratSocRefrThdHi_C "Threshold for maximum battery SOC" VALUE 0x8051B608 RB_Val_Wu8 127.5 RBPtCel_Perc_0p5_1 0.00 127.5 FORMAT "%5.1" /end CHARACTERISTIC
/begin CHARACTERISTIC Alt_ratSocRefrThdLo_C "Threshold for minimum battery SOC" VALUE 0x8051B609 RB_Val_Wu8 127.5 RBPtCel_Perc_0p5_1 0.00 127.5 FORMAT "%5.1" /end CHARACTERISTIC
/begin CHARACTERISTIC Alt_ratSocSetCold_C "Adjusted SOC in cold temperature" VALUE 0x8051B60A RB_Val_Ws16 799.9878 Prc -400.0000 399.9878 FORMAT "%8.4" /end CHARACTERISTIC
/begin CHARACTERISTIC Alt_ratSocSetIce_C "Adjusted SOC in very cold temperature" VALUE 0x8051B60C RB_Val_Ws16 799.9878 Prc -400.0000 399.9878 FORMAT "%8.4" /end CHARACTERISTIC
/begin CHARACTERISTIC Alt_ratSocSetMax_C "Threshold for maximum SOC" VALUE 0x8051B60E RB_Val_Ws16 799.9878 Prc -400.0000 399.9878 FORMAT "%8.4" /end CHARACTERISTIC
/begin CHARACTERISTIC Alt_ratSocSetMin_C "Threshold for minimum SOC" VALUE 0x8051B610 RB_Val_Ws16 799.9878 Prc -400.0000 399.9878 FORMAT "%8.4" /end CHARACTERISTIC
/begin CHARACTERISTIC Alt_ratSocSetNorm_C "Adjusted SOC in Normal temperature" VALUE 0x8051B612 RB_Val_Ws16 799.9878 Prc -400.0000 399.9878 FORMAT "%8.4" /end CHARACTERISTIC
/begin CHARACTERISTIC Alt_ratSocSetWrm_C "Adjusted SOC in Warm temperature" VALUE 0x8051B614 RB_Val_Ws16 799.9878 Prc -400.0000 399.9878 FORMAT "%8.4" /end CHARACTERISTIC
/begin CHARACTERISTIC Alt_ratSocSet_C "Default SOC level in the absence of temperature adjusted SOC" VALUE 0x8051B616 RB_Val_Ws16 799.9878 Prc -400.0000 399.9878 FORMAT "%8.4" /end CHARACTERISTIC
/begin CHARACTERISTIC Alt_ratSocThd_C "Status of charge threshold value" VALUE 0x8051B618 RB_Val_Wu8 127.5 RBPtCel_Perc_0p5_1 0.00 127.5 FORMAT "%5.1" /end CHARACTERISTIC
/begin CHARACTERISTIC Alt_ratThdSocHiHi_C "Threshold for maximum battery SOC" VALUE 0x8051B619 RB_Val_Wu8 127.5 RBPtCel_Perc_0p5_1 0.00 127.5 FORMAT "%5.1" /end CHARACTERISTIC
/begin CHARACTERISTIC Alt_ratThdSocHiLo_C "Upper threshold for Normal SOC" VALUE 0x8051B61A RB_Val_Wu8 127.5 RBPtCel_Perc_0p5_1 0.00 127.5 FORMAT "%5.1" /end CHARACTERISTIC
/begin CHARACTERISTIC Alt_ratThdSocLoHi_C "Upper threshold for Low SOC" VALUE 0x8051B61B RB_Val_Wu8 127.5 RBPtCel_Perc_0p5_1 0.00 127.5 FORMAT "%5.1" /end CHARACTERISTIC
/begin CHARACTERISTIC Alt_ratThdSocLoLo_C "Threshold for very low SOC" VALUE 0x8051B61C RB_Val_Wu8 127.5 RBPtCel_Perc_0p5_1 0.00 127.5 FORMAT "%5.1" /end CHARACTERISTIC
/begin CHARACTERISTIC Alt_ratThdSocNrmHi_C "Lower threshold for Normal SOC" VALUE 0x8051B61D RB_Val_Wu8 127.5 RBPtCel_Perc_0p5_1 0.00 127.5 FORMAT "%5.1" /end CHARACTERISTIC
/begin CHARACTERISTIC Alt_ratThdSocNrmLo_C "Lower threshold for Low SOC" VALUE 0x8051B61E RB_Val_Wu8 127.5 RBPtCel_Perc_0p5_1 0.00 127.5 FORMAT "%5.1" /end CHARACTERISTIC
/begin CHARACTERISTIC Alt_rBattDgrdHi_C "Battery resistance degradation high threshold" VALUE 0x8051B620 RB_Val_Ws16 0.6553500 RBPtCel_r_0p00001_1 -0.3276800 0.3276700 FORMAT "%9.7" /end CHARACTERISTIC
/begin CHARACTERISTIC Alt_rBattDgrdLo_C "Battery resistance degradation low threshold" VALUE 0x8051B622 RB_Val_Ws16 0.6553500 RBPtCel_r_0p00001_1 -0.3276800 0.3276700 FORMAT "%9.7" /end CHARACTERISTIC
/begin CHARACTERISTIC Alt_rBattThdSpclRngDi_C "Battery resistance threshold for disabling the special voltage range" VALUE 0x8051B624 RB_Val_Ws16 0.6553500 RBPtCel_r_0p00001_1 -0.3276800 0.3276700 FORMAT "%9.7" /end CHARACTERISTIC
/begin CHARACTERISTIC Alt_rLoadHiThd_C "Filtered Alternator load High threshold" VALUE 0x8051B9E2 RB_Val_Ws16 655.3500 DtyCyc -327.6800 327.6700 FORMAT "%8.4" /end CHARACTERISTIC
/begin CHARACTERISTIC Alt_rLoadLowrThd_C "Filtered Alternator load Lower threshold" VALUE 0x8051B9E4 RB_Val_Ws16 655.3500 DtyCyc -327.6800 327.6700 FORMAT "%8.4" /end CHARACTERISTIC
/begin CHARACTERISTIC Alt_stAltLoadIdleUp_C "Idle up request mask" VALUE 0x8051B9E6 RB_Val_Wu8 255.0 OneToOne 0.00 255.0 FORMAT "%5.1" /end CHARACTERISTIC
/begin CHARACTERISTIC Alt_stBattOffsCorrMask_C "Battery voltage offset learning condition status mask" VALUE 0x8051B9E8 RB_Val_Wu16 65535.00 OneToOne 0.00 65535.00 FORMAT "%8.2" /end CHARACTERISTIC
/begin CHARACTERISTIC Alt_stDecLoadEnaCdn_C "Bit mask for the Decrement load enable condition" VALUE 0x8051C566 RB_Val_Wu8 255.0 OneToOne 0.00 255.0 FORMAT "%5.1" /end CHARACTERISTIC
/begin CHARACTERISTIC Alt_stDecLoadStop_C "Bit mask for the Decrement load stop condition" VALUE 0x8051C567 RB_Val_Wu8 255.0 OneToOne 0.00 255.0 FORMAT "%5.1" /end CHARACTERISTIC
/begin CHARACTERISTIC Alt_stEbsErrSel_C "Mask bits for error in battery voltage; current or SOC" VALUE 0x8051B626 RB_Val_Wu8 255.0 OneToOne 0.00 255.0 FORMAT "%5.1" /end CHARACTERISTIC
/begin CHARACTERISTIC Alt_stElecLoadActv_C "Switch to enable voltage change sensitv loads" VALUE 0x8051B627 RB_Val_Wu8 255.0 OneToOne 0.00 255.0 FORMAT "%5.1" /end CHARACTERISTIC
/begin CHARACTERISTIC Alt_stErrSeln_C "Bit mask to choose sensor error condition for RECUP and DECLOAD mode" VALUE 0x8051C568 RB_Val_Wu8 255.0 OneToOne 0.00 255.0 FORMAT "%5.1" /end CHARACTERISTIC
/begin CHARACTERISTIC Alt_stFailSafe_C "Mask bits for alternator fail safe startegy" VALUE 0x8051B628 RB_Val_Wu16 65535.00 OneToOne 0.00 65535.00 FORMAT "%8.2" /end CHARACTERISTIC
/begin CHARACTERISTIC Alt_stFastGearCdnMask_C "Fast path gear condition mask for offset correction release" VALUE 0x8051B9EA RB_Val_Wu8 255.0 OneToOne 0.00 255.0 FORMAT "%5.1" /end CHARACTERISTIC
/begin CHARACTERISTIC Alt_stFFAltLoadSeln_C "Selection CW configuration for Fast and Slow path torque calculation" VALUE 0x8051B9EB RB_Val_Wu8 255.0 OneToOne 0.00 255.0 FORMAT "%5.1" /end CHARACTERISTIC
/begin CHARACTERISTIC Alt_stGripSelnAT_C "Calibration to select the powertrain grip information based on the transmission type." VALUE 0x8051C569 RB_Val_Wu8 1.00000000000 B_TRUE 0.00 1.00000000000 FORMAT "%13.11" /end CHARACTERISTIC
/begin CHARACTERISTIC Alt_stMaskErr_C "Mask bits for alternator error lamp activation" VALUE 0x8051B62A RB_Val_Wu8 255.0 OneToOne 0.00 255.0 FORMAT "%5.1" /end CHARACTERISTIC
/begin CHARACTERISTIC Alt_stNoGripInfoSeln_C "Calibration to select the powertrain No grip information." VALUE 0x8051C56A RB_Val_Wu8 1.00000000000 B_TRUE 0.00 1.00000000000 FORMAT "%13.11" /end CHARACTERISTIC
/begin CHARACTERISTIC Alt_stRawLoadCdnMask_C "Parameter to bypass the alternator raw load comparison with threshold value condition for all electrical loads" VALUE 0x8051B9EC RB_Val_Wu8 255.0 OneToOne 0.00 255.0 FORMAT "%5.1" /end CHARACTERISTIC
/begin CHARACTERISTIC Alt_stRecupBrk_C "Bit mask for detecting brake status" VALUE 0x8051C56B RB_Val_Wu8 255.0 OneToOne 0.00 255.0 FORMAT "%5.1" /end CHARACTERISTIC
/begin CHARACTERISTIC Alt_stRecupEnaCdn_C "Bit mask for the Recuperation enable condition" VALUE 0x8051C56C RB_Val_Wu8 255.0 OneToOne 0.00 255.0 FORMAT "%5.1" /end CHARACTERISTIC
/begin CHARACTERISTIC Alt_stRecupStopCdn_C "Bit mask for selecting Recuperation STOP condition" VALUE 0x8051C56D RB_Val_Wu8 255.0 OneToOne 0.00 255.0 FORMAT "%5.1" /end CHARACTERISTIC
/begin CHARACTERISTIC Alt_stSwtAltLoad_C "Switch of alternator load" VALUE 0x8051B9ED RB_Val_Wboolean 1.00000000000 B_TRUE 0.00 1.00000000000 FORMAT "%13.11" /end CHARACTERISTIC
/begin CHARACTERISTIC Alt_stSwtDesResv_C "Switch to determine where the estimation torque plus into is" VALUE 0x8051B9EE RB_Val_Wboolean 1.00000000000 B_TRUE 0.00 1.00000000000 FORMAT "%13.11" /end CHARACTERISTIC
/begin CHARACTERISTIC Alt_stSwtDFog_C "Input signal switch for defogger" VALUE 0x8051B9EF RB_Val_Wboolean 1.00000000000 B_TRUE 0.00 1.00000000000 FORMAT "%13.11" /end CHARACTERISTIC
/begin CHARACTERISTIC Alt_stSwtElecLoadTqCorrn_C "Switch of electrical load torque correction" VALUE 0x8051B9F0 RB_Val_Wboolean 1.00000000000 B_TRUE 0.00 1.00000000000 FORMAT "%13.11" /end CHARACTERISTIC
/begin CHARACTERISTIC Alt_swtEpsOnly_C "Only EPS current" VALUE 0x8051B9F1 RB_Val_Wboolean 1.00000000000 B_TRUE 0.00 1.00000000000 FORMAT "%13.11" /end CHARACTERISTIC
/begin CHARACTERISTIC Alt_swtFailSafeSel_C "Switch to enable or disable various Fail safe modes" VALUE 0x8051B62C RB_Val_Wu16 65535.00 OneToOne 0.00 65535.00 FORMAT "%8.2" /end CHARACTERISTIC
/begin CHARACTERISTIC Alt_swtGenrCtl_C "Switch to enable or disable alternator control" VALUE 0x8051B630 RB_Val_Wu32 4294967295.00 OneToOne 0.00 4294967295.00 FORMAT "%13.2" /end CHARACTERISTIC
/begin CHARACTERISTIC Alt_swtIdleEna_C "Switch to enable alternator idle mode" VALUE 0x8051B634 RB_Val_Wboolean 1.00000000000 B_TRUE 0.00 1.00000000000 FORMAT "%13.11" /end CHARACTERISTIC
/begin CHARACTERISTIC Alt_swtLoadRespActModTrqSel_C "Calibration switch for Actual modelled torque selection" VALUE 0x8051B635 RB_Val_Wboolean 1.00000000000 B_TRUE 0.00 1.00000000000 FORMAT "%13.11" /end CHARACTERISTIC
/begin CHARACTERISTIC Alt_swtLoadSeln_C "Alternator Load selection switch" VALUE 0x8051B9F2 RB_Val_Wboolean 1.00000000000 B_TRUE 0.00 1.00000000000 FORMAT "%13.11" /end CHARACTERISTIC
/begin CHARACTERISTIC Alt_swtLockUpCluExtn_C "Calibration switch for Lock Up Clutch Extension" VALUE 0x8051B636 RB_Val_Wboolean 1.00000000000 B_TRUE 0.00 1.00000000000 FORMAT "%13.11" /end CHARACTERISTIC
/begin CHARACTERISTIC Alt_swtRecupVEna_C "Switch to select vehicle velocity limit as enable condition for RECUP mode" VALUE 0x8051C56E RB_Val_Wu8 1.00000000000 B_TRUE 0.00 1.00000000000 FORMAT "%13.11" /end CHARACTERISTIC
/begin CHARACTERISTIC Alt_swtTrqMode_C "Torque modes" VALUE 0x8051B9F3 RB_Val_Wu8 255.0 OneToOne 0.00 255.0 FORMAT "%5.1" /end CHARACTERISTIC
/begin CHARACTERISTIC Alt_tBattChrgnRqrdUHi_C "High threshold temperature for battery charging required voltage" VALUE 0x8051B638 RB_Val_Ws16 65535.00 SCR_TEMP_CELS_float -32768.00 32767.00 FORMAT "%8.2" /end CHARACTERISTIC
/begin CHARACTERISTIC Alt_tBattChrgnRqrdULo_C "Low threshold temperature for battery charging required voltage" VALUE 0x8051B63A RB_Val_Ws16 65535.00 SCR_TEMP_CELS_float -32768.00 32767.00 FORMAT "%8.2" /end CHARACTERISTIC
/begin CHARACTERISTIC Alt_tBattFildULimThd_C "Battery Temperature threshold for battery voltage limitation by temperature" VALUE 0x8051B63C RB_Val_Ws16 6553.500 Temp_Cels_Diff -3276.800 3276.700 FORMAT "%8.3" /end CHARACTERISTIC
/begin CHARACTERISTIC Alt_tBattMaxRngDiHi_C "Allowed maximum Battery state of charge." VALUE 0x8051B63E RB_Val_Ws16 65535.00 SCR_TEMP_CELS_float -32768.00 32767.00 FORMAT "%8.2" /end CHARACTERISTIC
/begin CHARACTERISTIC Alt_tBattMaxRngDiLo_C "Allowed minimum Battery state of charge." VALUE 0x8051B640 RB_Val_Ws16 65535.00 SCR_TEMP_CELS_float -32768.00 32767.00 FORMAT "%8.2" /end CHARACTERISTIC
/begin CHARACTERISTIC Alt_tBattMaxSpclRngDi_C "Battery temperature maximum threshold for disabling the special voltage range" VALUE 0x8051B642 RB_Val_Ws16 65535.00 SCR_TEMP_CELS_float -32768.00 32767.00 FORMAT "%8.2" /end CHARACTERISTIC
/begin CHARACTERISTIC Alt_tBattMinSpclRngDi_C "Battery temperature minimum threshold for disabling the special voltage range" VALUE 0x8051B644 RB_Val_Ws16 65535.00 SCR_TEMP_CELS_float -32768.00 32767.00 FORMAT "%8.2" /end CHARACTERISTIC
/begin AXIS_PTS Alt_tBatt_AXIS "Axis battery temperature for determination of set voltage" 0x8051B646 Ebs_tBattFild RB_Axis_S16 65535.00 SCR_TEMP_CELS_float 8 -32768.00 32767.00 FORMAT "%8.2" DEPOSIT ABSOLUTE /end AXIS_PTS
/begin CHARACTERISTIC Alt_tEnvColdThdHi_C "Lower temperature threshold for SOC in normal temperature" VALUE 0x8051B658 RB_Val_Ws16 6553.500 Temp_Cels -3549.940 3003.560 FORMAT "%8.3" /end CHARACTERISTIC
/begin CHARACTERISTIC Alt_tEnvColdThdLo_C "Upper temperature threshold for SOC in cold temperature" VALUE 0x8051B65A RB_Val_Ws16 6553.500 Temp_Cels -3549.940 3003.560 FORMAT "%8.3" /end CHARACTERISTIC
/begin CHARACTERISTIC Alt_tEnvIceThdHi_C "Lower temperature threshold for SOC in very cold temperature" VALUE 0x8051B65C RB_Val_Ws16 6553.500 Temp_Cels -3549.940 3003.560 FORMAT "%8.3" /end CHARACTERISTIC
/begin CHARACTERISTIC Alt_tEnvIceThdLo_C "Lower temperature threshold for SOC in cold temperature" VALUE 0x8051B65E RB_Val_Ws16 6553.500 Temp_Cels -3549.940 3003.560 FORMAT "%8.3" /end CHARACTERISTIC
/begin CHARACTERISTIC Alt_tEnvNormThdHi_C "Upper temperature threshold for SOC in warm temperature" VALUE 0x8051B660 RB_Val_Ws16 6553.500 Temp_Cels -3549.940 3003.560 FORMAT "%8.3" /end CHARACTERISTIC
/begin CHARACTERISTIC Alt_tEnvNormThdLo_C "Upper temperature threshold for SOC in normal temperature" VALUE 0x8051B662 RB_Val_Ws16 6553.500 Temp_Cels -3549.940 3003.560 FORMAT "%8.3" /end CHARACTERISTIC
/begin CHARACTERISTIC Alt_tFastEng_C "Fast path engine temperature threshold for offset correction release" VALUE 0x8051B9F4 RB_Val_Wu8 191.3 temp_uw_q0p75_o48 -48.0 143.3 FORMAT "%5.1" /end CHARACTERISTIC
/begin CHARACTERISTIC Alt_tiAftEndStrtFFThd_C "Time threshold of feed forward since engine start end" VALUE 0x8051B9F6 RB_Val_Wu16 655.3500 t10msxs_uw_b655p35 0.00 655.3500 FORMAT "%8.4" /end CHARACTERISTIC
/begin CHARACTERISTIC Alt_tiAltLoadFlt_C "Time constant fot filtering alternator load" VALUE 0x8051B9F8 RB_Val_Wu16 655.3400 Time_s 0.0100 655.3500 FORMAT "%8.4" EXTENDED_LIMITS 0.00 655.3500 /end CHARACTERISTIC
/begin CHARACTERISTIC Alt_tiAltLoadGrdtFlt2_M "MAP for Alt_tiAltLoadGrdtFlt incase of fuel vapor lock" MAP 0x8051B9FA RB_Map_S16S16_S16 655.3500 Time_s -327.6800 327.6700 FORMAT "%8.4"
 /begin AXIS_DESCR STD_AXIS Alt_rDeltaDutyCyc DtyCyc 6 -327.6800 327.6700 FORMAT "%8.4" DEPOSIT ABSOLUTE /end AXIS_DESCR
 /begin AXIS_DESCR STD_AXIS AltIO_rAltLoad DtyCyc 6 -327.6800 327.6700 FORMAT "%8.4" DEPOSIT ABSOLUTE /end AXIS_DESCR
/end CHARACTERISTIC
/begin CHARACTERISTIC Alt_tiAltLoadGrdtFlt_M "MAP for Alt_tiAltLoadGrdtFlt" MAP 0x8051BA5E RB_Map_S16S16_S16 655.3500 Time_s -327.6800 327.6700 FORMAT "%8.4"
 /begin AXIS_DESCR STD_AXIS Alt_rDeltaDutyCyc DtyCyc 6 -327.6800 327.6700 FORMAT "%8.4" DEPOSIT ABSOLUTE /end AXIS_DESCR
 /begin AXIS_DESCR STD_AXIS AltIO_rAltLoad DtyCyc 6 -327.6800 327.6700 FORMAT "%8.4" DEPOSIT ABSOLUTE /end AXIS_DESCR
/end CHARACTERISTIC
/begin CHARACTERISTIC Alt_tiBattUFil_C "Fill time of battery voltage" VALUE 0x8051BAC4 RB_Val_Ws32 4294.9672940000000 TimeDelay_s 0.0000020000000 4294.9672959999998 FORMAT "%19.14" EXTENDED_LIMITS 0.000002000000001 4294.9672959999998 /end CHARACTERISTIC
/begin CHARACTERISTIC Alt_tiBlowrFanOff_C "Blower fan off filter time" VALUE 0x8051BAC8 RB_Val_Ws32 4294.9672940000000 TimeDelay_s 0.0000020000000 4294.9672959999998 FORMAT "%19.14" EXTENDED_LIMITS 0.000002000000001 4294.9672959999998 /end CHARACTERISTIC
/begin CHARACTERISTIC Alt_tiBlowrFanOn_C "Blower fan on filter time" VALUE 0x8051BACC RB_Val_Ws32 4294.9672940000000 TimeDelay_s 0.0000020000000 4294.9672959999998 FORMAT "%19.14" EXTENDED_LIMITS 0.000002000000001 4294.9672959999998 /end CHARACTERISTIC
/begin CHARACTERISTIC Alt_tiBlowrFanU_C "Delay time for blower fan" VALUE 0x8051BAD0 RB_Val_Wu16 655.3500 Time_s 0.00 655.3500 FORMAT "%8.4" /end CHARACTERISTIC
/begin CHARACTERISTIC Alt_tiCalcnPerd_C "Calculation period Delta duty cycle from alternator PWM signal" VALUE 0x8051BAD2 RB_Val_Wu16 655.3500 t_q0p01 0.00 655.3500 FORMAT "%8.4" /end CHARACTERISTIC
/begin CHARACTERISTIC Alt_tiCrkNotCmplDly_C "Crank not complete status delay time" VALUE 0x8051BAD4 RB_Val_Wu16 655.3500 t_q0p01 0.00 655.3500 FORMAT "%8.4" /end CHARACTERISTIC
/begin CHARACTERISTIC Alt_tiDecLoadLim_C "Turn OFF delay time constant for Decrement load mode." VALUE 0x8051C570 RB_Val_Ws16 655.3500 Time_s -327.6800 327.6700 FORMAT "%8.4" /end CHARACTERISTIC
/begin CHARACTERISTIC Alt_tiDFogOff_C "Defogger off filter time" VALUE 0x8051BAD8 RB_Val_Ws32 4294.9672940000000 TimeDelay_s 0.0000020000000 4294.9672959999998 FORMAT "%19.14" EXTENDED_LIMITS 0.000002000000001 4294.9672959999998 /end CHARACTERISTIC
/begin CHARACTERISTIC Alt_tiDFogOn_C "Defogger on filter time" VALUE 0x8051BADC RB_Val_Ws32 4294.9672940000000 TimeDelay_s 0.0000020000000 4294.9672959999998 FORMAT "%19.14" EXTENDED_LIMITS 0.000002000000001 4294.9672959999998 /end CHARACTERISTIC
/begin CHARACTERISTIC Alt_tiDFog_C "Delay time for defogger" VALUE 0x8051BAE0 RB_Val_Wu16 655.3500 Time_s 0.00 655.3500 FORMAT "%8.4" /end CHARACTERISTIC
/begin CHARACTERISTIC Alt_tiEPSDly_C "Delay time for EPS" VALUE 0x8051BAE2 RB_Val_Wu16 655.3500 Time_s 0.00 655.3500 FORMAT "%8.4" /end CHARACTERISTIC
/begin CHARACTERISTIC Alt_tiEPSOff_C "EPS off filter time" VALUE 0x8051BAE4 RB_Val_Ws32 4294.9672940000000 TimeDelay_s 0.0000020000000 4294.9672959999998 FORMAT "%19.14" EXTENDED_LIMITS 0.000002000000001 4294.9672959999998 /end CHARACTERISTIC
/begin CHARACTERISTIC Alt_tiEPSOn_C "EPS on filter time" VALUE 0x8051BAE8 RB_Val_Ws32 4294.9672940000000 TimeDelay_s 0.0000020000000 4294.9672959999998 FORMAT "%19.14" EXTENDED_LIMITS 0.000002000000001 4294.9672959999998 /end CHARACTERISTIC
/begin CHARACTERISTIC Alt_tiExctCrntGrdtFlt2_M "MAP for Alt_tiExctcrntGrdtFlt incase of fuel vapor lock" MAP 0x8051BAEC RB_Map_S16S16_S16 655.3500 Time_s -327.6800 327.6700 FORMAT "%8.4"
 /begin AXIS_DESCR STD_AXIS Alt_iDeltaExctCrnt Curr 6 -32768.00 32767.00 FORMAT "%8.2" DEPOSIT ABSOLUTE /end AXIS_DESCR
 /begin AXIS_DESCR STD_AXIS ComAlt_iExctCrnt Curr 6 -32768.00 32767.00 FORMAT "%8.2" DEPOSIT ABSOLUTE /end AXIS_DESCR
/end CHARACTERISTIC
/begin CHARACTERISTIC Alt_tiExctCrntGrdtFlt_M "MAP for Alt_tiExctcrntGrdtFlt" MAP 0x8051BB50 RB_Map_S16S16_S16 655.3500 Time_s -327.6800 327.6700 FORMAT "%8.4"
 /begin AXIS_DESCR STD_AXIS Alt_iDeltaExctCrnt Curr 6 -32768.00 32767.00 FORMAT "%8.2" DEPOSIT ABSOLUTE /end AXIS_DESCR
 /begin AXIS_DESCR STD_AXIS ComAlt_iExctCrnt Curr 6 -32768.00 32767.00 FORMAT "%8.2" DEPOSIT ABSOLUTE /end AXIS_DESCR
/end CHARACTERISTIC
/begin CHARACTERISTIC Alt_tiExctCurrDly_C "Excitation current delay time" VALUE 0x8051BBB4 RB_Val_Wu16 655.3500 Time_s 0.00 655.3500 FORMAT "%8.4" /end CHARACTERISTIC
/begin CHARACTERISTIC Alt_tiExctCurrFil_C "Excitation current filter time" VALUE 0x8051BBB6 RB_Val_Wu16 655.3400 Time_s 0.0100 655.3500 FORMAT "%8.4" EXTENDED_LIMITS 0.00 655.3500 /end CHARACTERISTIC
/begin CHARACTERISTIC Alt_tiFastBattCorrRels_C "Battery voltage offset learning condition debounce time" VALUE 0x8051BBB8 RB_Val_Wu16 655.3500 Time_s 0.00 655.3500 FORMAT "%8.4" /end CHARACTERISTIC
/begin CHARACTERISTIC Alt_tiFastBattOffsCorr_C "Battery voltage offset learning filter time" VALUE 0x8051BBBC RB_Val_Ws32 4294.9672940000000 TimeDelay_s 0.0000020000000 4294.9672959999998 FORMAT "%19.14" EXTENDED_LIMITS 0.000002000000001 4294.9672959999998 /end CHARACTERISTIC
/begin CHARACTERISTIC Alt_tiFastBattStabDeb_C "Fast path battery voltage stable debounce time" VALUE 0x8051BBC0 RB_Val_Wu16 655.3500 Time_s 0.00 655.3500 FORMAT "%8.4" /end CHARACTERISTIC
/begin CHARACTERISTIC Alt_tiFastBattStab_C "Fast path battery voltage stable filter time" VALUE 0x8051BBC4 RB_Val_Ws32 4294.9672940000000 TimeDelay_s 0.0000020000000 4294.9672959999998 FORMAT "%19.14" EXTENDED_LIMITS 0.000002000000001 4294.9672959999998 /end CHARACTERISTIC
/begin CHARACTERISTIC Alt_tiFastBattU_C "Battery voltage filter time" VALUE 0x8051BBC8 RB_Val_Ws32 4294.9672940000000 TimeDelay_s 0.0000020000000 4294.9672959999998 FORMAT "%19.14" EXTENDED_LIMITS 0.000002000000001 4294.9672959999998 /end CHARACTERISTIC
/begin CHARACTERISTIC Alt_tiFastFFCurActvResv_C "Torque reserve hold time after battery current increasing detection" VALUE 0x8051BBCC RB_Val_Wu16 655.3500 Time_s 0.00 655.3500 FORMAT "%8.4" /end CHARACTERISTIC
/begin CHARACTERISTIC Alt_tiFastFFCurActv_C "Hold time after battery current drop detection" VALUE 0x8051BBCE RB_Val_Wu16 655.3500 Time_s 0.00 655.3500 FORMAT "%8.4" /end CHARACTERISTIC
/begin CHARACTERISTIC Alt_tiFFAltLoadFastOff_C "Feed forward alternator load fast path off filter time" VALUE 0x8051BBD0 RB_Val_Ws32 4294.9672940000000 TimeDelay_s 0.0000020000000 4294.9672959999998 FORMAT "%19.14" EXTENDED_LIMITS 0.000002000000001 4294.9672959999998 /end CHARACTERISTIC
/begin CHARACTERISTIC Alt_tiFFAltLoadFastOn_C "Feed forward alternator load fast path on filter time" VALUE 0x8051BBD4 RB_Val_Ws32 4294.9672940000000 TimeDelay_s 0.0000020000000 4294.9672959999998 FORMAT "%19.14" EXTENDED_LIMITS 0.000002000000001 4294.9672959999998 /end CHARACTERISTIC
/begin CHARACTERISTIC Alt_tiFFAltLoadFastResvOffCmpOn_C "Feed forward alternator load fast path torque reserve off, torque compensation on filter time" VALUE 0x8051BBD8 RB_Val_Ws32 4294.9672940000000 TimeDelay_s 0.0000020000000 4294.9672959999998 FORMAT "%19.14" EXTENDED_LIMITS 0.000002000000001 4294.9672959999998 /end CHARACTERISTIC
/begin CHARACTERISTIC Alt_tiFFAltLoadFastResvOff_C "Feed forward alternator load fast path torque reserve off filter time" VALUE 0x8051BBDC RB_Val_Ws32 4294.9672940000000 TimeDelay_s 0.0000020000000 4294.9672959999998 FORMAT "%19.14" EXTENDED_LIMITS 0.000002000000001 4294.9672959999998 /end CHARACTERISTIC
/begin CHARACTERISTIC Alt_tiFFAltLoadFastResvOn_C "Feed forward alternator load fast path torque reserve on filter time" VALUE 0x8051BBE0 RB_Val_Ws32 4294.9672940000000 TimeDelay_s 0.0000020000000 4294.9672959999998 FORMAT "%19.14" EXTENDED_LIMITS 0.000002000000001 4294.9672959999998 /end CHARACTERISTIC
/begin CHARACTERISTIC Alt_tiFFAltLoadSlowOff_C "Feed forward alternator load slow path off filter time" VALUE 0x8051BBE4 RB_Val_Ws32 4294.9672940000000 TimeDelay_s 0.0000020000000 4294.9672959999998 FORMAT "%19.14" EXTENDED_LIMITS 0.000002000000001 4294.9672959999998 /end CHARACTERISTIC
/begin CHARACTERISTIC Alt_tiFFAltLoadSlowOn_C "Feed forward alternator load slow path on filter time" VALUE 0x8051BBE8 RB_Val_Ws32 4294.9672940000000 TimeDelay_s 0.0000020000000 4294.9672959999998 FORMAT "%19.14" EXTENDED_LIMITS 0.000002000000001 4294.9672959999998 /end CHARACTERISTIC
/begin CHARACTERISTIC Alt_tiFFAltLoadSlowResvOffCmpOn_C "Feed forward alternator load slow path torque reserve off, torque compensation on filter time" VALUE 0x8051BBEC RB_Val_Ws32 4294.9672940000000 TimeDelay_s 0.0000020000000 4294.9672959999998 FORMAT "%19.14" EXTENDED_LIMITS 0.000002000000001 4294.9672959999998 /end CHARACTERISTIC
/begin CHARACTERISTIC Alt_tiFFAltLoadSlowResvOff_C "Feed forward alternator load slow path torque reserve off filter time" VALUE 0x8051BBF0 RB_Val_Ws32 4294.9672940000000 TimeDelay_s 0.0000020000000 4294.9672959999998 FORMAT "%19.14" EXTENDED_LIMITS 0.000002000000001 4294.9672959999998 /end CHARACTERISTIC
/begin CHARACTERISTIC Alt_tiFFAltLoadSlowResvOn_C "Feed forward alternator load slow path torque reserve on filter time" VALUE 0x8051BBF4 RB_Val_Ws32 4294.9672940000000 TimeDelay_s 0.0000020000000 4294.9672959999998 FORMAT "%19.14" EXTENDED_LIMITS 0.000002000000001 4294.9672959999998 /end CHARACTERISTIC
/begin CHARACTERISTIC Alt_tiFltNAlt_C "Filter time constant for engine speed filter" VALUE 0x8051B664 RB_Val_Ws16 4294.8362200 TimeDelay_s 0.1310760 4294.9672960 FORMAT "%12.7" EXTENDED_LIMITS 0.13107600012 4294.9672960 /end CHARACTERISTIC
/begin CHARACTERISTIC Alt_tiFltRDf_C "Time delay factor for alternator load" VALUE 0x8051B666 RB_Val_Ws16 4294.8362200 TimeDelay_s 0.1310760 4294.9672960 FORMAT "%12.7" EXTENDED_LIMITS 0.13107600012 4294.9672960 /end CHARACTERISTIC
/begin CHARACTERISTIC Alt_tiFrntFogOff_C "Front fog lamp off filter time" VALUE 0x8051BBF8 RB_Val_Ws32 4294.9672940000000 TimeDelay_s 0.0000020000000 4294.9672959999998 FORMAT "%19.14" EXTENDED_LIMITS 0.000002000000001 4294.9672959999998 /end CHARACTERISTIC
/begin CHARACTERISTIC Alt_tiFrntFogOn_C "Front fog lamp on filter time" VALUE 0x8051BBFC RB_Val_Ws32 4294.9672940000000 TimeDelay_s 0.0000020000000 4294.9672959999998 FORMAT "%19.14" EXTENDED_LIMITS 0.000002000000001 4294.9672959999998 /end CHARACTERISTIC
/begin CHARACTERISTIC Alt_tiFrntFog_C "Delay time for front fog lamp" VALUE 0x8051BC00 RB_Val_Wu16 655.3500 Time_s 0.00 655.3500 FORMAT "%8.4" /end CHARACTERISTIC
/begin CHARACTERISTIC Alt_tiGrdtConst_C "Time delay factor for alternator gradual excitation completed state confirmation" VALUE 0x8051B668 RB_Val_Ws16 655.3500 Time_s -327.6800 327.6700 FORMAT "%8.4" /end CHARACTERISTIC
/begin CHARACTERISTIC Alt_tiHdLiOff_C "Headlight off filter time" VALUE 0x8051BC04 RB_Val_Ws32 4294.9672940000000 TimeDelay_s 0.0000020000000 4294.9672959999998 FORMAT "%19.14" EXTENDED_LIMITS 0.000002000000001 4294.9672959999998 /end CHARACTERISTIC
/begin CHARACTERISTIC Alt_tiHdLiOn_C "Headlight on filter time" VALUE 0x8051BC08 RB_Val_Ws32 4294.9672940000000 TimeDelay_s 0.0000020000000 4294.9672959999998 FORMAT "%19.14" EXTENDED_LIMITS 0.000002000000001 4294.9672959999998 /end CHARACTERISTIC
/begin CHARACTERISTIC Alt_tiHiTCutOffFailSafeActv_C "Turn On delay time for Fail safe alternator high temperature cut off" VALUE 0x8051B66A RB_Val_Ws16 655.3500 Time_s -327.6800 327.6700 FORMAT "%8.4" /end CHARACTERISTIC
/begin CHARACTERISTIC Alt_tiIdleUpEndDly_C "Delay time for idle up request end" VALUE 0x8051BC0C RB_Val_Wu16 655.3500 Time_s 0.00 655.3500 FORMAT "%8.4" /end CHARACTERISTIC
/begin CHARACTERISTIC Alt_tiIgrBattIDly_C "Delay time to ignore the Battery current after engine is being cranked" VALUE 0x8051B66C RB_Val_Ws16 655.3500 Time_s -327.6800 327.6700 FORMAT "%8.4" /end CHARACTERISTIC
/begin CHARACTERISTIC Alt_tiLiSwtInfo_C "Delay time for light switch" VALUE 0x8051BC0E RB_Val_Wu16 655.3500 Time_s 0.00 655.3500 FORMAT "%8.4" /end CHARACTERISTIC
/begin CHARACTERISTIC Alt_tiLoadRespBase_T "Load response time Base curve of alternator" CURVE 0x8051B66E RB_Curve_S16_S16 655.3500 Time_s -327.6800 327.6700 FORMAT "%8.4"
 /begin AXIS_DESCR STD_AXIS NO_INPUT_QUANTITY Trq 8 -3276.800 3276.700 FORMAT "%8.3" DEPOSIT ABSOLUTE /end AXIS_DESCR
/end CHARACTERISTIC
/begin CHARACTERISTIC Alt_tiLoadRespEngStrtEndStab_C "Load response time of Engine Start End stable" VALUE 0x8051B690 RB_Val_Wu16 6553.500 t_q0p1 0.00 6553.500 FORMAT "%8.3" /end CHARACTERISTIC
/begin CHARACTERISTIC Alt_tiLoadRespFast_C "Load response delay in case of fuel lock suspected" VALUE 0x8051B692 RB_Val_Ws16 655.3500 Time_s -327.6800 327.6700 FORMAT "%8.4" /end CHARACTERISTIC
/begin CHARACTERISTIC Alt_tiLoadRespOvrRunStab_C "Load Response time of OverRun condition" VALUE 0x8051B694 RB_Val_Wu16 6553.500 t_q0p1 0.00 6553.500 FORMAT "%8.3" /end CHARACTERISTIC
/begin CHARACTERISTIC Alt_tiLoadRespOvrRun_T "Load Response time Overrun Curve" CURVE 0x8051B696 RB_Curve_S16_S16 655.3500 Time_s -327.6800 327.6700 FORMAT "%8.4"
 /begin AXIS_DESCR STD_AXIS VehV_v Vel 5 -327.6800 327.6700 FORMAT "%8.4" DEPOSIT ABSOLUTE /end AXIS_DESCR
/end CHARACTERISTIC
/begin CHARACTERISTIC Alt_tiLoadRespStab_C "Load response time Stable" VALUE 0x8051B6AC RB_Val_Ws16 655.3500 Time_s -327.6800 327.6700 FORMAT "%8.4" /end CHARACTERISTIC
/begin CHARACTERISTIC Alt_tiMaxBattFullRefr_C "Maximum time between consecutive battery refresh" VALUE 0x8051B6B0 RB_Val_Ws32 4294967295.00 Time_sec_q1_COMPU -2147483648.00 2147483647.00 FORMAT "%13.2" /end CHARACTERISTIC
/begin CHARACTERISTIC Alt_tiMaxHldDfHi_C "Maximum hold time by alternator overload detection" VALUE 0x8051B6B4 RB_Val_Ws16 655.3500 Time_s -327.6800 327.6700 FORMAT "%8.4" /end CHARACTERISTIC
/begin CHARACTERISTIC Alt_tiMaxRefrActv_C "Maximum time in refresh mode allowed" VALUE 0x8051B6B8 RB_Val_Ws32 4294967295.00 Time_sec_q1_COMPU -2147483648.00 2147483647.00 FORMAT "%13.2" /end CHARACTERISTIC
/begin CHARACTERISTIC Alt_tiMaxRefrRepnLim_C "Maximum time for refresh to be activated" VALUE 0x8051B6BC RB_Val_Ws32 4294967295.00 Time_sec_q1_COMPU -2147483648.00 2147483647.00 FORMAT "%13.2" /end CHARACTERISTIC
/begin CHARACTERISTIC Alt_tiMinHldDfHi_C "Minimum hold time by alternator overload detection" VALUE 0x8051B6C0 RB_Val_Ws16 655.3500 Time_s -327.6800 327.6700 FORMAT "%8.4" /end CHARACTERISTIC
/begin CHARACTERISTIC Alt_tiMinRefrRepnLim_C "Minimum time for refresh to be deactivated" VALUE 0x8051B6C4 RB_Val_Ws32 4294967295.00 Time_sec_q1_COMPU -2147483648.00 2147483647.00 FORMAT "%13.2" /end CHARACTERISTIC
/begin CHARACTERISTIC Alt_tiNoDecI_C "Blocking time for decrement of setpoint alternator voltage based on current if setpoint alternator voltage was increased based on current" VALUE 0x8051B6C8 RB_Val_Ws16 655.3500 Time_s -327.6800 327.6700 FORMAT "%8.4" /end CHARACTERISTIC
/begin CHARACTERISTIC Alt_tiNoIncI_C "Blocking time for increment of setpoint alternator voltage based on current if setpoint alternator voltage was decreased based on current" VALUE 0x8051B6CA RB_Val_Ws16 655.3500 Time_s -327.6800 327.6700 FORMAT "%8.4" /end CHARACTERISTIC
/begin CHARACTERISTIC Alt_tiNormRedBlowrFanThd_C "Timer threshold of blower fan since engine running" VALUE 0x8051BC10 RB_Val_Ws16 655.3500 t_q0p01 -327.6800 327.6700 FORMAT "%8.4" /end CHARACTERISTIC
/begin CHARACTERISTIC Alt_tiNormRedDFogThd_C "Timer threshold of defogger since engine running" VALUE 0x8051BC12 RB_Val_Ws16 655.3500 t_q0p01 -327.6800 327.6700 FORMAT "%8.4" /end CHARACTERISTIC
/begin CHARACTERISTIC Alt_tiNormRedEPSThd_C "Timer threshold of EPS since engine running" VALUE 0x8051BC14 RB_Val_Ws16 655.3500 t_q0p01 -327.6800 327.6700 FORMAT "%8.4" /end CHARACTERISTIC
/begin CHARACTERISTIC Alt_tiNormRedFrntFogThd_C "Timer threshold of front fog lamp since engine running" VALUE 0x8051BC16 RB_Val_Ws16 655.3500 t_q0p01 -327.6800 327.6700 FORMAT "%8.4" /end CHARACTERISTIC
/begin CHARACTERISTIC Alt_tiNormRedLiSwtInfoThd_C "Timer threshold of light switch timer since engine running" VALUE 0x8051BC18 RB_Val_Ws16 655.3500 t_q0p01 -327.6800 327.6700 FORMAT "%8.4" /end CHARACTERISTIC
/begin CHARACTERISTIC Alt_tiNormRedRadioFanThd_C "Timer threshold of radio fan since engine running" VALUE 0x8051BC1A RB_Val_Ws16 655.3500 t_q0p01 -327.6800 327.6700 FORMAT "%8.4" /end CHARACTERISTIC
/begin CHARACTERISTIC Alt_tiNormRedRrFogThd_C "Timer threshold of rear fog lamp since engine running" VALUE 0x8051BC1C RB_Val_Ws16 655.3500 t_q0p01 -327.6800 327.6700 FORMAT "%8.4" /end CHARACTERISTIC
/begin CHARACTERISTIC Alt_tiNormRedWiprThd_C "Timer threshold of wiper since engine running" VALUE 0x8051BC1E RB_Val_Ws16 10485.60 TimeRed -5242.880 5242.720 FORMAT "%8.3" /end CHARACTERISTIC
/begin CHARACTERISTIC Alt_tiRadioFanOff_C "Radio fan off filter time" VALUE 0x8051BC20 RB_Val_Ws32 4294.9672940000000 TimeDelay_s 0.0000020000000 4294.9672959999998 FORMAT "%19.14" EXTENDED_LIMITS 0.000002000000001 4294.9672959999998 /end CHARACTERISTIC
/begin CHARACTERISTIC Alt_tiRadioFanOn_C "Radio fan on filter time" VALUE 0x8051BC24 RB_Val_Ws32 4294.9672940000000 TimeDelay_s 0.0000020000000 4294.9672959999998 FORMAT "%19.14" EXTENDED_LIMITS 0.000002000000001 4294.9672959999998 /end CHARACTERISTIC
/begin CHARACTERISTIC Alt_tiRadioFanStg_C "Delay time for radio fan" VALUE 0x8051BC28 RB_Val_Wu16 655.3500 Time_s 0.00 655.3500 FORMAT "%8.4" /end CHARACTERISTIC
/begin CHARACTERISTIC Alt_tiRecupAPT1_C "Filter time constant for vehicle accleration input" VALUE 0x8051C574 RB_Val_Ws32 4294.9672940000000 TimeDelay_s 0.0000020000000 4294.9672959999998 FORMAT "%19.14" EXTENDED_LIMITS 0.000002000000001 4294.9672959999998 /end CHARACTERISTIC
/begin CHARACTERISTIC Alt_tiRecupLim_C "Turn OFF delay time constant for Recuperation mode" VALUE 0x8051C578 RB_Val_Ws16 655.3500 Time_s -327.6800 327.6700 FORMAT "%8.4" /end CHARACTERISTIC
/begin CHARACTERISTIC Alt_tiResvACGHiUFil_C "Delay time for adding torque reserve which based on throttle valve respond" VALUE 0x8051BC2C RB_Val_Ws32 4294.9672940000000 TimeDelay_s 0.0000020000000 4294.9672959999998 FORMAT "%19.14" EXTENDED_LIMITS 0.000002000000001 4294.9672959999998 /end CHARACTERISTIC
/begin CHARACTERISTIC Alt_tiRrFogOff_C "Rear fog lamp off filter time" VALUE 0x8051BC30 RB_Val_Ws32 4294.9672940000000 TimeDelay_s 0.0000020000000 4294.9672959999998 FORMAT "%19.14" EXTENDED_LIMITS 0.000002000000001 4294.9672959999998 /end CHARACTERISTIC
/begin CHARACTERISTIC Alt_tiRrFogOn_C "Rear fog lamp on filter time" VALUE 0x8051BC34 RB_Val_Ws32 4294.9672940000000 TimeDelay_s 0.0000020000000 4294.9672959999998 FORMAT "%19.14" EXTENDED_LIMITS 0.000002000000001 4294.9672959999998 /end CHARACTERISTIC
/begin CHARACTERISTIC Alt_tiRrFog_C "Delay time for rear fog lamp" VALUE 0x8051BC38 RB_Val_Wu16 655.3500 Time_s 0.00 655.3500 FORMAT "%8.4" /end CHARACTERISTIC
/begin CHARACTERISTIC Alt_tiRstBkupDly_C "Reset delay time for Alternator Backup request" VALUE 0x8051B6CC RB_Val_Ws16 655.3500 Time_s -327.6800 327.6700 FORMAT "%8.4" /end CHARACTERISTIC
/begin CHARACTERISTIC Alt_tiRstErrLampDly_C "Reset delay time for Alternator error lamp activation request" VALUE 0x8051B6CE RB_Val_Ws16 655.3500 Time_s -327.6800 327.6700 FORMAT "%8.4" /end CHARACTERISTIC
/begin CHARACTERISTIC Alt_tiRstHTCutOffDly_C "Reset delay time for Alternator High Temperature cut-off" VALUE 0x8051B6D0 RB_Val_Ws16 655.3500 Time_s -327.6800 327.6700 FORMAT "%8.4" /end CHARACTERISTIC
/begin CHARACTERISTIC Alt_tiRstTBattDly_C "Reset delay time for Battery temperature out of range]" VALUE 0x8051B6D2 RB_Val_Ws16 655.3500 Time_s -327.6800 327.6700 FORMAT "%8.4" /end CHARACTERISTIC
/begin CHARACTERISTIC Alt_tiRstTEnvDly_C "Reset delay time for invalid battery temperature" VALUE 0x8051B6D4 RB_Val_Ws16 655.3500 Time_s -327.6800 327.6700 FORMAT "%8.4" /end CHARACTERISTIC
/begin CHARACTERISTIC Alt_tiSetBkupDly_C "Set delay time for Alternator Backup request" VALUE 0x8051B6D6 RB_Val_Ws16 655.3500 Time_s -327.6800 327.6700 FORMAT "%8.4" /end CHARACTERISTIC
/begin CHARACTERISTIC Alt_tiSetErrLampDly_C "Set delay time for Alternator error lamp activation request" VALUE 0x8051B6D8 RB_Val_Ws16 655.3500 Time_s -327.6800 327.6700 FORMAT "%8.4" /end CHARACTERISTIC
/begin CHARACTERISTIC Alt_tiSetHTCutOffDly_C "Set delay time for Alternator High Temperature cut-off" VALUE 0x8051B6DA RB_Val_Ws16 655.3500 Time_s -327.6800 327.6700 FORMAT "%8.4" /end CHARACTERISTIC
/begin CHARACTERISTIC Alt_tiSetTBattDly_C "Set delay time for Battery temperature out of range]" VALUE 0x8051B6DC RB_Val_Ws16 655.3500 Time_s -327.6800 327.6700 FORMAT "%8.4" /end CHARACTERISTIC
/begin CHARACTERISTIC Alt_tiSetTEnvDly_C "Set delay time for invalid battery temperature" VALUE 0x8051B6DE RB_Val_Ws16 655.3500 Time_s -327.6800 327.6700 FORMAT "%8.4" /end CHARACTERISTIC
/begin CHARACTERISTIC Alt_tiSlowFFActvDly_M "Map to determine delay time for slow path of feed forward" MAP 0x8051BC3A RB_Map_S16S16_U16 655.3500 Time_s 0.00 655.3500 FORMAT "%8.4"
 /begin AXIS_DESCR STD_AXIS BattU_u Volt_Batt 6 -655360.0 655340.0 FORMAT "%8.1" DEPOSIT ABSOLUTE /end AXIS_DESCR
 /begin AXIS_DESCR STD_AXIS Alt_uDes Volt_Batt 6 -655360.0 655340.0 FORMAT "%8.1" DEPOSIT ABSOLUTE /end AXIS_DESCR
/end CHARACTERISTIC
/begin CHARACTERISTIC Alt_tiSlowFFCurHldResv_C "Torque reserve hold time after battery current increasing detection" VALUE 0x8051BC9E RB_Val_Wu16 655.3500 Time_s 0.00 655.3500 FORMAT "%8.4" /end CHARACTERISTIC
/begin CHARACTERISTIC Alt_tiSlowFFCurHld_C "Hold time after battery current increasing detection" VALUE 0x8051BCA0 RB_Val_Wu16 655.3500 Time_s 0.00 655.3500 FORMAT "%8.4" /end CHARACTERISTIC
/begin CHARACTERISTIC Alt_tiUMeasdFil_C "Filter time constant for measured voltage filter" VALUE 0x8051B6E0 RB_Val_Ws16 4294.8362200 TimeDelay_s 0.1310760 4294.9672960 FORMAT "%12.7" EXTENDED_LIMITS 0.13107600012 4294.9672960 /end CHARACTERISTIC
/begin CHARACTERISTIC Alt_tiUpScaRstrctStop_C "Time threshold for disabling voltage up scale restriction due to battery voltage" VALUE 0x8051B6E2 RB_Val_Wu16 3276.700 t_q0p1 0.00 3276.700 FORMAT "%8.3" EXTENDED_LIMITS 0.00 6553.500 /end CHARACTERISTIC
/begin CHARACTERISTIC Alt_tiVapLockHiSetPoint_C "Time delay filter for alternator high voltage request incase of fuel vapor lock" VALUE 0x8051B6E4 RB_Val_Ws32 4294.9672940000000 TimeDelay_s 0.0000020000000 4294.9672959999998 FORMAT "%19.14" EXTENDED_LIMITS 0.000002000000001 4294.9672959999998 /end CHARACTERISTIC
/begin CHARACTERISTIC Alt_tiWiprOff_C "Wiper off filter time" VALUE 0x8051BCA4 RB_Val_Ws32 4294.9672940000000 TimeDelay_s 0.0000020000000 4294.9672959999998 FORMAT "%19.14" EXTENDED_LIMITS 0.000002000000001 4294.9672959999998 /end CHARACTERISTIC
/begin CHARACTERISTIC Alt_tiWiprOn_C "Wiper on filter time" VALUE 0x8051BCA8 RB_Val_Ws32 4294.9672940000000 TimeDelay_s 0.0000020000000 4294.9672959999998 FORMAT "%19.14" EXTENDED_LIMITS 0.000002000000001 4294.9672959999998 /end CHARACTERISTIC
/begin CHARACTERISTIC Alt_tiWiprStg_C "Delay time for wiper" VALUE 0x8051BCAC RB_Val_Wu16 655.3500 Time_s 0.00 655.3500 FORMAT "%8.4" /end CHARACTERISTIC
/begin CHARACTERISTIC Alt_tMaxThdHi_C "High threshold for battery temperature when exceeding valid range" VALUE 0x8051B6E8 RB_Val_Ws16 65535.00 SCR_TEMP_CELS_float -32768.00 32767.00 FORMAT "%8.2" /end CHARACTERISTIC
/begin CHARACTERISTIC Alt_tMaxThdLo_C "Low threshold for battery temperature when reentering valid range" VALUE 0x8051B6EA RB_Val_Ws16 65535.00 SCR_TEMP_CELS_float -32768.00 32767.00 FORMAT "%8.2" /end CHARACTERISTIC
/begin CHARACTERISTIC Alt_tMinThdHi_C "High threshold for battery temperature when reentering valid range" VALUE 0x8051B6EC RB_Val_Ws16 65535.00 SCR_TEMP_CELS_float -32768.00 32767.00 FORMAT "%8.2" /end CHARACTERISTIC
/begin CHARACTERISTIC Alt_tMinThdLo_C "Low threshold for battery temperature when below valid range" VALUE 0x8051B6EE RB_Val_Ws16 65535.00 SCR_TEMP_CELS_float -32768.00 32767.00 FORMAT "%8.2" /end CHARACTERISTIC
/begin CHARACTERISTIC Alt_tqAltCmp_M "Map for alternator compensation torque" MAP 0x8051BCAE RB_Map_S16S16_S16 6553.500 Trq -3276.800 3276.700 FORMAT "%8.3"
 /begin AXIS_DESCR STD_AXIS Alt_nAltSpdCmp EngN_2 12 -65536.00 65534.00 FORMAT "%8.2" DEPOSIT ABSOLUTE /end AXIS_DESCR
 /begin AXIS_DESCR STD_AXIS Alt_iAltFild Curr 10 -32768.00 32767.00 FORMAT "%8.2" DEPOSIT ABSOLUTE /end AXIS_DESCR
/end CHARACTERISTIC
/begin CHARACTERISTIC Alt_tqBlowrFanVolt1_M "Map to determine torque for blower fan" MAP 0x8051BDCE RB_Map_S16S16_S16 6553.500 Trq -3276.800 3276.700 FORMAT "%8.3"
 /begin AXIS_DESCR STD_AXIS Epm_nEng EngN 6 -16384.00 16383.50 FORMAT "%8.2" DEPOSIT ABSOLUTE /end AXIS_DESCR
 /begin AXIS_DESCR STD_AXIS Alt_uBlowrDelta Volt_q1 6 -32768.00 32767.00 FORMAT "%8.2" DEPOSIT ABSOLUTE /end AXIS_DESCR
/end CHARACTERISTIC
/begin CHARACTERISTIC Alt_tqBlowrFanVolt2_M "Map to determine torque for blower fan" MAP 0x8051BE32 RB_Map_S16S16_S16 6553.500 Trq -3276.800 3276.700 FORMAT "%8.3"
 /begin AXIS_DESCR STD_AXIS Blwr_uVoltReq Volt_q1 6 -32768.00 32767.00 FORMAT "%8.2" DEPOSIT ABSOLUTE /end AXIS_DESCR
 /begin AXIS_DESCR STD_AXIS Alt_uBlowrDelta Volt_q1 6 -32768.00 32767.00 FORMAT "%8.2" DEPOSIT ABSOLUTE /end AXIS_DESCR
/end CHARACTERISTIC
/begin CHARACTERISTIC Alt_tqBlowrFan_M "Map to determine torque for blower fan" MAP 0x8051BE96 RB_Map_S16S16_S16 6553.500 Trq -3276.800 3276.700 FORMAT "%8.3"
 /begin AXIS_DESCR STD_AXIS Epm_nEng EngN 6 -16384.00 16383.50 FORMAT "%8.2" DEPOSIT ABSOLUTE /end AXIS_DESCR
 /begin AXIS_DESCR STD_AXIS Blwr_uVoltReq Volt_q1 6 -32768.00 32767.00 FORMAT "%8.2" DEPOSIT ABSOLUTE /end AXIS_DESCR
/end CHARACTERISTIC
/begin CHARACTERISTIC Alt_tqDesCalcn_M "Calibration Map for calculation of additional alternator desired torque" MAP 0x8051BEFA RB_Map_U16S16_S16 6553.500 Trq -3276.800 3276.700 FORMAT "%8.3"
 /begin AXIS_DESCR STD_AXIS NO_INPUT_QUANTITY t10msxs_uw_b655p35 8 0.00 655.3500 FORMAT "%8.4" DEPOSIT ABSOLUTE /end AXIS_DESCR
 /begin AXIS_DESCR STD_AXIS NO_INPUT_QUANTITY DtyCyc 8 -327.6800 327.6700 FORMAT "%8.4" DEPOSIT ABSOLUTE /end AXIS_DESCR
/end CHARACTERISTIC
/begin CHARACTERISTIC Alt_tqDFog_T "Curve to determine torque for defogger" CURVE 0x8051BF9E RB_Curve_S16_S16 6553.500 Trq -3276.800 3276.700 FORMAT "%8.3"
 /begin AXIS_DESCR STD_AXIS Epm_nEng EngN 6 -16384.00 16383.50 FORMAT "%8.2" DEPOSIT ABSOLUTE /end AXIS_DESCR
/end CHARACTERISTIC
/begin CHARACTERISTIC Alt_tqEPS_M "Map to determine torque for EPS" MAP 0x8051BFB8 RB_Map_S16S16_S16 6553.500 Trq -3276.800 3276.700 FORMAT "%8.3"
 /begin AXIS_DESCR STD_AXIS Epm_nEng EngN 6 -16384.00 16383.50 FORMAT "%8.2" DEPOSIT ABSOLUTE /end AXIS_DESCR
 /begin AXIS_DESCR STD_AXIS Com_iEPS1ElecLd Curr_A 6 -327.6800 327.6700 FORMAT "%8.4" DEPOSIT ABSOLUTE /end AXIS_DESCR
/end CHARACTERISTIC
/begin CHARACTERISTIC Alt_tqFFAltLoadFastResv_T "Curve to determine torque reserve for fast path of feed forward" CURVE 0x8051C01C RB_Curve_S16_S16 6553.500 Trq -3276.800 3276.700 FORMAT "%8.3"
 /begin AXIS_DESCR STD_AXIS NO_INPUT_QUANTITY EngN 6 -16384.00 16383.50 FORMAT "%8.2" DEPOSIT ABSOLUTE /end AXIS_DESCR
/end CHARACTERISTIC
/begin CHARACTERISTIC Alt_tqFFAltLoadFast_T "Curve to determine torque for fast path of feed forward" CURVE 0x8051C036 RB_Curve_S16_S16 6553.500 Trq -3276.800 3276.700 FORMAT "%8.3"
 /begin AXIS_DESCR STD_AXIS NO_INPUT_QUANTITY EngN 6 -16384.00 16383.50 FORMAT "%8.2" DEPOSIT ABSOLUTE /end AXIS_DESCR
/end CHARACTERISTIC
/begin CHARACTERISTIC Alt_tqFFAltLoadSlowResv_M "Map to determine torque reserve for slow path active of feed forward" MAP 0x8051C050 RB_Map_S16S16_S16 6553.500 Trq -3276.800 3276.700 FORMAT "%8.3"
 /begin AXIS_DESCR STD_AXIS BattU_u Volt_Batt 6 -655360.0 655340.0 FORMAT "%8.1" DEPOSIT ABSOLUTE /end AXIS_DESCR
 /begin AXIS_DESCR STD_AXIS NO_INPUT_QUANTITY EngN 6 -16384.00 16383.50 FORMAT "%8.2" DEPOSIT ABSOLUTE /end AXIS_DESCR
/end CHARACTERISTIC
/begin CHARACTERISTIC Alt_tqFFAltLoadSlow_M "Map to determine torque for slow path active of feed forward" MAP 0x8051C0B4 RB_Map_S16S16_S16 6553.500 Trq -3276.800 3276.700 FORMAT "%8.3"
 /begin AXIS_DESCR STD_AXIS BattU_u Volt_Batt 6 -655360.0 655340.0 FORMAT "%8.1" DEPOSIT ABSOLUTE /end AXIS_DESCR
 /begin AXIS_DESCR STD_AXIS NO_INPUT_QUANTITY EngN 6 -16384.00 16383.50 FORMAT "%8.2" DEPOSIT ABSOLUTE /end AXIS_DESCR
/end CHARACTERISTIC
/begin CHARACTERISTIC Alt_tqFrntFog_T "Curve to determine torque for front fog lamp" CURVE 0x8051C118 RB_Curve_S16_S16 6553.500 Trq -3276.800 3276.700 FORMAT "%8.3"
 /begin AXIS_DESCR STD_AXIS Epm_nEng EngN 6 -16384.00 16383.50 FORMAT "%8.2" DEPOSIT ABSOLUTE /end AXIS_DESCR
/end CHARACTERISTIC
/begin CHARACTERISTIC Alt_tqHdLiHi_T "Curve to determine torque for healight high" CURVE 0x8051C132 RB_Curve_S16_S16 6553.500 Trq -3276.800 3276.700 FORMAT "%8.3"
 /begin AXIS_DESCR STD_AXIS Epm_nEng EngN 6 -16384.00 16383.50 FORMAT "%8.2" DEPOSIT ABSOLUTE /end AXIS_DESCR
/end CHARACTERISTIC
/begin CHARACTERISTIC Alt_tqHdLiLo_T "Curve to determine torque for healight low" CURVE 0x8051C14C RB_Curve_S16_S16 6553.500 Trq -3276.800 3276.700 FORMAT "%8.3"
 /begin AXIS_DESCR STD_AXIS Epm_nEng EngN 6 -16384.00 16383.50 FORMAT "%8.2" DEPOSIT ABSOLUTE /end AXIS_DESCR
/end CHARACTERISTIC
/begin CHARACTERISTIC Alt_tqRadioFanHi_T "Curve to determine torque for radio fan high" CURVE 0x8051C166 RB_Curve_S16_S16 6553.500 Trq -3276.800 3276.700 FORMAT "%8.3"
 /begin AXIS_DESCR STD_AXIS Epm_nEng EngN 6 -16384.00 16383.50 FORMAT "%8.2" DEPOSIT ABSOLUTE /end AXIS_DESCR
/end CHARACTERISTIC
/begin CHARACTERISTIC Alt_tqRadioFanLo_T "Curve to determine torque for radio fan low" CURVE 0x8051C180 RB_Curve_S16_S16 6553.500 Trq -3276.800 3276.700 FORMAT "%8.3"
 /begin AXIS_DESCR STD_AXIS Epm_nEng EngN 6 -16384.00 16383.50 FORMAT "%8.2" DEPOSIT ABSOLUTE /end AXIS_DESCR
/end CHARACTERISTIC
/begin CHARACTERISTIC Alt_tqResvAddlACGHiU_C "Additional torque reserve incase of engine start with vapor lock" VALUE 0x8051C19A RB_Val_Ws16 6553.500 Trq -3276.800 3276.700 FORMAT "%8.3" /end CHARACTERISTIC
/begin CHARACTERISTIC Alt_tqResvCalcn_M "Calibration Map for calculation of additional alternator torque reserve" MAP 0x8051C19C RB_Map_U16S16_S16 6553.500 Trq -3276.800 3276.700 FORMAT "%8.3"
 /begin AXIS_DESCR STD_AXIS NO_INPUT_QUANTITY t10msxs_uw_b655p35 8 0.00 655.3500 FORMAT "%8.4" DEPOSIT ABSOLUTE /end AXIS_DESCR
 /begin AXIS_DESCR STD_AXIS NO_INPUT_QUANTITY DtyCyc 8 -327.6800 327.6700 FORMAT "%8.4" DEPOSIT ABSOLUTE /end AXIS_DESCR
/end CHARACTERISTIC
/begin CHARACTERISTIC Alt_tqRrFog_T "Curve to determine torque for rear fog lamp" CURVE 0x8051C240 RB_Curve_S16_S16 6553.500 Trq -3276.800 3276.700 FORMAT "%8.3"
 /begin AXIS_DESCR STD_AXIS Epm_nEng EngN 6 -16384.00 16383.50 FORMAT "%8.2" DEPOSIT ABSOLUTE /end AXIS_DESCR
/end CHARACTERISTIC
/begin CHARACTERISTIC Alt_tqWipr_M "Map to determine torque for wiper" MAP 0x8051C25A RB_Map_S16U8_S16 6553.500 Trq -3276.800 3276.700 FORMAT "%8.3"
 /begin AXIS_DESCR STD_AXIS Epm_nEng EngN 6 -16384.00 16383.50 FORMAT "%8.2" DEPOSIT ABSOLUTE /end AXIS_DESCR
 /begin AXIS_DESCR STD_AXIS Com_stWipr OneToOne 6 0.00 255.0 FORMAT "%5.1" DEPOSIT ABSOLUTE /end AXIS_DESCR
/end CHARACTERISTIC
/begin CHARACTERISTIC Alt_trqCalc_MAP "Basic value of alternator torque" MAP 0x8051C2B8 RB_Map_S16S16_S16 6553.500 Trq -3276.800 3276.700 FORMAT "%8.3"
 /begin AXIS_DESCR STD_AXIS Epm_nEng EngN 12 -16384.00 16383.50 FORMAT "%8.2" DEPOSIT ABSOLUTE /end AXIS_DESCR
 /begin AXIS_DESCR STD_AXIS NO_INPUT_QUANTITY DtyCyc 10 -327.6800 327.6700 FORMAT "%8.4" DEPOSIT ABSOLUTE /end AXIS_DESCR
/end CHARACTERISTIC
/begin CHARACTERISTIC Alt_trqDmdThdHi_C "upper slope limit of Wheel torque demand." VALUE 0x8051C57C RB_Val_Ws32 429496729.500 TrqPrpHigh -214748364.800 214748364.700 FORMAT "%13.3" /end CHARACTERISTIC
/begin CHARACTERISTIC Alt_trqDmdThdLo_C "lower slope limit of Wheel torque demand." VALUE 0x8051C580 RB_Val_Ws32 429496729.500 TrqPrpHigh -214748364.800 214748364.700 FORMAT "%13.3" /end CHARACTERISTIC
/begin CHARACTERISTIC Alt_trqExctCrntCalc_M "Basic value of torque from Excitation current" MAP 0x8051C3D8 RB_Map_S16S16_S16 6553.500 Trq -3276.800 3276.700 FORMAT "%8.3"
 /begin AXIS_DESCR STD_AXIS Epm_nEng EngN 12 -16384.00 16383.50 FORMAT "%8.2" DEPOSIT ABSOLUTE /end AXIS_DESCR
 /begin AXIS_DESCR STD_AXIS NO_INPUT_QUANTITY Curr 10 -32768.00 32767.00 FORMAT "%8.2" DEPOSIT ABSOLUTE /end AXIS_DESCR
/end CHARACTERISTIC
/begin CHARACTERISTIC Alt_trqMinDecLoadThd_C "Upper threshold for evaluating Wheel torque demand" VALUE 0x8051C584 RB_Val_Ws32 429496729.500 TrqPrpHigh -214748364.800 214748364.700 FORMAT "%13.3" /end CHARACTERISTIC
/begin CHARACTERISTIC Alt_trqNPwrAct_Map "Torque based on current consumtion" MAP 0x8051C4F8 RB_Map_S16U16_S16 6553.500 Trq -3276.800 3276.700 FORMAT "%8.3"
 /begin AXIS_DESCR STD_AXIS Epm_nEng EngN 3 -16384.00 16383.50 FORMAT "%8.2" DEPOSIT ABSOLUTE /end AXIS_DESCR
 /begin AXIS_DESCR STD_AXIS NO_INPUT_QUANTITY Pwr1 3 0.00 6553.500 FORMAT "%8.3" DEPOSIT ABSOLUTE /end AXIS_DESCR
/end CHARACTERISTIC
/begin CHARACTERISTIC Alt_trqPwrRepl_C "Replacement value in case of faulty power measurement" VALUE 0x8051C51A RB_Val_Ws16 6553.500 Trq -3276.800 3276.700 FORMAT "%8.3" /end CHARACTERISTIC
/begin CHARACTERISTIC Alt_trqResvMax_C "Maximum of torque reserved" VALUE 0x8051C51C RB_Val_Ws16 6553.500 Trq -3276.800 3276.700 FORMAT "%8.3" /end CHARACTERISTIC
/begin CHARACTERISTIC Alt_uACGVltg_T "Alternator Control Gradient Voltage(ACG) curve" CURVE 0x8051B6F0 RB_Curve_S16_S16 1310700. Volt_Batt -655360.0 655340.0 FORMAT "%8.1"
 /begin AXIS_DESCR STD_AXIS VehV_v Vel 5 -327.6800 327.6700 FORMAT "%8.4" DEPOSIT ABSOLUTE /end AXIS_DESCR
/end CHARACTERISTIC
/begin CHARACTERISTIC Alt_uAltBkup_C "Alternator voltage set point in Back up mode" VALUE 0x8051B706 RB_Val_Ws16 1310700. Volt_Batt -655360.0 655340.0 FORMAT "%8.1" /end CHARACTERISTIC
/begin CHARACTERISTIC Alt_uAltDes_C "Set point value of the alternator voltage" VALUE 0x8051C51E RB_Val_Ws16 1310700. Volt_Batt -655360.0 655340.0 FORMAT "%8.1" /end CHARACTERISTIC
/begin CHARACTERISTIC Alt_uAltMaxTst_C "Default maximum test alternator voltage" VALUE 0x8051B708 RB_Val_Ws16 1310700. Volt_Batt -655360.0 655340.0 FORMAT "%8.1" /end CHARACTERISTIC
/begin CHARACTERISTIC Alt_uAltMax_C "Default Maximum Alternator voltage setpoint" VALUE 0x8051B70A RB_Val_Ws16 1310700. Volt_Batt -655360.0 655340.0 FORMAT "%8.1" /end CHARACTERISTIC
/begin CHARACTERISTIC Alt_uAltMinTst_C "Default minimum test alternator voltage" VALUE 0x8051B70C RB_Val_Ws16 1310700. Volt_Batt -655360.0 655340.0 FORMAT "%8.1" /end CHARACTERISTIC
/begin CHARACTERISTIC Alt_uAltMin_C "Default Minimum Alternator voltage setpoint" VALUE 0x8051B70E RB_Val_Ws16 1310700. Volt_Batt -655360.0 655340.0 FORMAT "%8.1" /end CHARACTERISTIC
/begin CHARACTERISTIC Alt_uAltOff_C "Set point value of the alternator voltage when alternator state = ON" VALUE 0x8051C520 RB_Val_Ws16 1310700. Volt_Batt -655360.0 655340.0 FORMAT "%8.1" /end CHARACTERISTIC
/begin CHARACTERISTIC Alt_uAltOfsDwn_C "Decreasing alternator offset voltage" VALUE 0x8051B710 RB_Val_Ws16 6553.500 Volt_Alt_100mV -3276.800 3276.700 FORMAT "%8.3" /end CHARACTERISTIC
/begin CHARACTERISTIC Alt_uAltOfsUp_C "Increasing alternator offset voltage" VALUE 0x8051B712 RB_Val_Ws16 6553.500 Volt_Alt_100mV -3276.800 3276.700 FORMAT "%8.3" /end CHARACTERISTIC
/begin CHARACTERISTIC Alt_uAltStrt_C "Alternator voltage set point during engine Start stop" VALUE 0x8051B714 RB_Val_Ws16 1310700. Volt_Batt -655360.0 655340.0 FORMAT "%8.1" /end CHARACTERISTIC
/begin CHARACTERISTIC Alt_uBattACGLim_C "Battery Voltage threshold for voltage up scale restriction" VALUE 0x8051B716 RB_Val_Wu16 327.6700 RBPtCel_u_0p01_1 0.00 327.6700 FORMAT "%8.4" EXTENDED_LIMITS 0.00 655.3500 /end CHARACTERISTIC
/begin CHARACTERISTIC Alt_uBattCorrAlt_CUR "Battery voltage offset correction by alternator voltage" CURVE 0x8051C522 RB_Curve_S16_S16 1310700. Volt_Batt -655360.0 655340.0 FORMAT "%8.1"
 /begin AXIS_DESCR STD_AXIS Alt_uDes Volt_Batt 7 -655360.0 655340.0 FORMAT "%8.1" DEPOSIT ABSOLUTE /end AXIS_DESCR
/end CHARACTERISTIC
/begin CHARACTERISTIC Alt_uBattDeIni_C "Initial value of voltage offset correction" VALUE 0x8051C540 RB_Val_Ws16 1310700. Volt_Batt -655360.0 655340.0 FORMAT "%8.1" /end CHARACTERISTIC
/begin CHARACTERISTIC Alt_uBattFixdMaxRed_C "Fixed value for Maximum of reduced voltage range" VALUE 0x8051B718 RB_Val_Ws16 1310700. Volt_Batt -655360.0 655340.0 FORMAT "%8.1" /end CHARACTERISTIC
/begin CHARACTERISTIC Alt_uBattFixdMinRed_C "Fixed value for Minimum of reduced voltage range" VALUE 0x8051B71A RB_Val_Ws16 1310700. Volt_Batt -655360.0 655340.0 FORMAT "%8.1" /end CHARACTERISTIC
/begin CHARACTERISTIC Alt_uBattHdLiMaxRed_T "Battery voltage head light reduce max range" CURVE 0x8051B71C RB_Curve_S16_S16 1310700. Volt_Batt -655360.0 655340.0 FORMAT "%8.1"
 /begin AXIS_DESCR STD_AXIS Ebs_tBattFild SCR_TEMP_CELS_float 11 -32768.00 32767.00 FORMAT "%8.2" DEPOSIT ABSOLUTE /end AXIS_DESCR
/end CHARACTERISTIC
/begin CHARACTERISTIC Alt_uBattHdLiMinRed_T "Battery voltage head light reduce min range" CURVE 0x8051B74A RB_Curve_S16_S16 1310700. Volt_Batt -655360.0 655340.0 FORMAT "%8.1"
 /begin AXIS_DESCR STD_AXIS Ebs_tBattFild SCR_TEMP_CELS_float 11 -32768.00 32767.00 FORMAT "%8.2" DEPOSIT ABSOLUTE /end AXIS_DESCR
/end CHARACTERISTIC
/begin CHARACTERISTIC Alt_uBattMaxAntiFlickActv_C "rget value for the ramp forder to avoid flickering of headlight" VALUE 0x8051B778 RB_Val_Ws16 1310700. Volt_Batt -655360.0 655340.0 FORMAT "%8.1" /end CHARACTERISTIC
/begin CHARACTERISTIC Alt_uBattMaxRed_C "Maximum of reduced voltage range" VALUE 0x8051B77A RB_Val_Ws16 1310700. Volt_Batt -655360.0 655340.0 FORMAT "%8.1" /end CHARACTERISTIC
/begin CHARACTERISTIC Alt_uBattMaxSpcl_C "Higher threshold limit for Special Voltage range." VALUE 0x8051B77C RB_Val_Ws16 1310700. Volt_Batt -655360.0 655340.0 FORMAT "%8.1" /end CHARACTERISTIC
/begin CHARACTERISTIC Alt_uBattMaxTst_C "Test value of operative maximum battery voltage in controller" VALUE 0x8051B77E RB_Val_Ws16 1310700. Volt_Batt -655360.0 655340.0 FORMAT "%8.1" /end CHARACTERISTIC
/begin CHARACTERISTIC Alt_uBattMax_C "Battery voltage upper threshold limit" VALUE 0x8051B780 RB_Val_Ws16 1310700. Volt_Batt -655360.0 655340.0 FORMAT "%8.1" /end CHARACTERISTIC
/begin CHARACTERISTIC Alt_uBattMinRed_C "Minimum of reduced voltage range" VALUE 0x8051B782 RB_Val_Ws16 1310700. Volt_Batt -655360.0 655340.0 FORMAT "%8.1" /end CHARACTERISTIC
/begin CHARACTERISTIC Alt_uBattMinSpcl_C "The MInimum Battery Voltage threshold in Special Range" VALUE 0x8051B784 RB_Val_Ws16 1310700. Volt_Batt -655360.0 655340.0 FORMAT "%8.1" /end CHARACTERISTIC
/begin CHARACTERISTIC Alt_uBattMinTst_C "Test value of operative minimum battery voltage in controller" VALUE 0x8051B786 RB_Val_Ws16 1310700. Volt_Batt -655360.0 655340.0 FORMAT "%8.1" /end CHARACTERISTIC
/begin CHARACTERISTIC Alt_uBattMin_C "Battery voltage lower threshold limit" VALUE 0x8051B788 RB_Val_Ws16 1310700. Volt_Batt -655360.0 655340.0 FORMAT "%8.1" /end CHARACTERISTIC
/begin CHARACTERISTIC Alt_uBattSet_MAP "Battery voltage depending on battery temperature and state of charge" MAP 0x8051B78A RB_Map_S16S16_S16 1310700. Volt_Batt -655360.0 655340.0 FORMAT "%8.1"
 /begin AXIS_DESCR STD_AXIS Ebs_ratSocFild RBPtCel_Perc_0p5_1 10 0.00 127.5000 FORMAT "%8.4" EXTENDED_LIMITS -16384.00 16383.50 DEPOSIT ABSOLUTE /end AXIS_DESCR
 /begin AXIS_DESCR STD_AXIS Ebs_tBattFild SCR_TEMP_CELS_float 10 -32768.00 32767.00 FORMAT "%8.2" DEPOSIT ABSOLUTE /end AXIS_DESCR
/end CHARACTERISTIC
/begin CHARACTERISTIC Alt_uBlowrFanDeltaThd_C "Blower fan voltage delta threshold" VALUE 0x8051C542 RB_Val_Ws16 65535.00 Volt_q1 -32768.00 32767.00 FORMAT "%8.2" /end CHARACTERISTIC
/begin CHARACTERISTIC Alt_uBlowrFanThd_C "Voltage threshold of blower fan" VALUE 0x8051C544 RB_Val_Ws16 65535.00 Volt_q1 -32768.00 32767.00 FORMAT "%8.2" /end CHARACTERISTIC
/begin CHARACTERISTIC Alt_uDecHi_C "Higher decrement of setpoint alternator voltage when alternator speed is high and alternator voltage is too high compared to battery voltage" VALUE 0x8051B87E RB_Val_Ws16 655350.0 RBPtCel_u_10p0_1 -327680.0 327670.0 FORMAT "%8.1" /end CHARACTERISTIC
/begin CHARACTERISTIC Alt_uDecLo_C "Lower decrement of setpoint alternator voltage when alternator speed is not high and alternator voltage is too high compared to battery voltage" VALUE 0x8051B880 RB_Val_Ws16 655350.0 RBPtCel_u_10p0_1 -327680.0 327670.0 FORMAT "%8.1" /end CHARACTERISTIC
/begin CHARACTERISTIC Alt_uDesGrdtThd_C "Voltage thresold to determine the ACG gradual excitation completed status" VALUE 0x8051B882 RB_Val_Ws16 1310700. Volt_Batt -655360.0 655340.0 FORMAT "%8.1" /end CHARACTERISTIC
/begin CHARACTERISTIC Alt_uDesThdHi_C "Hysteresis upper threshold for allowing the voltage up scaling based on alternator desired voltage during Fuel cut" VALUE 0x8051B884 RB_Val_Ws16 1310700. Volt_Batt -655360.0 655340.0 FORMAT "%8.1" /end CHARACTERISTIC
/begin CHARACTERISTIC Alt_uDesThdLo_C "Hysteresis lower threshold for allowing the voltage up scaling based on alternator desired voltage during Fuel cut" VALUE 0x8051B886 RB_Val_Ws16 1310700. Volt_Batt -655360.0 655340.0 FORMAT "%8.1" /end CHARACTERISTIC
/begin CHARACTERISTIC Alt_uDiffAccl_C "Voltage offset to optimal voltage when battery discharging" VALUE 0x8051B888 RB_Val_Ws16 1310700. Volt_Batt -655360.0 655340.0 FORMAT "%8.1" /end CHARACTERISTIC
/begin CHARACTERISTIC Alt_uDiffDecl_C "Voltage offset to optimal voltage when battery charging" VALUE 0x8051B88A RB_Val_Ws16 1310700. Volt_Batt -655360.0 655340.0 FORMAT "%8.1" /end CHARACTERISTIC
/begin CHARACTERISTIC Alt_uDrpHi_C "Alternator desired voltage drop high threshold" VALUE 0x8051C546 RB_Val_Ws16 1310700. Volt_Batt -655360.0 655340.0 FORMAT "%8.1" /end CHARACTERISTIC
/begin CHARACTERISTIC Alt_uDrpLo_C "Alternator desired voltage drop low limit" VALUE 0x8051C548 RB_Val_Ws16 1310700. Volt_Batt -655360.0 655340.0 FORMAT "%8.1" /end CHARACTERISTIC
/begin CHARACTERISTIC Alt_uFastBattStab_C "Fast path battery voltage stable range voltage" VALUE 0x8051C54A RB_Val_Ws16 1310700. Volt_Batt -655360.0 655340.0 FORMAT "%8.1" /end CHARACTERISTIC
/begin CHARACTERISTIC Alt_uFltDecFix_C "Low alternator voltage during fault" VALUE 0x8051B88C RB_Val_Ws16 655350.0 RBPtCel_u_10p0_1 -327680.0 327670.0 FORMAT "%8.1" /end CHARACTERISTIC
/begin CHARACTERISTIC Alt_uFltIncFix_C "High alternator voltage during fault" VALUE 0x8051B88E RB_Val_Ws16 655350.0 RBPtCel_u_10p0_1 -327680.0 327670.0 FORMAT "%8.1" /end CHARACTERISTIC
/begin CHARACTERISTIC Alt_uGenMax_C "Maximum limit of alternator set voltage" VALUE 0x8051B890 RB_Val_Ws16 6553.500 Volt_Alt_100mV -3276.800 3276.700 FORMAT "%8.3" /end CHARACTERISTIC
/begin CHARACTERISTIC Alt_uGenMin_C "Minimum limit of alternator set voltage" VALUE 0x8051B892 RB_Val_Ws16 6553.500 Volt_Alt_100mV -3276.800 3276.700 FORMAT "%8.3" /end CHARACTERISTIC
/begin CHARACTERISTIC Alt_uGenrOffsStrt_C "Alternator offset voltage during start stop" VALUE 0x8051B894 RB_Val_Ws16 1310700. Volt_Batt -655360.0 655340.0 FORMAT "%8.1" /end CHARACTERISTIC
/begin CHARACTERISTIC Alt_uIncHi_C "Higher increment of setpoint alternator voltage when alternator speed is high and alternator voltage is too low compared to battery voltage" VALUE 0x8051B896 RB_Val_Ws16 655350.0 RBPtCel_u_10p0_1 -327680.0 327670.0 FORMAT "%8.1" /end CHARACTERISTIC
/begin CHARACTERISTIC Alt_uIncLo_C "Lower increment of setpoint alternator voltage when alternator speed is not high and alternator voltage is too low compared to battery voltage" VALUE 0x8051B898 RB_Val_Ws16 655350.0 RBPtCel_u_10p0_1 -327680.0 327670.0 FORMAT "%8.1" /end CHARACTERISTIC
/begin CHARACTERISTIC Alt_uLimDwnConsObs_C "Lower alternator set point voltage when electrical loads are active" VALUE 0x8051B89A RB_Val_Ws16 655350.0 RBPtCel_u_10p0_1 -327680.0 327670.0 FORMAT "%8.1" /end CHARACTERISTIC
/begin CHARACTERISTIC Alt_uLimDwnFailSafe_C "Lower alternator set point voltage during high temperature failsafe cut off" VALUE 0x8051B89C RB_Val_Ws16 655350.0 RBPtCel_u_10p0_1 -327680.0 327670.0 FORMAT "%8.1" /end CHARACTERISTIC
/begin CHARACTERISTIC Alt_uLimDwn_C "Lower alternator set point voltage with out any error" VALUE 0x8051B89E RB_Val_Ws16 655350.0 RBPtCel_u_10p0_1 -327680.0 327670.0 FORMAT "%8.1" /end CHARACTERISTIC
/begin CHARACTERISTIC Alt_uLimUpConsObs_C "Higher alternator set point voltage when electrical loads are active" VALUE 0x8051B8A0 RB_Val_Ws16 655350.0 RBPtCel_u_10p0_1 -327680.0 327670.0 FORMAT "%8.1" /end CHARACTERISTIC
/begin CHARACTERISTIC Alt_uLimUpFailSafe_C "Higher alternator set point voltage during high temperature failsafe cut off" VALUE 0x8051B8A2 RB_Val_Ws16 655350.0 RBPtCel_u_10p0_1 -327680.0 327670.0 FORMAT "%8.1" /end CHARACTERISTIC
/begin CHARACTERISTIC Alt_uLimUp_C "Higher alternator set point voltage with out any error" VALUE 0x8051B8A4 RB_Val_Ws16 655350.0 RBPtCel_u_10p0_1 -327680.0 327670.0 FORMAT "%8.1" /end CHARACTERISTIC
/begin CHARACTERISTIC Alt_uNormU_C "Normal battery voltage" VALUE 0x8051C54C RB_Val_Ws16 1310700. Volt_Batt -655360.0 655340.0 FORMAT "%8.1" /end CHARACTERISTIC
/begin CHARACTERISTIC Alt_uNrmTBatt_GCUR "curve for battery voltage and battery temperature" CURVE 0x8051B8A6 RB_CurveGroup_S16 1310700. Volt_Batt -655360.0 655340.0 FORMAT "%8.1"
 /begin AXIS_DESCR COM_AXIS Ebs_tBattFild SCR_TEMP_CELS_float 8 -32768.00 32767.00 FORMAT "%8.2" AXIS_PTS_REF Alt_tBatt_AXIS /end AXIS_DESCR
/end CHARACTERISTIC
/begin CHARACTERISTIC Alt_uNrmTEnv_CUR "Curve which gives relationship between Battery voltage and environmental temperature" CURVE 0x8051B8B6 RB_Curve_S16_S16 1310700. Volt_Batt -655360.0 655340.0 FORMAT "%8.1"
 /begin AXIS_DESCR STD_AXIS GlbDa_tEnv Temp_Cels 10 -3549.940 3003.560 FORMAT "%8.3" DEPOSIT ABSOLUTE /end AXIS_DESCR
/end CHARACTERISTIC
/begin CHARACTERISTIC Alt_uStepMaxLim_C "Maximum of voltage delta" VALUE 0x8051B8E0 RB_Val_Ws16 655350.0 RBPtCel_u_10p0_1 -327680.0 327670.0 FORMAT "%8.1" /end CHARACTERISTIC
/begin CHARACTERISTIC Alt_uStepMinLim_C "Maximum of negative voltage delta" VALUE 0x8051B8E2 RB_Val_Ws16 655350.0 RBPtCel_u_10p0_1 -327680.0 327670.0 FORMAT "%8.1" /end CHARACTERISTIC
/begin CHARACTERISTIC Alt_uTrafoCurrDiff_CUR "Curve which gives relationship between Battery current and voltage" CURVE 0x8051B8E4 RB_Curve_S16_S16 655350.0 RBPtCel_u_10p0_1 -327680.0 327670.0 FORMAT "%8.1"
 /begin AXIS_DESCR STD_AXIS s_iBattDiff Curr_A 10 -327.6800 327.6700 FORMAT "%8.4" DEPOSIT ABSOLUTE /end AXIS_DESCR
/end CHARACTERISTIC
/begin CHARACTERISTIC Alt_uVapLockHiSetPoint_C "Alternator voltage set point in case of fuel vapor lock" VALUE 0x8051B90E RB_Val_Ws16 655350.0 RBPtCel_u_10p0_1 -327680.0 327670.0 FORMAT "%8.1" /end CHARACTERISTIC
/begin CHARACTERISTIC Alt_vCutOffSVehSpd_C "Alternator speed cut-off calibration based on Vehicle speed" VALUE 0x8051B910 RB_Val_Ws16 655.3500 Vel -327.6800 327.6700 FORMAT "%8.4" /end CHARACTERISTIC
/begin CHARACTERISTIC Alt_vRecupMinHi_C "Upper threshold for vehicle velocity limit for RECUPmode" VALUE 0x8051C588 RB_Val_Ws16 655.3500 Vel -327.6800 327.6700 FORMAT "%8.4" /end CHARACTERISTIC
/begin CHARACTERISTIC Alt_vRecupMinLo_C "Lower threshold for vehicle velocity limit for RECUPmode" VALUE 0x8051C58A RB_Val_Ws16 655.3500 Vel -327.6800 327.6700 FORMAT "%8.4" /end CHARACTERISTIC
/begin CHARACTERISTIC Alt_vVehSpdExctLimHi_C "Higher limit for vehicle speed to limit excitation current" VALUE 0x8051B912 RB_Val_Ws16 655.3500 Vel -327.6800 327.6700 FORMAT "%8.4" /end CHARACTERISTIC
/begin CHARACTERISTIC Alt_vVehSpdExctLimLo_C "Lower limit for vehicle speed to limit excitation current" VALUE 0x8051B914 RB_Val_Ws16 655.3500 Vel -327.6800 327.6700 FORMAT "%8.4" /end CHARACTERISTIC
/begin CHARACTERISTIC Alt_vVehStopHi_C "High threshold vehicle standstill" VALUE 0x8051C54E RB_Val_Ws16 655.3500 Vel -327.6800 327.6700 FORMAT "%8.4" /end CHARACTERISTIC
/begin CHARACTERISTIC Alt_vVehStopLo_C "Low threshold vehicle standstill" VALUE 0x8051C550 RB_Val_Ws16 655.3500 Vel -327.6800 327.6700 FORMAT "%8.4" /end CHARACTERISTIC
/begin CHARACTERISTIC Alt_vVehStopSlowResvHi_C "Slow path torque reserve high threshold vehicle standstill" VALUE 0x8051C552 RB_Val_Ws16 655.3500 Vel -327.6800 327.6700 FORMAT "%8.4" /end CHARACTERISTIC
/begin CHARACTERISTIC Alt_vVehStopSlowResvLo_C "Slow path torque reserve low threshold vehicle standstill" VALUE 0x8051C554 RB_Val_Ws16 655.3500 Vel -327.6800 327.6700 FORMAT "%8.4" /end CHARACTERISTIC
/begin CHARACTERISTIC ANZTIHDREN "Number of injections for enabling high-pressure controller during high-pressure-start" VALUE 0x80507F5C RB_Val_Wu8 255.0 dez 0.00 255.0 FORMAT "%5.1" /end CHARACTERISTIC
/begin CHARACTERISTIC APP_d2ratUnFltThd_C "Threshold second derivative value of unfiltered accelarator pedal ratio to detect oscillation" VALUE 0x80507FC0 RB_Val_Ws32 79999999.9814 q0p01862_Perc_DIV_s2 -40000000.0000 39999999.9814 FORMAT "%13.4" /end CHARACTERISTIC
/begin CHARACTERISTIC APP_drLimNeg_C "Max. pedal value decrease per computation step during operation of brake" VALUE 0x80507F94 RB_Val_Ws16 39999.39 PrcPerSec -20000.00 19999.39 FORMAT "%8.2" /end CHARACTERISTIC
/begin CHARACTERISTIC APP_drLimpMax_C "Limit for APP gradient in limphome mode" VALUE 0x80507F96 RB_Val_Ws16 39999.39 PrcPerSec -20000.00 19999.39 FORMAT "%8.2" /end CHARACTERISTIC
/begin CHARACTERISTIC APP_drLimPos_C "Max. permissible pedal value increase per computation step after operating brake" VALUE 0x80507F98 RB_Val_Ws16 39999.39 PrcPerSec -20000.00 19999.39 FORMAT "%8.2" /end CHARACTERISTIC
/begin CHARACTERISTIC APP_drUnFltLim_C "Threshold for APP gradient to reset plausibility with brake" VALUE 0x80507FE0 RB_Val_Ws16 39999.39 PrcPerSec -20000.00 19999.39 FORMAT "%8.2" /end CHARACTERISTIC
/begin CHARACTERISTIC APP_ratOscnDetnIdle_C "Idle value of unfiltered accelerator pedal ratio to detect an oscillation" VALUE 0x80507FC4 RB_Val_Ws16 799.9878 Prc -400.0000 399.9878 FORMAT "%8.4" /end CHARACTERISTIC
/begin CHARACTERISTIC APP_rLimpMax_C "Limit for APP value in limphome mode" VALUE 0x80507F9A RB_Val_Ws16 799.9878 Prc -400.0000 399.9878 FORMAT "%8.4" /end CHARACTERISTIC
/begin CHARACTERISTIC APP_rPlaMaxVal_C "Maximum APP value when plausibility with brake failed" VALUE 0x80507F9C RB_Val_Ws16 799.9878 Prc -400.0000 399.9878 FORMAT "%8.4" /end CHARACTERISTIC
/begin CHARACTERISTIC APP_rThresAliveDet_C "APP threshold for alive detection" VALUE 0x80507F9E RB_Val_Ws16 799.9878 Prc -400.0000 399.9878 FORMAT "%8.4" /end CHARACTERISTIC
/begin CHARACTERISTIC APP_rUnFltPlausBrkMax_C "Maximum pedal ratio to detect brake plausibility" VALUE 0x80507FE2 RB_Val_Ws16 799.9878 Prc -400.0000 399.9878 FORMAT "%8.4" /end CHARACTERISTIC
/begin CHARACTERISTIC APP_swtBrkStRedOff_C "Calibration to select brake light switch signal" VALUE 0x80507FE4 RB_Val_Wboolean 1.00000000000 B_TRUE 0.00 1.00000000000 FORMAT "%13.11" /end CHARACTERISTIC
/begin CHARACTERISTIC APP_tiAliveDebHiLo_C "debounce time for the acceleration pedal alive detection falling edge" VALUE 0x80507FA0 RB_Val_Ws16 655350.0 Time_ms -327680.0 327670.0 FORMAT "%8.1" /end CHARACTERISTIC
/begin CHARACTERISTIC APP_tiAliveDebLoHi_C "debounce time for the acceleration pedal alive detection rising edge" VALUE 0x80507FA2 RB_Val_Ws16 655350.0 Time_ms -327680.0 327670.0 FORMAT "%8.1" /end CHARACTERISTIC
/begin CHARACTERISTIC APP_tiGradCondDebHiLo_C "debounce time for the release of the acceleration brake plausibility by gradient falling edge" VALUE 0x80507FE6 RB_Val_Ws16 655350.0 Time_ms -327680.0 327670.0 FORMAT "%8.1" /end CHARACTERISTIC
/begin CHARACTERISTIC APP_tiGradCondDebLoHi_C "debounce time for the release of the acceleration brake plausibility by gradient rising edge" VALUE 0x80507FE8 RB_Val_Ws16 655350.0 Time_ms -327680.0 327670.0 FORMAT "%8.1" /end CHARACTERISTIC
/begin CHARACTERISTIC APP_tiMaxLrnTmr_C "Time for Current max value from APP sensor 1 updation." VALUE 0x80507FB8 RB_Val_Ws16 655350.0 Time_ms -327680.0 327670.0 FORMAT "%8.1" /end CHARACTERISTIC
/begin CHARACTERISTIC APP_tiOscnCfmdIdleTout_C "Minimum time for the pedal to be in Idle position to reset a confirmed oscillation" VALUE 0x80507FC6 RB_Val_Ws16 655350.0 Time_ms -327680.0 327670.0 FORMAT "%8.1" /end CHARACTERISTIC
/begin CHARACTERISTIC APP_tiOscnCfmdNoIdle_C "Minimum time for the pedal to be in non-Idle position to reset a confirmed oscillation" VALUE 0x80507FC8 RB_Val_Ws16 655350.0 Time_ms -327680.0 327670.0 FORMAT "%8.1" /end CHARACTERISTIC
/begin CHARACTERISTIC APP_tiOscnCfmdTout_C "Maximum time allowed for a confirmed oscillation" VALUE 0x80507FCA RB_Val_Ws16 655350.0 Time_ms -327680.0 327670.0 FORMAT "%8.1" /end CHARACTERISTIC
/begin CHARACTERISTIC APP_tiOscnExptTOut_C "Maximum time allowed for expected oscillation" VALUE 0x80507FCC RB_Val_Ws16 655350.0 Time_ms -327680.0 327670.0 FORMAT "%8.1" /end CHARACTERISTIC
/begin CHARACTERISTIC APP_tiPlaBrkActvtDeb_C "Debounce time to activate BOA" VALUE 0x80507FEA RB_Val_Ws16 655350.0 Time_ms -327680.0 327670.0 FORMAT "%8.1" /end CHARACTERISTIC
/begin CHARACTERISTIC APP_tiPlaBrkDeactvtDeb_C "Debounce time to deactivate BOA" VALUE 0x80507FEC RB_Val_Ws16 655350.0 Time_ms -327680.0 327670.0 FORMAT "%8.1" /end CHARACTERISTIC
/begin CHARACTERISTIC APP_uCurrSnsrLimMax_C "Max limit of sensor voltage learning update." VALUE 0x80507FBA RB_Val_Ws16 13107.00 Volt -6553.600 6553.400 FORMAT "%8.3" /end CHARACTERISTIC
/begin CHARACTERISTIC APP_uKDHighAPP_C "Upper threshold for kickdown hysteresis" VALUE 0x80507FB4 RB_Val_Ws16 13107.00 Volt -6553.600 6553.400 FORMAT "%8.3" /end CHARACTERISTIC
/begin CHARACTERISTIC APP_uKDLowAPP_C "Lower threshold for kickdown hysteresis" VALUE 0x80507FB6 RB_Val_Ws16 13107.00 Volt -6553.600 6553.400 FORMAT "%8.3" /end CHARACTERISTIC
/begin CHARACTERISTIC APP_uRaw1PhyHigh_C "Physical range high threshold of APP sensor 1" VALUE 0x80507FA4 RB_Val_Ws16 13107.00 Volt -6553.600 6553.400 FORMAT "%8.3" /end CHARACTERISTIC
/begin CHARACTERISTIC APP_uRaw1PhyLow_C "Physical range low threshold of APP sensor 1" VALUE 0x80507FA6 RB_Val_Ws16 13107.00 Volt -6553.600 6553.400 FORMAT "%8.3" /end CHARACTERISTIC
/begin CHARACTERISTIC APP_uRaw1SRCHigh_C "Threshold for SRC high for sensor 1" VALUE 0x80507FA8 RB_Val_Ws16 13107.00 Volt -6553.600 6553.400 FORMAT "%8.3" /end CHARACTERISTIC
/begin CHARACTERISTIC APP_uRaw1SRCLow_C "Threshold for SRC low for sensor 1" VALUE 0x80507FAA RB_Val_Ws16 13107.00 Volt -6553.600 6553.400 FORMAT "%8.3" /end CHARACTERISTIC
/begin CHARACTERISTIC APP_uRaw2PhyHigh_C "Physical range high threshold of APP sensor 2" VALUE 0x80507FAC RB_Val_Ws16 13107.00 Volt -6553.600 6553.400 FORMAT "%8.3" /end CHARACTERISTIC
/begin CHARACTERISTIC APP_uRaw2PhyLow_C "Physical range low threshold of APP sensor 2" VALUE 0x80507FAE RB_Val_Ws16 13107.00 Volt -6553.600 6553.400 FORMAT "%8.3" /end CHARACTERISTIC
/begin CHARACTERISTIC APP_uRaw2SRCHigh_C "Threshold for SRC high for sensor 2" VALUE 0x80507FB0 RB_Val_Ws16 13107.00 Volt -6553.600 6553.400 FORMAT "%8.3" /end CHARACTERISTIC
/begin CHARACTERISTIC APP_uRaw2SRCLow_C "Threshold for SRC low for sensor 2" VALUE 0x80507FB2 RB_Val_Ws16 13107.00 Volt -6553.600 6553.400 FORMAT "%8.3" /end CHARACTERISTIC
/begin CHARACTERISTIC APP_uSnsrMaxDft_C "Default max value of sensor voltage corresponding to 100 APP" VALUE 0x80507FBC RB_Val_Ws16 13107.00 Volt -6553.600 6553.400 FORMAT "%8.3" /end CHARACTERISTIC
/begin CHARACTERISTIC APP_uSyncMin_C "Minimum voltage to enable sync check" VALUE 0x80507FD0 RB_Val_Ws16 13107.00 Volt -6553.600 6553.400 FORMAT "%8.3" /end CHARACTERISTIC
/begin CHARACTERISTIC APP_uSync_CUR "Curve to calculate permitted maximum for difference of signal voltages of sensor 1 and sensor 2" CURVE 0x80507FD2 RB_Curve_S16_S16 13107.00 Volt -6553.600 6553.400 FORMAT "%8.3"
 /begin AXIS_DESCR STD_AXIS APP_uMin12half Volt 3 -6553.600 6553.400 FORMAT "%8.3" DEPOSIT ABSOLUTE /end AXIS_DESCR
/end CHARACTERISTIC
/begin CHARACTERISTIC APP_vLim_C "threshold for vehicle speed to skip security check" VALUE 0x80507FEE RB_Val_Ws16 655.3500 Vel -327.6800 327.6700 FORMAT "%8.4" /end CHARACTERISTIC
/begin CHARACTERISTIC CWAMSV "Codeword for activation of the demand control valve" VALUE 0x80507F5D RB_Val_Wu8 255.0 dez 0.00 255.0 FORMAT "%5.1" /end CHARACTERISTIC
/begin CHARACTERISTIC DWAMSVMN "angle for min. error simulation" VALUE 0x80507F5E RB_Val_Ws16 720.0000 kw_q0p1 -360.0000 360.0000 FORMAT "%8.4" EXTENDED_LIMITS -3276.800 3276.700 /end CHARACTERISTIC
/begin CHARACTERISTIC DWAMSVMX "angle for max. error simulation" VALUE 0x80507F60 RB_Val_Ws16 720.0000 kw_q0p1 -360.0000 360.0000 FORMAT "%8.4" EXTENDED_LIMITS -3276.800 3276.700 /end CHARACTERISTIC
/begin CHARACTERISTIC DWMSVMN "limit angle for minimum delivery rate" VALUE 0x80507F62 RB_Val_Ws16 720.0000 kw_q0p1 -360.0000 360.0000 FORMAT "%8.4" EXTENDED_LIMITS -3276.800 3276.700 /end CHARACTERISTIC
/begin CHARACTERISTIC DWMSVMX "limit angle for maximum delivery rate" VALUE 0x80507F64 RB_Val_Ws16 720.0000 kw_q0p1 -360.0000 360.0000 FORMAT "%8.4" EXTENDED_LIMITS -3276.800 3276.700 /end CHARACTERISTIC
/begin CHARACTERISTIC FDWMSVRDR "factor matching controller" VALUE 0x80507F66 RB_Val_Wu16 199.9969 kw_q0p00305_KWdivMPa 0.00 199.9969 FORMAT "%8.4" /end CHARACTERISTIC
/begin CHARACTERISTIC FlSplG_stSyncActHDR_C "state of synchronisation for activation of rail pressure control" VALUE 0x80507F68 RB_Val_Wu8 255.0 OneToOne 0.00 255.0 FORMAT "%5.1" /end CHARACTERISTIC
/begin CHARACTERISTIC FuPHi_pDifHpMaxFco_T "maximum difference between actual rail pressure and set rail pressure ( prist prsoll) for deactivation of MSV if fuel cutt off is active" CURVE 0x80507F6A RB_Curve_S16_U16_Static 131.0700 RBPtCel_p_0p002_1 0.00 131.0700 FORMAT "%8.4"
 /begin AXIS_DESCR STD_AXIS dwmsvdloc_w kw_q0p1 4 -3276.800 3276.700 FORMAT "%8.3" DEPOSIT ABSOLUTE /end AXIS_DESCR
/end CHARACTERISTIC
/begin CHARACTERISTIC FuPHi_pMaxHiPMSVCtlrDi_C "Maximum permitted pressure for the protection of pressure limitation valve when controller is disabled" VALUE 0x80507F7C RB_Val_Wu16 131.0700 RBPtCel_p_0p002_1 0.00 131.0700 FORMAT "%8.4" /end CHARACTERISTIC
/begin CHARACTERISTIC FuPHi_pOffsActvDemCtlFuCutOff_C "rail pressure offset during fuel cutoff for activation demand control" VALUE 0x80507F7E RB_Val_Wu16 131.0700 RBPtCel_p_0p002_1 0.00 131.0700 FORMAT "%8.4" /end CHARACTERISTIC
/begin CHARACTERISTIC FuPHi_pRlHpMaxErrSim_C "pressure threshold during error simulation" VALUE 0x80507F80 RB_Val_Wu16 131.0700 RBPtCel_p_0p002_1 0.00 131.0700 FORMAT "%8.4" /end CHARACTERISTIC
/begin CHARACTERISTIC FuPHi_pThresMSVCtlHpStrt_C "pressure threshold for msv cont. control during high pressure start" VALUE 0x80507F82 RB_Val_Wu16 131.0700 RBPtCel_p_0p002_1 0.00 131.0700 FORMAT "%8.4" /end CHARACTERISTIC
/begin CHARACTERISTIC FuPHi_tiMaxErrMfVlvSimn_C "maximum time for max error simulation" VALUE 0x80507F84 RB_Val_Ws32 2147.48364700 Time_Dt 0.00 2147.48364700 FORMAT "%13.8" EXTENDED_LIMITS -2147.48364800 2147.48364700 /end CHARACTERISTIC
/begin CHARACTERISTIC FuPHi_tiMinErrMfVlvSimn_C "maximum time for min error simulation" VALUE 0x80507F88 RB_Val_Ws32 2147.48364700 Time_Dt 0.00 2147.48364700 FORMAT "%13.8" EXTENDED_LIMITS -2147.48364800 2147.48364700 /end CHARACTERISTIC
/begin CHARACTERISTIC NMMNAMSV "minimum rpm for release error simulation" VALUE 0x80507F8C RB_Val_Wu8 10200. nmot_ub_q40 0.00 10200. FORMAT "%5.0" /end CHARACTERISTIC
/begin CHARACTERISTIC NMMXAMSV "maximum rpm for release error simulation" VALUE 0x80507F8D RB_Val_Wu8 10200. nmot_ub_q40 0.00 10200. FORMAT "%5.0" /end CHARACTERISTIC
/begin CHARACTERISTIC REDMXMSV "maximal step number for MSV off" VALUE 0x80507F8E RB_Val_Wu8 255.0 dez 0.00 255.0 FORMAT "%5.1" /end CHARACTERISTIC
/begin CHARACTERISTIC REDSMXMSV "maximal step number for MSV off" VALUE 0x80507F8F RB_Val_Wu8 255.0 dez 0.00 255.0 FORMAT "%5.1" /end CHARACTERISTIC
/begin CHARACTERISTIC TPREL_MSV "Tooth debouncing time during initialisation for enabling MSV" VALUE 0x80507F90 RB_Val_Wu8 2.540 t_q0p02 0.00 2.540 FORMAT "%5.3" EXTENDED_LIMITS 0.00 5.100 /end CHARACTERISTIC
/begin CHARACTERISTIC TVDPRMAX "delay time for pressure threshold during error simulation" VALUE 0x80507F92 RB_Val_Wu16 1310.700 t_q0p02 0.00 1310.700 FORMAT "%8.3" /end CHARACTERISTIC
/begin MEASUREMENT Alt_aRecupFil "Filtered vehicle accleration" SWORD Acc 1 100 -32.76800 32.76700 FORMAT "%8.5" ECU_ADDRESS 0x60007912 /end MEASUREMENT
/begin MEASUREMENT Alt_bAltLoadHi_MP "Measuring point for high alternator workload" UBYTE B_TRUE 1 100 0.00 1.00000000000 BIT_MASK 0x1 FORMAT "%13.11" ECU_ADDRESS 0x7000A8A8 /end MEASUREMENT
/begin MEASUREMENT Alt_bHTCutOffMng_MP "Measuring point for Alternator High temperature cut-off" UBYTE B_TRUE 1 100 0.00 1.00000000000 BIT_MASK 0x1 FORMAT "%13.11" ECU_ADDRESS 0x7000A8A7 /end MEASUREMENT
/begin MEASUREMENT Alt_bNAltHi_MP "Measuring point to view the alternator speed which is a ratio of engine speed." UBYTE B_TRUE 1 100 0.00 1.00000000000 BIT_MASK 0x1 FORMAT "%13.11" ECU_ADDRESS 0x7000A8A6 /end MEASUREMENT
/begin MEASUREMENT Alt_bNoDecl_MP "Measuring point to view decrease in current decrease" UBYTE B_TRUE 1 100 0.00 1.00000000000 BIT_MASK 0x1 FORMAT "%13.11" ECU_ADDRESS 0x7000A8A5 /end MEASUREMENT
/begin MEASUREMENT Alt_bNoIncl_MP "Measuring point to view increase in current decrease" UBYTE B_TRUE 1 100 0.00 1.00000000000 BIT_MASK 0x1 FORMAT "%13.11" ECU_ADDRESS 0x7000A8A4 /end MEASUREMENT
/begin MEASUREMENT Alt_bTBattMng_MP "Measuring point for status of Battery temperature out-of-range" UBYTE B_TRUE 1 100 0.00 1.00000000000 BIT_MASK 0x1 FORMAT "%13.11" ECU_ADDRESS 0x7000A8A3 /end MEASUREMENT
/begin MEASUREMENT Alt_bTEnvMng_MP "Measuring point for Battery temperature invalid or battery sensor not available" UBYTE B_TRUE 1 100 0.00 1.00000000000 BIT_MASK 0x1 FORMAT "%13.11" ECU_ADDRESS 0x7000A8A2 /end MEASUREMENT
/begin MEASUREMENT Alt_cntBattRExcddThd "Number of times the battery resistance has exceeded the threshold value." UBYTE OneToOne 1 100 0.00 255.0 FORMAT "%5.1" ECU_ADDRESS 0x600394D3 /end MEASUREMENT
/begin MEASUREMENT Alt_cntFastPeakHld "Fast path battery voltage peak hold counter" UBYTE OneToOne 1 100 0.00 255.0 FORMAT "%5.1" ECU_ADDRESS 0x6000E9A4 /end MEASUREMENT
/begin MEASUREMENT Alt_cntrAltLoadPastPosn "Past position of battery current in the array" UBYTE OneToOne 1 100 0.00 255.0 FORMAT "%5.1" ECU_ADDRESS 0x6000E9A3 /end MEASUREMENT
/begin MEASUREMENT Alt_cntrAltLoadPastPosnFast "Past position of battery current in the array fast path" UBYTE OneToOne 1 100 0.00 255.0 FORMAT "%5.1" ECU_ADDRESS 0x6000E9A2 /end MEASUREMENT
/begin MEASUREMENT Alt_cntrAltLoadPosn "Current position of battery current in the array" UBYTE OneToOne 1 100 0.00 255.0 FORMAT "%5.1" ECU_ADDRESS 0x6000E9A1 /end MEASUREMENT
/begin MEASUREMENT Alt_cntrIniDrv "Drive state enter count" UBYTE OneToOne 1 100 0.00 255.0 FORMAT "%5.1" ECU_ADDRESS 0x6000E9A0 /end MEASUREMENT
/begin MEASUREMENT Alt_cntUpScaRstrctACG "ACG Voltage up scale restriction counter" UWORD Fact100 1 100 0.00 655.3500 FORMAT "%8.4" ECU_ADDRESS 0x60007A16 /end MEASUREMENT
/begin MEASUREMENT Alt_cntUpScaRstrctACGDisbl "ACG Voltage up scale restriction disabling counter" UWORD Fact100 1 100 0.00 655.3500 FORMAT "%8.4" ECU_ADDRESS 0x60007A14 /end MEASUREMENT
/begin MEASUREMENT Alt_facAltCmpByBattU "Final factor of alternator compensation torque by battery voltage" SWORD fak_sw_b8 1 100 -8.000000 7.999756 FORMAT "%8.6" ECU_ADDRESS 0x60007A00 /end MEASUREMENT
/begin MEASUREMENT Alt_facBattUFild1 "First factor of battery voltage after filled" SWORD fak_sw_b8 1 100 -8.000000 7.999756 FORMAT "%8.6" ECU_ADDRESS 0x600079FE /end MEASUREMENT
/begin MEASUREMENT Alt_facBattUFild2 "Second factor of battery voltage after filled" SWORD fak_sw_b8 1 100 -8.000000 7.999756 FORMAT "%8.6" ECU_ADDRESS 0x600079FC /end MEASUREMENT
/begin MEASUREMENT Alt_facFastBatt "Fast path battery voltage and current multiplication value" SLONG Fact_10000 1 100 -214748.364800 214748.364700 FORMAT "%13.6" ECU_ADDRESS 0x600031F0 /end MEASUREMENT
/begin MEASUREMENT Alt_flgACGExctCmpl "ACG gradual excitation after engine started completed status" UBYTE B_TRUE 1 100 0.00 1.00000000000 BIT_MASK 0x1 FORMAT "%13.11" ECU_ADDRESS 0x6000EEC1 /end MEASUREMENT
/begin MEASUREMENT Alt_flgACGFailr "ACG failure status" UBYTE B_TRUE 1 100 0.00 1.00000000000 BIT_MASK 0x1 FORMAT "%13.11" ECU_ADDRESS 0x6000EEC0 /end MEASUREMENT
/begin MEASUREMENT Alt_flgAltFastCmnCdn "Fast path alternator common condition" UBYTE B_TRUE 1 100 0.00 1.00000000000 BIT_MASK 0x1 FORMAT "%13.11" ECU_ADDRESS 0x6000E99F /end MEASUREMENT
/begin MEASUREMENT Alt_flgAltFastCmnCdnDly "Fast path alternator common condition delay" UBYTE B_TRUE 1 100 0.00 1.00000000000 BIT_MASK 0x1 FORMAT "%13.11" ECU_ADDRESS 0x6000E99E /end MEASUREMENT
/begin MEASUREMENT Alt_flgAltLoadIdleUpBefDly "Flag of alternator load idle up request before delay" UBYTE B_TRUE 1 100 0.00 1.00000000000 BIT_MASK 0x1 FORMAT "%13.11" ECU_ADDRESS 0x6000E99D /end MEASUREMENT
/begin MEASUREMENT Alt_flgAltLoadIdleUpReq "Flag of alternator load idle up request" UBYTE B_TRUE 1 100 0.00 1.00000000000 BIT_MASK 0x1 FORMAT "%13.11" ECU_ADDRESS 0x6000F28C /end MEASUREMENT
/begin MEASUREMENT Alt_flgAltSlowCmnCdn "Slow path alternator common condition" UBYTE B_TRUE 1 100 0.00 1.00000000000 BIT_MASK 0x1 FORMAT "%13.11" ECU_ADDRESS 0x6000E99C /end MEASUREMENT
/begin MEASUREMENT Alt_flgBattChrgnRqrdU "Battery charging required voltage flag" UBYTE B_TRUE 1 100 0.00 1.00000000000 BIT_MASK 0x1 FORMAT "%13.11" ECU_ADDRESS 0x6000E9B3 /end MEASUREMENT
/begin MEASUREMENT Alt_flgBattDgrd "Flag of battery degradation detection" UBYTE B_TRUE 1 100 0.00 1.00000000000 BIT_MASK 0x1 FORMAT "%13.11" ECU_ADDRESS 0x600394D2 /end MEASUREMENT
/begin MEASUREMENT Alt_flgBattRExcddThd "Batteryresistance exceeded the threshold for more than the allowed number of times." UBYTE B_TRUE 1 100 0.00 1.00000000000 BIT_MASK 0x1 FORMAT "%13.11" ECU_ADDRESS 0x6000E9B2 /end MEASUREMENT
/begin MEASUREMENT Alt_flgBattSOCHys "IBSUML hysterisis output for battery voltage limitation by battery temperature" UBYTE B_TRUE 1 100 0.00 1.00000000000 BIT_MASK 0x1 FORMAT "%13.11" ECU_ADDRESS 0x6000E9B1 /end MEASUREMENT
/begin MEASUREMENT Alt_flgBattStab "Battery voltage stable judgement flag" UBYTE B_TRUE 1 100 0.00 1.00000000000 BIT_MASK 0x1 FORMAT "%13.11" ECU_ADDRESS 0x6000E99B /end MEASUREMENT
/begin MEASUREMENT Alt_flgBattStabDly "Battery voltage stable judgement delay flag" UBYTE B_TRUE 1 100 0.00 1.00000000000 BIT_MASK 0x1 FORMAT "%13.11" ECU_ADDRESS 0x6000E99A /end MEASUREMENT
/begin MEASUREMENT Alt_flgBattTRng "Battery common range check flag" UBYTE B_TRUE 1 100 0.00 1.00000000000 BIT_MASK 0x1 FORMAT "%13.11" ECU_ADDRESS 0x6000EEBF /end MEASUREMENT
/begin MEASUREMENT Alt_flgBattUISocInvld_MP "Measuring point for Battery voltage; current or SOC invalid" UBYTE B_TRUE 1 100 0.00 1.00000000000 BIT_MASK 0x1 FORMAT "%13.11" ECU_ADDRESS 0x7000A8A1 /end MEASUREMENT
/begin MEASUREMENT Alt_flgBkup "Condition backup" UBYTE B_TRUE 1 100 0.00 1.00000000000 BIT_MASK 0x1 FORMAT "%13.11" ECU_ADDRESS 0x6000EEBE /end MEASUREMENT
/begin MEASUREMENT Alt_flgBlowrActv "Flag of blower active" UBYTE B_TRUE 1 100 0.00 1.00000000000 BIT_MASK 0x1 FORMAT "%13.11" ECU_ADDRESS 0x6000E9B0 /end MEASUREMENT
/begin MEASUREMENT Alt_flgDecLoadActv_MP "Decrement mode mode Active status" UBYTE B_TRUE 1 100 0.00 1.00000000000 BIT_MASK 0x1 FORMAT "%13.11" ECU_ADDRESS 0x7000A837 /end MEASUREMENT
/begin MEASUREMENT Alt_flgDecLoadCdn_MP "Status of decrement load enable condition" UBYTE B_TRUE 1 100 0.00 1.00000000000 BIT_MASK 0x1 FORMAT "%13.11" ECU_ADDRESS 0x7000A836 /end MEASUREMENT
/begin MEASUREMENT Alt_flgDecLoadErr_MP "Status of error in sensor corresponding to decrement load mode" UBYTE B_TRUE 1 100 0.00 1.00000000000 BIT_MASK 0x1 FORMAT "%13.11" ECU_ADDRESS 0x7000A835 /end MEASUREMENT
/begin MEASUREMENT Alt_flgDecLoadStop_MP "Status of decrement load stop condition" UBYTE B_TRUE 1 100 0.00 1.00000000000 BIT_MASK 0x1 FORMAT "%13.11" ECU_ADDRESS 0x7000A834 /end MEASUREMENT
/begin MEASUREMENT Alt_flgEngSpdCdnSlow "Condition for judgment slow path engine speed deviation" UBYTE B_TRUE 1 100 0.00 1.00000000000 BIT_MASK 0x1 FORMAT "%13.11" ECU_ADDRESS 0x6000E999 /end MEASUREMENT
/begin MEASUREMENT Alt_flgEngStrtd "Message for Engine start detection" UBYTE B_TRUE 1 100 0.00 1.00000000000 BIT_MASK 0x1 FORMAT "%13.11" ECU_ADDRESS 0x6000EEBD /end MEASUREMENT
/begin MEASUREMENT Alt_flgErrLamp "Error lamp of the alternator" UBYTE B_TRUE 1 100 0.00 1.00000000000 BIT_MASK 0x1 FORMAT "%13.11" ECU_ADDRESS 0x6000EEBC /end MEASUREMENT
/begin MEASUREMENT Alt_flgErrLamp_MP "Measuring point to view status of Generator error lamp activation" UBYTE B_TRUE 1 100 0.00 1.00000000000 BIT_MASK 0x1 FORMAT "%13.11" ECU_ADDRESS 0x7000A8A0 /end MEASUREMENT
/begin MEASUREMENT Alt_flgFastBattCdn "Fast path battery voltage condition" UBYTE B_TRUE 1 100 0.00 1.00000000000 BIT_MASK 0x1 FORMAT "%13.11" ECU_ADDRESS 0x6000E998 /end MEASUREMENT
/begin MEASUREMENT Alt_flgFastBattCorrBefDly "Fast path Battery offset learning before delay flag" UBYTE B_TRUE 1 100 0.00 1.00000000000 BIT_MASK 0x1 FORMAT "%13.11" ECU_ADDRESS 0x6000E997 /end MEASUREMENT
/begin MEASUREMENT Alt_flgFastBattCorrRels "Fast path Battery offset learning release flag" UBYTE B_TRUE 1 100 0.00 1.00000000000 BIT_MASK 0x1 FORMAT "%13.11" ECU_ADDRESS 0x6000E996 /end MEASUREMENT
/begin MEASUREMENT Alt_flgFastCurrCdn "Fast path battery current condition" UBYTE B_TRUE 1 100 0.00 1.00000000000 BIT_MASK 0x1 FORMAT "%13.11" ECU_ADDRESS 0x6000E995 /end MEASUREMENT
/begin MEASUREMENT Alt_flgFastFacNegCdn "Fast path battery voltage and current multiplication negative value" UBYTE B_TRUE 1 100 0.00 1.00000000000 BIT_MASK 0x1 FORMAT "%13.11" ECU_ADDRESS 0x6000E994 /end MEASUREMENT
/begin MEASUREMENT Alt_flgFastFacPosCdn "Fast path battery voltage and current multiplication positive value" UBYTE B_TRUE 1 100 0.00 1.00000000000 BIT_MASK 0x1 FORMAT "%13.11" ECU_ADDRESS 0x6000E993 /end MEASUREMENT
/begin MEASUREMENT Alt_flgFastResvCdnDly "Fast path torque reserve condition delay" UBYTE B_TRUE 1 100 0.00 1.00000000000 BIT_MASK 0x1 FORMAT "%13.11" ECU_ADDRESS 0x6000E992 /end MEASUREMENT
/begin MEASUREMENT Alt_flgFastVehSpdCdn "Vehicle standstill flag" UBYTE B_TRUE 1 100 0.00 1.00000000000 BIT_MASK 0x1 FORMAT "%13.11" ECU_ADDRESS 0x6000E991 /end MEASUREMENT
/begin MEASUREMENT Alt_flgFFAltLoadFast "Flag of fast path alternator torque compensation" UBYTE B_TRUE 1 100 0.00 1.00000000000 BIT_MASK 0x1 FORMAT "%13.11" ECU_ADDRESS 0x6000E990 /end MEASUREMENT
/begin MEASUREMENT Alt_flgFFAltLoadFastResv "Fast path torque reserve request" UBYTE B_TRUE 1 100 0.00 1.00000000000 BIT_MASK 0x1 FORMAT "%13.11" ECU_ADDRESS 0x6000E98F /end MEASUREMENT
/begin MEASUREMENT Alt_flgFFAltLoadSlow "Flag of slow path alternator torque compensation" UBYTE B_TRUE 1 100 0.00 1.00000000000 BIT_MASK 0x1 FORMAT "%13.11" ECU_ADDRESS 0x6000E98E /end MEASUREMENT
/begin MEASUREMENT Alt_flgFFAltLoadSlowBefDly "Flag of slow path alternator torque compensation before delay" UBYTE B_TRUE 1 100 0.00 1.00000000000 BIT_MASK 0x1 FORMAT "%13.11" ECU_ADDRESS 0x6000E98D /end MEASUREMENT
/begin MEASUREMENT Alt_flgFFAltLoadSlowResv "Slow path torque reserve request" UBYTE B_TRUE 1 100 0.00 1.00000000000 BIT_MASK 0x1 FORMAT "%13.11" ECU_ADDRESS 0x6000E98C /end MEASUREMENT
/begin MEASUREMENT Alt_flgGripInfo "Powertrain grip information" UBYTE B_TRUE 1 100 0.00 1.00000000000 BIT_MASK 0x1 FORMAT "%13.11" ECU_ADDRESS 0x6000E97B /end MEASUREMENT
/begin MEASUREMENT Alt_flgHdLiActv "Flag of head light active" UBYTE B_TRUE 1 100 0.00 1.00000000000 BIT_MASK 0x1 FORMAT "%13.11" ECU_ADDRESS 0x6000E9AF /end MEASUREMENT
/begin MEASUREMENT Alt_flgHiLoadExtd_MP "Time extended signal for high alternator load" UBYTE B_TRUE 1 100 0.00 1.00000000000 BIT_MASK 0x1 FORMAT "%13.11" ECU_ADDRESS 0x7000A89F /end MEASUREMENT
/begin MEASUREMENT Alt_flgHiTCutOffFailActv_MP "Measuring point for Fail safe alternator high temperature cut off" UBYTE B_TRUE 1 100 0.00 1.00000000000 BIT_MASK 0x1 FORMAT "%13.11" ECU_ADDRESS 0x7000A89E /end MEASUREMENT
/begin MEASUREMENT Alt_flgHoodOpenActv "Flag of open hood active" UBYTE B_TRUE 1 100 0.00 1.00000000000 BIT_MASK 0x1 FORMAT "%13.11" ECU_ADDRESS 0x6000E9AE /end MEASUREMENT
/begin MEASUREMENT Alt_flgIdleNThd_MP "Status of Engine speed threshold for Idle mode" UBYTE B_TRUE 1 100 0.00 1.00000000000 BIT_MASK 0x1 FORMAT "%13.11" ECU_ADDRESS 0x7000A833 /end MEASUREMENT
/begin MEASUREMENT Alt_flgLockUpCluExtnReq "Lock up extension request flag." UBYTE B_TRUE 1 100 0.00 1.00000000000 BIT_MASK 0x1 FORMAT "%13.11" ECU_ADDRESS 0x6000F28B /end MEASUREMENT
/begin MEASUREMENT Alt_flgMaxChrgBlnc_MP "Charge/discharge limit for Refresh reached" UBYTE B_TRUE 1 100 0.00 1.00000000000 BIT_MASK 0x1 FORMAT "%13.11" ECU_ADDRESS 0x7000A89D /end MEASUREMENT
/begin MEASUREMENT Alt_flgMaxTiBattFull_MP "Measuring point to view if timer for battery refresh has expired or not" UBYTE B_TRUE 1 100 0.00 1.00000000000 BIT_MASK 0x1 FORMAT "%13.11" ECU_ADDRESS 0x7000A89C /end MEASUREMENT
/begin MEASUREMENT Alt_flgMaxTiBefRepn_MP "Measuring point to view if battery refresh has been activated or not" UBYTE B_TRUE 1 100 0.00 1.00000000000 BIT_MASK 0x1 FORMAT "%13.11" ECU_ADDRESS 0x7000A89B /end MEASUREMENT
/begin MEASUREMENT Alt_flgMaxTiRefrActv_MP "Measuring point for Maximum refresh active time reached" UBYTE B_TRUE 1 100 0.00 1.00000000000 BIT_MASK 0x1 FORMAT "%13.11" ECU_ADDRESS 0x7000A89A /end MEASUREMENT
/begin MEASUREMENT Alt_flgMinTiBefRepn_MP "Measuring point for Maximum time before battery refresh has to be performed" UBYTE B_TRUE 1 100 0.00 1.00000000000 BIT_MASK 0x1 FORMAT "%13.11" ECU_ADDRESS 0x7000A899 /end MEASUREMENT
/begin MEASUREMENT Alt_flgNRecupDi_MP "Engine speed limit status of recuperation mode" UBYTE B_TRUE 1 100 0.00 1.00000000000 BIT_MASK 0x1 FORMAT "%13.11" ECU_ADDRESS 0x7000A832 /end MEASUREMENT
/begin MEASUREMENT Alt_flgRecupActv_MP "Recuperation mode Active status" UBYTE B_TRUE 1 100 0.00 1.00000000000 BIT_MASK 0x1 FORMAT "%13.11" ECU_ADDRESS 0x7000A831 /end MEASUREMENT
/begin MEASUREMENT Alt_flgRecupEnaCdn_MP "Status of recuperation enable condition" UBYTE B_TRUE 1 100 0.00 1.00000000000 BIT_MASK 0x1 FORMAT "%13.11" ECU_ADDRESS 0x7000A830 /end MEASUREMENT
/begin MEASUREMENT Alt_flgRecupErr_MP "Status of error in sensor corresponding to recuperation mode" UBYTE B_TRUE 1 100 0.00 1.00000000000 BIT_MASK 0x1 FORMAT "%13.11" ECU_ADDRESS 0x7000A82F /end MEASUREMENT
/begin MEASUREMENT Alt_flgRecupStop_MP "Status of recuperation stop condition" UBYTE B_TRUE 1 100 0.00 1.00000000000 BIT_MASK 0x1 FORMAT "%13.11" ECU_ADDRESS 0x7000A82E /end MEASUREMENT
/begin MEASUREMENT Alt_flgRecupVEna_MP "Status of vehicle velocity limit for Recuperation mode" UBYTE B_TRUE 1 100 0.00 1.00000000000 BIT_MASK 0x1 FORMAT "%13.11" ECU_ADDRESS 0x7000A82D /end MEASUREMENT
/begin MEASUREMENT Alt_flgRefrReq_MP "Measuring point for request for battery refresh" UBYTE B_TRUE 1 100 0.00 1.00000000000 BIT_MASK 0x1 FORMAT "%13.11" ECU_ADDRESS 0x7000A898 /end MEASUREMENT
/begin MEASUREMENT Alt_flgRpdChrg "Flag indicates Rapid Charge status" UBYTE B_TRUE 1 100 0.00 1.00000000000 BIT_MASK 0x1 FORMAT "%13.11" ECU_ADDRESS 0x6000EEBB /end MEASUREMENT
/begin MEASUREMENT Alt_flgSlopLimr "Status of activation of electrical loads" UBYTE B_TRUE 1 100 0.00 1.00000000000 BIT_MASK 0x1 FORMAT "%13.11" ECU_ADDRESS 0x6000EEBA /end MEASUREMENT
/begin MEASUREMENT Alt_flgSlowCmpCdn "Slow path torque compensation condition" UBYTE B_TRUE 1 100 0.00 1.00000000000 BIT_MASK 0x1 FORMAT "%13.11" ECU_ADDRESS 0x6000E98B /end MEASUREMENT
/begin MEASUREMENT Alt_flgSlowCmpCdnHld "Slow path torque compensation condition hold" UBYTE B_TRUE 1 100 0.00 1.00000000000 BIT_MASK 0x1 FORMAT "%13.11" ECU_ADDRESS 0x6000E98A /end MEASUREMENT
/begin MEASUREMENT Alt_flgSlowResvCdn "Slow path torque reserve condition" UBYTE B_TRUE 1 100 0.00 1.00000000000 BIT_MASK 0x1 FORMAT "%13.11" ECU_ADDRESS 0x6000E989 /end MEASUREMENT
/begin MEASUREMENT Alt_flgSlowResvCdnHld "Slow path torque reserve condition hold" UBYTE B_TRUE 1 100 0.00 1.00000000000 BIT_MASK 0x1 FORMAT "%13.11" ECU_ADDRESS 0x6000E988 /end MEASUREMENT
/begin MEASUREMENT Alt_flgSlowResvEngDrp "Slow path torque reserve engine drop condition" UBYTE B_TRUE 1 100 0.00 1.00000000000 BIT_MASK 0x1 FORMAT "%13.11" ECU_ADDRESS 0x6000E987 /end MEASUREMENT
/begin MEASUREMENT Alt_flgSocHiHdLi "High SOC flag for Headlight activity check" UBYTE B_TRUE 1 100 0.00 1.00000000000 BIT_MASK 0x1 FORMAT "%13.11" ECU_ADDRESS 0x6000E9AD /end MEASUREMENT
/begin MEASUREMENT Alt_flgSpclRngDi "Flag indicating Special Voltage range is disabled" UBYTE B_TRUE 1 100 0.00 1.00000000000 BIT_MASK 0x1 FORMAT "%13.11" ECU_ADDRESS 0x6000EEB9 /end MEASUREMENT
/begin MEASUREMENT Alt_flgSpclRngMaxDi "Flag indicating Miaximum threshold of Special Voltage range is disabled" UBYTE B_TRUE 1 100 0.00 1.00000000000 BIT_MASK 0x1 FORMAT "%13.11" ECU_ADDRESS 0x6000E9AC /end MEASUREMENT
/begin MEASUREMENT Alt_flgSpclRngMinDi "Flag indicating Minimum threshold of Special Voltage range is disabled" UBYTE B_TRUE 1 100 0.00 1.00000000000 BIT_MASK 0x1 FORMAT "%13.11" ECU_ADDRESS 0x6000EEB8 /end MEASUREMENT
/begin MEASUREMENT Alt_flgTBattMin "Low battery temperature flag" UBYTE B_TRUE 1 100 0.00 1.00000000000 BIT_MASK 0x1 FORMAT "%13.11" ECU_ADDRESS 0x6000EEB7 /end MEASUREMENT
/begin MEASUREMENT Alt_flgThActv "Flag of thermostat active" UBYTE B_TRUE 1 100 0.00 1.00000000000 BIT_MASK 0x1 FORMAT "%13.11" ECU_ADDRESS 0x6000E9AB /end MEASUREMENT
/begin MEASUREMENT Alt_flgUpScaRstrctACG "ACG Voltage up scale restriction flag" UBYTE B_TRUE 1 100 0.00 1.00000000000 BIT_MASK 0x1 FORMAT "%13.11" ECU_ADDRESS 0x6000E9AA /end MEASUREMENT
/begin MEASUREMENT Alt_flgUpScaRstrctBattU "ACG voltage scaling up restriction due to battery voltage" UBYTE B_TRUE 1 100 0.00 1.00000000000 BIT_MASK 0x1 FORMAT "%13.11" ECU_ADDRESS 0x6000E9A9 /end MEASUREMENT
/begin MEASUREMENT Alt_flgUpScaRstrctFC "Fuel cut Voltage up scale restriction flag" UBYTE B_TRUE 1 100 0.00 1.00000000000 BIT_MASK 0x1 FORMAT "%13.11" ECU_ADDRESS 0x6000E9A8 /end MEASUREMENT
/begin MEASUREMENT Alt_flgURngSeln "Voltage range selection flag" UBYTE B_TRUE 1 100 0.00 1.00000000000 BIT_MASK 0x1 FORMAT "%13.11" ECU_ADDRESS 0x6000E9A7 /end MEASUREMENT
/begin MEASUREMENT Alt_flgWipr "State of wiper after delay time" UBYTE B_TRUE 1 100 0.00 1.00000000000 BIT_MASK 0x1 FORMAT "%13.11" ECU_ADDRESS 0x6000E986 /end MEASUREMENT
/begin MEASUREMENT Alt_flgWiprActv "Flag of wiper active" UBYTE B_TRUE 1 100 0.00 1.00000000000 BIT_MASK 0x1 FORMAT "%13.11" ECU_ADDRESS 0x6000E9A6 /end MEASUREMENT
/begin MEASUREMENT Alt_iAltFild "Excitation current after filled" SWORD Curr 1 100 -32768.00 32767.00 FORMAT "%8.2" ECU_ADDRESS 0x600079FA /end MEASUREMENT
/begin MEASUREMENT Alt_iBattDiffGov_MP "Difference between set current and measured current" SWORD Curr_A 1 100 -327.6800 327.6700 FORMAT "%8.4" ECU_ADDRESS 0x7000A896 /end MEASUREMENT
/begin MEASUREMENT Alt_iBattFildDeltaFast "Fast path battery current value delta" SWORD Curr_A 1 100 -327.6800 327.6700 FORMAT "%8.4" ECU_ADDRESS 0x600079F8 /end MEASUREMENT
/begin MEASUREMENT Alt_iBattFildDeltaSlow "Slow path delta value of battery current" SWORD Curr_A 1 100 -327.6800 327.6700 FORMAT "%8.4" ECU_ADDRESS 0x600079F6 /end MEASUREMENT
/begin MEASUREMENT Alt_iBattFildOldFast "Fast path battery current old value" SWORD Curr_A 1 100 -327.6800 327.6700 FORMAT "%8.4" ECU_ADDRESS 0x600079F4 /end MEASUREMENT
/begin MEASUREMENT Alt_iBattMaxIn_MP "Limitation of maximum battery current" SWORD Curr_A 1 100 -327.6800 327.6700 FORMAT "%8.4" ECU_ADDRESS 0x7000A894 /end MEASUREMENT
/begin MEASUREMENT Alt_iBattMinIn_MP "Limitation of minimum battery current" SWORD Curr_A 1 100 -327.6800 327.6700 FORMAT "%8.4" ECU_ADDRESS 0x7000A892 /end MEASUREMENT
/begin MEASUREMENT Alt_iBattSetGovr_MP "Measuring point for current set-point to alternator" SWORD Curr_A 1 100 -327.6800 327.6700 FORMAT "%8.4" ECU_ADDRESS 0x7000A890 /end MEASUREMENT
/begin MEASUREMENT Alt_iBattSetIn "Setpoint of battery current dependent on battery state of charge" SWORD Curr_A 1 100 -327.6800 327.6700 FORMAT "%8.4" ECU_ADDRESS 0x60008A2E /end MEASUREMENT
/begin MEASUREMENT Alt_iBattSet_MP "Setpoint of battery current" SWORD Curr_A 1 100 -327.6800 327.6700 FORMAT "%8.4" ECU_ADDRESS 0x7000A88E /end MEASUREMENT
/begin MEASUREMENT Alt_iDeltaExctCrnt "Delta Excitaton current from alternator current" SWORD Curr 1 100 -32768.00 32767.00 FORMAT "%8.2" ECU_ADDRESS 0x600079F2 /end MEASUREMENT
/begin MEASUREMENT Alt_iEcxtCrntFilOut_MP "Measurement point for Excitation current filtered output" SWORD Curr 1 100 -32768.00 32767.00 FORMAT "%8.2" ECU_ADDRESS 0x7000A842 /end MEASUREMENT
/begin MEASUREMENT Alt_iExctCrntOld "Value of ComAlt_iExctCrnt in last rastor" SWORD Curr 1 100 -32768.00 32767.00 FORMAT "%8.2" ECU_ADDRESS 0x600079F0 /end MEASUREMENT
/begin MEASUREMENT Alt_iExctLim "Max excitation limit current for alternator" SWORD Curr_A 1 100 -327.6800 327.6700 FORMAT "%8.4" ECU_ADDRESS 0x60008A2C /end MEASUREMENT
/begin MEASUREMENT Alt_iFFAltLoadAry "Array to hold the value of battery current" SWORD Curr_A 1 100 -327.6800 327.6700 FORMAT "%8.4" ARRAY_SIZE 50 ECU_ADDRESS 0x6000798C /end MEASUREMENT
/begin MEASUREMENT Alt_nAltFltd_MP "Measuring point for filtered alternator speed" SWORD EngN 1 100 -16384.00 16383.50 FORMAT "%8.2" ECU_ADDRESS 0x7000A88C /end MEASUREMENT
/begin MEASUREMENT Alt_nAltSpdCmp "Compensation speed of alternator by engine speed" SWORD EngN_2 1 100 -65536.00 65534.00 FORMAT "%8.2" ECU_ADDRESS 0x6000798A /end MEASUREMENT
/begin MEASUREMENT Alt_nAltSpdCmpRaw "Raw compensation speed of alternator by engine speed" SWORD EngN_2 1 100 -65536.00 65534.00 FORMAT "%8.2" ECU_ADDRESS 0x60007988 /end MEASUREMENT
/begin MEASUREMENT Alt_nCutOff "Cutoff speed for alternator" SWORD EngN 1 100 -16384.00 16383.50 FORMAT "%8.2" ECU_ADDRESS 0x60008A2A /end MEASUREMENT
/begin MEASUREMENT Alt_nEngSpdDeltaSlow "Slow path engine speed deviation" SWORD EngN 1 100 -16384.00 16383.50 FORMAT "%8.2" ECU_ADDRESS 0x60007986 /end MEASUREMENT
/begin MEASUREMENT Alt_qBattFildNegFast "Battery current drop integral for fast path" SLONG q0p001_A_s_1 1 100 -2147483.64800 2147483.64700 FORMAT "%13.5" ECU_ADDRESS 0x600031EC /end MEASUREMENT
/begin MEASUREMENT Alt_qBattSumEep "Total charge present in battery" SLONG AmpSec 1 100 -21474836.4800 21474836.4700 FORMAT "%13.4" ECU_ADDRESS 0x600037B0 /end MEASUREMENT
/begin MEASUREMENT Alt_rAltExct "Filtered value of alternator field excitation duty" SWORD DtyCyc 1 100 -327.6800 327.6700 FORMAT "%8.4" ECU_ADDRESS 0x60008A28 /end MEASUREMENT
/begin MEASUREMENT Alt_rAltLoadFilOut_MP "Ratio of filtered alternator load" SWORD DtyCyc 1 100 -327.6800 327.6700 FORMAT "%8.4" ECU_ADDRESS 0x7000A840 /end MEASUREMENT
/begin MEASUREMENT Alt_rAltLoadFilTqCalcn_MP "Filtered altrernator load for torque calculation" SWORD DtyCyc 1 100 -327.6800 327.6700 FORMAT "%8.4" ECU_ADDRESS 0x7000A83E /end MEASUREMENT
/begin MEASUREMENT Alt_rAltLoadOld "Value of AltIO_rAltLoad in last raster" SWORD DtyCyc 1 100 -327.6800 327.6700 FORMAT "%8.4" ECU_ADDRESS 0x60007984 /end MEASUREMENT
/begin MEASUREMENT Alt_ratDfFlt_MP "Measuring point for filtered duty cycle" SWORD DtyCyc 1 100 -327.6800 327.6700 FORMAT "%8.4" ECU_ADDRESS 0x7000A88A /end MEASUREMENT
/begin MEASUREMENT Alt_ratSocSet_MP "Measuring point for SOC" SWORD Prc 1 100 -400.0000 399.9878 FORMAT "%8.4" ECU_ADDRESS 0x7000A888 /end MEASUREMENT
/begin MEASUREMENT Alt_ratTEnv_MP "Measuring point for temeprature adjusted SOC" SWORD Prc 1 100 -400.0000 399.9878 FORMAT "%8.4" ECU_ADDRESS 0x7000A886 /end MEASUREMENT
/begin MEASUREMENT Alt_rBattMeanPrev "Previous raster value of battery resistance" SWORD RBPtCel_r_0p00001_1 1 100 -0.3276800 0.3276700 FORMAT "%9.7" ECU_ADDRESS 0x60007A12 /end MEASUREMENT
/begin MEASUREMENT Alt_rDeltaDutyCyc "Delta duty cycle from alternator PWM signal" SWORD DtyCyc 1 100 -327.6800 327.6700 FORMAT "%8.4" ECU_ADDRESS 0x60007982 /end MEASUREMENT
/begin MEASUREMENT Alt_ReqGenrBkup_MP "Measuring point for status of activation of back up mode" UBYTE B_TRUE 1 100 0.00 1.00000000000 BIT_MASK 0x1 FORMAT "%13.11" ECU_ADDRESS 0x7000A884 /end MEASUREMENT
/begin MEASUREMENT Alt_stACGHiUReq "Alternator high voltage request due to fuel vapor lock" UBYTE B_TRUE 1 100 0.00 1.00000000000 BIT_MASK 0x1 FORMAT "%13.11" ECU_ADDRESS 0x6000F28A /end MEASUREMENT
/begin MEASUREMENT Alt_stAltLoadIdleUpCdn "Fast and slow path idle up request status" UBYTE OneToOne 1 100 0.00 255.0 FORMAT "%5.1" ECU_ADDRESS 0x6000E985 /end MEASUREMENT
/begin MEASUREMENT Alt_stBattOffsCorrCdn "Battery voltage offset correction learning release status" UWORD OneToOne 1 100 0.00 65535.00 FORMAT "%8.2" ECU_ADDRESS 0x60007980 /end MEASUREMENT
/begin MEASUREMENT Alt_stBattSoc "Status of Battery state of charge" UBYTE OneToOne 1 100 0.00 255.0 FORMAT "%5.1" ECU_ADDRESS 0x6000F051 /end MEASUREMENT
/begin MEASUREMENT Alt_stBlowrFan "State of blower fan after delay time" UBYTE B_TRUE 1 100 0.00 1.00000000000 BIT_MASK 0x1 FORMAT "%13.11" ECU_ADDRESS 0x6000E984 /end MEASUREMENT
/begin MEASUREMENT Alt_stCalcnPerd_MP "Measuring point used for the calculation of Delta duty cycle" UBYTE B_TRUE 1 100 0.00 1.00000000000 BIT_MASK 0x1 FORMAT "%13.11" ECU_ADDRESS 0x7000A83C /end MEASUREMENT
/begin MEASUREMENT Alt_stDchaAltUpprLimStk "Judgement for discharge with ACG upper limit stuck" UBYTE B_TRUE 1 100 0.00 1.00000000000 BIT_MASK 0x1 FORMAT "%13.11" ECU_ADDRESS 0x6000F289 /end MEASUREMENT
/begin MEASUREMENT Alt_stDecLoadVehCdn_MP "Status of decrement load enable condition" UBYTE OneToOne 1 100 0.00 255.0 FORMAT "%5.1" ECU_ADDRESS 0x7000A82C /end MEASUREMENT
/begin MEASUREMENT Alt_stDFog "State of defogger after delay time" UBYTE B_TRUE 1 100 0.00 1.00000000000 BIT_MASK 0x1 FORMAT "%13.11" ECU_ADDRESS 0x6000E983 /end MEASUREMENT
/begin MEASUREMENT Alt_stEPS "State of EPS after delay time" UBYTE B_TRUE 1 100 0.00 1.00000000000 BIT_MASK 0x1 FORMAT "%13.11" ECU_ADDRESS 0x6000E982 /end MEASUREMENT
/begin MEASUREMENT Alt_stErr "Error state of alternator" UBYTE OneToOne 1 100 0.00 255.0 FORMAT "%5.1" ECU_ADDRESS 0x6000F050 /end MEASUREMENT
/begin MEASUREMENT Alt_stExctCurrDly "State condition of excitation current" UBYTE B_TRUE 1 100 0.00 1.00000000000 BIT_MASK 0x1 FORMAT "%13.11" ECU_ADDRESS 0x6000E981 /end MEASUREMENT
/begin MEASUREMENT Alt_stFastGearCdn "Fast path gear condition status" UBYTE OneToOne 1 100 0.00 255.0 FORMAT "%5.1" ECU_ADDRESS 0x6000E980 /end MEASUREMENT
/begin MEASUREMENT Alt_stFrntFog "State of front fog lamp after delay time" UBYTE B_TRUE 1 100 0.00 1.00000000000 BIT_MASK 0x1 FORMAT "%13.11" ECU_ADDRESS 0x6000E97F /end MEASUREMENT
/begin MEASUREMENT Alt_stGov "Status of governor" UWORD OneToOne 1 100 0.00 65535.00 FORMAT "%8.2" ECU_ADDRESS 0x6000875A /end MEASUREMENT
/begin MEASUREMENT Alt_stLiSwtInfo "State of light switch after delay time" UBYTE B_TRUE 1 100 0.00 1.00000000000 BIT_MASK 0x1 FORMAT "%13.11" ECU_ADDRESS 0x6000E97E /end MEASUREMENT
/begin MEASUREMENT Alt_stRadioFan "State of radio fan after delay time" UBYTE B_TRUE 1 100 0.00 1.00000000000 BIT_MASK 0x1 FORMAT "%13.11" ECU_ADDRESS 0x6000E97D /end MEASUREMENT
/begin MEASUREMENT Alt_stRecup "Alternator recuperation status" UBYTE OneToOne 1 100 0.00 255.0 FORMAT "%5.1" ECU_ADDRESS 0x6000F04F /end MEASUREMENT
/begin MEASUREMENT Alt_stRecupVehCdn_MP "Status of vehicle pararmetes for evaluating alternator recuperation status" UBYTE OneToOne 1 100 0.00 255.0 FORMAT "%5.1" ECU_ADDRESS 0x7000A82B /end MEASUREMENT
/begin MEASUREMENT Alt_stRrFog "State of rear fog lamp after delay time" UBYTE B_TRUE 1 100 0.00 1.00000000000 BIT_MASK 0x1 FORMAT "%13.11" ECU_ADDRESS 0x6000E97C /end MEASUREMENT
/begin MEASUREMENT Alt_stSel "Status of used strategy" UWORD OneToOne 1 100 0.00 65535.00 FORMAT "%8.2" ECU_ADDRESS 0x60008758 /end MEASUREMENT
/begin MEASUREMENT Alt_stStgyFailSafe "Alternator fail safe modes" UWORD OneToOne 1 100 0.00 65535.00 FORMAT "%8.2" ECU_ADDRESS 0x60008756 /end MEASUREMENT
/begin MEASUREMENT Alt_stStgyFailSafeSel_MP "Measuring point for Alternator Failsafe Post selection" UBYTE OneToOne 1 100 0.00 255.0 FORMAT "%5.1" ECU_ADDRESS 0x7000A883 /end MEASUREMENT
/begin MEASUREMENT Alt_stStgyFailSafe_MP "Measuring point for Alternator fail safe modes" UBYTE OneToOne 1 100 0.00 255.0 FORMAT "%5.1" ECU_ADDRESS 0x7000A882 /end MEASUREMENT
/begin MEASUREMENT Alt_stVehErrCdn_MP "Status of sensor errors in alternator recuperation module" UBYTE OneToOne 1 100 0.00 255.0 FORMAT "%5.1" ECU_ADDRESS 0x7000A82A /end MEASUREMENT
/begin MEASUREMENT Alt_tiAltLoadGrdtFlt "Alternator gradiation filter time constant" SWORD Time_s 1 100 -327.6800 327.6700 FORMAT "%8.4" ECU_ADDRESS 0x6000797E /end MEASUREMENT
/begin MEASUREMENT Alt_tiDecLoad "Exit timer for Decrement load mode" SLONG Time_Dt 1 100 -2147.48364800 2147.48364700 FORMAT "%13.8" ECU_ADDRESS 0x600031E8 /end MEASUREMENT
/begin MEASUREMENT Alt_tiExctcrntGrdtFlt "Alternator Excitation gradient filter time constant" SWORD Time_s 1 100 -327.6800 327.6700 FORMAT "%8.4" ECU_ADDRESS 0x6000797C /end MEASUREMENT
/begin MEASUREMENT Alt_tiFFSlowDly "Delay time for slow path of feed forward" UWORD Time_s 1 100 0.00 655.3500 FORMAT "%8.4" ECU_ADDRESS 0x6000797A /end MEASUREMENT
/begin MEASUREMENT Alt_tiLoadResp "Load response Control Time" SWORD Time_s 1 100 -327.6800 327.6700 FORMAT "%8.4" ECU_ADDRESS 0x60008A26 /end MEASUREMENT
/begin MEASUREMENT Alt_tiLoadRespTmp "Temporary Load response Control Time" SWORD Time_s 1 100 -327.6800 327.6700 FORMAT "%8.4" ECU_ADDRESS 0x60007A10 /end MEASUREMENT
/begin MEASUREMENT Alt_tiRecup "Exit timer for Recuperation mode" SLONG Time_Dt 1 100 -2147.48364800 2147.48364700 FORMAT "%13.8" ECU_ADDRESS 0x600031E4 /end MEASUREMENT
/begin MEASUREMENT Alt_tiRefrActvEep "Accumulated Battery Refresh mode time" SLONG Time_sec_q1_COMPU 1 100 -2147483648.00 2147483647.00 FORMAT "%13.2" ECU_ADDRESS 0x50004D54 /end MEASUREMENT
/begin MEASUREMENT Alt_tiRefrBattFullEep "Refresh active time" SLONG Time_sec_q1_COMPU 1 100 -2147483648.00 2147483647.00 FORMAT "%13.2" ECU_ADDRESS 0x600037AC /end MEASUREMENT
/begin MEASUREMENT Alt_tiRefrDeactvEep "Time since last refresh" SLONG Time_sec_q1_COMPU 1 100 -2147483648.00 2147483647.00 FORMAT "%13.2" ECU_ADDRESS 0x600037A8 /end MEASUREMENT
/begin MEASUREMENT Alt_tqAltCmp "Alternator compensation torque by battery voltage" SWORD Trq 1 100 -3276.800 3276.700 FORMAT "%8.3" ECU_ADDRESS 0x60007978 /end MEASUREMENT
/begin MEASUREMENT Alt_tqAltCmpRaw "Raw alternator compensation torque by battery voltage" SWORD Trq 1 100 -3276.800 3276.700 FORMAT "%8.3" ECU_ADDRESS 0x60007976 /end MEASUREMENT
/begin MEASUREMENT Alt_tqAltLoadTqResv "Fast and Slow path torque reserve" SWORD Trq 1 100 -3276.800 3276.700 FORMAT "%8.3" ECU_ADDRESS 0x60007974 /end MEASUREMENT
/begin MEASUREMENT Alt_tqBlowrFan "Blower fan torque" SWORD Trq 1 100 -3276.800 3276.700 FORMAT "%8.3" ECU_ADDRESS 0x60007972 /end MEASUREMENT
/begin MEASUREMENT Alt_tqBlowrFanEstimn "Blower fan estimation torque" SWORD Trq 1 100 -3276.800 3276.700 FORMAT "%8.3" ECU_ADDRESS 0x60007970 /end MEASUREMENT
/begin MEASUREMENT Alt_tqBlowrFanFil "Torque for blower fan before filter" SWORD Trq 1 100 -3276.800 3276.700 FORMAT "%8.3" ECU_ADDRESS 0x6000796E /end MEASUREMENT
/begin MEASUREMENT Alt_tqDesCalcn_MP "Additional alternator desired torque calculated based on alternator load and time after engine start" SWORD Trq 1 100 -3276.800 3276.700 FORMAT "%8.3" ECU_ADDRESS 0x7000A83A /end MEASUREMENT
/begin MEASUREMENT Alt_tqDFog "Defogger torque" SWORD Trq 1 100 -3276.800 3276.700 FORMAT "%8.3" ECU_ADDRESS 0x6000796C /end MEASUREMENT
/begin MEASUREMENT Alt_tqDFogEstimn "Defogger estimation torque" SWORD Trq 1 100 -3276.800 3276.700 FORMAT "%8.3" ECU_ADDRESS 0x6000796A /end MEASUREMENT
/begin MEASUREMENT Alt_tqDFogFil "Torque for defogger before filter" SWORD Trq 1 100 -3276.800 3276.700 FORMAT "%8.3" ECU_ADDRESS 0x60007968 /end MEASUREMENT
/begin MEASUREMENT Alt_tqElecLoadTqCorrn "Electrical load torque correction" SWORD Trq 1 100 -3276.800 3276.700 FORMAT "%8.3" ECU_ADDRESS 0x60007966 /end MEASUREMENT
/begin MEASUREMENT Alt_tqEPS "EPS torque" SWORD Trq 1 100 -3276.800 3276.700 FORMAT "%8.3" ECU_ADDRESS 0x60007964 /end MEASUREMENT
/begin MEASUREMENT Alt_tqEPSEstimn "EPS estimation torque" SWORD Trq 1 100 -3276.800 3276.700 FORMAT "%8.3" ECU_ADDRESS 0x60007962 /end MEASUREMENT
/begin MEASUREMENT Alt_tqEPSFil "Torque for EPS before filter" SWORD Trq 1 100 -3276.800 3276.700 FORMAT "%8.3" ECU_ADDRESS 0x60007960 /end MEASUREMENT
/begin MEASUREMENT Alt_tqFFAltLoadEstimn "Feed forward estimation torque" SWORD Trq 1 100 -3276.800 3276.700 FORMAT "%8.3" ECU_ADDRESS 0x6000795E /end MEASUREMENT
/begin MEASUREMENT Alt_tqFFAltLoadFast "Fast path of feed forward estimation torque" SWORD Trq 1 100 -3276.800 3276.700 FORMAT "%8.3" ECU_ADDRESS 0x6000795C /end MEASUREMENT
/begin MEASUREMENT Alt_tqFFAltLoadFastFild "Fast path of feed forward estimation filtered torque" SWORD Trq 1 100 -3276.800 3276.700 FORMAT "%8.3" ECU_ADDRESS 0x6000795A /end MEASUREMENT
/begin MEASUREMENT Alt_tqFFAltLoadFastResv "Fast path torque reserve" SWORD Trq 1 100 -3276.800 3276.700 FORMAT "%8.3" ECU_ADDRESS 0x60007958 /end MEASUREMENT
/begin MEASUREMENT Alt_tqFFAltLoadFastResvFild "Fast path filtered torque reserve" SWORD Trq 1 100 -3276.800 3276.700 FORMAT "%8.3" ECU_ADDRESS 0x60007956 /end MEASUREMENT
/begin MEASUREMENT Alt_tqFFAltLoadSlow "Slow path of feed forward estimation torque" SWORD Trq 1 100 -3276.800 3276.700 FORMAT "%8.3" ECU_ADDRESS 0x60007954 /end MEASUREMENT
/begin MEASUREMENT Alt_tqFFAltLoadSlowFild "Slow path of feed forward estimation filtered torque" SWORD Trq 1 100 -3276.800 3276.700 FORMAT "%8.3" ECU_ADDRESS 0x60007952 /end MEASUREMENT
/begin MEASUREMENT Alt_tqFFAltLoadSlowResv "Slow path torque reserve" SWORD Trq 1 100 -3276.800 3276.700 FORMAT "%8.3" ECU_ADDRESS 0x60007950 /end MEASUREMENT
/begin MEASUREMENT Alt_tqFFAltLoadSlowResvFild "Slow path filtered torque reserve" SWORD Trq 1 100 -3276.800 3276.700 FORMAT "%8.3" ECU_ADDRESS 0x6000794E /end MEASUREMENT
/begin MEASUREMENT Alt_tqFrntFog "Front fog lamp torque" SWORD Trq 1 100 -3276.800 3276.700 FORMAT "%8.3" ECU_ADDRESS 0x6000794C /end MEASUREMENT
/begin MEASUREMENT Alt_tqFrntFogEstimn "Front fog lamp estimation torque" SWORD Trq 1 100 -3276.800 3276.700 FORMAT "%8.3" ECU_ADDRESS 0x6000794A /end MEASUREMENT
/begin MEASUREMENT Alt_tqFrntFogFil "Torque for front fog lamp before filter" SWORD Trq 1 100 -3276.800 3276.700 FORMAT "%8.3" ECU_ADDRESS 0x60007948 /end MEASUREMENT
/begin MEASUREMENT Alt_tqHdLiEstimn "Headlight estimation torque" SWORD Trq 1 100 -3276.800 3276.700 FORMAT "%8.3" ECU_ADDRESS 0x60007946 /end MEASUREMENT
/begin MEASUREMENT Alt_tqHdLiFil "Torque for headlight before filter" SWORD Trq 1 100 -3276.800 3276.700 FORMAT "%8.3" ECU_ADDRESS 0x60007944 /end MEASUREMENT
/begin MEASUREMENT Alt_tqHdLiHi "Headlight high torque" SWORD Trq 1 100 -3276.800 3276.700 FORMAT "%8.3" ECU_ADDRESS 0x60007942 /end MEASUREMENT
/begin MEASUREMENT Alt_tqHdLiLo "Headlight low torque" SWORD Trq 1 100 -3276.800 3276.700 FORMAT "%8.3" ECU_ADDRESS 0x60007940 /end MEASUREMENT
/begin MEASUREMENT Alt_tqRadioFanEstimn "Radio fan estimation torque" SWORD Trq 1 100 -3276.800 3276.700 FORMAT "%8.3" ECU_ADDRESS 0x6000793E /end MEASUREMENT
/begin MEASUREMENT Alt_tqRadioFanFil "Torque for radio fan before filter" SWORD Trq 1 100 -3276.800 3276.700 FORMAT "%8.3" ECU_ADDRESS 0x6000793C /end MEASUREMENT
/begin MEASUREMENT Alt_tqRadioFanHi "Radio fan high torque" SWORD Trq 1 100 -3276.800 3276.700 FORMAT "%8.3" ECU_ADDRESS 0x6000793A /end MEASUREMENT
/begin MEASUREMENT Alt_tqRadioFanLo "Radio fan low torque" SWORD Trq 1 100 -3276.800 3276.700 FORMAT "%8.3" ECU_ADDRESS 0x60007938 /end MEASUREMENT
/begin MEASUREMENT Alt_tqResvAddlACGHiU "Actual additional torque reserve incase of engine start with vapor lock after filter" SWORD Trq 1 100 -3276.800 3276.700 FORMAT "%8.3" ECU_ADDRESS 0x60007936 /end MEASUREMENT
/begin MEASUREMENT Alt_tqResvBefACGHiUReq "Alternator torque reserve before adding ACG high voltage torque" SWORD Trq 1 100 -3276.800 3276.700 FORMAT "%8.3" ECU_ADDRESS 0x60007934 /end MEASUREMENT
/begin MEASUREMENT Alt_tqResvCalcn_MP "Additional alternator torque reserve calculated based on alternator load and time after engine start" SWORD Trq 1 100 -3276.800 3276.700 FORMAT "%8.3" ECU_ADDRESS 0x7000A838 /end MEASUREMENT
/begin MEASUREMENT Alt_tqRrFog "State of rear fog lamp after delay time" SWORD Trq 1 100 -3276.800 3276.700 FORMAT "%8.3" ECU_ADDRESS 0x60007932 /end MEASUREMENT
/begin MEASUREMENT Alt_tqRrFogEstimn "Rear fog lamp estimation torque" SWORD Trq 1 100 -3276.800 3276.700 FORMAT "%8.3" ECU_ADDRESS 0x60007930 /end MEASUREMENT
/begin MEASUREMENT Alt_tqRrFogFil "Torque for rear fog lamp before filter" SWORD Trq 1 100 -3276.800 3276.700 FORMAT "%8.3" ECU_ADDRESS 0x6000792E /end MEASUREMENT
/begin MEASUREMENT Alt_tqWipr "Wiper torque" SWORD Trq 1 100 -3276.800 3276.700 FORMAT "%8.3" ECU_ADDRESS 0x6000792C /end MEASUREMENT
/begin MEASUREMENT Alt_tqWiprEstimn "Wiper estimation torque" SWORD Trq 1 100 -3276.800 3276.700 FORMAT "%8.3" ECU_ADDRESS 0x6000792A /end MEASUREMENT
/begin MEASUREMENT Alt_tqWiprFil "Torque for wiper before filter" SWORD Trq 1 100 -3276.800 3276.700 FORMAT "%8.3" ECU_ADDRESS 0x60007928 /end MEASUREMENT
/begin MEASUREMENT Alt_trqDes "Application parameter for Desired torque for Alternator" SWORD Trq 1 100 -3276.800 3276.700 FORMAT "%8.3" ECU_ADDRESS 0x6000939E /end MEASUREMENT
/begin MEASUREMENT Alt_trqResv "Alternator reserved torque" SWORD Trq 1 100 -3276.800 3276.700 FORMAT "%8.3" ECU_ADDRESS 0x6000939C /end MEASUREMENT
/begin MEASUREMENT Alt_trqWhlDesOld "Previous raster value of wheel torque demand" SLONG TrqPrpHigh 1 100 -214748364.800 214748364.700 FORMAT "%13.3" ECU_ADDRESS 0x500010BC /end MEASUREMENT
/begin MEASUREMENT Alt_uActFb_MP "Measuring point to view the feedback voltage from alternator" SWORD RBPtCel_u_10p0_1 1 100 -327680.0 327670.0 FORMAT "%8.1" ECU_ADDRESS 0x7000A880 /end MEASUREMENT
/begin MEASUREMENT Alt_uActQnts "Alternator quantized voltage levels" SWORD Volt_Alt_100mV 1 100 -3276.800 3276.700 FORMAT "%8.3" ECU_ADDRESS 0x60008A24 /end MEASUREMENT
/begin MEASUREMENT Alt_uAltDelta_MP "Voltage delta of voltage set point" SWORD RBPtCel_u_10p0_1 1 100 -327680.0 327670.0 FORMAT "%8.1" ECU_ADDRESS 0x7000A87E /end MEASUREMENT
/begin MEASUREMENT Alt_uAltDesAfterHiSetPoint "Alternator high voltage set point in case of fuel vapor lock" SWORD RBPtCel_u_10p0_1 1 100 -327680.0 327670.0 FORMAT "%8.1" ECU_ADDRESS 0x60007A0E /end MEASUREMENT
/begin MEASUREMENT Alt_uAltDesHiSetPoint "Alternator filled high voltage set point in case of fuel vapor Lock" SWORD RBPtCel_u_10p0_1 1 100 -327680.0 327670.0 FORMAT "%8.1" ECU_ADDRESS 0x60007A0C /end MEASUREMENT
/begin MEASUREMENT Alt_uAltDesLimp "Alternator voltage after ramp limitation" SWORD RBPtCel_u_10p0_1 1 100 -327680.0 327670.0 FORMAT "%8.1" ECU_ADDRESS 0x60007A0A /end MEASUREMENT
/begin MEASUREMENT Alt_uAltFltQnts_MP "Measuring point to view Quatised Alternator voltage" SWORD Volt_Alt_100mV 1 100 -3276.800 3276.700 FORMAT "%8.3" ECU_ADDRESS 0x7000A87C /end MEASUREMENT
/begin MEASUREMENT Alt_uAltFlt_MP "Measuring point to view Filtered alternator set point voltage" SWORD Volt_Batt 1 100 -655360.0 655340.0 FORMAT "%8.1" ECU_ADDRESS 0x7000A87A /end MEASUREMENT
/begin MEASUREMENT Alt_uAltLim_MP "Measuring point to view alternator voltage set point limited between electrical load activation and Alternator fail safe" SWORD RBPtCel_u_10p0_1 1 100 -327680.0 327670.0 FORMAT "%8.1" ECU_ADDRESS 0x7000A878 /end MEASUREMENT
/begin MEASUREMENT Alt_uAltMaxGovrQnts_MP "Measuring point to view maximum alternator quatized voltage" SWORD Volt_Alt_100mV 1 100 -3276.800 3276.700 FORMAT "%8.3" ECU_ADDRESS 0x7000A876 /end MEASUREMENT
/begin MEASUREMENT Alt_uAltMaxGovr_MP "Measuring point to view maximum alternator voltage" SWORD RBPtCel_u_10p0_1 1 100 -327680.0 327670.0 FORMAT "%8.1" ECU_ADDRESS 0x7000A874 /end MEASUREMENT
/begin MEASUREMENT Alt_uAltMaxVltg_MP "Alternator Maximum Voltage" SWORD Volt_Batt 1 100 -655360.0 655340.0 FORMAT "%8.1" ECU_ADDRESS 0x7000A872 /end MEASUREMENT
/begin MEASUREMENT Alt_uAltMax_MP "Measuring point to view maximum alternator voltage" SWORD Volt_Batt 1 100 -655360.0 655340.0 FORMAT "%8.1" ECU_ADDRESS 0x7000A870 /end MEASUREMENT
/begin MEASUREMENT Alt_uAltMinGovrQnts_MP "Measuring point to view minimum alternator quatized voltage" SWORD Volt_Alt_100mV 1 100 -3276.800 3276.700 FORMAT "%8.3" ECU_ADDRESS 0x7000A86E /end MEASUREMENT
/begin MEASUREMENT Alt_uAltMinGovr_MP "Measuring point to view minimum alternator voltage" SWORD RBPtCel_u_10p0_1 1 100 -327680.0 327670.0 FORMAT "%8.1" ECU_ADDRESS 0x7000A86C /end MEASUREMENT
/begin MEASUREMENT Alt_uAltMinReq_MP "Minimum supply voltage" SWORD Volt_Batt 1 100 -655360.0 655340.0 FORMAT "%8.1" ECU_ADDRESS 0x7000A86A /end MEASUREMENT
/begin MEASUREMENT Alt_uAltMin_MP "Measuring point to view minimum alternator voltage" SWORD Volt_Batt 1 100 -655360.0 655340.0 FORMAT "%8.1" ECU_ADDRESS 0x7000A868 /end MEASUREMENT
/begin MEASUREMENT Alt_uBattAcclIn_MP "Calculated voltage setpoint for acceleration mode" SWORD Volt_Batt 1 100 -655360.0 655340.0 FORMAT "%8.1" ECU_ADDRESS 0x7000A866 /end MEASUREMENT
/begin MEASUREMENT Alt_uBattDeBefFild "Battery deviation voltage before filter" SWORD Volt_Batt 1 100 -655360.0 655340.0 FORMAT "%8.1" ECU_ADDRESS 0x60007926 /end MEASUREMENT
/begin MEASUREMENT Alt_uBattDeclIn_MP "Calculated voltage setpoint for deceleration mode" SWORD Volt_Batt 1 100 -655360.0 655340.0 FORMAT "%8.1" ECU_ADDRESS 0x7000A864 /end MEASUREMENT
/begin MEASUREMENT Alt_uBattDeclRamp_MP "Measurement point for Ramp battery Voltage during Deceleration" SWORD Volt_Batt 1 100 -655360.0 655340.0 FORMAT "%8.1" ECU_ADDRESS 0x7000A862 /end MEASUREMENT
/begin MEASUREMENT Alt_uBattDeclRapid_MP "Measurement point for Rapid battery voltage during deceleration" SWORD Volt_Batt 1 100 -655360.0 655340.0 FORMAT "%8.1" ECU_ADDRESS 0x7000A860 /end MEASUREMENT
/begin MEASUREMENT Alt_uBattDeclSpIn_MP "Measurement point for Battery voltage setpoint during deceleration" SWORD Volt_Batt 1 100 -655360.0 655340.0 FORMAT "%8.1" ECU_ADDRESS 0x7000A85E /end MEASUREMENT
/begin MEASUREMENT Alt_uBattDeFild "Battery deviation voltage filtered" SWORD Volt_Batt 1 100 -655360.0 655340.0 FORMAT "%8.1" ECU_ADDRESS 0x600394D0 /end MEASUREMENT
/begin MEASUREMENT Alt_uBattDeltaFast "Fast path battery voltage delta" SWORD Volt_Batt 1 100 -655360.0 655340.0 FORMAT "%8.1" ECU_ADDRESS 0x60007924 /end MEASUREMENT
/begin MEASUREMENT Alt_uBattDeltaFastPeak "Fast path battery voltage delta peak" SWORD Volt_Batt 1 100 -655360.0 655340.0 FORMAT "%8.1" ECU_ADDRESS 0x60007922 /end MEASUREMENT
/begin MEASUREMENT Alt_uBattFildFast "Fast path battery voltage filtered" SWORD Volt_Batt 1 100 -655360.0 655340.0 FORMAT "%8.1" ECU_ADDRESS 0x60007920 /end MEASUREMENT
/begin MEASUREMENT Alt_uBattMaxAntiFlick "Maximun voltage limit for anti-flickering" SWORD Volt_Batt 1 100 -655360.0 655340.0 FORMAT "%8.1" ECU_ADDRESS 0x60008A22 /end MEASUREMENT
/begin MEASUREMENT Alt_uBattMaxGovrQnts_MP "Measuring point to view maximum quantised battery voltage" SWORD Volt_Alt_100mV 1 100 -3276.800 3276.700 FORMAT "%8.3" ECU_ADDRESS 0x7000A85C /end MEASUREMENT
/begin MEASUREMENT Alt_uBattMaxIn_MP "Measuring point to view Maximum battery voltage increment step size when electrical loadsd are activated" SWORD Volt_Batt 1 100 -655360.0 655340.0 FORMAT "%8.1" ECU_ADDRESS 0x7000A85A /end MEASUREMENT
/begin MEASUREMENT Alt_uBattMax_MP "Setpoint for maximum battery voltage" SWORD Volt_Batt 1 100 -655360.0 655340.0 FORMAT "%8.1" ECU_ADDRESS 0x7000A858 /end MEASUREMENT
/begin MEASUREMENT Alt_uBattMinGovrQnts_MP "Measuring point to view minimum quantised battery voltage" SWORD Volt_Alt_100mV 1 100 -3276.800 3276.700 FORMAT "%8.3" ECU_ADDRESS 0x7000A856 /end MEASUREMENT
/begin MEASUREMENT Alt_uBattMinIn_MP "Calculated minimum voltage" SWORD Volt_Batt 1 100 -655360.0 655340.0 FORMAT "%8.1" ECU_ADDRESS 0x7000A854 /end MEASUREMENT
/begin MEASUREMENT Alt_uBattMin_MP "Setpoint for minimum battery voltage" SWORD Volt_Batt 1 100 -655360.0 655340.0 FORMAT "%8.1" ECU_ADDRESS 0x7000A852 /end MEASUREMENT
/begin MEASUREMENT Alt_uBattOffsCorr "Battery deviation offset correction voltage" SWORD Volt_Batt 1 100 -655360.0 655340.0 FORMAT "%8.1" ECU_ADDRESS 0x6000791E /end MEASUREMENT
/begin MEASUREMENT Alt_uBattOptIn_MP "Calculated optimum battery voltage" SWORD Volt_Batt 1 100 -655360.0 655340.0 FORMAT "%8.1" ECU_ADDRESS 0x7000A850 /end MEASUREMENT
/begin MEASUREMENT Alt_uBattUFild "Battery voltage after filled" SWORD Volt_Batt 1 100 -655360.0 655340.0 FORMAT "%8.1" ECU_ADDRESS 0x6000791C /end MEASUREMENT
/begin MEASUREMENT Alt_uBlowrDelta "Delta value of battery voltage" SWORD Volt_q1 1 100 -32768.00 32767.00 FORMAT "%8.2" ECU_ADDRESS 0x6000791A /end MEASUREMENT
/begin MEASUREMENT Alt_uBlowrLst "Previous value of battery voltage" SWORD Volt_q1 1 100 -32768.00 32767.00 FORMAT "%8.2" ECU_ADDRESS 0x60007918 /end MEASUREMENT
/begin MEASUREMENT Alt_uDecI_MP "Measuring point to view minimum voltage set point during acceleration" SWORD RBPtCel_u_10p0_1 1 100 -327680.0 327670.0 FORMAT "%8.1" ECU_ADDRESS 0x7000A84E /end MEASUREMENT
/begin MEASUREMENT Alt_uDes "Desired voltage" SWORD Volt_Batt 1 100 -655360.0 655340.0 FORMAT "%8.1" ECU_ADDRESS 0x60008A20 /end MEASUREMENT
/begin MEASUREMENT Alt_uDesOld "Old value for Desired voltage" SWORD Volt_Batt 1 100 -655360.0 655340.0 FORMAT "%8.1" ECU_ADDRESS 0x60007A08 /end MEASUREMENT
/begin MEASUREMENT Alt_uDesTmp "Alternator desired voltage, temporary storage" SLONG RBPtCel_u_10p0_1 1 100 -21474836480.0 21474836470.0 FORMAT "%13.1" ECU_ADDRESS 0x600031F4 /end MEASUREMENT
/begin MEASUREMENT Alt_uFastBattDelta "Fast path battery voltage delta covert from mV to V" SWORD RBPtCel_u_0p02_1 1 100 -655.3600 655.3400 FORMAT "%8.4" ECU_ADDRESS 0x60007916 /end MEASUREMENT
/begin MEASUREMENT Alt_uFastBattStabFild "Fast path Batttery voltage filtered value for stable judgement" SWORD Volt_Batt 1 100 -655360.0 655340.0 FORMAT "%8.1" ECU_ADDRESS 0x60007914 /end MEASUREMENT
/begin MEASUREMENT Alt_uIncl_MP "Measuring point to view maximum voltage set point during deceleration" SWORD RBPtCel_u_10p0_1 1 100 -327680.0 327670.0 FORMAT "%8.1" ECU_ADDRESS 0x7000A84C /end MEASUREMENT
/begin MEASUREMENT Alt_uMeasdFild_MP "Measuring point to view filtered measured voltage at alternator" SWORD RBPtCel_u_10p0_1 1 100 -327680.0 327670.0 FORMAT "%8.1" ECU_ADDRESS 0x7000A84A /end MEASUREMENT
/begin MEASUREMENT Alt_uNrmTBatt_MP "Measuring point to view Battery temperature limited between electrical loads active" SWORD Volt_Batt 1 100 -655360.0 655340.0 FORMAT "%8.1" ECU_ADDRESS 0x7000A848 /end MEASUREMENT
/begin MEASUREMENT Alt_uNrmTEnv_MP "Measuring point to view Battery temperature limited between electrical loads active" SWORD Volt_Batt 1 100 -655360.0 655340.0 FORMAT "%8.1" ECU_ADDRESS 0x7000A846 /end MEASUREMENT
/begin MEASUREMENT APP_bAlive "Status alive detection of the acceleration pedal" UBYTE B_TRUE 1 100 0.00 1.00000000000 BIT_MASK 0x1 FORMAT "%13.11" ECU_ADDRESS 0x6000F2B9 /end MEASUREMENT
/begin MEASUREMENT APP_bAPP1FinalDef "Status Sensor 1 of the acceleration pedal finally defect" UBYTE B_TRUE 1 100 0.00 1.00000000000 BIT_MASK 0x1 FORMAT "%13.11" ECU_ADDRESS 0x6000E979 /end MEASUREMENT
/begin MEASUREMENT APP_bAPP1ProvDef "Status Sensor 1 of the acceleration pedal temporary defect" UBYTE B_TRUE 1 100 0.00 1.00000000000 BIT_MASK 0x1 FORMAT "%13.11" ECU_ADDRESS 0x6000E978 /end MEASUREMENT
/begin MEASUREMENT APP_bAPP2FinalDef "Status Sensor 2 of the acceleration pedal finally defect" UBYTE B_TRUE 1 100 0.00 1.00000000000 BIT_MASK 0x1 FORMAT "%13.11" ECU_ADDRESS 0x6000E977 /end MEASUREMENT
/begin MEASUREMENT APP_bAPP2ProvDef "Status Sensor 2 of the acceleration pedal temporary defect" UBYTE B_TRUE 1 100 0.00 1.00000000000 BIT_MASK 0x1 FORMAT "%13.11" ECU_ADDRESS 0x6000E976 /end MEASUREMENT
/begin MEASUREMENT APP_bAPPNTP "Status No Load Test Impuls of the acceleration pedal" UBYTE B_TRUE 1 100 0.00 1.00000000000 BIT_MASK 0x1 FORMAT "%13.11" ECU_ADDRESS 0x70005482 /end MEASUREMENT
/begin MEASUREMENT APP_bBrkActv "Status brake" UBYTE B_TRUE 1 100 0.00 1.00000000000 BIT_MASK 0x1 FORMAT "%13.11" ECU_ADDRESS 0x7000544C /end MEASUREMENT
/begin MEASUREMENT APP_bKDInfo "Status Kickdown" UBYTE B_TRUE 1 100 0.00 1.00000000000 BIT_MASK 0x1 FORMAT "%13.11" ECU_ADDRESS 0x6000E975 /end MEASUREMENT
/begin MEASUREMENT APP_bPhyHigh1 "Temporary physical range high error of APP sensor 1" UBYTE B_TRUE 1 100 0.00 1.00000000000 BIT_MASK 0x1 FORMAT "%13.11" ECU_ADDRESS 0x6000F2B8 /end MEASUREMENT
/begin MEASUREMENT APP_bPhyHigh1Deb "Debounced physical range high error of APP sensor 1" UBYTE B_TRUE 1 100 0.00 1.00000000000 BIT_MASK 0x1 FORMAT "%13.11" ECU_ADDRESS 0x6000F2B7 /end MEASUREMENT
/begin MEASUREMENT APP_bPhyHigh2 "Temporary physical range high error of APP sensor 2" UBYTE B_TRUE 1 100 0.00 1.00000000000 BIT_MASK 0x1 FORMAT "%13.11" ECU_ADDRESS 0x6000F2B6 /end MEASUREMENT
/begin MEASUREMENT APP_bPhyHigh2Deb "Debounced physical range high error of APP sensor 2" UBYTE B_TRUE 1 100 0.00 1.00000000000 BIT_MASK 0x1 FORMAT "%13.11" ECU_ADDRESS 0x6000F2B5 /end MEASUREMENT
/begin MEASUREMENT APP_bPhyLow1 "Temporary physical range low error of APP sensor 1" UBYTE B_TRUE 1 100 0.00 1.00000000000 BIT_MASK 0x1 FORMAT "%13.11" ECU_ADDRESS 0x6000F2B4 /end MEASUREMENT
/begin MEASUREMENT APP_bPhyLow1Deb "Debounced physical range low error of APP sensor 1" UBYTE B_TRUE 1 100 0.00 1.00000000000 BIT_MASK 0x1 FORMAT "%13.11" ECU_ADDRESS 0x6000F2B3 /end MEASUREMENT
/begin MEASUREMENT APP_bPhyLow2 "Temporary physical range low error of APP sensor 2" UBYTE B_TRUE 1 100 0.00 1.00000000000 BIT_MASK 0x1 FORMAT "%13.11" ECU_ADDRESS 0x6000F2B2 /end MEASUREMENT
/begin MEASUREMENT APP_bPhyLow2Deb "Debounced physical range low error of APP sensor 2" UBYTE B_TRUE 1 100 0.00 1.00000000000 BIT_MASK 0x1 FORMAT "%13.11" ECU_ADDRESS 0x6000F2B1 /end MEASUREMENT
/begin MEASUREMENT APP_bPlaBrk "Status acceleration pedal brake plausibility" UBYTE B_TRUE 1 100 0.00 1.00000000000 BIT_MASK 0x1 FORMAT "%13.11" ECU_ADDRESS 0x6000F2B0 /end MEASUREMENT
/begin MEASUREMENT APP_bSRCHigh1 "Status temporary SRC-High error Sensor 1" UBYTE B_TRUE 1 100 0.00 1.00000000000 BIT_MASK 0x1 FORMAT "%13.11" ECU_ADDRESS 0x6000F2AF /end MEASUREMENT
/begin MEASUREMENT APP_bSRCHigh1Deb "Status debounced SRC-High error Sensor 1" UBYTE B_TRUE 1 100 0.00 1.00000000000 BIT_MASK 0x1 FORMAT "%13.11" ECU_ADDRESS 0x6000F2AE /end MEASUREMENT
/begin MEASUREMENT APP_bSRCHigh2 "Status temporary SRC-High error Sensor 2" UBYTE B_TRUE 1 100 0.00 1.00000000000 BIT_MASK 0x1 FORMAT "%13.11" ECU_ADDRESS 0x6000F2AD /end MEASUREMENT
/begin MEASUREMENT APP_bSRCHigh2Deb "Status debounced SRC-High error Sensor 2" UBYTE B_TRUE 1 100 0.00 1.00000000000 BIT_MASK 0x1 FORMAT "%13.11" ECU_ADDRESS 0x6000F2AC /end MEASUREMENT
/begin MEASUREMENT APP_bSRCLow1 "Status temporary SRC-Low error Sensor 1" UBYTE B_TRUE 1 100 0.00 1.00000000000 BIT_MASK 0x1 FORMAT "%13.11" ECU_ADDRESS 0x6000F2AB /end MEASUREMENT
/begin MEASUREMENT APP_bSRCLow1Deb "Status debounced SRC-Low error Sensor 1" UBYTE B_TRUE 1 100 0.00 1.00000000000 BIT_MASK 0x1 FORMAT "%13.11" ECU_ADDRESS 0x6000F2AA /end MEASUREMENT
/begin MEASUREMENT APP_bSRCLow2 "Status temporary SRC-Low error Sensor 2" UBYTE B_TRUE 1 100 0.00 1.00000000000 BIT_MASK 0x1 FORMAT "%13.11" ECU_ADDRESS 0x6000F2A9 /end MEASUREMENT
/begin MEASUREMENT APP_bSRCLow2Deb "Status debounced SRC-Low error Sensor 2" UBYTE B_TRUE 1 100 0.00 1.00000000000 BIT_MASK 0x1 FORMAT "%13.11" ECU_ADDRESS 0x6000F2A8 /end MEASUREMENT
/begin MEASUREMENT APP_bSync "Status temporary sync check" UBYTE B_TRUE 1 100 0.00 1.00000000000 BIT_MASK 0x1 FORMAT "%13.11" ECU_ADDRESS 0x6000E96D /end MEASUREMENT
/begin MEASUREMENT APP_bSyncChkOld "Status previous temporary sync check" UBYTE B_TRUE 1 100 0.00 1.00000000000 BIT_MASK 0x1 FORMAT "%13.11" ECU_ADDRESS 0x7000544D /end MEASUREMENT
/begin MEASUREMENT APP_bSyncDeb "Status debounced sync check" UBYTE B_TRUE 1 100 0.00 1.00000000000 BIT_MASK 0x1 FORMAT "%13.11" ECU_ADDRESS 0x6000E96C /end MEASUREMENT
/begin MEASUREMENT APP_cntrIniDrv "ReIni drive counter" UBYTE OneToOne 1 100 0.00 255.0 FORMAT "%5.1" ECU_ADDRESS 0x6000E97A /end MEASUREMENT
/begin MEASUREMENT APP_cntrReIni "ReIni counter" UBYTE OneToOne 1 100 0.00 255.0 FORMAT "%5.1" ECU_ADDRESS 0x6000E96B /end MEASUREMENT
/begin MEASUREMENT APP_d2ratUnFlt "Second derivative of unfiltered accelarator pedal ratio" SLONG q0p01862_Perc_DIV_s2 1 100 -40000000.0000 39999999.9814 FORMAT "%13.4" ECU_ADDRESS 0x500010A8 /end MEASUREMENT
/begin MEASUREMENT APP_d2ratUnFltOld "Old value of second derivative of unfiltered accelarator pedal ratio" SLONG q0p01862_Perc_DIV_s2 1 100 -40000000.0000 39999999.9814 FORMAT "%13.4" ECU_ADDRESS 0x500010AC /end MEASUREMENT
/begin MEASUREMENT APP_drUnFltOld "Old value of rate of change of unfiltered pedal ratio" SWORD PrcPerSec 1 100 -20000.00 19999.39 FORMAT "%8.2" ECU_ADDRESS 0x6000790A /end MEASUREMENT
/begin MEASUREMENT APP_flgHiGrdt "True: Gradient of acceleration pedal above threshold" UBYTE B_TRUE 1 100 0.00 1.00000000000 BIT_MASK 0x1 FORMAT "%13.11" ECU_ADDRESS 0x6000F2A5 /end MEASUREMENT
/begin MEASUREMENT APP_flgMaxLrnClrActv "Tester request to clear the learned value is active" UBYTE B_TRUE 1 100 0.00 1.00000000000 BIT_MASK 0x1 FORMAT "%13.11" ECU_ADDRESS 0x6000E974 /end MEASUREMENT
/begin MEASUREMENT APP_flgOscnCfmd "Accelarator pedal Oscillation Confirmed" UBYTE B_TRUE 1 100 0.00 1.00000000000 BIT_MASK 0x1 FORMAT "%13.11" ECU_ADDRESS 0x6000E973 /end MEASUREMENT
/begin MEASUREMENT APP_flgOscnCfmdIdleTout "Oscillation confirmed timeout due to pedal ratio not being in idle" UBYTE B_TRUE 1 100 0.00 1.00000000000 BIT_MASK 0x1 FORMAT "%13.11" ECU_ADDRESS 0x6000E972 /end MEASUREMENT
/begin MEASUREMENT APP_flgOscnCfmdNoIdleTout "Oscillation confirmed timeout due to pedal ratio not being in idle" UBYTE B_TRUE 1 100 0.00 1.00000000000 BIT_MASK 0x1 FORMAT "%13.11" ECU_ADDRESS 0x6000E971 /end MEASUREMENT
/begin MEASUREMENT APP_flgOscnCfmdTout "Oscillation confirmed timeout" UBYTE B_TRUE 1 100 0.00 1.00000000000 BIT_MASK 0x1 FORMAT "%13.11" ECU_ADDRESS 0x6000E970 /end MEASUREMENT
/begin MEASUREMENT APP_flgOscnDetnEnad "Oscillation detection enabled" UBYTE B_TRUE 1 100 0.00 1.00000000000 BIT_MASK 0x1 FORMAT "%13.11" ECU_ADDRESS 0x6000E96F /end MEASUREMENT
/begin MEASUREMENT APP_flgOscnExpt "Accelarator pedal oscillation expected" UBYTE B_TRUE 1 100 0.00 1.00000000000 BIT_MASK 0x1 FORMAT "%13.11" ECU_ADDRESS 0x6000E96E /end MEASUREMENT
/begin MEASUREMENT APP_rChk "APP value checked for brake plausibility and living signal" SWORD Prc 1 100 -400.0000 399.9878 FORMAT "%8.4" ECU_ADDRESS 0x60007910 /end MEASUREMENT
/begin MEASUREMENT APP_rUnLim "acceleration pedal ratio by the acceleration brake plausibility in normal and limp mode" SWORD Prc 1 100 -400.0000 399.9878 FORMAT "%8.4" ECU_ADDRESS 0x6000790E /end MEASUREMENT
/begin MEASUREMENT APP_stKD "State of accelerator pedal kick down" UBYTE dez 1 100 0.00 255.0 FORMAT "%5.1" ECU_ADDRESS 0x6000F7A1 /end MEASUREMENT
/begin MEASUREMENT APP_stRawExcddMax_mp "Flag to check Raw APP value exceeded Current Max value." UBYTE OneToOne 1 100 0.00 255.0 FORMAT "%5.1" ECU_ADDRESS 0x7000A829 /end MEASUREMENT
/begin MEASUREMENT APP_stTmrRawExcddTmp_mp "Flag to check Raw APP exceeded temporary value" UBYTE OneToOne 1 100 0.00 255.0 FORMAT "%5.1" ECU_ADDRESS 0x7000A828 /end MEASUREMENT
/begin MEASUREMENT APP_tiMaxLrnTmr_mp "Difference time to check APP sensor maximum value learning" SWORD Time_ms 1 100 -327680.0 327670.0 FORMAT "%8.1" ECU_ADDRESS 0x7000A826 /end MEASUREMENT
/begin MEASUREMENT APP_uCurrSnsrMax "Acceleration pedal sensor current maximum learnt voltage value" SWORD Volt 1 100 -6553.600 6553.400 FORMAT "%8.3" ECU_ADDRESS 0x600093F6 /end MEASUREMENT
/begin MEASUREMENT APP_uDiff "difference signal voltage between sensor 1 and sensor 2" SWORD Volt 1 100 -6553.600 6553.400 FORMAT "%8.3" ECU_ADDRESS 0x60007908 /end MEASUREMENT
/begin MEASUREMENT APP_uDiffMax "permitted difference signal voltage between sensor 1 and sensor 2" SWORD Volt 1 100 -6553.600 6553.400 FORMAT "%8.3" ECU_ADDRESS 0x70005276 /end MEASUREMENT
/begin MEASUREMENT APP_uMin12half "Minimum of signal 1 and signal 2 in range of signal 2" SWORD Volt 1 100 -6553.600 6553.400 FORMAT "%8.3" ECU_ADDRESS 0x70005278 /end MEASUREMENT
/begin MEASUREMENT APP_uRaw1ADC "raw value sensor 1" SWORD Volt 1 100 -6553.600 6553.400 FORMAT "%8.3" ECU_ADDRESS 0x600093F4 /end MEASUREMENT
/begin MEASUREMENT APP_uRaw1ADCRead "raw value sensor 1" SWORD Volt 1 100 -6553.600 6553.400 FORMAT "%8.3" ECU_ADDRESS 0x600093F2 /end MEASUREMENT
/begin MEASUREMENT APP_uRaw2ADC "raw value sensor 2 without NTP" SWORD Volt 1 100 -6553.600 6553.400 FORMAT "%8.3" ECU_ADDRESS 0x600093F0 /end MEASUREMENT
/begin MEASUREMENT APP_uRaw2ADCRead "raw value sensor 2" SWORD Volt 1 100 -6553.600 6553.400 FORMAT "%8.3" ECU_ADDRESS 0x600093EE /end MEASUREMENT
/begin MEASUREMENT APP_uRawMaxTmp "Current maximum voltage raw valuefrom sensor temporary." SWORD Volt 1 100 -6553.600 6553.400 FORMAT "%8.3" ECU_ADDRESS 0x6000790C /end MEASUREMENT
/begin MEASUREMENT B_cononmsvloc "Condition mass flow valve supplied by permanent current during high pressure start" UBYTE B_TRUE 1 100 0.00 1.00000000000 BIT_MASK 0x1 FORMAT "%13.11" ECU_ADDRESS 0x6000015C /end MEASUREMENT
/begin MEASUREMENT B_cononmsv_msg "Condition mass flow valve supplied by permanent current during high pressure start" UBYTE B_TRUE 1 100 0.00 1.00000000000 BIT_MASK 0x1 FORMAT "%13.11" ECU_ADDRESS 0x60000248 /end MEASUREMENT
/begin MEASUREMENT B_hdrbaloc "Flag for disabling the integrator while set value is limited local value" UBYTE B_TRUE 1 100 0.00 1.00000000000 BIT_MASK 0x1 FORMAT "%13.11" ECU_ADDRESS 0x6000015B /end MEASUREMENT
/begin MEASUREMENT B_hdrba_msg "Flag for disabling the integrator while set value is limited" UBYTE B_TRUE 1 100 0.00 1.00000000000 BIT_MASK 0x1 FORMAT "%13.11" ECU_ADDRESS 0x60000213 /end MEASUREMENT
/begin MEASUREMENT B_hdrresloc "Condition: reset high-pressure regulation local value" UBYTE B_TRUE 1 100 0.00 1.00000000000 BIT_MASK 0x1 FORMAT "%13.11" ECU_ADDRESS 0x6000015A /end MEASUREMENT
/begin MEASUREMENT B_hdrres_msg "Condition: reset high-pressure regulation" UBYTE B_TRUE 1 100 0.00 1.00000000000 BIT_MASK 0x1 FORMAT "%13.11" ECU_ADDRESS 0x60000212 /end MEASUREMENT
/begin MEASUREMENT B_kd_msg "Condition: kick-down" UBYTE B_TRUE 1 100 0.00 1.00000000000 BIT_MASK 0x1 FORMAT "%13.11" ECU_ADDRESS 0x6000F241 /end MEASUREMENT
/begin MEASUREMENT B_msvactloc "Condition MSV active ,local" UBYTE B_TRUE 1 100 0.00 1.00000000000 BIT_MASK 0x1 FORMAT "%13.11" ECU_ADDRESS 0x60000159 /end MEASUREMENT
/begin MEASUREMENT B_msvact_msg "Condition actuator mass flow valve active" UBYTE B_TRUE 1 100 0.00 1.00000000000 BIT_MASK 0x1 FORMAT "%13.11" ECU_ADDRESS 0x600001FA /end MEASUREMENT
/begin MEASUREMENT B_prmsvhdst "To indicate pressure threshold for msv cont. control during high pressure start" UBYTE B_TRUE 1 100 0.00 1.00000000000 BIT_MASK 0x1 FORMAT "%13.11" ECU_ADDRESS 0x60000158 /end MEASUREMENT
/begin MEASUREMENT B_pwgnotfr_msg "FR error reaction pedal-travel sensor limphome" UBYTE B_TRUE 1 100 0.00 1.00000000000 BIT_MASK 0x1 FORMAT "%13.11" ECU_ADDRESS 0x6000F22B /end MEASUREMENT
/begin MEASUREMENT B_rqtmsvabloc "Cond. tester control of mass flow valve aborted local value" UBYTE B_TRUE 1 100 0.00 1.00000000000 BIT_MASK 0x1 FORMAT "%13.11" ECU_ADDRESS 0x60000157 /end MEASUREMENT
/begin MEASUREMENT B_rqtmsvab_msg "Cond. tester control of mass flow valve aborted" UBYTE B_TRUE 1 100 0.00 1.00000000000 BIT_MASK 0x1 FORMAT "%13.11" ECU_ADDRESS 0x600001D8 /end MEASUREMENT
/begin MEASUREMENT B_stpreldlyloc "condition delayed start debouncing of crankshaft signal" UBYTE B_TRUE 1 100 0.00 1.00000000000 BIT_MASK 0x1 FORMAT "%13.11" ECU_ADDRESS 0x70000413 /end MEASUREMENT
/begin MEASUREMENT dwmsvdloc_w "local copy of delivery duration of MSV in degrees crankshaft" SWORD kw_q0p1 1 100 -3276.800 3276.700 FORMAT "%8.3" ECU_ADDRESS 0x600011DA /end MEASUREMENT
/begin MEASUREMENT dwmsvd_w_msg "Delivery duration of mass flow valve in degrees crankshaft" SWORD kw_q0p1 1 100 -3276.800 3276.700 FORMAT "%8.3" ECU_ADDRESS 0x6000163E /end MEASUREMENT
/begin MEASUREMENT dwmsvovb_w "MSV opening angle before limitation in degrees crankshaft (feeding time)" SWORD kw_q0p1 1 100 -3276.800 3276.700 FORMAT "%8.3" ECU_ADDRESS 0x600011D8 /end MEASUREMENT
/begin MEASUREMENT dwped_msg "gradient of the standardized accelerator pedal angle" SBYTE rel_q0p39 1 100 -50.00 49.61 FORMAT "%5.2" ECU_ADDRESS 0x6000F7AD /end MEASUREMENT
/begin MEASUREMENT dwped_w_msg "gradient of the standardized accelerator pedal angle" SWORD rel_sw_b50 1 100 -50.00000 49.99847 FORMAT "%8.5" ECU_ADDRESS 0x60008D9C /end MEASUREMENT
/begin MEASUREMENT Ebs_uBattFildQnts_MP "Measuring point for Filtered quatised battery voltage received from sensor" SWORD Volt_Alt_100mV 1 100 -3276.800 3276.700 FORMAT "%8.3" ECU_ADDRESS 0x7000A844 /end MEASUREMENT
/begin MEASUREMENT ESS_rLdAlt "Alternator load" SWORD DtyCyc 1 100 -327.6800 327.6700 FORMAT "%8.4" ECU_ADDRESS 0x600091B4 /end MEASUREMENT
/begin MEASUREMENT FlSplG_flgMfVlvActvContMod "Condition mass flow valve active during continuous mode" UBYTE B_TRUE 1 100 0.00 1.00000000000 BIT_MASK 0x1 FORMAT "%13.11" ECU_ADDRESS 0x600001B2 /end MEASUREMENT
/begin MEASUREMENT s_bHTCutOffAltMng "Alternator High temperature cut-off" UBYTE B_TRUE 1 100 0.00 1.00000000000 BIT_MASK 0x1 FORMAT "%13.11" ECU_ADDRESS 0x6000E9A5 /end MEASUREMENT
/begin MEASUREMENT s_flgMaxChrgBlnc "Maximum charge available at battery" UBYTE B_TRUE 1 100 0.00 1.00000000000 BIT_MASK 0x1 FORMAT "%13.11" ECU_ADDRESS 0x6000EE10 /end MEASUREMENT
/begin MEASUREMENT s_flgMaxTiBattFull "timer for battery refresh has expired or not" UBYTE B_TRUE 1 100 0.00 1.00000000000 BIT_MASK 0x1 FORMAT "%13.11" ECU_ADDRESS 0x6000EE0F /end MEASUREMENT
/begin MEASUREMENT s_flgMaxTiBefRepn "battery refresh has been activated or not" UBYTE B_TRUE 1 100 0.00 1.00000000000 BIT_MASK 0x1 FORMAT "%13.11" ECU_ADDRESS 0x6000EE0E /end MEASUREMENT
/begin MEASUREMENT s_flgMaxTiRefrActv "Maximum refresh active time reached" UBYTE B_TRUE 1 100 0.00 1.00000000000 BIT_MASK 0x1 FORMAT "%13.11" ECU_ADDRESS 0x6000EE0D /end MEASUREMENT
/begin MEASUREMENT s_flgMinTiBefRepn "Maximum time before battery refresh has to be performed" UBYTE B_TRUE 1 100 0.00 1.00000000000 BIT_MASK 0x1 FORMAT "%13.11" ECU_ADDRESS 0x6000EE0C /end MEASUREMENT
/begin MEASUREMENT s_iBattDiff "difference between battery current set by the alternator and actual battery current" SWORD Curr_A 1 100 -327.6800 327.6700 FORMAT "%8.4" ECU_ADDRESS 0x60007A06 /end MEASUREMENT
/begin MEASUREMENT s_ratAdjSoc "Local static" SWORD Prc 1 100 -400.0000 399.9878 FORMAT "%8.4" ECU_ADDRESS 0x60007A04 /end MEASUREMENT
/begin MEASUREMENT s_stAltSel "Status of alternator selector" UWORD OneToOne 1 100 0.00 65535.00 FORMAT "%8.2" ECU_ADDRESS 0x60007A02 /end MEASUREMENT
/begin MEASUREMENT upwg1_w_msg "Voltage PWG potentiometer 1 (word)" UWORD spg_q0p00488 1 100 0.00 319.9951 FORMAT "%8.4" ECU_ADDRESS 0x60008A4C /end MEASUREMENT
/begin MEASUREMENT upwg2_w_msg "Voltage PWG potentiometer 2 (word)" UWORD spg_q0p00488 1 100 0.00 319.9951 FORMAT "%8.4" ECU_ADDRESS 0x60008A4A /end MEASUREMENT
/begin MEASUREMENT wped_msg "Standardized accelerator pedal angle" UBYTE relPED_ub_b100 1 100 0.00 100.0 FORMAT "%5.1" ECU_ADDRESS 0x6000F2C7 /end MEASUREMENT
/begin MEASUREMENT wped_w_msg "normalized angle acceleration pedal" UWORD relPED_q0p00153 1 100 0.00 100.0000 FORMAT "%8.4" ECU_ADDRESS 0x60008A40 /end MEASUREMENT
/begin FUNCTION Alt_Ctl "28.1.0    alternator control"
 /begin DEF_CHARACTERISTIC Alt_chBattSoc_CUR Alt_cntBattRExcddThd_C Alt_cntRed_C Alt_cntrUpScaRstrct_C Alt_cntUpScaRstrctACGDisblThd_C Alt_cntUpScaRstrctACGThd_C Alt_duAntiFlickSlop_C Alt_facIDecHi_C Alt_facIDecLo_C Alt_facIIncHi_C Alt_facIIncLo_C Alt_facRGenr_C Alt_facUDecHi_C Alt_facUDecLo_C Alt_facUIncHi_C Alt_facUIncLo_C Alt_flgSwtBattSetIn_C Alt_flgSwtSelACGBattDgrt_C Alt_flgSwtSelACGWipr_C Alt_flgSwtSelReqACGHdLi_C Alt_iBattMax_GCUR Alt_iBattMin_GCUR Alt_iBattSetTst_C Alt_iBattSet_CUR Alt_iBattSOCSet_T Alt_iBattThdSpclRngDi_C Alt_iExctLim_C Alt_iExctLim_T Alt_iMaxDiffNoDecI_C Alt_iMaxDiffNoIncI_C Alt_nCutOffHiVehSpd_C Alt_nCutOff_C Alt_nEngSpdExctLimHi_C Alt_nEngSpdExctLimLo_C Alt_nGenrHiHi_C Alt_nGenrHiLo_C Alt_nrActPtcActv_C Alt_nrIdAltMnfc_C Alt_nrIdAlt_C Alt_nrIdChp_C Alt_qSOCHdLiHiThd_C Alt_qSOCHdLiLoThd_C Alt_qUpScaEnaThdHi_C Alt_qUpScaEnaThdLo_C Alt_ratDfHiHi_C Alt_ratDfHiLo_C Alt_ratHdLiHiThd_C Alt_ratHdLiLoThd_C Alt_ratSocAdj_CUR Alt_ratSocRefrThdHi_C Alt_ratSocRefrThdLo_C Alt_ratSocSetCold_C Alt_ratSocSetIce_C Alt_ratSocSetMax_C Alt_ratSocSetMin_C Alt_ratSocSetNorm_C Alt_ratSocSetWrm_C Alt_ratSocSet_C Alt_ratSocThd_C Alt_ratThdSocHiHi_C Alt_ratThdSocHiLo_C Alt_ratThdSocLoHi_C Alt_ratThdSocLoLo_C Alt_ratThdSocNrmHi_C Alt_ratThdSocNrmLo_C Alt_rBattDgrdHi_C Alt_rBattDgrdLo_C Alt_rBattThdSpclRngDi_C Alt_stEbsErrSel_C Alt_stElecLoadActv_C Alt_stFailSafe_C Alt_stMaskErr_C Alt_swtFailSafeSel_C Alt_swtGenrCtl_C Alt_swtIdleEna_C Alt_swtLoadRespActModTrqSel_C Alt_swtLockUpCluExtn_C Alt_tBattChrgnRqrdUHi_C Alt_tBattChrgnRqrdULo_C Alt_tBattFildULimThd_C Alt_tBattMaxRngDiHi_C Alt_tBattMaxRngDiLo_C Alt_tBattMaxSpclRngDi_C Alt_tBattMinSpclRngDi_C Alt_tBatt_AXIS Alt_tEnvColdThdHi_C Alt_tEnvColdThdLo_C Alt_tEnvIceThdHi_C Alt_tEnvIceThdLo_C Alt_tEnvNormThdHi_C Alt_tEnvNormThdLo_C Alt_tiFltNAlt_C Alt_tiFltRDf_C Alt_tiGrdtConst_C Alt_tiHiTCutOffFailSafeActv_C Alt_tiIgrBattIDly_C Alt_tiLoadRespBase_T Alt_tiLoadRespEngStrtEndStab_C Alt_tiLoadRespFast_C Alt_tiLoadRespOvrRunStab_C Alt_tiLoadRespOvrRun_T Alt_tiLoadRespStab_C Alt_tiMaxBattFullRefr_C Alt_tiMaxHldDfHi_C Alt_tiMaxRefrActv_C Alt_tiMaxRefrRepnLim_C Alt_tiMinHldDfHi_C Alt_tiMinRefrRepnLim_C Alt_tiNoDecI_C Alt_tiNoIncI_C Alt_tiRstBkupDly_C Alt_tiRstErrLampDly_C Alt_tiRstHTCutOffDly_C Alt_tiRstTBattDly_C Alt_tiRstTEnvDly_C Alt_tiSetBkupDly_C Alt_tiSetErrLampDly_C Alt_tiSetHTCutOffDly_C Alt_tiSetTBattDly_C Alt_tiSetTEnvDly_C Alt_tiUMeasdFil_C Alt_tiUpScaRstrctStop_C Alt_tiVapLockHiSetPoint_C Alt_tMaxThdHi_C Alt_tMaxThdLo_C Alt_tMinThdHi_C Alt_tMinThdLo_C Alt_uACGVltg_T Alt_uAltBkup_C Alt_uAltMaxTst_C Alt_uAltMax_C Alt_uAltMinTst_C Alt_uAltMin_C Alt_uAltOfsDwn_C Alt_uAltOfsUp_C Alt_uAltStrt_C Alt_uBattACGLim_C Alt_uBattFixdMaxRed_C Alt_uBattFixdMinRed_C Alt_uBattHdLiMaxRed_T Alt_uBattHdLiMinRed_T Alt_uBattMaxAntiFlickActv_C Alt_uBattMaxRed_C Alt_uBattMaxSpcl_C Alt_uBattMaxTst_C Alt_uBattMax_C Alt_uBattMinRed_C Alt_uBattMinSpcl_C Alt_uBattMinTst_C Alt_uBattMin_C Alt_uBattSet_MAP Alt_uDecHi_C Alt_uDecLo_C Alt_uDesGrdtThd_C Alt_uDesThdHi_C Alt_uDesThdLo_C Alt_uDiffAccl_C Alt_uDiffDecl_C Alt_uFltDecFix_C Alt_uFltIncFix_C Alt_uGenMax_C Alt_uGenMin_C Alt_uGenrOffsStrt_C Alt_uIncHi_C Alt_uIncLo_C Alt_uLimDwnConsObs_C Alt_uLimDwnFailSafe_C Alt_uLimDwn_C Alt_uLimUpConsObs_C Alt_uLimUpFailSafe_C Alt_uLimUp_C Alt_uNrmTBatt_GCUR Alt_uNrmTEnv_CUR Alt_uStepMaxLim_C Alt_uStepMinLim_C Alt_uTrafoCurrDiff_CUR Alt_uVapLockHiSetPoint_C Alt_vCutOffSVehSpd_C Alt_vVehSpdExctLimHi_C Alt_vVehSpdExctLimLo_C /end DEF_CHARACTERISTIC
 /begin IN_MEASUREMENT ActMod_trqClth ActMod_trqInr AltIO_uAltDes AltIO_uMeasd Alt_stACGHiUReq Alt_stRecup BattU_u Batt_flgChrgMod Batt_flgSt7Tran Batt_qSumHi Batt_qSumLo Batt_rMean Batt_stCalc BdInt_stHoodOpenDurgEngStrt Blwr_flgActv B_stend CoEng_st CoESS_flgUReq CoESS_stAlt CoESS_uMinReq CoESS_uSlopRampVal Com_bALTErr Com_bDern Com_bElec Com_bMec Com_bTO Com_nrActPtcActv Com_nrIdAlt Com_nrIdChp Com_nrIdMnfc Com_ratDyc Com_ratSoc Com_stACGUpReq Com_stLiSwtInfo Com_stRrFog Com_stShipMod Com_stSoc Com_stWiprActvnCdn Ebs_iBattFild Ebs_qSohFild Ebs_ratSocFild Ebs_stErr Ebs_tBattFild Ebs_uBattFild Eep_EnvRamInvld Epm_nEng FanCtl_flgAntiFlickActv Gbx_stPNPos GlbDa_tEnv HdLi_flgActv HLSDem_nSetPLo PthSet_bOvrRun PT_stTraType StrtCtl_flgEngStrtCmpl T15_st VehV_v Wiper_flgActv /end IN_MEASUREMENT
 /begin OUT_MEASUREMENT Alt_flgACGExctCmpl Alt_flgACGFailr Alt_flgBattTRng Alt_flgBkup Alt_flgEngStrtd Alt_flgErrLamp Alt_flgLockUpCluExtnReq Alt_flgSlopLimr Alt_flgSpclRngDi Alt_flgSpclRngMinDi Alt_flgTBattMin Alt_iBattSetIn Alt_iExctLim Alt_nCutOff Alt_qBattSumEep Alt_rAltExct Alt_stBattSoc Alt_stErr Alt_stGov Alt_stSel Alt_stStgyFailSafe Alt_tiLoadResp Alt_tiRefrActvEep Alt_tiRefrBattFullEep Alt_tiRefrDeactvEep Alt_uActQnts Alt_uBattMaxAntiFlick Alt_uDes s_flgMaxChrgBlnc s_flgMaxTiBattFull s_flgMaxTiBefRepn s_flgMaxTiRefrActv s_flgMinTiBefRepn s_stAltSel /end OUT_MEASUREMENT
 /begin LOC_MEASUREMENT Alt_bAltLoadHi_MP Alt_bHTCutOffMng_MP Alt_bNAltHi_MP Alt_bNoDecl_MP Alt_bNoIncl_MP Alt_bTBattMng_MP Alt_bTEnvMng_MP Alt_cntBattRExcddThd Alt_cntUpScaRstrctACG Alt_cntUpScaRstrctACGDisbl Alt_flgBattChrgnRqrdU Alt_flgBattDgrd Alt_flgBattRExcddThd Alt_flgBattSOCHys Alt_flgBattUISocInvld_MP Alt_flgBlowrActv Alt_flgErrLamp_MP Alt_flgHdLiActv Alt_flgHiLoadExtd_MP Alt_flgHiTCutOffFailActv_MP Alt_flgHoodOpenActv Alt_flgMaxChrgBlnc_MP Alt_flgMaxTiBattFull_MP Alt_flgMaxTiBefRepn_MP Alt_flgMaxTiRefrActv_MP Alt_flgMinTiBefRepn_MP Alt_flgRefrReq_MP Alt_flgRpdChrg Alt_flgSocHiHdLi Alt_flgSpclRngMaxDi Alt_flgThActv Alt_flgUpScaRstrctACG Alt_flgUpScaRstrctBattU Alt_flgUpScaRstrctFC Alt_flgURngSeln Alt_flgWiprActv Alt_iBattDiffGov_MP Alt_iBattMaxIn_MP Alt_iBattMinIn_MP Alt_iBattSetGovr_MP Alt_iBattSet_MP Alt_nAltFltd_MP Alt_ratDfFlt_MP Alt_ratSocSet_MP Alt_ratTEnv_MP Alt_rBattMeanPrev Alt_ReqGenrBkup_MP Alt_stStgyFailSafeSel_MP Alt_stStgyFailSafe_MP Alt_tiLoadRespTmp Alt_uActFb_MP Alt_uAltDelta_MP Alt_uAltDesAfterHiSetPoint Alt_uAltDesHiSetPoint Alt_uAltDesLimp Alt_uAltFltQnts_MP Alt_uAltFlt_MP Alt_uAltLim_MP Alt_uAltMaxGovrQnts_MP Alt_uAltMaxGovr_MP Alt_uAltMaxVltg_MP Alt_uAltMax_MP Alt_uAltMinGovrQnts_MP Alt_uAltMinGovr_MP Alt_uAltMinReq_MP Alt_uAltMin_MP Alt_uBattAcclIn_MP Alt_uBattDeclIn_MP Alt_uBattDeclRamp_MP Alt_uBattDeclRapid_MP Alt_uBattDeclSpIn_MP Alt_uBattMaxGovrQnts_MP Alt_uBattMaxIn_MP Alt_uBattMax_MP Alt_uBattMinGovrQnts_MP Alt_uBattMinIn_MP Alt_uBattMin_MP Alt_uBattOptIn_MP Alt_uDecI_MP Alt_uDesOld Alt_uDesTmp Alt_uIncl_MP Alt_uMeasdFild_MP Alt_uNrmTBatt_MP Alt_uNrmTEnv_MP Ebs_uBattFildQnts_MP s_bHTCutOffAltMng s_iBattDiff s_ratAdjSoc /end LOC_MEASUREMENT
 FUNCTION_VERSION "28.1.0" /end FUNCTION
/begin FUNCTION Alt_Demand "56.2.0    Alternator"
 /begin DEF_CHARACTERISTIC AltIO_tiLR_C Alt_cntFastPeakHld_C Alt_cntrAltLoadPastPosnFast_C Alt_cntrAltLoadPastPosn_C Alt_facAltCmpByBattU_C Alt_facBattUFildMax_C Alt_facBattUFildMin_C Alt_facCorrnTTqDes_T Alt_facCorrnTTqResv_T Alt_facCorTemp_CUR Alt_facCorT_CUR Alt_facFastBattDecHi_C Alt_facFastBattDecLo_C Alt_facFastBattIncHi_C Alt_facFastBattIncLo_C Alt_flgAltLoadFastResv_C Alt_flgAltLoadSlowResv_C Alt_flgSwtEngSpd_C Alt_iBattFildFastHi_C Alt_iBattFildFastLo_C Alt_iBattFildSlowHi_C Alt_iBattFildSlowLo_C Alt_iBattFildSlowResvHi_C Alt_iBattFildSlowResvLo_C Alt_iEPS1ElecLdThd_C Alt_nAltEngSpdLim_C Alt_nAltFastTqCmpHi_C Alt_nAltFastTqCmpLo_C Alt_nAltFastTqResvHi_C Alt_nAltFastTqResvLo_C Alt_nAltSlowEngResvHi_C Alt_nAltSlowEngResvLo_C Alt_nEngDeltaSlowHi_C Alt_nEngDeltaSlowLo_C Alt_nEngHi_C Alt_nEngLow_C Alt_nFastEngSpdStab_C Alt_nFastMaxIdleSpd_C Alt_nThres_C Alt_nWESThd_C Alt_qBattFildNegThd_C Alt_rAltLoadBlowrFanThd_C Alt_rAltLoadDFogThd_C Alt_rAltLoadEPSThd_C Alt_rAltLoadFrntFogThd_C Alt_rAltLoadLiSwtInfoThd_C Alt_rAltLoadRadioFanThd_C Alt_rAltLoadRrFogThd_C Alt_rAltLoadWiprThd_C Alt_ratAltEngSpd_C Alt_rLoadHiThd_C Alt_rLoadLowrThd_C Alt_stAltLoadIdleUp_C Alt_stBattOffsCorrMask_C Alt_stFastGearCdnMask_C Alt_stFFAltLoadSeln_C Alt_stRawLoadCdnMask_C Alt_stSwtAltLoad_C Alt_stSwtDesResv_C Alt_stSwtDFog_C Alt_stSwtElecLoadTqCorrn_C Alt_swtEpsOnly_C Alt_swtLoadSeln_C Alt_swtTrqMode_C Alt_tFastEng_C Alt_tiAftEndStrtFFThd_C Alt_tiAltLoadFlt_C Alt_tiAltLoadGrdtFlt2_M Alt_tiAltLoadGrdtFlt_M Alt_tiBattUFil_C Alt_tiBlowrFanOff_C Alt_tiBlowrFanOn_C Alt_tiBlowrFanU_C Alt_tiCalcnPerd_C Alt_tiCrkNotCmplDly_C Alt_tiDFogOff_C Alt_tiDFogOn_C Alt_tiDFog_C Alt_tiEPSDly_C Alt_tiEPSOff_C Alt_tiEPSOn_C Alt_tiExctCrntGrdtFlt2_M Alt_tiExctCrntGrdtFlt_M Alt_tiExctCurrDly_C Alt_tiExctCurrFil_C Alt_tiFastBattCorrRels_C Alt_tiFastBattOffsCorr_C Alt_tiFastBattStabDeb_C Alt_tiFastBattStab_C Alt_tiFastBattU_C Alt_tiFastFFCurActvResv_C Alt_tiFastFFCurActv_C Alt_tiFFAltLoadFastOff_C Alt_tiFFAltLoadFastOn_C Alt_tiFFAltLoadFastResvOffCmpOn_C Alt_tiFFAltLoadFastResvOff_C Alt_tiFFAltLoadFastResvOn_C Alt_tiFFAltLoadSlowOff_C Alt_tiFFAltLoadSlowOn_C Alt_tiFFAltLoadSlowResvOffCmpOn_C Alt_tiFFAltLoadSlowResvOff_C Alt_tiFFAltLoadSlowResvOn_C Alt_tiFrntFogOff_C Alt_tiFrntFogOn_C Alt_tiFrntFog_C Alt_tiHdLiOff_C Alt_tiHdLiOn_C Alt_tiIdleUpEndDly_C Alt_tiLiSwtInfo_C Alt_tiNormRedBlowrFanThd_C Alt_tiNormRedDFogThd_C Alt_tiNormRedEPSThd_C Alt_tiNormRedFrntFogThd_C Alt_tiNormRedLiSwtInfoThd_C Alt_tiNormRedRadioFanThd_C Alt_tiNormRedRrFogThd_C Alt_tiNormRedWiprThd_C Alt_tiRadioFanOff_C Alt_tiRadioFanOn_C Alt_tiRadioFanStg_C Alt_tiResvACGHiUFil_C Alt_tiRrFogOff_C Alt_tiRrFogOn_C Alt_tiRrFog_C Alt_tiSlowFFActvDly_M Alt_tiSlowFFCurHldResv_C Alt_tiSlowFFCurHld_C Alt_tiWiprOff_C Alt_tiWiprOn_C Alt_tiWiprStg_C Alt_tqAltCmp_M Alt_tqBlowrFanVolt1_M Alt_tqBlowrFanVolt2_M Alt_tqBlowrFan_M Alt_tqDesCalcn_M Alt_tqDFog_T Alt_tqEPS_M Alt_tqFFAltLoadFastResv_T Alt_tqFFAltLoadFast_T Alt_tqFFAltLoadSlowResv_M Alt_tqFFAltLoadSlow_M Alt_tqFrntFog_T Alt_tqHdLiHi_T Alt_tqHdLiLo_T Alt_tqRadioFanHi_T Alt_tqRadioFanLo_T Alt_tqResvAddlACGHiU_C Alt_tqResvCalcn_M Alt_tqRrFog_T Alt_tqWipr_M Alt_trqCalc_MAP Alt_trqExctCrntCalc_M Alt_trqNPwrAct_Map Alt_trqPwrRepl_C Alt_trqResvMax_C Alt_uAltDes_C Alt_uAltOff_C Alt_uBattCorrAlt_CUR Alt_uBattDeIni_C Alt_uBlowrFanDeltaThd_C Alt_uBlowrFanThd_C Alt_uDrpHi_C Alt_uDrpLo_C Alt_uFastBattStab_C Alt_uNormU_C Alt_vVehStopHi_C Alt_vVehStopLo_C Alt_vVehStopSlowResvHi_C Alt_vVehStopSlowResvLo_C /end DEF_CHARACTERISTIC
 /begin IN_MEASUREMENT AltIO_rAltLoad AltIO_tiLRAlt AltIO_uAltDes Alt_uDes BattU_u Blwr_uVoltReq B_stendmd_msg CEngDsT_t CoEng_st CoEng_tiNormalRed CoESS_stAlt ComAlt_iExctCrnt Com_bReDEFOutCdn Com_bReDEFSwCdn Com_iEPS1ElecLd Com_stFrtFog Com_stLiSwtInfo Com_stRrFog Com_stWipr Com_stWiprActvnCdn Ebs_iBattFild Eep_EnvRamInvld ElecLd_iEPSLd ElecLd_iEPSLoadOnly EngDa_tEng Epm_nEng Epm_nEng10ms FanCtl_stStg Gbx_stGearLvr HLSDem_nSetPLo HLSDem_nSetPTrck PSPCtl_flgRmnVapSuspc SyC_ctPostDrvLeave tnst_w_msg Tra_stCrkNotCmpl VehV_v /end IN_MEASUREMENT
 /begin OUT_MEASUREMENT Alt_flgAltLoadIdleUpReq Alt_stACGHiUReq Alt_stDchaAltUpprLimStk Alt_trqDes Alt_trqResv ESS_rLdAlt /end OUT_MEASUREMENT
 /begin LOC_MEASUREMENT Alt_cntFastPeakHld Alt_cntrAltLoadPastPosn Alt_cntrAltLoadPastPosnFast Alt_cntrAltLoadPosn Alt_cntrIniDrv Alt_facAltCmpByBattU Alt_facBattUFild1 Alt_facBattUFild2 Alt_facFastBatt Alt_flgAltFastCmnCdn Alt_flgAltFastCmnCdnDly Alt_flgAltLoadIdleUpBefDly Alt_flgAltSlowCmnCdn Alt_flgBattStab Alt_flgBattStabDly Alt_flgEngSpdCdnSlow Alt_flgFastBattCdn Alt_flgFastBattCorrBefDly Alt_flgFastBattCorrRels Alt_flgFastCurrCdn Alt_flgFastFacNegCdn Alt_flgFastFacPosCdn Alt_flgFastResvCdnDly Alt_flgFastVehSpdCdn Alt_flgFFAltLoadFast Alt_flgFFAltLoadFastResv Alt_flgFFAltLoadSlow Alt_flgFFAltLoadSlowBefDly Alt_flgFFAltLoadSlowResv Alt_flgSlowCmpCdn Alt_flgSlowCmpCdnHld Alt_flgSlowResvCdn Alt_flgSlowResvCdnHld Alt_flgSlowResvEngDrp Alt_flgWipr Alt_iAltFild Alt_iBattFildDeltaFast Alt_iBattFildDeltaSlow Alt_iBattFildOldFast Alt_iDeltaExctCrnt Alt_iEcxtCrntFilOut_MP Alt_iExctCrntOld Alt_iFFAltLoadAry Alt_nAltSpdCmp Alt_nAltSpdCmpRaw Alt_nEngSpdDeltaSlow Alt_qBattFildNegFast Alt_rAltLoadFilOut_MP Alt_rAltLoadFilTqCalcn_MP Alt_rAltLoadOld Alt_rDeltaDutyCyc Alt_stAltLoadIdleUpCdn Alt_stBattOffsCorrCdn Alt_stBlowrFan Alt_stCalcnPerd_MP Alt_stDFog Alt_stEPS Alt_stExctCurrDly Alt_stFastGearCdn Alt_stFrntFog Alt_stLiSwtInfo Alt_stRadioFan Alt_stRrFog Alt_tiAltLoadGrdtFlt Alt_tiExctcrntGrdtFlt Alt_tiFFSlowDly Alt_tqAltCmp Alt_tqAltCmpRaw Alt_tqAltLoadTqResv Alt_tqBlowrFan Alt_tqBlowrFanEstimn Alt_tqBlowrFanFil Alt_tqDesCalcn_MP Alt_tqDFog Alt_tqDFogEstimn Alt_tqDFogFil Alt_tqElecLoadTqCorrn Alt_tqEPS Alt_tqEPSEstimn Alt_tqEPSFil Alt_tqFFAltLoadEstimn Alt_tqFFAltLoadFast Alt_tqFFAltLoadFastFild Alt_tqFFAltLoadFastResv Alt_tqFFAltLoadFastResvFild Alt_tqFFAltLoadSlow Alt_tqFFAltLoadSlowFild Alt_tqFFAltLoadSlowResv Alt_tqFFAltLoadSlowResvFild Alt_tqFrntFog Alt_tqFrntFogEstimn Alt_tqFrntFogFil Alt_tqHdLiEstimn Alt_tqHdLiFil Alt_tqHdLiHi Alt_tqHdLiLo Alt_tqRadioFanEstimn Alt_tqRadioFanFil Alt_tqRadioFanHi Alt_tqRadioFanLo Alt_tqResvAddlACGHiU Alt_tqResvBefACGHiUReq Alt_tqResvCalcn_MP Alt_tqRrFog Alt_tqRrFogEstimn Alt_tqRrFogFil Alt_tqWipr Alt_tqWiprEstimn Alt_tqWiprFil Alt_uBattDeBefFild Alt_uBattDeFild Alt_uBattDeltaFast Alt_uBattDeltaFastPeak Alt_uBattFildFast Alt_uBattOffsCorr Alt_uBattUFild Alt_uBlowrDelta Alt_uBlowrLst Alt_uFastBattDelta Alt_uFastBattStabFild /end LOC_MEASUREMENT
 FUNCTION_VERSION "56.2.0" /end FUNCTION
/begin FUNCTION Alt_RecupSt "3.1.0     Alternator Recuperation State detection"
 /begin DEF_CHARACTERISTIC Alt_aDecLoadMinHi_C Alt_aDecLoadMinLo_C Alt_flgErrModActv_C Alt_nIdleMinHi_C Alt_nIdleMinLo_C Alt_nRecupDiThdHi_C Alt_nRecupDiThdLo_C Alt_stDecLoadEnaCdn_C Alt_stDecLoadStop_C Alt_stErrSeln_C Alt_stGripSelnAT_C Alt_stNoGripInfoSeln_C Alt_stRecupBrk_C Alt_stRecupEnaCdn_C Alt_stRecupStopCdn_C Alt_swtRecupVEna_C Alt_tiDecLoadLim_C Alt_tiRecupAPT1_C Alt_tiRecupLim_C Alt_trqDmdThdHi_C Alt_trqDmdThdLo_C Alt_trqMinDecLoadThd_C Alt_vRecupMinHi_C Alt_vRecupMinLo_C /end DEF_CHARACTERISTIC
 /begin IN_MEASUREMENT APP_stKD Brk_st CoEng_st Epm_nEng PthSet_stOvrRun PT_bConvSlip PT_bGrip PT_bNoGrip T15_st VehV_a VehV_v VMD_trqDes /end IN_MEASUREMENT
 /begin OUT_MEASUREMENT Alt_stRecup /end OUT_MEASUREMENT
 /begin LOC_MEASUREMENT Alt_aRecupFil Alt_flgDecLoadActv_MP Alt_flgDecLoadCdn_MP Alt_flgDecLoadErr_MP Alt_flgDecLoadStop_MP Alt_flgGripInfo Alt_flgIdleNThd_MP Alt_flgNRecupDi_MP Alt_flgRecupActv_MP Alt_flgRecupEnaCdn_MP Alt_flgRecupErr_MP Alt_flgRecupStop_MP Alt_flgRecupVEna_MP Alt_stDecLoadVehCdn_MP Alt_stRecupVehCdn_MP Alt_stVehErrCdn_MP Alt_tiDecLoad Alt_tiRecup Alt_trqWhlDesOld /end LOC_MEASUREMENT
 FUNCTION_VERSION "3.1.0" /end FUNCTION
/begin FUNCTION AMSV "51.12.0   Actuator MSV"
 /begin DEF_CHARACTERISTIC ANZTIHDREN CWAMSV DWAMSVMN DWAMSVMX DWMSVMN DWMSVMX FDWMSVRDR FlSplG_stSyncActHDR_C FuPHi_pDifHpMaxFco_T FuPHi_pMaxHiPMSVCtlrDi_C FuPHi_pOffsActvDemCtlFuCutOff_C FuPHi_pRlHpMaxErrSim_C FuPHi_pThresMSVCtlHpStrt_C FuPHi_tiMaxErrMfVlvSimn_C FuPHi_tiMinErrMfVlvSimn_C NMMNAMSV NMMXAMSV REDMXMSV REDSMXMSV TPREL_MSV TVDPRMAX /end DEF_CHARACTERISTIC
 /begin IN_MEASUREMENT anztib_msg B_entist_msg B_hdrakt_msg B_hdrkhakt_msg B_msvoff_msg B_msvzpa_msg B_sthdp_msg B_sthdrpre_msg dwmsvvst_w_msg EngStrt_bStrtEnd EpmCrS_stSigMode Epm_nEngLRes Epm_stSpd Epm_stSync FuPHi_pHpCtrlrOut FuPHi_pHpRglnDe FuPHi_pRail FuPHi_pRailSpUnlim InjSys_stActRedStg SyC_stSub TrqCnv_numRedStgDem /end IN_MEASUREMENT
 /begin OUT_MEASUREMENT B_cononmsv_msg B_hdrba_msg B_hdrres_msg B_msvact_msg B_rqtmsvab_msg dwmsvd_w_msg FlSplG_flgMfVlvActvContMod /end OUT_MEASUREMENT
 /begin LOC_MEASUREMENT B_cononmsvloc B_hdrbaloc B_hdrresloc B_msvactloc B_prmsvhdst B_rqtmsvabloc B_stpreldlyloc dwmsvdloc_w dwmsvovb_w /end LOC_MEASUREMENT
 FUNCTION_VERSION "51.12.0" /end FUNCTION
/begin FUNCTION APP2MED "8.0.0     Interface Adapter APP to MED17"
 /begin IN_MEASUREMENT APP_drUnFlt APP_r APP_stKD APP_stSigSrc APP_uRaw1unLim APP_uRaw2unLim /end IN_MEASUREMENT
 /begin OUT_MEASUREMENT B_kd_msg B_pwgnotfr_msg dwped_msg dwped_w_msg upwg1_w_msg upwg2_w_msg wped_msg wped_w_msg /end OUT_MEASUREMENT
 FUNCTION_VERSION "8.0.0" /end FUNCTION
/begin FUNCTION APP_ADCRead "1.5.0     Device driver for accelerator pedal signals" /begin REF_CHARACTERISTIC APP_swtCfg_CW /end REF_CHARACTERISTIC /begin IN_MEASUREMENT MoCADC_stMsg /end IN_MEASUREMENT
 /begin OUT_MEASUREMENT APP_uRaw1ADC APP_uRaw1ADCRead APP_uRaw2ADC APP_uRaw2ADCRead /end OUT_MEASUREMENT
 FUNCTION_VERSION "1.5.0" /end FUNCTION
/begin FUNCTION APP_ChkSig "169.2.0   Acceleration Pedal Position error reaction"
 /begin DEF_CHARACTERISTIC APP_drLimNeg_C APP_drLimpMax_C APP_drLimPos_C APP_rLimpMax_C APP_rPlaMaxVal_C APP_rThresAliveDet_C APP_tiAliveDebHiLo_C APP_tiAliveDebLoHi_C /end DEF_CHARACTERISTIC
 /begin REF_CHARACTERISTIC APP_swtCfg_CW /end REF_CHARACTERISTIC
 /begin IN_MEASUREMENT APP_stSigSrc Brk_st B_dksbeg_msg MoFAPP_stAPPMsg SyC_ctPostDrvLeave /end IN_MEASUREMENT
 /begin OUT_MEASUREMENT APP_bAlive /end OUT_MEASUREMENT
 /begin LOC_MEASUREMENT APP_cntrIniDrv APP_rChk APP_rUnLim /end LOC_MEASUREMENT
 FUNCTION_VERSION "169.2.0" /end FUNCTION
/begin FUNCTION APP_DD1 "169.1.0   Acceleration Pedal Position Device Driver Sensor 1"
 /begin DEF_CHARACTERISTIC APP_uRaw1PhyHigh_C APP_uRaw1PhyLow_C APP_uRaw1SRCHigh_C APP_uRaw1SRCLow_C /end DEF_CHARACTERISTIC
 /begin IN_MEASUREMENT APP_bT15Deb App_flgHiImpdChkEna App_flgSRCLo1HiImpdChk APP_tiPhyHigh1DebDef APP_tiPhyHigh1DebOk APP_tiPhyLow1DebDef APP_tiPhyLow1DebOk APP_tiSRCHigh1DebDef APP_tiSRCHigh1DebOk APP_tiSRCLow1DebDef APP_tiSRCLow1DebOk MoCADC_stMsg T15_st /end IN_MEASUREMENT
 /begin OUT_MEASUREMENT APP_bAPP1FinalDef APP_bAPP1ProvDef APP_bPhyHigh1 APP_bPhyHigh1Deb APP_bPhyLow1 APP_bPhyLow1Deb APP_bSRCHigh1 APP_bSRCHigh1Deb APP_bSRCLow1 APP_bSRCLow1Deb /end OUT_MEASUREMENT
 FUNCTION_VERSION "169.1.0" /end FUNCTION
/begin FUNCTION APP_DD2 "169.1.0   Acceleration Pedal Position Device Driver Sensor 2"
 /begin DEF_CHARACTERISTIC APP_uRaw2PhyHigh_C APP_uRaw2PhyLow_C APP_uRaw2SRCHigh_C APP_uRaw2SRCLow_C /end DEF_CHARACTERISTIC
 /begin IN_MEASUREMENT APP_bT15Deb App_flgHiImpdChkEna App_flgSRCLo2HiImpdChk APP_tiPhyHigh2DebDef APP_tiPhyHigh2DebOk APP_tiPhyLow2DebDef APP_tiPhyLow2DebOk APP_tiSRCHigh2DebDef APP_tiSRCHigh2DebOk APP_tiSRCLow2DebDef APP_tiSRCLow2DebOk MoCADC_stMsg T15_st /end IN_MEASUREMENT
 /begin OUT_MEASUREMENT APP_bAPP2FinalDef APP_bAPP2ProvDef APP_bAPPNTP APP_bPhyHigh2 APP_bPhyHigh2Deb APP_bPhyLow2 APP_bPhyLow2Deb APP_bSRCHigh2 APP_bSRCHigh2Deb APP_bSRCLow2 APP_bSRCLow2Deb /end OUT_MEASUREMENT
 FUNCTION_VERSION "169.1.0" /end FUNCTION
/begin FUNCTION APP_Kickdown "7.2.0     Acceleration Pedal Position Kickdown" /begin DEF_CHARACTERISTIC APP_uKDHighAPP_C APP_uKDLowAPP_C /end DEF_CHARACTERISTIC /begin REF_CHARACTERISTIC APP_swtCfg_CW /end REF_CHARACTERISTIC /begin IN_MEASUREMENT APP_stSigSrc /end IN_MEASUREMENT /begin OUT_MEASUREMENT APP_stKD /end OUT_MEASUREMENT /begin LOC_MEASUREMENT APP_bKDInfo /end LOC_MEASUREMENT FUNCTION_VERSION "7.2.0" /end FUNCTION
/begin FUNCTION APP_Learn "169.0.0   Acceleration pedal learn function" /begin DEF_CHARACTERISTIC APP_tiMaxLrnTmr_C APP_uCurrSnsrLimMax_C APP_uSnsrMaxDft_C /end DEF_CHARACTERISTIC /begin IN_MEASUREMENT I14229_stSuppRst /end IN_MEASUREMENT /begin OUT_MEASUREMENT APP_uCurrSnsrMax /end OUT_MEASUREMENT
 /begin LOC_MEASUREMENT APP_flgMaxLrnClrActv APP_stRawExcddMax_mp APP_stTmrRawExcddTmp_mp APP_tiMaxLrnTmr_mp APP_uRawMaxTmp /end LOC_MEASUREMENT
 FUNCTION_VERSION "169.0.0" /end FUNCTION
/begin FUNCTION APP_OscnDetn "169.1.0   Oscillation detection of the acceleration pedal"
 /begin DEF_CHARACTERISTIC APP_d2ratUnFltThd_C APP_ratOscnDetnIdle_C APP_tiOscnCfmdIdleTout_C APP_tiOscnCfmdNoIdle_C APP_tiOscnCfmdTout_C APP_tiOscnExptTOut_C /end DEF_CHARACTERISTIC
 /begin IN_MEASUREMENT APP_bAPP1ProvDef APP_bAPP2ProvDef APP_bSync T15_st /end IN_MEASUREMENT
 /begin LOC_MEASUREMENT APP_d2ratUnFlt APP_d2ratUnFltOld APP_drUnFltOld APP_flgOscnCfmd APP_flgOscnCfmdIdleTout APP_flgOscnCfmdNoIdleTout APP_flgOscnCfmdTout APP_flgOscnDetnEnad APP_flgOscnExpt /end LOC_MEASUREMENT
 FUNCTION_VERSION "169.1.0" /end FUNCTION
/begin FUNCTION APP_Plaus12 "42.0.0    Acceleration Pedal Position Plausibility" /begin DEF_CHARACTERISTIC APP_uSyncMin_C APP_uSync_CUR /end DEF_CHARACTERISTIC
 /begin REF_CHARACTERISTIC APP_dRawSigFac_C APP_flgT15HealEnad_C APP_swtCfg_CW APP_tiPlaAPP12DebDef_C APP_tiPlaAPP12DebOk_C /end REF_CHARACTERISTIC
 /begin IN_MEASUREMENT APP_bAPP1FinalDef APP_bAPP1ProvDef APP_bAPP2FinalDef APP_bAPP2ProvDef APP_bT15Deb T15_st /end IN_MEASUREMENT
 /begin OUT_MEASUREMENT APP_bSync APP_bSyncDeb /end OUT_MEASUREMENT
 /begin LOC_MEASUREMENT APP_bSyncChkOld APP_uDiff APP_uDiffMax APP_uMin12half /end LOC_MEASUREMENT
 FUNCTION_VERSION "42.0.0" /end FUNCTION
/begin FUNCTION APP_PlausBrk "169.2.0   Acceleration Pedal Position Brake Plausibility"
 /begin DEF_CHARACTERISTIC APP_drUnFltLim_C APP_rUnFltPlausBrkMax_C APP_swtBrkStRedOff_C APP_tiGradCondDebHiLo_C APP_tiGradCondDebLoHi_C APP_tiPlaBrkActvtDeb_C APP_tiPlaBrkDeactvtDeb_C APP_vLim_C /end DEF_CHARACTERISTIC
 /begin REF_CHARACTERISTIC APP_swtCfg_CW /end REF_CHARACTERISTIC
 /begin IN_MEASUREMENT Brk_st Brk_stMn Brk_stRed Com_stHydPCtrlOper Com_stIMGACCBrkReq GlbDa_stTrqDem SyC_ctPostDrvLeave VehV_v /end IN_MEASUREMENT
 /begin OUT_MEASUREMENT APP_bPlaBrk APP_flgHiGrdt /end OUT_MEASUREMENT
 /begin LOC_MEASUREMENT APP_bBrkActv APP_cntrReIni /end LOC_MEASUREMENT
 FUNCTION_VERSION "169.2.0" /end FUNCTION
/begin COMPU_METHOD Acc "" RAT_FUNC "%6.5" "m/s^2" COEFFS 0 1000 0 0 0 1 /end COMPU_METHOD
/begin COMPU_METHOD AmpHr "" RAT_FUNC "%6.2" "" COEFFS 0 1 0 0 0 1 /end COMPU_METHOD
/begin COMPU_METHOD AmpSec "" RAT_FUNC "%6.4" "As" COEFFS 0 100 0 0 0 1 /end COMPU_METHOD
/begin COMPU_METHOD Ampsec100 "" RAT_FUNC "%6.0" "As" COEFFS 0 1 0 0 0 100 /end COMPU_METHOD
/begin COMPU_METHOD BATTSENS_SY_Compu "" TAB_VERB "%6.3" "" COMPU_TAB_REF BATTSENS_SY_Compu /end COMPU_METHOD
/begin COMPU_VTAB BATTSENS_SY_Compu "" TAB_VERB 2 0 "False" 1 "True" /end COMPU_VTAB
/begin COMPU_METHOD BATTUDIAGRIPPLEACTV_SC_Compu "" TAB_VERB "%6.3" "" COMPU_TAB_REF BATTUDIAGRIPPLEACTV_SC_Compu /end COMPU_METHOD
/begin COMPU_VTAB BATTUDIAGRIPPLEACTV_SC_Compu "" TAB_VERB 2 0 "False" 1 "True" /end COMPU_VTAB
/begin COMPU_METHOD BBCC_SC_Compu "" TAB_VERB "%6.3" "" COMPU_TAB_REF BBCC_SC_Compu /end COMPU_METHOD
/begin COMPU_VTAB BBCC_SC_Compu "" TAB_VERB 2 0 "False" 1 "True" /end COMPU_VTAB
/begin COMPU_METHOD BBSAFG_SUPRTATS_SC_Compu "" TAB_VERB "%6.3" "" COMPU_TAB_REF BBSAFG_SUPRTATS_SC_Compu /end COMPU_METHOD
/begin COMPU_VTAB BBSAFG_SUPRTATS_SC_Compu "" TAB_VERB 2 0 "False" 1 "True" /end COMPU_VTAB
/begin COMPU_METHOD BBSTVE_SY_Compu "" TAB_VERB "%6.3" "" COMPU_TAB_REF BBSTVE_SY_Compu /end COMPU_METHOD
/begin COMPU_VTAB BBSTVE_SY_Compu "" TAB_VERB 2 0 "False" 1 "True" /end COMPU_VTAB
/begin COMPU_METHOD BGBVG_SY_Compu "" TAB_VERB "%6.3" "" COMPU_TAB_REF BGBVG_SY_Compu /end COMPU_METHOD
/begin COMPU_VTAB BGBVG_SY_Compu "" TAB_VERB 4 0 "0" 1 "1" 2 "2" 3 "3" /end COMPU_VTAB
/begin COMPU_METHOD BKS_SY_Compu "" TAB_VERB "%6.3" "" COMPU_TAB_REF BKS_SY_Compu /end COMPU_METHOD
/begin COMPU_VTAB BKS_SY_Compu "" TAB_VERB 3 0 "BKSWITHOUTNDS" 1 "BKSWITHNDS" 2 "BKSNDSMANUEL" /end COMPU_VTAB
/begin COMPU_METHOD BLOWRIFTYP_SC_Compu "" TAB_VERB "%6.3" "" COMPU_TAB_REF BLOWRIFTYP_SC_Compu /end COMPU_METHOD
/begin COMPU_VTAB BLOWRIFTYP_SC_Compu "" TAB_VERB 7 0 "BLOWRIFTYP_NON" 1 "BLOWRIFTYP_DIG" 2 "BLOWRIFTYP_ADC" 3 "BLOWRIFTYP_MISC" 4 "BLOWRIFTYP_BUS" 5 "BLOWRIFTYP_BUS_DIG" 6 "BLOWRIFTYP_BUS_ADC" /end COMPU_VTAB
/begin COMPU_METHOD BMW_PRODUCTLINE_SY_Compu "" TAB_VERB "%6.3" "" COMPU_TAB_REF BMW_PRODUCTLINE_SY_Compu /end COMPU_METHOD
/begin COMPU_VTAB BMW_PRODUCTLINE_SY_Compu "" TAB_VERB 11 0 "no BMW productline" 1 "L1" 2 "L2" 3 "L3" 4 "L4" 5 "L5" 6 "L6" 7 "L7" 8 "L8" 9 "L9" 10 "L10" /end COMPU_VTAB
/begin COMPU_METHOD BRKBOOSTTQLIMN_SC_Compu "" TAB_VERB "%6.3" "" COMPU_TAB_REF BRKBOOSTTQLIMN_SC_Compu /end COMPU_METHOD
/begin COMPU_VTAB BRKBOOSTTQLIMN_SC_Compu "" TAB_VERB 2 0 "False" 1 "True" /end COMPU_VTAB
/begin COMPU_METHOD BRKBOOST_INHOUSE_SC_Compu "" TAB_VERB "%6.3" "" COMPU_TAB_REF BRKBOOST_INHOUSE_SC_Compu /end COMPU_METHOD
/begin COMPU_VTAB BRKBOOST_INHOUSE_SC_Compu "" TAB_VERB 2 0 "False" 1 "True" /end COMPU_VTAB
/begin COMPU_METHOD BRKBSTMVP_SY_Compu "" TAB_VERB "%6.3" "" COMPU_TAB_REF BRKBSTMVP_SY_Compu /end COMPU_METHOD
/begin COMPU_VTAB BRKBSTMVP_SY_Compu "" TAB_VERB 2 0 "NO_BRKBSTMVP" 1 "BRKBSTMVP_MECH" /end COMPU_VTAB
/begin COMPU_METHOD BRKBSTPMDLENA_SC_Compu "" TAB_VERB "%6.3" "" COMPU_TAB_REF BRKBSTPMDLENA_SC_Compu /end COMPU_METHOD
/begin COMPU_VTAB BRKBSTPMDLENA_SC_Compu "" TAB_VERB 2 0 "No brake booster pressure model" 1 "Brake booster pressure Model" /end COMPU_VTAB
/begin COMPU_METHOD BRKBSTPMP_SC_Compu "" TAB_VERB "%6.3" "" COMPU_TAB_REF BRKBSTPMP_SC_Compu /end COMPU_METHOD
/begin COMPU_VTAB BRKBSTPMP_SC_Compu "" TAB_VERB 2 0 "False" 1 "True" /end COMPU_VTAB
/begin COMPU_METHOD BRKBSTP_SWTADC_SC_Compu "" TAB_VERB "%6.3" "" COMPU_TAB_REF BRKBSTP_SWTADC_SC_Compu /end COMPU_METHOD
/begin COMPU_VTAB BRKBSTP_SWTADC_SC_Compu "" TAB_VERB 2 0 "False" 1 "True" /end COMPU_VTAB
/begin COMPU_METHOD BRKBSTP_TYPAVL_SC_Compu "" TAB_VERB "%6.3" "" COMPU_TAB_REF BRKBSTP_TYPAVL_SC_Compu /end COMPU_METHOD
/begin COMPU_VTAB BRKBSTP_TYPAVL_SC_Compu "" TAB_VERB 2 0 "False" 1 "True" /end COMPU_VTAB
/begin COMPU_METHOD BRKBSTVP_SY_Compu "" TAB_VERB "%6.3" "" COMPU_TAB_REF BRKBSTVP_SY_Compu /end COMPU_METHOD
/begin COMPU_VTAB BRKBSTVP_SY_Compu "" TAB_VERB 3 0 "NO_BRKBSTVP" 1 "BRKBSTVP_CONT" 2 "BRKBSTVP_ONDEM" /end COMPU_VTAB
/begin COMPU_METHOD BRKBST_MDLAIRMF_SC_Compu "" TAB_VERB "%6.3" "" COMPU_TAB_REF BRKBST_MDLAIRMF_SC_Compu /end COMPU_METHOD
/begin COMPU_VTAB BRKBST_MDLAIRMF_SC_Compu "" TAB_VERB 2 0 "Disable" 1 "Enable" /end COMPU_VTAB
/begin COMPU_METHOD BRKEXT_SY_Compu "" TAB_VERB "%6.3" "" COMPU_TAB_REF BRKEXT_SY_Compu /end COMPU_METHOD
/begin COMPU_VTAB BRKEXT_SY_Compu "" TAB_VERB 2 0 "False" 1 "True" /end COMPU_VTAB
/begin COMPU_METHOD BRKPEDLEVLN_SC_Compu "" RAT_FUNC "%6.2" "" COEFFS 0 1 0 0 0 1 /end COMPU_METHOD
/begin COMPU_METHOD BRKP_ACQCANENA_SC_Compu "" TAB_VERB "%6.3" "" COMPU_TAB_REF BRKP_ACQCANENA_SC_Compu /end COMPU_METHOD
/begin COMPU_VTAB BRKP_ACQCANENA_SC_Compu "" TAB_VERB 2 0 "False" 1 "True" /end COMPU_VTAB
/begin COMPU_METHOD BRKP_ACQHWENA_SC_Compu "" TAB_VERB "%6.3" "" COMPU_TAB_REF BRKP_ACQHWENA_SC_Compu /end COMPU_METHOD
/begin COMPU_VTAB BRKP_ACQHWENA_SC_Compu "" TAB_VERB 2 0 "Disable" 1 "Enable" /end COMPU_VTAB
/begin COMPU_METHOD BRKP_PHYSRNGCHK_SY_Compu "" TAB_VERB "%6.3" "" COMPU_TAB_REF BRKP_PHYSRNGCHK_SY_Compu /end COMPU_METHOD
/begin COMPU_VTAB BRKP_PHYSRNGCHK_SY_Compu "" TAB_VERB 2 0 "False" 1 "True" /end COMPU_VTAB
/begin COMPU_METHOD BRKP_SC_Compu "" TAB_VERB "%6.3" "" COMPU_TAB_REF BRKP_SC_Compu /end COMPU_METHOD
/begin COMPU_VTAB BRKP_SC_Compu "" TAB_VERB 2 0 "False" 1 "True" /end COMPU_VTAB
/begin COMPU_METHOD BRKSWTECU_SY_Compu "" TAB_VERB "%6.3" "" COMPU_TAB_REF BRKSWTECU_SY_Compu /end COMPU_METHOD
/begin COMPU_VTAB BRKSWTECU_SY_Compu "" TAB_VERB 2 0 "False" 1 "True" /end COMPU_VTAB
/begin COMPU_METHOD BRK_ATS_SY_Compu "" TAB_VERB "%6.3" "" COMPU_TAB_REF BRK_ATS_SY_Compu /end COMPU_METHOD
/begin COMPU_VTAB BRK_ATS_SY_Compu "" TAB_VERB 2 0 "ATS disabled" 1 "ATS enabled" /end COMPU_VTAB
/begin COMPU_METHOD BRK_BRKR_SY_Compu "" TAB_VERB "%6.3" "" COMPU_TAB_REF BRK_BRKR_SY_Compu /end COMPU_METHOD
/begin COMPU_VTAB BRK_BRKR_SY_Compu "" TAB_VERB 4 0 "BRKR_OFF" 1 "BRKR_ADC_ON" 2 "BRKR_PWM_ON" 3 "BRKR_ADCPWM_ON" /end COMPU_VTAB
/begin COMPU_METHOD BRK_OPTNSWTSEL_SY_Compu "" TAB_VERB "%6.3" "" COMPU_TAB_REF BRK_OPTNSWTSEL_SY_Compu /end COMPU_METHOD
/begin COMPU_VTAB BRK_OPTNSWTSEL_SY_Compu "" TAB_VERB 2 0 "False" 1 "True" /end COMPU_VTAB
/begin COMPU_METHOD BRK_RAT_SC_Compu "" TAB_VERB "%6.3" "" COMPU_TAB_REF BRK_RAT_SC_Compu /end COMPU_METHOD
/begin COMPU_VTAB BRK_RAT_SC_Compu "" TAB_VERB 2 0 "False" 1 "True" /end COMPU_VTAB
/begin COMPU_METHOD BRK_RDNTBRK_SC_Compu "" TAB_VERB "%6.3" "" COMPU_TAB_REF BRK_RDNTBRK_SC_Compu /end COMPU_METHOD
/begin COMPU_VTAB BRK_RDNTBRK_SC_Compu "" TAB_VERB 2 0 "NOTAVAILABLE" 1 "AVAILABLE" /end COMPU_VTAB
/begin COMPU_METHOD BRK_SIGSELMASK_SC_Compu "" RAT_FUNC "%6.2" "" COEFFS 0 1 0 0 0 1 /end COMPU_METHOD
/begin COMPU_METHOD BRSBLTDRVN_SC_Compu "" TAB_VERB "%6.3" "" COMPU_TAB_REF BRSBLTDRVN_SC_Compu /end COMPU_METHOD
/begin COMPU_VTAB BRSBLTDRVN_SC_Compu "" TAB_VERB 2 0 "NOBRSBLTDRVN" 1 "BRSBLTDRVN" /end COMPU_VTAB
/begin COMPU_METHOD BSTSET_TCHISPDPROTNENA_SC_Compu "" TAB_VERB "%6.3" "" COMPU_TAB_REF BSTSET_TCHISPDPROTNENA_SC_Compu /end COMPU_METHOD
/begin COMPU_VTAB BSTSET_TCHISPDPROTNENA_SC_Compu "" TAB_VERB 2 0 "False" 1 "True" /end COMPU_VTAB
/begin COMPU_METHOD BSWCPTEXCLSN_SC_Compu "" TAB_VERB "%6.3" "" COMPU_TAB_REF BSWCPTEXCLSN_SC_Compu /end COMPU_METHOD
/begin COMPU_VTAB BSWCPTEXCLSN_SC_Compu "" TAB_VERB 1 0 "EXCLUDED" /end COMPU_VTAB
/begin COMPU_METHOD BSWDEVLERRDETNACTVN_SC_Compu "" TAB_VERB "%6.3" "" COMPU_TAB_REF BSWDEVLERRDETNACTVN_SC_Compu /end COMPU_METHOD
/begin COMPU_VTAB BSWDEVLERRDETNACTVN_SC_Compu "" TAB_VERB 2 0 "False" 1 "True" /end COMPU_VTAB
/begin COMPU_METHOD B_TRUE "" TAB_VERB "%6.3" "" COMPU_TAB_REF B_TRUE /end COMPU_METHOD
/begin COMPU_VTAB B_TRUE "" TAB_VERB 2 0 "FALSE" 1 "TRUE" /end COMPU_VTAB
/begin COMPU_METHOD Curr "" RAT_FUNC "%6.2" "mA" COEFFS 0 1 0 0 0 1 /end COMPU_METHOD
/begin COMPU_METHOD Curr_A "" RAT_FUNC "%6.4" "A" COEFFS 0 100 0 0 0 1 /end COMPU_METHOD
/begin COMPU_METHOD dez "" RAT_FUNC "%6.2" "" COEFFS 0 1 0 0 0 1 /end COMPU_METHOD
/begin COMPU_METHOD DtyCyc "" RAT_FUNC "%6.4" "%" COEFFS 0 100 0 0 0 1 /end COMPU_METHOD
/begin COMPU_METHOD ElecChrg_Ah_q0p125_COMPU "" RAT_FUNC "%6.3" "Ah" COEFFS 0 8 0 0 0 1 /end COMPU_METHOD
/begin COMPU_METHOD EngN "" RAT_FUNC "%6.3" "rpm" COEFFS 0 2 0 0 0 1 /end COMPU_METHOD
/begin COMPU_METHOD EngN_2 "" RAT_FUNC "%6.2" "rpm" COEFFS 0 1 0 0 0 2 /end COMPU_METHOD
/begin COMPU_METHOD Fact "" RAT_FUNC "%6.5" "-" COEFFS 0 8192 0 0 0 1 /end COMPU_METHOD
/begin COMPU_METHOD Fact1 "" RAT_FUNC "%6.4" "-" COEFFS 0 128 0 0 0 1 /end COMPU_METHOD
/begin COMPU_METHOD Fact100 "" RAT_FUNC "%6.4" "-" COEFFS 0 100 0 0 0 1 /end COMPU_METHOD
/begin COMPU_METHOD Fact_10000 "" RAT_FUNC "%7.6" "-" COEFFS 0 10000 0 0 0 1 /end COMPU_METHOD
/begin COMPU_METHOD fak_sw_b8 "" RAT_FUNC "%6.5" "-" COEFFS 0 65536 0 0 0 16 /end COMPU_METHOD
/begin COMPU_METHOD kw_q0p00305_KWdivMPa "" RAT_FUNC "%6.4" "deg KW/MPa" COEFFS 0 8192 0 0 0 25 /end COMPU_METHOD
/begin COMPU_METHOD kw_q0p1 "" RAT_FUNC "%6.3" "Grad KW" COEFFS 0 10 0 0 0 1 /end COMPU_METHOD
/begin COMPU_METHOD nmot_sw_q0p5 "" RAT_FUNC "%6.3" "1/min" COEFFS 0 2 0 0 0 1 /end COMPU_METHOD
/begin COMPU_METHOD nmot_ub_q40 "" RAT_FUNC "%6.1" "1/min" COEFFS 0 1 0 0 0 40 /end COMPU_METHOD
/begin COMPU_METHOD OneToOne "" RAT_FUNC "%6.2" "-" COEFFS 0 1 0 0 0 1 /end COMPU_METHOD
/begin COMPU_METHOD Prc "" RAT_FUNC "%6.4" "%" COEFFS 0 81.92 0 0 0 1 /end COMPU_METHOD
/begin COMPU_METHOD PrcPerSec "" RAT_FUNC "%6.3" "%/s" COEFFS 0 1.6384 0 0 0 1 /end COMPU_METHOD
/begin COMPU_METHOD Pwr1 "" RAT_FUNC "%6.3" "W" COEFFS 0 10 0 0 0 1 /end COMPU_METHOD
/begin COMPU_METHOD q0p001_A_s_1 "" RAT_FUNC "%6.5" "As" COEFFS 0 1000 0 0 0 1 /end COMPU_METHOD
/begin COMPU_METHOD q0p01862_Perc_DIV_s2 "" RAT_FUNC "%6.4" "%/s2" COEFFS 0 536870912 0 0 0 10000000 /end COMPU_METHOD
/begin COMPU_METHOD RBPtCel_Perc_0p5_1 "" RAT_FUNC "%6.3" "%" COEFFS 0 2 0 0 0 1 /end COMPU_METHOD
/begin COMPU_METHOD RBPtCel_p_0p002_1 "" RAT_FUNC "%6.4" "MPa" COEFFS 0 1000 0 0 0 2 /end COMPU_METHOD
/begin COMPU_METHOD RBPtCel_q_0p001_1 "" RAT_FUNC "%6.5" "As" COEFFS 0 1000 0 0 0 1 /end COMPU_METHOD
/begin COMPU_METHOD RBPtCel_r_0p00001_1 "" RAT_FUNC "%8.7" "Ohm" COEFFS 0 100000 0 0 0 1 /end COMPU_METHOD
/begin COMPU_METHOD RBPtCel_u_0p01_1 "" RAT_FUNC "%6.4" "V" COEFFS 0 100 0 0 0 1 /end COMPU_METHOD
/begin COMPU_METHOD RBPtCel_u_0p02_1 "" RAT_FUNC "%6.4" "V" COEFFS 0 50 0 0 0 1 /end COMPU_METHOD
/begin COMPU_METHOD RBPtCel_u_10p0_1 "" RAT_FUNC "%6.1" "mV" COEFFS 0 1 0 0 0 10 /end COMPU_METHOD
/begin COMPU_METHOD relPED_q0p00153 "" RAT_FUNC "%6.4" "% PED" COEFFS 0 65535 0 0 0 100 /end COMPU_METHOD
/begin COMPU_METHOD relPED_ub_b100 "" RAT_FUNC "%6.3" "%PED" COEFFS 0 255 0 0 0 100 /end COMPU_METHOD
/begin COMPU_METHOD rel_q0p39 "" RAT_FUNC "%6.3" "%" COEFFS 0 256 0 0 0 100 /end COMPU_METHOD
/begin COMPU_METHOD rel_sw_b50 "" RAT_FUNC "%6.4" "%" COEFFS 0 65536 0 0 0 100 /end COMPU_METHOD
/begin COMPU_METHOD RmpVoltBatt "" RAT_FUNC "%6.3" "mV/s" COEFFS 0 3.2768 0 0 0 1 /end COMPU_METHOD
/begin COMPU_METHOD SCR_TEMP_CELS_float "" RAT_FUNC "%6.2" "deg C" COEFFS 0 1 0 0 0 1 /end COMPU_METHOD
/begin COMPU_METHOD spg_q0p00488 "" RAT_FUNC "%6.4" "V" COEFFS 0 1024 0 0 0 5 /end COMPU_METHOD
/begin COMPU_METHOD t10msxs_uw_b655p35 "" RAT_FUNC "%6.4" "s" COEFFS 0 1 0 0 0 0.01 /end COMPU_METHOD
/begin COMPU_METHOD Temp_Cels "" RAT_FUNC "%6.1" "deg C" COEFFS 0 10 2731.4 0 0 1 /end COMPU_METHOD
/begin COMPU_METHOD Temp_Cels_Diff "" RAT_FUNC "%6.3" "deg C" COEFFS 0 10 0 0 0 1 /end COMPU_METHOD
/begin COMPU_METHOD temp_uw_q0p75_o48 "" RAT_FUNC "%6.2" "Grad C" COEFFS 0 1 48 0 0 0.75 /end COMPU_METHOD
/begin COMPU_METHOD TimeDelay_s "" RAT_FUNC "%6.1" "s" COEFFS 0 0 1 0 0.00023283064365387 0 /end COMPU_METHOD
/begin COMPU_METHOD TimeRed "" RAT_FUNC "%6.3" "s" COEFFS 0 6.25 0 0 0 1 /end COMPU_METHOD
/begin COMPU_METHOD Time_Dt "" RAT_FUNC "%9.8" "s" COEFFS 0 1000000 0 0 0 1 /end COMPU_METHOD
/begin COMPU_METHOD Time_ms "" RAT_FUNC "%6.1" "ms" COEFFS 0 0.1 0 0 0 1 /end COMPU_METHOD
/begin COMPU_METHOD Time_s "" RAT_FUNC "%6.4" "s" COEFFS 0 100 0 0 0 1 /end COMPU_METHOD
/begin COMPU_METHOD Time_sec_q1_COMPU "" RAT_FUNC "%6.2" "s" COEFFS 0 1 0 0 0 1 /end COMPU_METHOD
/begin COMPU_METHOD Trq "" RAT_FUNC "%6.3" "Nm" COEFFS 0 10 0 0 0 1 /end COMPU_METHOD
/begin COMPU_METHOD TrqPrpHigh "" RAT_FUNC "%6.3" "Nm" COEFFS 0 10 0 0 0 1 /end COMPU_METHOD
/begin COMPU_METHOD t_q0p01 "" RAT_FUNC "%6.4" "s" COEFFS 0 100 0 0 0 1 /end COMPU_METHOD
/begin COMPU_METHOD t_q0p02 "" RAT_FUNC "%6.4" "s" COEFFS 0 100 0 0 0 2 /end COMPU_METHOD
/begin COMPU_METHOD t_q0p1 "" RAT_FUNC "%6.3" "s" COEFFS 0 10 0 0 0 1 /end COMPU_METHOD
/begin COMPU_METHOD Vel "" RAT_FUNC "%6.4" "km/h" COEFFS 0 100 0 0 0 1 /end COMPU_METHOD
/begin COMPU_METHOD Volt "" RAT_FUNC "%6.3" "mV" COEFFS 0 5 0 0 0 1 /end COMPU_METHOD
/begin COMPU_METHOD Volt_Alt_100mV "" RAT_FUNC "%6.3" "V" COEFFS 0 10 0 0 0 1 /end COMPU_METHOD
/begin COMPU_METHOD Volt_Batt "" RAT_FUNC "%6.1" "mV" COEFFS 0 0.05 0 0 0 1 /end COMPU_METHOD
/begin COMPU_METHOD Volt_q1 "" RAT_FUNC "%6.2" "V" COEFFS 0 1 0 0 0 1 /end COMPU_METHOD
/begin RECORD_LAYOUT RB_Axis_S16 NO_AXIS_PTS_X 1 SWORD AXIS_PTS_X 2 SWORD INDEX_INCR DIRECT /end RECORD_LAYOUT
/begin RECORD_LAYOUT RB_CurveGroup_S16 FNC_VALUES 1 SWORD COLUMN_DIR DIRECT /end RECORD_LAYOUT
/begin RECORD_LAYOUT RB_Curve_S16_S16 NO_AXIS_PTS_X 1 SWORD AXIS_PTS_X 2 SWORD INDEX_INCR DIRECT FNC_VALUES 3 SWORD COLUMN_DIR DIRECT /end RECORD_LAYOUT
/begin RECORD_LAYOUT RB_Curve_S16_U16_Static NO_AXIS_PTS_X 1 SWORD AXIS_PTS_X 2 SWORD INDEX_INCR DIRECT FNC_VALUES 3 UWORD COLUMN_DIR DIRECT STATIC_RECORD_LAYOUT /end RECORD_LAYOUT
/begin RECORD_LAYOUT RB_Map_S16S16_S16 NO_AXIS_PTS_X 1 SWORD NO_AXIS_PTS_Y 2 SWORD AXIS_PTS_X 3 SWORD INDEX_INCR DIRECT AXIS_PTS_Y 4 SWORD INDEX_INCR DIRECT FNC_VALUES 5 SWORD COLUMN_DIR DIRECT /end RECORD_LAYOUT
/begin RECORD_LAYOUT RB_Map_S16S16_U16 NO_AXIS_PTS_X 1 SWORD NO_AXIS_PTS_Y 2 SWORD AXIS_PTS_X 3 SWORD INDEX_INCR DIRECT AXIS_PTS_Y 4 SWORD INDEX_INCR DIRECT FNC_VALUES 5 UWORD COLUMN_DIR DIRECT /end RECORD_LAYOUT
/begin RECORD_LAYOUT RB_Map_S16U16_S16 NO_AXIS_PTS_X 1 SWORD NO_AXIS_PTS_Y 2 SWORD AXIS_PTS_X 3 SWORD INDEX_INCR DIRECT AXIS_PTS_Y 4 UWORD INDEX_INCR DIRECT FNC_VALUES 5 SWORD ROW_DIR DIRECT /end RECORD_LAYOUT
/begin RECORD_LAYOUT RB_Map_S16U8_S16 NO_AXIS_PTS_X 1 SWORD NO_AXIS_PTS_Y 2 SWORD AXIS_PTS_X 3 SWORD INDEX_INCR DIRECT AXIS_PTS_Y 4 UBYTE INDEX_INCR DIRECT FNC_VALUES 5 SWORD COLUMN_DIR DIRECT /end RECORD_LAYOUT
/begin RECORD_LAYOUT RB_Map_U16S16_S16 NO_AXIS_PTS_X 1 UWORD NO_AXIS_PTS_Y 2 UWORD AXIS_PTS_X 3 UWORD INDEX_INCR DIRECT AXIS_PTS_Y 4 SWORD INDEX_INCR DIRECT FNC_VALUES 5 SWORD COLUMN_DIR DIRECT /end RECORD_LAYOUT
/begin RECORD_LAYOUT RB_Val_Wboolean FNC_VALUES 1 UBYTE COLUMN_DIR DIRECT /end RECORD_LAYOUT
/begin RECORD_LAYOUT RB_Val_Ws16 FNC_VALUES 1 SWORD COLUMN_DIR DIRECT /end RECORD_LAYOUT
/begin RECORD_LAYOUT RB_Val_Ws32 FNC_VALUES 1 SLONG COLUMN_DIR DIRECT /end RECORD_LAYOUT
/begin RECORD_LAYOUT RB_Val_Wu16 FNC_VALUES 1 UWORD COLUMN_DIR DIRECT /end RECORD_LAYOUT
/begin RECORD_LAYOUT RB_Val_Wu32 FNC_VALUES 1 ULONG COLUMN_DIR DIRECT /end RECORD_LAYOUT
/begin RECORD_LAYOUT RB_Val_Wu8 FNC_VALUES 1 UBYTE COLUMN_DIR DIRECT /end RECORD_LAYOUT
/end MODULE
/end PROJECT
