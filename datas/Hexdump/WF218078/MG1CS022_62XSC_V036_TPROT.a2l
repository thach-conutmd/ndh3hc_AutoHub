ASAP2_VERSION 1 60
/begin PROJECT MG1CS022 "MG1CS022"
/begin HEADER "" VERSION "MG1CS022_62XSC_V036_TPROT" PROJECT_NO MG1CS022 /end HEADER
/begin MODULE DIM ""
/begin MOD_COMMON "" BYTE_ORDER MSB_LAST ALIGNMENT_BYTE 1 ALIGNMENT_WORD 2 ALIGNMENT_LONG 4 ALIGNMENT_INT64 4 ALIGNMENT_FLOAT32_IEEE 4 ALIGNMENT_FLOAT64_IEEE 4 DATA_SIZE 32 /end MOD_COMMON
/begin CHARACTERISTIC EGSDO2_cntrLoad_C "Threshold for counter of load changes" VALUE 0x8053E847 RB_Val_Wu8 255.0 dez 0.00 255.0 FORMAT "%5.1" /end CHARACTERISTIC
/begin CHARACTERISTIC EGSDO2_dratFillgEnaOffs_C "Maximal allowed change in filling to enable fast offset adaptation" VALUE 0x8053E848 RB_Val_Wu16 1535.977 relNWU_q0p0234 0.00 1535.977 FORMAT "%8.3" /end CHARACTERISTIC
/begin CHARACTERISTIC EGSDO2_facFuByFpcPlaus_T "Maximum permissible fuel purge control factor for enabling the slow offset check" CURVE 0x8053E8A4 RB_Curve_S8_U16_Static 3.999939 fak_uw_b4 0.00 3.999939 FORMAT "%8.6"
 /begin AXIS_DESCR STD_AXIS NO_INPUT_QUANTITY fak_sb_b64 6 -64.00 63.50 FORMAT "%5.2" DEPOSIT ABSOLUTE /end AXIS_DESCR
/end CHARACTERISTIC
/begin CHARACTERISTIC EGSDO2_facInertGasEgr_C "Factor for weighting the relative filling of inert gas" VALUE 0x8053E958 RB_Val_Wu16 1.999969 fak_uw_b2 0.00 1.999969 FORMAT "%8.6" /end CHARACTERISTIC
/begin CHARACTERISTIC EGSDO2_facOffsFastNegPlaus_C "Offsetadpation factor during negative i-part after activation of the fast offset adaption in the slow path" VALUE 0x8053E8B8 RB_Val_Wu16 0.9999847 fak_uw_b1 0.00 0.9999847 FORMAT "%9.7" /end CHARACTERISTIC
/begin CHARACTERISTIC EGSDO2_facOffsFastPosPlaus_C "Offsetadpation factor during positive i-part after activation of the fast offset adaption in the slow path" VALUE 0x8053E8BA RB_Val_Wu16 0.9999847 fak_uw_b1 0.00 0.9999847 FORMAT "%9.7" /end CHARACTERISTIC
/begin CHARACTERISTIC EGSDO2_facOffsFast_C "Learning factor for fast offset adaptation" VALUE 0x8053E7C8 RB_Val_Wu16 0.9999847 fak_uw_b1 0.00 0.9999847 FORMAT "%9.7" /end CHARACTERISTIC
/begin CHARACTERISTIC EGSDO2_facOffsSlowNegPlaus_C "Offsetadpation factor during negative i-part in the slow path" VALUE 0x8053E8BC RB_Val_Wu16 0.9999847 fak_uw_b1 0.00 0.9999847 FORMAT "%9.7" /end CHARACTERISTIC
/begin CHARACTERISTIC EGSDO2_facOffsSlowPosPlaus_C "Offsetadpation factor during positive i-part in the slow path" VALUE 0x8053E8BE RB_Val_Wu16 0.9999847 fak_uw_b1 0.00 0.9999847 FORMAT "%9.7" /end CHARACTERISTIC
/begin CHARACTERISTIC EGSDO2_facScaOffsSlow_T "mass flow dependent scaling factor for to scale down the I-Part of the offset diagnosis" CURVE 0x8053E8D8 RB_Curve_R32_U16_Static 0.9999695 fak_uw_b1 0.0000153 0.9999847 FORMAT "%9.7" EXTENDED_LIMITS 0.00 0.9999847
 /begin AXIS_DESCR STD_AXIS NO_INPUT_QUANTITY AirMassPerTime_float 6 -50000.0000 50000.0000 FORMAT "%10.4" EXTENDED_LIMITS -3.40282347E+038 3.40282347E+038 DEPOSIT ABSOLUTE /end AXIS_DESCR
/end CHARACTERISTIC
/begin CHARACTERISTIC EGSDO2_flgActvnRedCondVirt_C "Activation of the reduced enabling conditions of the virtual offset adaption (only in case Offset runs befor parallelization)" VALUE 0x8053E84A RB_Val_Wu8 1.00000000000 B_TRUE 0.00 1.00000000000 FORMAT "%13.11" /end CHARACTERISTIC
/begin CHARACTERISTIC EGSDO2_flgEnaChkOnceOffsFast_CW "Codeword to activate the One-time check of the fast offset adaptation" VALUE 0x8053E84B RB_Val_Wu8 1.00000000000 B_TRUE 0.00 1.00000000000 FORMAT "%13.11" /end CHARACTERISTIC
/begin CHARACTERISTIC EGSDO2_flgEnaCnsdrCtrlrLim_C "To decide if a mixture error shall be taken into account as a root cause for an UEGO offset error" VALUE 0x8053E7CA RB_Val_Wu8 1.00000000000 B_TRUE 0.00 1.00000000000 FORMAT "%13.11" /end CHARACTERISTIC
/begin CHARACTERISTIC EGSDO2_flgEnaDebRatLamOffs_CW "enable debouncing based on lambda value" VALUE 0x8053E84C RB_Val_Wu8 1.00000000000 B_TRUE 0.00 1.00000000000 FORMAT "%13.11" /end CHARACTERISTIC
/begin CHARACTERISTIC EGSDO2_flgITwcHiResl_C "Code bit: I-part of lambda control downstream catalyst with high resolution" VALUE 0x8053E8C0 RB_Val_Wu8 1.00000000000 B_TRUE 0.00 1.00000000000 FORMAT "%13.11" /end CHARACTERISTIC
/begin CHARACTERISTIC EGSDO2_flgLamOffsFastAftParl_CW "Fast offset adaptation runs after parallelization" VALUE 0x8053E900 RB_Val_Wu8 1.00000000000 B_TRUE 0.00 1.00000000000 FORMAT "%13.11" /end CHARACTERISTIC
/begin CHARACTERISTIC EGSDO2_flgLamOffsFastPreParl_CW "Fast offset adaptation runs before parallelization" VALUE 0x8053E901 RB_Val_Wu8 1.00000000000 B_TRUE 0.00 1.00000000000 FORMAT "%13.11" /end CHARACTERISTIC
/begin CHARACTERISTIC EGSDO2_flgLimLamOffsDynErr_CW "Codebit: Alternative limits for lambda offset in case of a dynamic error" VALUE 0x8053E8C1 RB_Val_Wu8 1.00000000000 B_TRUE 0.00 1.00000000000 FORMAT "%13.11" /end CHARACTERISTIC
/begin CHARACTERISTIC EGSDO2_flgRstLamOffsDynErr_CW "Reset of lambda offset in case of a LSU dynamic error to the value at the beginning of the driving cycle" VALUE 0x8053E8C2 RB_Val_Wu8 1.00000000000 B_TRUE 0.00 1.00000000000 FORMAT "%13.11" /end CHARACTERISTIC
/begin CHARACTERISTIC EGSDO2_flgSlopChgIni_C "Activation of the reset filter and delay if change in slope direction" VALUE 0x8053E964 RB_Val_Wu8 1.00000000000 B_TRUE 0.00 1.00000000000 FORMAT "%13.11" /end CHARACTERISTIC
/begin CHARACTERISTIC EGSDO2_mExhEnaGnrlNoCatPurge_C "Minimal exhaust mass threshold for general enabling of fast offset adaption if no catalyst purge done before" VALUE 0x8053E84E RB_Val_Wu16 1820.417 m_q0p0277_g 0.00 1820.417 FORMAT "%8.3" /end CHARACTERISTIC
/begin CHARACTERISTIC EGSDO2_mExhEnaGnrlShtrp_C "Minimal exhaust mass threshold for general enabling of fast offset adaption during short trip" VALUE 0x8053E850 RB_Val_Wu16 1820.417 m_q0p0277_g 0.00 1820.417 FORMAT "%8.3" /end CHARACTERISTIC
/begin CHARACTERISTIC EGSDO2_mExhEnaGnrl_C "Minimal exhaust mass threshold for general enabling of fast offset adaption" VALUE 0x8053E852 RB_Val_Wu16 1820.417 m_q0p0277_g 0.00 1820.417 FORMAT "%8.3" /end CHARACTERISTIC
/begin CHARACTERISTIC EGSDO2_mExhEnaOffsFastPlaus_C "Massflow threshold for the fast offset adaption in the slow path" VALUE 0x8053E902 RB_Val_Wu16 65.53500 m_q0p001_kg 0.00 65.53500 FORMAT "%8.5" /end CHARACTERISTIC
/begin CHARACTERISTIC EGSDO2_mExhEnaOffsFast_T "Minimal exhaust mass threshold for enabling of fast offset adaption" CURVE 0x8053E7CC RB_Curve_S16_U16_Static 1820.417 m_q0p0277_g 0.00 1820.417 FORMAT "%8.3"
 /begin AXIS_DESCR STD_AXIS NO_INPUT_QUANTITY fak_sw_b1 8 -1.000000 0.999969 FORMAT "%8.6" EXTENDED_LIMITS -1.000000 0.9999695 DEPOSIT ABSOLUTE /end AXIS_DESCR
/end CHARACTERISTIC
/begin CHARACTERISTIC EGSDO2_mExhEnaOffsSlowPlaus_C "Exhaust gas mass for the debouncing of release for adaption and diagnose" VALUE 0x8053E904 RB_Val_Wu16 65.53500 m_q0p001_kg 0.00 65.53500 FORMAT "%8.5" /end CHARACTERISTIC
/begin CHARACTERISTIC EGSDO2_mExhEnaShtrp_C "Minimal exhaust mass threshold for enabling of fast offset adaption during short trip" VALUE 0x8053E7EE RB_Val_Wu16 1820.417 m_q0p0277_g 0.00 1820.417 FORMAT "%8.3" /end CHARACTERISTIC
/begin CHARACTERISTIC EGSDO2_mExhMEnaVirt_T "Minimal virtual exhaust mass threshold for enabling fast offset adaption in context of IUMPR simulation" CURVE 0x8053E7F0 RB_Curve_U8_U16_Static 1820.417 m_q0p0277_g 0.00 1820.417 FORMAT "%8.3"
 /begin AXIS_DESCR STD_AXIS NO_INPUT_QUANTITY dez 3 0.00 255.0 FORMAT "%5.1" DEPOSIT ABSOLUTE /end AXIS_DESCR
/end CHARACTERISTIC
/begin CHARACTERISTIC EGSDO2_mfExhCatVirtHev_C "Virtual exhaust mass flow in catalyst at hybrid operation (for IUMPR simulation)" VALUE 0x8053E854 RB_Val_Wu16 6553.500 m_uw_b6553p5 0.00 6553.500 FORMAT "%8.3" /end CHARACTERISTIC
/begin CHARACTERISTIC EGSDO2_mfExhMaxOffsFast_C "Maximal exhaust mass flow to enable fast offset adaptation" VALUE 0x8053E856 RB_Val_Wu16 6553.500 m_uw_b6553p5 0.00 6553.500 FORMAT "%8.3" /end CHARACTERISTIC
/begin CHARACTERISTIC EGSDO2_mfExhMinOffsFastShtrp_C "Minimal exhaust mass flow to enable fast offset adaptation during short trip" VALUE 0x8053E858 RB_Val_Wu16 6553.500 m_uw_b6553p5 0.00 6553.500 FORMAT "%8.3" /end CHARACTERISTIC
/begin CHARACTERISTIC EGSDO2_mfExhMinOffsFast_C "Minimal exhaust mass flow to enable fast offset adaptation" VALUE 0x8053E85A RB_Val_Wu16 6553.500 m_uw_b6553p5 0.00 6553.500 FORMAT "%8.3" /end CHARACTERISTIC
/begin CHARACTERISTIC EGSDO2_mfExhTmpMaxOffsFast_C "Maximum exhaust gas flow for the temporary release of the fast offset adaptation" VALUE 0x8053E85C RB_Val_Wu16 6553.500 m_uw_b6553p5 0.00 6553.500 FORMAT "%8.3" /end CHARACTERISTIC
/begin CHARACTERISTIC EGSDO2_mfExhTmpMinOffsFast_C "Minimal exhaust mass flow to temporarily enable fast offset adaptation" VALUE 0x8053E85E RB_Val_Wu16 6553.500 m_uw_b6553p5 0.00 6553.500 FORMAT "%8.3" /end CHARACTERISTIC
/begin CHARACTERISTIC EGSDO2_nEngMinEnaOffsFast_C "Minimal engine speed to enable fast offset adaptation" VALUE 0x8053E860 RB_Val_Ws16 32767.50 EngN -16384.00 16383.50 FORMAT "%8.2" /end CHARACTERISTIC
/begin CHARACTERISTIC EGSDO2_nEngSlowOffsMax_C "Maximum engine speed for slow adaptation" VALUE 0x8053E906 RB_Val_Ws16 32767.50 EngN -16384.00 16383.50 FORMAT "%8.2" /end CHARACTERISTIC
/begin CHARACTERISTIC EGSDO2_nEngSlowOffsMin_C "Minimum engine speed for slow adaptation" VALUE 0x8053E908 RB_Val_Ws16 32767.50 EngN -16384.00 16383.50 FORMAT "%8.2" /end CHARACTERISTIC
/begin CHARACTERISTIC EGSDO2_nrCntrOffsPredAbvThd_C "Threshold for counter that predicted offset is above threshold" VALUE 0x8053E7FA RB_Val_Wu16 65535.00 dez 0.00 65535.00 FORMAT "%8.2" /end CHARACTERISTIC
/begin CHARACTERISTIC EGSDO2_nrExhMOffsFastVirt_C "Necessary number of exhaust masses to virtually debounce fault with fast offset adaptation (IUMPR simulation)" VALUE 0x8053E7FC RB_Val_Wu8 255.0 dez 0.00 255.0 FORMAT "%5.1" /end CHARACTERISTIC
/begin CHARACTERISTIC EGSDO2_nrExhMOffsFast_C "Necessary number of exhaust masses to debounce fault with fast offset adaptation" VALUE 0x8053E7FD RB_Val_Wu8 255.0 dez 0.00 255.0 FORMAT "%5.1" /end CHARACTERISTIC
/begin CHARACTERISTIC EGSDO2_nrNoStepRowOffsFast_C "Necessary number of no offset step (or increasing offset) in a row to debounce fast offset adaptation" VALUE 0x8053E7FE RB_Val_Wu8 255.0 dez 0.00 255.0 FORMAT "%5.1" /end CHARACTERISTIC
/begin CHARACTERISTIC EGSDO2_numGrdtPnt_C "number of values for moving average of reciprocal lambda gradient" VALUE 0x8053E965 RB_Val_Wu8 254.0 OneToOne 1.0 255.0 FORMAT "%5.1" EXTENDED_LIMITS 0.00 255.0 /end CHARACTERISTIC
/begin CHARACTERISTIC EGSDO2_ofsCntrLoad_C "Positive offset for counter at load change" VALUE 0x8053E862 RB_Val_Wu8 255.0 dez 0.00 255.0 FORMAT "%5.1" /end CHARACTERISTIC
/begin CHARACTERISTIC EGSDO2_ofsCntrNegOffsFast_C "Negative offset to reduced counter after fast offset adaptation" VALUE 0x8053E7FF RB_Val_Wu8 255.0 dez 0.00 255.0 FORMAT "%5.1" /end CHARACTERISTIC
/begin CHARACTERISTIC EGSDO2_ratFuTrmFltMax_C "Maximal (upper) fault threshold for fuel trim" VALUE 0x8053E90A RB_Val_Ws16 1.999969 fak_sw_b1 -1.000000 0.999969 FORMAT "%8.6" EXTENDED_LIMITS -1.000000 0.9999695 /end CHARACTERISTIC
/begin CHARACTERISTIC EGSDO2_ratFuTrmFltMin_C "Minimal (lower) fault threshold for fuel trim" VALUE 0x8053E90C RB_Val_Ws16 1.999969 fak_sw_b1 -1.000000 0.999969 FORMAT "%8.6" EXTENDED_LIMITS -1.000000 0.9999695 /end CHARACTERISTIC
/begin CHARACTERISTIC EGSDO2_ratLamDeltaActMax_C "Threshold for change in LSU offset to detect fast adaptation step" VALUE 0x8053E800 RB_Val_Ws32 131071.999969 fak_sw_b1 -65536.0000000 65535.9999695 FORMAT "%13.7" /end CHARACTERISTIC
/begin CHARACTERISTIC EGSDO2_ratLamOffsChgFuTrmCfm_C "Maximal offset change in non-fault direction for confirmation of fuel trim fault" VALUE 0x8053E8C4 RB_Val_Ws16 1.999969 fak_sw_b1 -1.000000 0.999969 FORMAT "%8.6" EXTENDED_LIMITS -1.000000 0.9999695 /end CHARACTERISTIC
/begin CHARACTERISTIC EGSDO2_ratLamOffsFastMaxDePlaus_C "Deviation if the offset for the deactivation of the fast offset adaption during slow path" VALUE 0x8053E8C6 RB_Val_Ws16 1.999969 fak_sw_b1 -1.000000 0.999969 FORMAT "%8.6" EXTENDED_LIMITS -1.000000 0.9999695 /end CHARACTERISTIC
/begin CHARACTERISTIC EGSDO2_ratLamOffsFltMax_C "Maximal (upper) fault threshold for lambda offset" VALUE 0x8053E90E RB_Val_Ws16 1.999969 fak_sw_b1 -1.000000 0.999969 FORMAT "%8.6" EXTENDED_LIMITS -1.000000 0.9999695 /end CHARACTERISTIC
/begin CHARACTERISTIC EGSDO2_ratLamOffsFltMin_C "Minimal (lower) fault threshold for lambda offset" VALUE 0x8053E910 RB_Val_Ws16 1.999969 fak_sw_b1 -1.000000 0.999969 FORMAT "%8.6" EXTENDED_LIMITS -1.000000 0.9999695 /end CHARACTERISTIC
/begin CHARACTERISTIC EGSDO2_ratLamOffsMaxDynErr_C "Maximal limit for lambda offset in case of LSU dynamic fault" VALUE 0x8053E8C8 RB_Val_Ws16 1.999969 fak_sw_b1 -1.000000 0.999969 FORMAT "%8.6" EXTENDED_LIMITS -1.000000 0.9999695 /end CHARACTERISTIC
/begin CHARACTERISTIC EGSDO2_ratLamOffsMax_C "Maximal limit for lambda offset" VALUE 0x8053E8CA RB_Val_Ws16 1.999969 fak_sw_b1 -1.000000 0.999969 FORMAT "%8.6" EXTENDED_LIMITS -1.000000 0.9999695 /end CHARACTERISTIC
/begin CHARACTERISTIC EGSDO2_ratLamOffsMinDynErr_C "Minimal limit for lambda offset in case of LSU dynamic fault" VALUE 0x8053E8CC RB_Val_Ws16 1.999969 fak_sw_b1 -1.000000 0.999969 FORMAT "%8.6" EXTENDED_LIMITS -1.000000 0.9999695 /end CHARACTERISTIC
/begin CHARACTERISTIC EGSDO2_ratLamOffsMin_C "Minimal limit for lambda offset" VALUE 0x8053E8CE RB_Val_Ws16 1.999969 fak_sw_b1 -1.000000 0.999969 FORMAT "%8.6" EXTENDED_LIMITS -1.000000 0.9999695 /end CHARACTERISTIC
/begin CHARACTERISTIC EGSDO2_ratLamOffsPredCntr_C "Threshold for predicted lambda offset to increment counter" VALUE 0x8053E804 RB_Val_Wu16 1.999969 fak_uw_b2 0.00 1.999969 FORMAT "%8.6" /end CHARACTERISTIC
/begin CHARACTERISTIC EGSDO2_ratLamOffsPredCtrlrLim_C "Threshold for predicted lambda offset if controller is in limitation" VALUE 0x8053E806 RB_Val_Wu16 1.999969 fak_uw_b2 0.00 1.999969 FORMAT "%8.6" /end CHARACTERISTIC
/begin CHARACTERISTIC EGSDO2_ratLamOffsPredNeg_T "Threshold for negative predicted lambda offset to enable fast offset adaptation" CURVE 0x8053E808 RB_Curve_U16_U16 1.999969 fak_uw_b2 0.00 1.999969 FORMAT "%8.6"
 /begin AXIS_DESCR STD_AXIS NO_INPUT_QUANTITY fak_uw_b2 5 0.00 1.999969 FORMAT "%8.6" DEPOSIT ABSOLUTE /end AXIS_DESCR
/end CHARACTERISTIC
/begin CHARACTERISTIC EGSDO2_ratLamOffsPredPos_T "Threshold for positive predicted lambda offset to enable fast offset adaptation" CURVE 0x8053E81E RB_Curve_U16_U16 1.999969 fak_uw_b2 0.00 1.999969 FORMAT "%8.6"
 /begin AXIS_DESCR STD_AXIS NO_INPUT_QUANTITY fak_uw_b2 5 0.00 1.999969 FORMAT "%8.6" DEPOSIT ABSOLUTE /end AXIS_DESCR
/end CHARACTERISTIC
/begin CHARACTERISTIC EGSDO2_ratLamSpMaxMntdDiag_C "maximal lambda set point for sensor mounted diagnosis" VALUE 0x8053E968 RB_Val_Wu16 15.99976 fak_uw_b16 0.00 15.99976 FORMAT "%8.5" /end CHARACTERISTIC
/begin CHARACTERISTIC EGSDO2_ratLoadMinEnaOffsFastShtrp_C "Minimum relative load for release of fas offset adptation during short trip" VALUE 0x8053E864 RB_Val_Wu16 1535.977 rel_uw_q0p0234 0.00 1535.977 FORMAT "%8.3" /end CHARACTERISTIC
/begin CHARACTERISTIC EGSDO2_ratLoadMinEnaOffsFast_T "Minimal relative load to enable fast offset adaptation (engine speed dependent curve)" CURVE 0x8053E866 RB_Curve_S16_U16_Static 1535.977 rel_uw_q0p0234 0.00 1535.977 FORMAT "%8.3"
 /begin AXIS_DESCR STD_AXIS Epm_nEng EngN 5 -16384.00 16383.50 FORMAT "%8.2" DEPOSIT ABSOLUTE /end AXIS_DESCR
/end CHARACTERISTIC
/begin CHARACTERISTIC EGSDO2_ratLoadSlowOffsMax_T "Maximum relative load for slow adaptation" CURVE 0x8053E912 RB_Curve_S16_U16_Static 1535.977 rel_q0p0234 0.00 1535.977 FORMAT "%8.3"
 /begin AXIS_DESCR STD_AXIS Epm_nEng EngN 6 -16384.00 16383.50 FORMAT "%8.2" DEPOSIT ABSOLUTE /end AXIS_DESCR
/end CHARACTERISTIC
/begin CHARACTERISTIC EGSDO2_ratLoadSlowOffsMin_T "Minimum relative load for slow adaptation" CURVE 0x8053E92C RB_Curve_S16_U16_Static 1535.977 rel_q0p0234 0.00 1535.977 FORMAT "%8.3"
 /begin AXIS_DESCR STD_AXIS Epm_nEng EngN 6 -16384.00 16383.50 FORMAT "%8.2" DEPOSIT ABSOLUTE /end AXIS_DESCR
/end CHARACTERISTIC
/begin CHARACTERISTIC EGSDO2_ratLoadThdOffsFast_C "Relative Air charge threshold above the minimal permissible relative air charge for enabling lambda offset fault detection." VALUE 0x8053E87C RB_Val_Ws16 1535.977 rel_uw_q0p0234 -768.0000 767.9766 FORMAT "%8.4" /end CHARACTERISTIC
/begin CHARACTERISTIC EGSDO2_rPCtlPriMaxPlaus_C "Maximum allowed p-part of the downstream catalyst control for the release of adaption and diagnose" VALUE 0x8053E946 RB_Val_Ws16 1.999969 fak_sw_b1 -1.000000 0.999969 FORMAT "%8.6" EXTENDED_LIMITS -1.000000 0.9999695 /end CHARACTERISTIC
/begin CHARACTERISTIC EGSDO2_rPCtlPriMinPlaus_C "Minimal allowed p-part of the downstream catalyst control for the release of adaption and diagnose" VALUE 0x8053E948 RB_Val_Ws16 1.999969 fak_sw_b1 -1.000000 0.999969 FORMAT "%8.6" EXTENDED_LIMITS -1.000000 0.9999695 /end CHARACTERISTIC
/begin CHARACTERISTIC EGSDO2_stLamOffsFast_C "Code word of fast offset adaptation" VALUE 0x8053E87E RB_Val_Wu8 255.0 dez 0.00 255.0 FORMAT "%5.1" /end CHARACTERISTIC
/begin CHARACTERISTIC EGSDO2_stLamPlaus_C "Code word of lambda plausibility diagnosis" VALUE 0x8053E94A RB_Val_Wu8 255.0 dez 0.00 255.0 FORMAT "%5.1" /end CHARACTERISTIC
/begin CHARACTERISTIC EGSDO2_tCatMaxEnaOffsFast_C "maximum catalyst temperature to release the fast offset adaptation" VALUE 0x8053E880 RB_Val_Ws16 6553.500 Temp_Cels -3549.940 3003.560 FORMAT "%8.3" /end CHARACTERISTIC
/begin CHARACTERISTIC EGSDO2_tCatMinEnaOffsFast_C "minimum catalyst temperature to release the fast offset adaptation" VALUE 0x8053E882 RB_Val_Ws16 6553.500 Temp_Cels -3549.940 3003.560 FORMAT "%8.3" /end CHARACTERISTIC
/begin CHARACTERISTIC EGSDO2_tEngEnaOffsFast_C "Engine temperature threshold to enable fast offset adaptation" VALUE 0x8053E884 RB_Val_Ws16 6553.500 Temp_Cels -3549.940 3003.560 FORMAT "%8.3" /end CHARACTERISTIC
/begin CHARACTERISTIC EGSDO2_tEngMdlEnaOffsFast_C "Modelled engine temperature threshold to enable fast offset adaptation" VALUE 0x8053E886 RB_Val_Ws16 6553.500 Temp_Cels -3549.940 3003.560 FORMAT "%8.3" /end CHARACTERISTIC
/begin CHARACTERISTIC EGSDO2_tiDebMntdDiagErr_C "debounce time for error regarding sensor mounted diagnosis" VALUE 0x8053E96A RB_Val_Wu8 25.50 t_q0p1 0.00 25.50 FORMAT "%5.2" /end CHARACTERISTIC
/begin CHARACTERISTIC EGSDO2_tiDlyCatPurgEnd_C "Delay time till the Lambda setpoint is readjusted and the reduced enabling condition will be reset (if there is a catalyst purge after the parallelization)." VALUE 0x8053E888 RB_Val_Wu8 25.50 t_q0p1 0.00 25.50 FORMAT "%5.2" /end CHARACTERISTIC
/begin CHARACTERISTIC EGSDO2_tiDlyFlgNoPurg_C "Delay time till the Lambda setpoint is readjusted and the reduced enabling condition will be reset (if there is No catalyst purge after the parallelization)." VALUE 0x8053E889 RB_Val_Wu8 25.50 t_q0p1 0.00 25.50 FORMAT "%5.2" /end CHARACTERISTIC
/begin CHARACTERISTIC EGSDO2_tiDt1HipFlt_C "Highpass time constant (DT1) at fault suspicion" VALUE 0x8053E95A RB_Val_Wu16 655.3400 t_q0p01 0.0100 655.3500 FORMAT "%8.4" EXTENDED_LIMITS 0.00 655.3500 /end CHARACTERISTIC
/begin CHARACTERISTIC EGSDO2_tiDt1Hip_C "Highpass time constant (DT1)" VALUE 0x8053E95C RB_Val_Wu16 655.3400 t_q0p01 0.0100 655.3500 FORMAT "%8.4" EXTENDED_LIMITS 0.00 655.3500 /end CHARACTERISTIC
/begin CHARACTERISTIC EGSDO2_tiLamOffsSlowDebFuTrmShrtp_C "" VALUE 0x8053E8D0 RB_Val_Wu16 6553.500 t_q0p1 0.00 6553.500 FORMAT "%8.3" /end CHARACTERISTIC
/begin CHARACTERISTIC EGSDO2_tiLamOffsSlowDebFuTrm_C "Debouncing time for slow offset adaptation (fuel trim fault)" VALUE 0x8053E8D2 RB_Val_Wu16 6553.500 t_q0p1 0.00 6553.500 FORMAT "%8.3" /end CHARACTERISTIC
/begin CHARACTERISTIC EGSDO2_tiLamOffsSlowDebOffsShrtp_C "Debouncing time for slow offset adaptation during short trip (offset fault)" VALUE 0x8053E8D4 RB_Val_Wu16 6553.500 t_q0p1 0.00 6553.500 FORMAT "%8.3" /end CHARACTERISTIC
/begin CHARACTERISTIC EGSDO2_tiLamOffsSlowDebOffs_C "Debouncing time for slow offset adaptation (offset fault)" VALUE 0x8053E8D6 RB_Val_Wu16 6553.500 t_q0p1 0.00 6553.500 FORMAT "%8.3" /end CHARACTERISTIC
/begin CHARACTERISTIC EGSDO2_tiMdlAsymPreFilt_C "Time constant for prefilter of asymmetric fault model" VALUE 0x8053E95E RB_Val_Wu16 655.34999985 zk10msxs_uw_b655 0.01000015 655.36000000 FORMAT "%12.8" EXTENDED_LIMITS 0.010000152590 655.36000000 /end CHARACTERISTIC
/begin CHARACTERISTIC EGSDO2_tiMflowExhTmpMax_T "Maximum duration for temporary release of fast offset adaptation via maximum exhaust gas flow" CURVE 0x8053E88A RB_Curve_U16_U8_Static 25.50 t_q0p1 0.00 25.50 FORMAT "%5.2"
 /begin AXIS_DESCR STD_AXIS NO_INPUT_QUANTITY m_uw_b6553p5 4 0.00 6553.500 FORMAT "%8.3" DEPOSIT ABSOLUTE /end AXIS_DESCR
/end CHARACTERISTIC
/begin CHARACTERISTIC EGSDO2_tiMflowExhTmpMin_C "Maximal duration for temporary enabling of fast offset adaptation with minimal exhaust mass flow" VALUE 0x8053E898 RB_Val_Wu8 25.50 t_q0p1 0.00 25.50 FORMAT "%5.2" /end CHARACTERISTIC
/begin CHARACTERISTIC EGSDO2_tiPt1LamDerS1_C "Time constant of lambda (derivative) filter (sensor 1)" VALUE 0x8053E966 RB_Val_Wu16 655.3400 t_q0p01 0.0100 655.3500 FORMAT "%8.4" EXTENDED_LIMITS 0.00 655.3500 /end CHARACTERISTIC
/begin CHARACTERISTIC EGSDO2_tiPt1OffsPred_T "Filter time constant (PT1) for predicted offset" CURVE 0x8053E834 RB_Curve_U16_U16 6553.4999985 zk100msxs_uw_b6553 0.1000015 6553.6000000 FORMAT "%12.7" EXTENDED_LIMITS 0.10000152590 6553.6000000
 /begin AXIS_DESCR STD_AXIS NO_INPUT_QUANTITY m_uw_b6553p5 4 0.00 6553.500 FORMAT "%8.3" DEPOSIT ABSOLUTE /end AXIS_DESCR
/end CHARACTERISTIC
/begin CHARACTERISTIC EGSDO2_tiSumRefCtrlActv_C "Threshold for summed time with active reference control" VALUE 0x8053E89A RB_Val_Wu16 6553.500 t_q0p1 0.00 6553.500 FORMAT "%8.3" /end CHARACTERISTIC
/begin CHARACTERISTIC EGSDO2_tiTranBpNarrow_C "Transition time threshold for switching back to narrow bandpass" VALUE 0x8053E960 RB_Val_Wu16 655.3500 t_q0p01 0.00 655.3500 FORMAT "%8.4" /end CHARACTERISTIC
/begin CHARACTERISTIC EGSDO2_tiTranBpWide_C "Transition time threshold for switching to wide bandpass" VALUE 0x8053E962 RB_Val_Wu16 655.3500 t_q0p01 0.00 655.3500 FORMAT "%8.4" /end CHARACTERISTIC
/begin CHARACTERISTIC EGSDO2_tiTurnOffCtrlrSt_C "TurnOff delay after change in controller status" VALUE 0x8053E89C RB_Val_Wu8 25.50 t_q0p1 0.00 25.50 FORMAT "%5.2" /end CHARACTERISTIC
/begin CHARACTERISTIC EGSDO2_tiTurnOnCatTShtrp_C "TurnOn delay to enable fast offset adaptation by catalyst temperature at short trip" VALUE 0x8053E89D RB_Val_Wu8 25.50 t_q0p1 0.00 25.50 FORMAT "%5.2" /end CHARACTERISTIC
/begin CHARACTERISTIC EGSDO2_tiTurnOnCatT_C "TurnOn delay to enable fast offset adaptation by catalyst temperature" VALUE 0x8053E89E RB_Val_Wu8 25.50 t_q0p1 0.00 25.50 FORMAT "%5.2" /end CHARACTERISTIC
/begin CHARACTERISTIC EGSDO2_tiTurnOnCtrlrLimNoOffs_C "Time after which the error suspicion due to mixture error leads to reset of UEGO offset error" VALUE 0x8053E846 RB_Val_Wu8 25.50 t_q0p1 0.00 25.50 FORMAT "%5.2" /end CHARACTERISTIC
/begin CHARACTERISTIC EGSDO2_tiTurnOnCtrlrLim_C "TurnOn delay if lambda controller upstream catalyst at limitation and sensor voltages in opposite direction" VALUE 0x8053E89F RB_Val_Wu8 25.50 t_q0p1 0.00 25.50 FORMAT "%5.2" /end CHARACTERISTIC
/begin CHARACTERISTIC EGSDO2_tiTurnOnCtrlrSt_C "TurnOn delay after change in controller status" VALUE 0x8053E8A0 RB_Val_Wu8 25.50 t_q0p1 0.00 25.50 FORMAT "%5.2" /end CHARACTERISTIC
/begin CHARACTERISTIC EGSDO2_tiTurnOnNEng_C "Turn-on delay after falling below engine speed threshold to disable fast offset adaptation" VALUE 0x8053E8A1 RB_Val_Wu8 25.50 t_q0p1 0.00 25.50 FORMAT "%5.2" /end CHARACTERISTIC
/begin CHARACTERISTIC EGSDU_DlyMeasS2B1_I.ticorrCatEftLtr_M "Measurement of delay time, sensor 2 (binary sensor) / Characteristic map for correction of delay measurement Lean-Rich via Voltage gradient and Exhaust Gas Mass flow (compensation fo variable catalyst storage capacity)" MAP 0x8053E9B8 RB_Map_U16U16_S16 655.3500 t_q0p01 -327.6800 327.6700 FORMAT "%8.4"
 /begin AXIS_DESCR STD_AXIS EGSDU_DlyMeasS2B1_I.duLtrCorrGrdt spgg_q0p00488_V_DIV_s 4 0.00 319.9951 FORMAT "%8.4" DEPOSIT ABSOLUTE /end AXIS_DESCR
 /begin AXIS_DESCR STD_AXIS EGSDU_DlyMeasS2B1_I.mfEgCatParl m_q0p1 4 0.00 6553.500 FORMAT "%8.3" DEPOSIT ABSOLUTE /end AXIS_DESCR
/end CHARACTERISTIC
/begin CHARACTERISTIC EGSDU_DlyMeasS2B1_I.ticorrCatEftRtl_M "Measurement of delay time, sensor 2 (binary sensor) / Characteristic map for correction of delay measurement Rich-Lean via Voltage gradient and Exhaust Gas Mass flow (compensation fo variable catalyst storage capacity)" MAP 0x8053E9EC RB_Map_U16U16_S16 655.3500 t_q0p01 -327.6800 327.6700 FORMAT "%8.4"
 /begin AXIS_DESCR STD_AXIS EGSDU_DlyMeasS2B1_I.duRtlCorrGrdt spgg_q0p00488_V_DIV_s 10 0.00 319.9951 FORMAT "%8.4" DEPOSIT ABSOLUTE /end AXIS_DESCR
 /begin AXIS_DESCR STD_AXIS EGSDU_DlyMeasS2B1_I.mfEgCatParl m_q0p1 10 0.00 6553.500 FORMAT "%8.3" DEPOSIT ABSOLUTE /end AXIS_DESCR
/end CHARACTERISTIC
/begin CHARACTERISTIC EGSDU_duFallDly_C "Threshold voltage decrease for measurement delay time of sensor voltage rich to lean" VALUE 0x8053E970 RB_Val_Wu16 4.998779 spg_q1p221Em3_V 0.00 4.998779 FORMAT "%8.6" EXTENDED_LIMITS 0.00 79.99878 /end CHARACTERISTIC
/begin CHARACTERISTIC EGSDU_duFallGrdtDly_C "Threshold voltage decrease for calculation of correction gradient for delay time of sensor voltage rich to lean" VALUE 0x8053E972 RB_Val_Wu16 4.998779 spg_q1p221Em3_V 0.00 4.998779 FORMAT "%8.6" EXTENDED_LIMITS 0.00 79.99878 /end CHARACTERISTIC
/begin CHARACTERISTIC EGSDU_duRiseDly_C "Threshold voltage increase during measurement delay time of sensor voltage lean to rich" VALUE 0x8053E974 RB_Val_Wu16 4.998779 spg_q1p221Em3_V 0.00 4.998779 FORMAT "%8.6" EXTENDED_LIMITS 0.00 79.99878 /end CHARACTERISTIC
/begin CHARACTERISTIC EGSDU_duRiseGrdtDly_C "Threshold voltage increase for calculation of correction gradient for delay time of sensor voltage lean to rich" VALUE 0x8053E976 RB_Val_Wu16 4.998779 spg_q1p221Em3_V 0.00 4.998779 FORMAT "%8.6" EXTENDED_LIMITS 0.00 79.99878 /end CHARACTERISTIC
/begin CHARACTERISTIC EGSDU_duS2StrtLtrInflTranDly_C "Voltage slope to start the delay measuerement in case of delay-transition cross-influence correction, lean to rich, sensor 2" VALUE 0x8053E978 RB_Val_Ws16 49.99924 RBPtCel_du_7p62939em4 -25.00000 24.99924 FORMAT "%8.5" /end CHARACTERISTIC
/begin CHARACTERISTIC EGSDU_duS2StrtRtlInflTranDly_C "Voltage slope to start the delay measuerement in case of delay-transition cross-influence correction, rich to lean, sensor 2" VALUE 0x8053E97A RB_Val_Ws16 49.99924 RBPtCel_du_7p62939em4 -25.00000 24.99924 FORMAT "%8.5" /end CHARACTERISTIC
/begin CHARACTERISTIC EGSDU_flgCorrCatEftDly_CW "Codeword (Binary): correction of delay time due catalyst effects" VALUE 0x8053E97C RB_Val_Wu8 1.00000000000 B_TRUE 0.00 1.00000000000 FORMAT "%13.11" /end CHARACTERISTIC
/begin CHARACTERISTIC EGSDU_ratLamNoiseLtrDly_C "distance to target lambda during measurement of delay time lean to rich of sensor voltage" VALUE 0x8053E97E RB_Val_Wu16 15.99976 fak_uw_b16 0.00 15.99976 FORMAT "%8.5" /end CHARACTERISTIC
/begin CHARACTERISTIC EGSDU_ratLamNoiseRtlDly_C "distance to target lambda during measurement of delay time rich to lean of sensor voltage" VALUE 0x8053E980 RB_Val_Wu16 15.99976 fak_uw_b16 0.00 15.99976 FORMAT "%8.5" /end CHARACTERISTIC
/begin CHARACTERISTIC EGSDU_S2TiLenLtrDly_CUR "Characteristic line: Expected delay time of sensor voltage at transition lean to rich in system without fault, sensor 2" CURVE 0x8053E982 RB_Curve_U16_U16 655.3500 t_q0p01 0.00 655.3500 FORMAT "%8.4"
 /begin AXIS_DESCR STD_AXIS EGSDCmn_mfEgCat1B1Parl m_q0p1 5 0.00 6553.500 FORMAT "%8.3" DEPOSIT ABSOLUTE /end AXIS_DESCR
/end CHARACTERISTIC
/begin CHARACTERISTIC EGSDU_S2TiLenRtlDly_CUR "Characteristic line: Expected delay time of sensor voltage at transition rich to lean in system without fault, sensor 2" CURVE 0x8053E998 RB_Curve_U16_U16 655.3500 t_q0p01 0.00 655.3500 FORMAT "%8.4"
 /begin AXIS_DESCR STD_AXIS EGSDCmn_mfEgCat1B1Parl m_q0p1 5 0.00 6553.500 FORMAT "%8.3" DEPOSIT ABSOLUTE /end AXIS_DESCR
/end CHARACTERISTIC
/begin CHARACTERISTIC EGSDU_tiToutLtrDly_C "Maximum time for measurement delay time of sensor voltage at transition lean to rich" VALUE 0x8053E9AE RB_Val_Wu16 655.3500 t_q0p01 0.00 655.3500 FORMAT "%8.4" /end CHARACTERISTIC
/begin CHARACTERISTIC EGSDU_tiToutRtlDly_C "Maximum time for measurement delay time of sensor voltage at transition rich to lean" VALUE 0x8053E9B0 RB_Val_Wu16 655.3500 t_q0p01 0.00 655.3500 FORMAT "%8.4" /end CHARACTERISTIC
/begin CHARACTERISTIC LamPlausB1_I.EGSDO2_ratLamOffsInin_C "Class instance of lambda-based plausibility diagnosis (offset) of a wideband sensor (bank 1) / Initialisation value for lambda offset (for calibration purposes only!)" VALUE 0x8053E954 RB_Val_Ws16 1.999969 fak_sw_b1 -1.000000 0.999969 FORMAT "%8.6" EXTENDED_LIMITS -1.000000 0.9999695 /end CHARACTERISTIC
/begin CHARACTERISTIC UEGO_ratLamMaxMntdDiag_C "air fuel ratio threshold for sensor mounted diagnosis" VALUE 0x8053E96C RB_Val_Wu16 15.99976 fak_uw_b16 0.00 15.99976 FORMAT "%8.5" /end CHARACTERISTIC
/begin MEASUREMENT B_saTONV_I.outbit "delayed disablining of fast offset adaptation after fuel cut off / return value" UBYTE B_TRUE 1 100 0.00 1.00000000000 BIT_MASK 0x1 FORMAT "%13.11" ECU_ADDRESS 0x600072B2 /end MEASUREMENT
/begin MEASUREMENT B_saTONV_I.time "delayed disablining of fast offset adaptation after fuel cut off / expired delay time" UBYTE t_q0p1 1 100 0.00 25.50 FORMAT "%5.2" ECU_ADDRESS 0x600072B3 /end MEASUREMENT
/begin MEASUREMENT ddltrmo_l "delta lambda between BGLSUOFFS-LRHKC" SLONG fak_sl_b1 1 100 -1.00000000000 0.99999999953 FORMAT "%13.11" ECU_ADDRESS 0x50002210 /end MEASUREMENT
/begin MEASUREMENT dlatrmo_w "Lambda offset downstream lambda control" SWORD fak_sw_b1 1 100 -1.000000 0.999969 FORMAT "%8.6" ECU_ADDRESS 0x6001346E /end MEASUREMENT
/begin MEASUREMENT EGSDO2_cntrLoad "Counter for load changes" UBYTE dez 1 100 0.00 255.0 FORMAT "%5.1" ECU_ADDRESS 0x6000B1F4 /end MEASUREMENT
/begin MEASUREMENT EGSDO2_ctReIni100msLamOffsFast "counter for reinitialization trigger after PostDrive leave" UBYTE dez 1 100 0.00 255.0 FORMAT "%5.1" ECU_ADDRESS 0x6000B1F3 /end MEASUREMENT
/begin MEASUREMENT EGSDO2_ctReIni100msLamPlaus "counter for reinitialization trigger after PostDrive leave" UBYTE dez 1 100 0.00 255.0 FORMAT "%5.1" ECU_ADDRESS 0x600140AC /end MEASUREMENT
/begin MEASUREMENT EGSDO2_ctReIni10msSigPrepn "ReIni counter" UBYTE dez 1 100 0.00 255.0 FORMAT "%5.1" ECU_ADDRESS 0x6000B1EF /end MEASUREMENT
/begin MEASUREMENT EGSDO2_CtrlrLimOffsB1TONV_I.outbit "TurnOn Delay to release offset detection if lambda control is in their limit / return value" UBYTE B_TRUE 1 100 0.00 1.00000000000 BIT_MASK 0x1 FORMAT "%13.11" ECU_ADDRESS 0x600072B0 /end MEASUREMENT
/begin MEASUREMENT EGSDO2_CtrlrLimOffsB1TONV_I.time "TurnOn Delay to release offset detection if lambda control is in their limit / expired delay time" UBYTE t_q0p1 1 100 0.00 25.50 FORMAT "%5.2" ECU_ADDRESS 0x600072B1 /end MEASUREMENT
/begin MEASUREMENT EGSDO2_CtrlrStOffsB1TOFFV_I.outbit "TurnOff delay of the release condition based on the condition of the lambda control / Output Bit" UBYTE B_TRUE 1 100 0.00 1.00000000000 BIT_MASK 0x1 FORMAT "%13.11" ECU_ADDRESS 0x600072AE /end MEASUREMENT
/begin MEASUREMENT EGSDO2_CtrlrStOffsB1TOFFV_I.time "TurnOff delay of the release condition based on the condition of the lambda control / Occured Time" UBYTE t_q0p1 1 100 0.00 25.50 FORMAT "%5.2" ECU_ADDRESS 0x600072AF /end MEASUREMENT
/begin MEASUREMENT EGSDO2_CtrlrStOffsB1TONV_I.outbit "TurnOn delay of the release condition based on the condition of the lambda control / return value" UBYTE B_TRUE 1 100 0.00 1.00000000000 BIT_MASK 0x1 FORMAT "%13.11" ECU_ADDRESS 0x600072AC /end MEASUREMENT
/begin MEASUREMENT EGSDO2_CtrlrStOffsB1TONV_I.time "TurnOn delay of the release condition based on the condition of the lambda control / expired delay time" UBYTE t_q0p1 1 100 0.00 25.50 FORMAT "%5.2" ECU_ADDRESS 0x600072AD /end MEASUREMENT
/begin MEASUREMENT EGSDO2_DerFilB1_I.dratLamRecpr "Derivation filter / Derivative of reciprocal lambda" SWORD freq_q9p1553Em5 1 100 -3.000000 2.999908 FORMAT "%8.6" ECU_ADDRESS 0x60012584 /end MEASUREMENT
/begin MEASUREMENT EGSDO2_DerFilB1_I.dratLamRecprFild "Derivation filter / Derivative of reciprocal lambda (filtered)" SWORD freq_q9p1553Em5 1 100 -3.000000 2.999908 FORMAT "%8.6" ECU_ADDRESS 0x60012586 /end MEASUREMENT
/begin MEASUREMENT EGSDO2_DerFilB1_I.dratLamRecprSum "Derivation filter / summe of the last reciprocol lambda gradient, to build the moving average" SLONG freq_q9p1553Em5 1 100 -196608.000000 196607.999908 FORMAT "%13.6" ECU_ADDRESS 0x60012588 /end MEASUREMENT
/begin MEASUREMENT EGSDO2_DerFilB1_I.idxInp "Derivation filter / index for moving average filter" UBYTE dez 1 100 0.00 10.00 FORMAT "%5.2" ECU_ADDRESS 0x6001258C /end MEASUREMENT
/begin MEASUREMENT EGSDO2_DerFilB1_I.ratLamRecpr "Derivation filter / reciprocal lambda" UWORD fak_q3p0518Em5 1 100 0.00 1.999969 FORMAT "%8.6" ECU_ADDRESS 0x6001258E /end MEASUREMENT
/begin MEASUREMENT EGSDO2_DerFilB1_I.ratLamRecprFild "Derivation filter / Reciprocal lambda (filtered)" UWORD fak_uw_b2 1 100 0.00 1.999969 FORMAT "%8.6" ECU_ADDRESS 0x60012590 /end MEASUREMENT
/begin MEASUREMENT EGSDO2_DerFilB1_I.ratlam_a "Derivation filter / array of reciprocol lambda gradient" SWORD freq_q9p1553Em5 1 100 -3.000000 2.999908 FORMAT "%8.6" ARRAY_SIZE 11 ECU_ADDRESS 0x60012594 /end MEASUREMENT
/begin MEASUREMENT EGSDO2_DerFilB1_I.tiFildDly "Derivation filter / Delaytime of reciprokol lambda in case of moving average" UWORD t_q0p01 1 100 0.00 655.3500 FORMAT "%8.4" ECU_ADDRESS 0x600125AA /end MEASUREMENT
/begin MEASUREMENT EGSDO2_DerFilB1_I.LamRecprLT_I.memory "Derivation filter / Lowpass filter (PT1) for reciprocal lambda / current lowpass value" ULONG fak_q4p6566Em10 1 100 0.00 1.999999999534339 FORMAT "%17.15" ECU_ADDRESS 0x600125AC /end MEASUREMENT
/begin MEASUREMENT EGSDO2_dratLamRecprFildS1B1 "Derivative of reciprocal lambda (filtered)" SWORD freq_q9p1553Em5 1 100 -3.000000 2.999908 FORMAT "%8.6" ECU_ADDRESS 0x600091DE /end MEASUREMENT
/begin MEASUREMENT EGSDO2_EnaCatOffsB1TTONV_I.outbit "TurnOn delay of the release condition based on the catalyst temperature / return value" UBYTE B_TRUE 1 100 0.00 1.00000000000 BIT_MASK 0x1 FORMAT "%13.11" ECU_ADDRESS 0x600072AA /end MEASUREMENT
/begin MEASUREMENT EGSDO2_EnaCatOffsB1TTONV_I.time "TurnOn delay of the release condition based on the catalyst temperature / expired delay time" UBYTE t_q0p1 1 100 0.00 25.50 FORMAT "%5.2" ECU_ADDRESS 0x600072AB /end MEASUREMENT
/begin MEASUREMENT EGSDO2_EnaCondDurgParlB1FF_I.status "FlipFlop: switch for reduced enabling conditions of the virtual offset adaption (only in case Offset runs befor parallelization) / current value of RS-FF" UBYTE B_TRUE 1 100 0.00 1.00000000000 BIT_MASK 0x1 FORMAT "%13.11" ECU_ADDRESS 0x6000B1F2 /end MEASUREMENT
/begin MEASUREMENT EGSDO2_EnaMflowExhTmpMaxOffsB1TONV_I.outbit "TurnOn delay of the release condition based on the exhaust gas massflow / return value" UBYTE B_TRUE 1 100 0.00 1.00000000000 BIT_MASK 0x1 FORMAT "%13.11" ECU_ADDRESS 0x600072A8 /end MEASUREMENT
/begin MEASUREMENT EGSDO2_EnaMflowExhTmpMaxOffsB1TONV_I.time "TurnOn delay of the release condition based on the exhaust gas massflow / expired delay time" UBYTE t_q0p1 1 100 0.00 25.50 FORMAT "%5.2" ECU_ADDRESS 0x600072A9 /end MEASUREMENT
/begin MEASUREMENT EGSDO2_EnaMflowExhTmpMinOffsB1TONV_I.outbit "TurnOn delay of the release condition based on the exhaust gas massflow / return value" UBYTE B_TRUE 1 100 0.00 1.00000000000 BIT_MASK 0x1 FORMAT "%13.11" ECU_ADDRESS 0x600072A6 /end MEASUREMENT
/begin MEASUREMENT EGSDO2_EnaMflowExhTmpMinOffsB1TONV_I.time "TurnOn delay of the release condition based on the exhaust gas massflow / expired delay time" UBYTE t_q0p1 1 100 0.00 25.50 FORMAT "%5.2" ECU_ADDRESS 0x600072A7 /end MEASUREMENT
/begin MEASUREMENT EGSDO2_ExhMEnaGnrlOffsB1IK_I.memory "Exhaust gas massflow integral to release the fast offset adaptation / current integrator value" ULONG m_q4p239Em7_g 1 100 0.00 1820.44907366 FORMAT "%13.8" ECU_ADDRESS 0x60002D2C /end MEASUREMENT
/begin MEASUREMENT EGSDO2_ExhMEnaGnrlOffsVirtB1IK_I.memory "Exhaust gas massflow integral to release IUMPR simulation of fast offset adaptation / current integrator value" ULONG m_q4p239Em7_g 1 100 0.00 1820.44907366 FORMAT "%13.8" ECU_ADDRESS 0x60002D28 /end MEASUREMENT
/begin MEASUREMENT EGSDO2_flgBpWideS1B1 "wide evaluation thresholds active" UBYTE B_TRUE 1 100 0.00 1.00000000000 BIT_MASK 0x1 FORMAT "%13.11" ECU_ADDRESS 0x70000A05 /end MEASUREMENT
/begin MEASUREMENT EGSDO2_flgCatPurgAftParlOffsB1 "cat purge after parallelization is active (extended by delay time EGSDO2_tiDlyCatPurgEnd_C)" UBYTE B_TRUE 1 100 0.00 1.00000000000 BIT_MASK 0x1 FORMAT "%13.11" ECU_ADDRESS 0x70000302 /end MEASUREMENT
/begin MEASUREMENT EGSDO2_flgCatPurgEndB1EF_I.buffer "Falling Edge for the delayed end of cat purge after parallelization / memory to detect falling edge" UBYTE B_TRUE 1 100 0.00 1.00000000000 BIT_MASK 0x1 FORMAT "%13.11" ECU_ADDRESS 0x600072A2 /end MEASUREMENT
/begin MEASUREMENT EGSDO2_flgCatPurgEndB1EF_I.oldSignal "Falling Edge for the delayed end of cat purge after parallelization / memory to detect falling edge" UBYTE B_TRUE 1 100 0.00 1.00000000000 BIT_MASK 0x1 FORMAT "%13.11" ECU_ADDRESS 0x600072A3 /end MEASUREMENT
/begin MEASUREMENT EGSDO2_flgCatPurgEndB1TOFFV_I.outbit "TurnOff delay for the end of cat purge after parallelization / Output Bit" UBYTE B_TRUE 1 100 0.00 1.00000000000 BIT_MASK 0x1 FORMAT "%13.11" ECU_ADDRESS 0x600072A0 /end MEASUREMENT
/begin MEASUREMENT EGSDO2_flgCatPurgEndB1TOFFV_I.time "TurnOff delay for the end of cat purge after parallelization / Occured Time" UBYTE t_q0p1 1 100 0.00 25.50 FORMAT "%5.2" ECU_ADDRESS 0x600072A1 /end MEASUREMENT
/begin MEASUREMENT EGSDO2_flgClrSigPrepn10msB1 "Indication of clearing of error memory" UBYTE B_TRUE 1 100 0.00 1.00000000000 BIT_MASK 0x1 FORMAT "%13.11" ECU_ADDRESS 0x700002E6 /end MEASUREMENT
/begin MEASUREMENT EGSDO2_flgCtrlrLimMaxOffsFastB1 "check if lambda control has reached its max limit for offset diagnosis" UBYTE B_TRUE 1 100 0.00 1.00000000000 BIT_MASK 0x1 FORMAT "%13.11" ECU_ADDRESS 0x70000301 /end MEASUREMENT
/begin MEASUREMENT EGSDO2_flgCtrlrLimMinOffsFastB1 "check if lambda control has reached its min limit for offset diagnosis" UBYTE B_TRUE 1 100 0.00 1.00000000000 BIT_MASK 0x1 FORMAT "%13.11" ECU_ADDRESS 0x70000300 /end MEASUREMENT
/begin MEASUREMENT EGSDO2_flgCtrlrLimNoOffsB1 "check if lambda control has reached its max limit without the assumption of an UEGO offset error" UBYTE B_TRUE 1 100 0.00 1.00000000000 BIT_MASK 0x1 FORMAT "%13.11" ECU_ADDRESS 0x700002FF /end MEASUREMENT
/begin MEASUREMENT EGSDO2_flgCtrlrLimNoOffsSuspcB1 "error suspicion: lambda control has reached its limits without an UEGO offset error as root cause" UBYTE B_TRUE 1 100 0.00 1.00000000000 BIT_MASK 0x1 FORMAT "%13.11" ECU_ADDRESS 0x700002FE /end MEASUREMENT
/begin MEASUREMENT EGSDO2_flgCtrlrLimOffsFastB1 "Lambda control fault suspicion" UBYTE B_TRUE 1 100 0.00 1.00000000000 BIT_MASK 0x1 FORMAT "%13.11" ECU_ADDRESS 0x700002FD /end MEASUREMENT
/begin MEASUREMENT EGSDO2_flgCtrlrLimSnsrOppOffsFastB1 "Lambda control fault suspicion" UBYTE B_TRUE 1 100 0.00 1.00000000000 BIT_MASK 0x1 FORMAT "%13.11" ECU_ADDRESS 0x700002FC /end MEASUREMENT
/begin MEASUREMENT EGSDO2_flgDebFltOffsFastS1B1 "Debounce condition for fault confirmation by fast offset adaptation (sensor 1, bank 1)" UBYTE B_TRUE 1 100 0.00 1.00000000000 BIT_MASK 0x1 FORMAT "%13.11" ECU_ADDRESS 0x70000A01 /end MEASUREMENT
/begin MEASUREMENT EGSDO2_flgDebFltOffsFastVirtS1B1 "Virtual debounce condition (for IUMPR simulation) for fault confirmation by fast offset adaptation (sensor 1, bank 1)" UBYTE B_TRUE 1 100 0.00 1.00000000000 BIT_MASK 0x1 FORMAT "%13.11" ECU_ADDRESS 0x70000A00 /end MEASUREMENT
/begin MEASUREMENT EGSDO2_flgDebHealOffsFastS1B1 "Debounce condition for fault healing by fast offset adaptation (sensor 1, bank 1)" UBYTE B_TRUE 1 100 0.00 1.00000000000 BIT_MASK 0x1 FORMAT "%13.11" ECU_ADDRESS 0x700009FF /end MEASUREMENT
/begin MEASUREMENT EGSDO2_flgDfcFuTrmActvd "DFCs for fuel-trim fault activated" UBYTE B_TRUE 1 100 0.00 1.00000000000 BIT_MASK 0x1 FORMAT "%13.11" ECU_ADDRESS 0x700009FE /end MEASUREMENT
/begin MEASUREMENT EGSDO2_flgDiOffsBnkIndpdt "Bank-independent disabling conditions of fast offset adaptation" UBYTE B_TRUE 1 100 0.00 1.00000000000 BIT_MASK 0x1 FORMAT "%13.11" ECU_ADDRESS 0x700002FB /end MEASUREMENT
/begin MEASUREMENT EGSDO2_flgDiOffsBnkIndpdtVirt "Bank-independent disabling conditions of fast offset adaptation for IUMPR simulation" UBYTE B_TRUE 1 100 0.00 1.00000000000 BIT_MASK 0x1 FORMAT "%13.11" ECU_ADDRESS 0x700002FA /end MEASUREMENT
/begin MEASUREMENT EGSDO2_flgDiOffsEngT "Disable fast offset adaptation due to engine temperature" UBYTE B_TRUE 1 100 0.00 1.00000000000 BIT_MASK 0x1 FORMAT "%13.11" ECU_ADDRESS 0x700002F9 /end MEASUREMENT
/begin MEASUREMENT EGSDO2_flgEnaDiagPlaus "Operation mode for actiive offset diagnosis" UBYTE B_TRUE 1 100 0.00 1.00000000000 BIT_MASK 0x1 FORMAT "%13.11" ECU_ADDRESS 0x700002E8 /end MEASUREMENT
/begin MEASUREMENT EGSDO2_flgEnaGnrlCatTOffsFastB1 "Catalyst temperature criteria fulfilled" UBYTE B_TRUE 1 100 0.00 1.00000000000 BIT_MASK 0x1 FORMAT "%13.11" ECU_ADDRESS 0x700002F8 /end MEASUREMENT
/begin MEASUREMENT EGSDO2_flgEnaGnrlCdnOffsFastB1 "enabling conditions of fast offset adaptation (bank1)" UBYTE B_TRUE 1 100 0.00 1.00000000000 BIT_MASK 0x1 FORMAT "%13.11" ECU_ADDRESS 0x700002F7 /end MEASUREMENT
/begin MEASUREMENT EGSDO2_flgEnaGnrlCdnOffsFastVirtB1 "Virtual enabling conditions of fast offset adaptation (bank1)" UBYTE B_TRUE 1 100 0.00 1.00000000000 BIT_MASK 0x1 FORMAT "%13.11" ECU_ADDRESS 0x700002F6 /end MEASUREMENT
/begin MEASUREMENT EGSDO2_flgEnaGnrlExhMOffsFastB1 "Debounced enable conditions via massflow" UBYTE B_TRUE 1 100 0.00 1.00000000000 BIT_MASK 0x1 FORMAT "%13.11" ECU_ADDRESS 0x700002F5 /end MEASUREMENT
/begin MEASUREMENT EGSDO2_flgEnaGnrlExhMOffsVirtB1 "virtual enabling condition of fast offset adaptation due to catalyst conditioning" UBYTE B_TRUE 1 100 0.00 1.00000000000 BIT_MASK 0x1 FORMAT "%13.11" ECU_ADDRESS 0x700002F4 /end MEASUREMENT
/begin MEASUREMENT EGSDO2_flgEnaGnrlMflowExhOffsFastB1 "Massflow criteria fulfilled" UBYTE B_TRUE 1 100 0.00 1.00000000000 BIT_MASK 0x1 FORMAT "%13.11" ECU_ADDRESS 0x700002F3 /end MEASUREMENT
/begin MEASUREMENT EGSDO2_flgEnaGnrlOffsFastB1 "General enabling condition of fast offset adaptation fulfilled (bank 1)" UBYTE B_TRUE 1 100 0.00 1.00000000000 BIT_MASK 0x1 FORMAT "%13.11" ECU_ADDRESS 0x700009F4 /end MEASUREMENT
/begin MEASUREMENT EGSDO2_flgEnaGnrlOffsFastVirtB1 "General enabling condition for IUMPR simulation of fast offset adaptation fulfilled (bank 1)" UBYTE B_TRUE 1 100 0.00 1.00000000000 BIT_MASK 0x1 FORMAT "%13.11" ECU_ADDRESS 0x700009F3 /end MEASUREMENT
/begin MEASUREMENT EGSDO2_flgEnaGnrlPhyOffsFastB1 "Physical enable conditions fulfilled" UBYTE B_TRUE 1 100 0.00 1.00000000000 BIT_MASK 0x1 FORMAT "%13.11" ECU_ADDRESS 0x700002F2 /end MEASUREMENT
/begin MEASUREMENT EGSDO2_flgEnaGnrlPhyOffsFastVirtB1 "Physical enabling condition for IUMPR simulation of fast offset adaptation" UBYTE B_TRUE 1 100 0.00 1.00000000000 BIT_MASK 0x1 FORMAT "%13.11" ECU_ADDRESS 0x700002F1 /end MEASUREMENT
/begin MEASUREMENT EGSDO2_flgEnaGnrlReldOffsFastB1 "Function released from DSM" UBYTE B_TRUE 1 100 0.00 1.00000000000 BIT_MASK 0x1 FORMAT "%13.11" ECU_ADDRESS 0x700009F2 /end MEASUREMENT
/begin MEASUREMENT EGSDO2_flgEnaMflowExhTmpMaxOffsFastB1 "Massflow criteria fulfilled" UBYTE B_TRUE 1 100 0.00 1.00000000000 BIT_MASK 0x1 FORMAT "%13.11" ECU_ADDRESS 0x700002F0 /end MEASUREMENT
/begin MEASUREMENT EGSDO2_flgEnaMflowExhTmpMinOffsFastB1 "Massflow criteria fulfilled" UBYTE B_TRUE 1 100 0.00 1.00000000000 BIT_MASK 0x1 FORMAT "%13.11" ECU_ADDRESS 0x700002EF /end MEASUREMENT
/begin MEASUREMENT EGSDO2_flgEnaOffsFastBnkIndpdt "Bank-independent enabling conditions of fast offset adaptation" UBYTE B_TRUE 1 100 0.00 1.00000000000 BIT_MASK 0x1 FORMAT "%13.11" ECU_ADDRESS 0x700002EE /end MEASUREMENT
/begin MEASUREMENT EGSDO2_flgEnaRedCondDurgParlB1 "Release of reduced enabling conditions during parallelization for the virtual offset adaption (only in case Offset runs befor parallelization)" UBYTE B_TRUE 1 100 0.00 1.00000000000 BIT_MASK 0x1 FORMAT "%13.11" ECU_ADDRESS 0x700002ED /end MEASUREMENT
/begin MEASUREMENT EGSDO2_flgEnaRefCtrlOffsFastB1 "reference lambda control" UBYTE B_TRUE 1 100 0.00 1.00000000000 BIT_MASK 0x1 FORMAT "%13.11" ECU_ADDRESS 0x700002EC /end MEASUREMENT
/begin MEASUREMENT EGSDO2_flgExhMNoSignChgOffsFastS1B1 "exhaust mass and no sign change enabling conditions for fast offset adaption are fulfilled (bank 1)" UBYTE B_TRUE 1 100 0.00 1.00000000000 BIT_MASK 0x1 FORMAT "%13.11" ECU_ADDRESS 0x700009ED /end MEASUREMENT
/begin MEASUREMENT EGSDO2_flgLamOffsFastFltSuspcS1B1 "Fault suspicion from fast offset adaptation (sensor 1, bank 1)" UBYTE B_TRUE 1 100 0.00 1.00000000000 BIT_MASK 0x1 FORMAT "%13.11" ECU_ADDRESS 0x700009E3 /end MEASUREMENT
/begin MEASUREMENT EGSDO2_flgLamPlausFltMaxS1B1 "Status of Lambda Plausibility max error" UBYTE B_TRUE 1 100 0.00 1.00000000000 BIT_MASK 0x1 FORMAT "%13.11" ECU_ADDRESS 0x700009E2 /end MEASUREMENT
/begin MEASUREMENT EGSDO2_flgLamPlausFltMinS1B1 "Status of Lambda Plausibility min error" UBYTE B_TRUE 1 100 0.00 1.00000000000 BIT_MASK 0x1 FORMAT "%13.11" ECU_ADDRESS 0x700009E1 /end MEASUREMENT
/begin MEASUREMENT EGSDO2_flgLamPlausFltSuspcS1B1 "Fault suspicion from lambda plausibility diagnosis (sensor 1, bank 1)" UBYTE B_TRUE 1 100 0.00 1.00000000000 BIT_MASK 0x1 FORMAT "%13.11" ECU_ADDRESS 0x700009E0 /end MEASUREMENT
/begin MEASUREMENT EGSDO2_flgLamPlausFltVirtS1B1 "Status of virtual Lambda Plausibility error" UBYTE B_TRUE 1 100 0.00 1.00000000000 BIT_MASK 0x1 FORMAT "%13.11" ECU_ADDRESS 0x700009DF /end MEASUREMENT
/begin MEASUREMENT EGSDO2_flgLamPlausInhbParlS1B1 "Inhibition of parallelization by Lambda plausibility diagnosis (sensor 1, bank 1)" UBYTE B_TRUE 1 100 0.00 1.00000000000 BIT_MASK 0x1 FORMAT "%13.11" ECU_ADDRESS 0x700009DE /end MEASUREMENT
/begin MEASUREMENT EGSDO2_flgLamPlausParlDneOnceS1B1 "Parallelization done at least once in this cycle from Lambda plausiblity point of view (sensor 1, bank 1)" UBYTE B_TRUE 1 100 0.00 1.00000000000 BIT_MASK 0x1 FORMAT "%13.11" ECU_ADDRESS 0x700009DD /end MEASUREMENT
/begin MEASUREMENT EGSDO2_flgLamPlausTstdS1B1 "Lambda based plausibility diagnosis tested (sensor 1, bank 1)" UBYTE B_TRUE 1 100 0.00 1.00000000000 BIT_MASK 0x1 FORMAT "%13.11" ECU_ADDRESS 0x700009DC /end MEASUREMENT
/begin MEASUREMENT EGSDO2_flgNoPurgAftParlB1EF_I.buffer "Falling Edge if there is No catalyst purge after the parallelization / memory to detect falling edge" UBYTE B_TRUE 1 100 0.00 1.00000000000 BIT_MASK 0x1 FORMAT "%13.11" ECU_ADDRESS 0x6000729E /end MEASUREMENT
/begin MEASUREMENT EGSDO2_flgNoPurgAftParlB1EF_I.oldSignal "Falling Edge if there is No catalyst purge after the parallelization / memory to detect falling edge" UBYTE B_TRUE 1 100 0.00 1.00000000000 BIT_MASK 0x1 FORMAT "%13.11" ECU_ADDRESS 0x6000729F /end MEASUREMENT
/begin MEASUREMENT EGSDO2_flgNoPurgAftParlB1TOFFV_I.outbit "TurnOff delay if there is No catalyst purge after the parallelization / Output Bit" UBYTE B_TRUE 1 100 0.00 1.00000000000 BIT_MASK 0x1 FORMAT "%13.11" ECU_ADDRESS 0x6000729C /end MEASUREMENT
/begin MEASUREMENT EGSDO2_flgNoPurgAftParlB1TOFFV_I.time "TurnOff delay if there is No catalyst purge after the parallelization / Occured Time" UBYTE t_q0p1 1 100 0.00 25.50 FORMAT "%5.2" ECU_ADDRESS 0x6000729D /end MEASUREMENT
/begin MEASUREMENT EGSDO2_flgOperPntRelsDiag "Operation point release condition for the offset calculation slow path" UBYTE B_TRUE 1 100 0.00 1.00000000000 BIT_MASK 0x1 FORMAT "%13.11" ECU_ADDRESS 0x700002E7 /end MEASUREMENT
/begin MEASUREMENT EGSDO2_flgParlEndB1TOFFV_I.outbit "TurnOff Delay at the end of parallelization / Output Bit" UBYTE B_TRUE 1 100 0.00 1.00000000000 BIT_MASK 0x1 FORMAT "%13.11" ECU_ADDRESS 0x6000729A /end MEASUREMENT
/begin MEASUREMENT EGSDO2_flgParlEndB1TOFFV_I.time "TurnOff Delay at the end of parallelization / Occured Time" UBYTE t_q0p1 1 100 0.00 25.50 FORMAT "%5.2" ECU_ADDRESS 0x6000729B /end MEASUREMENT
/begin MEASUREMENT EGSDO2_flgParlEndDlydB1EF_I.buffer "Falling Edge of the delayed end of parallelization / memory to detect falling edge" UBYTE B_TRUE 1 100 0.00 1.00000000000 BIT_MASK 0x1 FORMAT "%13.11" ECU_ADDRESS 0x60007298 /end MEASUREMENT
/begin MEASUREMENT EGSDO2_flgParlEndDlydB1EF_I.oldSignal "Falling Edge of the delayed end of parallelization / memory to detect falling edge" UBYTE B_TRUE 1 100 0.00 1.00000000000 BIT_MASK 0x1 FORMAT "%13.11" ECU_ADDRESS 0x60007299 /end MEASUREMENT
/begin MEASUREMENT EGSDO2_flgRstCondDurgParlB1 "Reset of the reduced enabling conditions for the virtual offset adaption (only in case Offset runs befor parallelization)" UBYTE B_TRUE 1 100 0.00 1.00000000000 BIT_MASK 0x1 FORMAT "%13.11" ECU_ADDRESS 0x700002EB /end MEASUREMENT
/begin MEASUREMENT EGSDO2_flgRstDneVirtOffsB1EF_I.buffer "Falling Edge if the reduced enabling conditions of the virtual offset adaption are no longer valid / memory to detect falling edge" UBYTE B_TRUE 1 100 0.00 1.00000000000 BIT_MASK 0x1 FORMAT "%13.11" ECU_ADDRESS 0x60007296 /end MEASUREMENT
/begin MEASUREMENT EGSDO2_flgRstDneVirtOffsB1EF_I.oldSignal "Falling Edge if the reduced enabling conditions of the virtual offset adaption are no longer valid / memory to detect falling edge" UBYTE B_TRUE 1 100 0.00 1.00000000000 BIT_MASK 0x1 FORMAT "%13.11" ECU_ADDRESS 0x60007297 /end MEASUREMENT
/begin MEASUREMENT EGSDO2_flgRstExhMIntglOffsFastB1 "Reset conditions for massflow debouncing" UBYTE B_TRUE 1 100 0.00 1.00000000000 BIT_MASK 0x1 FORMAT "%13.11" ECU_ADDRESS 0x700002EA /end MEASUREMENT
/begin MEASUREMENT EGSDO2_flgRstExhMIntglOffsVirtB1 "Criteria for resetting of the exhaust gas mass integral fopr IUMPR simulation fulfilled (Bank1)" UBYTE B_TRUE 1 100 0.00 1.00000000000 BIT_MASK 0x1 FORMAT "%13.11" ECU_ADDRESS 0x700002E9 /end MEASUREMENT
/begin MEASUREMENT EGSDO2_IdnSigB1_I.flgBpWide "Class for identification signals for lambda-based dynamics diagnosis of a wideband-sensor / Wide bandpass active" UBYTE B_TRUE 1 100 0.00 1.00000000000 BIT_MASK 0x1 FORMAT "%13.11" ECU_ADDRESS 0x50001690 /end MEASUREMENT
/begin MEASUREMENT EGSDO2_IdnSigB1_I.ratLamRecprBp "Class for identification signals for lambda-based dynamics diagnosis of a wideband-sensor / Reciprocal lambda (bandpass filtered)" SWORD fak_q3p0518Em5 1 100 -1.000000 0.999969 FORMAT "%8.6" ECU_ADDRESS 0x50001692 /end MEASUREMENT
/begin MEASUREMENT EGSDO2_IdnSigB1_I.ratLamRecprBpLtr "Class for identification signals for lambda-based dynamics diagnosis of a wideband-sensor / Reciprocal lambda (bandpass filtered in lean-rich direction)" UWORD fak_q3p0518Em5 1 100 0.00 1.999969 FORMAT "%8.6" ECU_ADDRESS 0x50001694 /end MEASUREMENT
/begin MEASUREMENT EGSDO2_IdnSigB1_I.ratLamRecprBpRtl "Class for identification signals for lambda-based dynamics diagnosis of a wideband-sensor / Reciprocal lambda (bandpass filtered in rich-lean direction)" UWORD fak_q3p0518Em5 1 100 0.00 1.999969 FORMAT "%8.6" ECU_ADDRESS 0x50001696 /end MEASUREMENT
/begin MEASUREMENT EGSDO2_IdnSigB1_I.ratLamRecprMdl "Class for identification signals for lambda-based dynamics diagnosis of a wideband-sensor / Reciprocal modelled lambda" UWORD fak_q3p0518Em5 1 100 0.00 1.999969 FORMAT "%8.6" ECU_ADDRESS 0x50001698 /end MEASUREMENT
/begin MEASUREMENT EGSDO2_IdnSigB1_I.ratLamRecprMdlBp "Class for identification signals for lambda-based dynamics diagnosis of a wideband-sensor / Reciprocal modelled lambda (bandpass filtered)" SWORD fak_q3p0518Em5 1 100 -1.000000 0.999969 FORMAT "%8.6" ECU_ADDRESS 0x5000169A /end MEASUREMENT
/begin MEASUREMENT EGSDO2_IdnSigB1_I.ratLamRecprMdlBpLtr "Class for identification signals for lambda-based dynamics diagnosis of a wideband-sensor / Reciprocal modelled lambda (bandpass filtered in lean-rich direction)" UWORD fak_q3p0518Em5 1 100 0.00 1.999969 FORMAT "%8.6" ECU_ADDRESS 0x5000169C /end MEASUREMENT
/begin MEASUREMENT EGSDO2_IdnSigB1_I.ratLamRecprMdlBpRtl "Class for identification signals for lambda-based dynamics diagnosis of a wideband-sensor / Reciprocal modelled lambda (bandpass filtered in rich-lean direction)" UWORD fak_q3p0518Em5 1 100 0.00 1.999969 FORMAT "%8.6" ECU_ADDRESS 0x5000169E /end MEASUREMENT
/begin MEASUREMENT EGSDO2_IdnSigB1_I.ratLamRecprMdlChmb "Class for identification signals for lambda-based dynamics diagnosis of a wideband-sensor / Reciprocal modelled lambda in combustion chamber" UWORD fak_q3p0518Em5 1 100 0.00 1.999969 FORMAT "%8.6" ECU_ADDRESS 0x500016A0 /end MEASUREMENT
/begin MEASUREMENT EGSDO2_IdnSigB1_I.ratLamRecprMdlFlt "Class for identification signals for lambda-based dynamics diagnosis of a wideband-sensor / Reciprocal modelled lambda with fault model" UWORD fak_q3p0518Em5 1 100 0.00 1.999969 FORMAT "%8.6" ECU_ADDRESS 0x500016A2 /end MEASUREMENT
/begin MEASUREMENT EGSDO2_IdnSigB1_I.ratLamRecprMdlFltBp "Class for identification signals for lambda-based dynamics diagnosis of a wideband-sensor / Reciprocal modelled lambda with fault model (bandpass filtered)" SWORD fak_q3p0518Em5 1 100 -1.000000 0.999969 FORMAT "%8.6" ECU_ADDRESS 0x500016A4 /end MEASUREMENT
/begin MEASUREMENT EGSDO2_IdnSigB1_I.ratLamRecprMdlFltBpLtr "Class for identification signals for lambda-based dynamics diagnosis of a wideband-sensor / Reciprocal modelled lambda with fault model (bandpass filtered in lean-rich direction)" UWORD fak_q3p0518Em5 1 100 0.00 1.999969 FORMAT "%8.6" ECU_ADDRESS 0x500016A6 /end MEASUREMENT
/begin MEASUREMENT EGSDO2_IdnSigB1_I.ratLamRecprMdlFltBpRtl "Class for identification signals for lambda-based dynamics diagnosis of a wideband-sensor / Reciprocal modelled lambda with fault model (bandpass filtered in rich-lean direction)" UWORD fak_q3p0518Em5 1 100 0.00 1.999969 FORMAT "%8.6" ECU_ADDRESS 0x500016A8 /end MEASUREMENT
/begin MEASUREMENT EGSDO2_IdnSigB1_I.ratLamRecprSpChmbCorrd "Class for identification signals for lambda-based dynamics diagnosis of a wideband-sensor / Reciprocal lambda set point in combustion chamber (corrected due to EGR)" ULONG fak_uw_b1 1 100 0.00 65535.9999847 FORMAT "%13.7" ECU_ADDRESS 0x500016AC /end MEASUREMENT
/begin MEASUREMENT EGSDO2_IdnSigB1_I.LamLtrFF_I.status "Class for identification signals for lambda-based dynamics diagnosis of a wideband-sensor / . / current value of RS-FF" UBYTE B_TRUE 1 100 0.00 1.00000000000 BIT_MASK 0x1 FORMAT "%13.11" ECU_ADDRESS 0x500016B0 /end MEASUREMENT
/begin MEASUREMENT EGSDO2_IdnSigB1_I.MdlAsymLT_I.memory "Class for identification signals for lambda-based dynamics diagnosis of a wideband-sensor / Lowpass of asymmetric fault model / current lowpass value" ULONG fak_q4p6566Em10 1 100 0.00 1.999999999534339 FORMAT "%17.15" ECU_ADDRESS 0x500016E4 /end MEASUREMENT
/begin MEASUREMENT EGSDO2_IdnSigB1_I.MdlAsymPreFilLT_I.memory "Class for identification signals for lambda-based dynamics diagnosis of a wideband-sensor / Prefilter of asymmetric fault model / current lowpass value" ULONG fak_q4p6566Em10 1 100 0.00 1.999999999534339 FORMAT "%17.15" ECU_ADDRESS 0x500016E8 /end MEASUREMENT
/begin MEASUREMENT EGSDO2_IdnSigB1_I.SlopChgEBNM_I.oldSignal "Class for identification signals for lambda-based dynamics diagnosis of a wideband-sensor / Falling and rising edge to detect change in slope direction / EdgeBiNoMem.oldsignal" UBYTE B_TRUE 1 100 0.00 1.00000000000 BIT_MASK 0x1 FORMAT "%13.11" ECU_ADDRESS 0x500016EC /end MEASUREMENT
/begin MEASUREMENT EGSDO2_IdnSigB1_I.dratLamRecprFildLT_I.memory "Class for identification signals for lambda-based dynamics diagnosis of a wideband-sensor / Lowpass (PT1) for derivative of measured reciprocal lambda / current lowpass value" SLONG fak_q4p6566Em10 1 100 -1.000000000000000 0.999999999534339 FORMAT "%17.15" ECU_ADDRESS 0x500016F0 /end MEASUREMENT
/begin MEASUREMENT EGSDO2_IdnSigB1_I.ratLamRecprMdlChmbLT_I.memory "Class for identification signals for lambda-based dynamics diagnosis of a wideband-sensor / Lowpass for reciprocal modelled lambda in combustion chamber / current lowpass value" ULONG fak_q4p6566Em10 1 100 0.00 1.999999999534339 FORMAT "%17.15" ECU_ADDRESS 0x50001724 /end MEASUREMENT
/begin MEASUREMENT EGSDO2_IdnSigB1_I.ratLamRecprMdlDt1LT_I.memory "Class for identification signals for lambda-based dynamics diagnosis of a wideband-sensor / Lowpass for filtered derivative of reciprocal modelled lambda / current lowpass value" ULONG fak_q4p6566Em10 1 100 0.00 1.999999999534339 FORMAT "%17.15" ECU_ADDRESS 0x50001728 /end MEASUREMENT
/begin MEASUREMENT EGSDO2_IdnSigB1_I.ratLamRecprMdlFltDt1LT_I.memory "Class for identification signals for lambda-based dynamics diagnosis of a wideband-sensor / Lowpass for filtered derivative of reciprocal modelled lambda with fault / current lowpass value" ULONG fak_q4p6566Em10 1 100 0.00 1.999999999534339 FORMAT "%17.15" ECU_ADDRESS 0x5000172C /end MEASUREMENT
/begin MEASUREMENT EGSDO2_IdnSigB1_I.ratLamRecprMdlFltLT_I.memory "Class for identification signals for lambda-based dynamics diagnosis of a wideband-sensor / Lowpass for reciprocal modelled lambda with fault / current lowpass value" ULONG fak_q4p6566Em10 1 100 0.00 1.999999999534339 FORMAT "%17.15" ECU_ADDRESS 0x50001730 /end MEASUREMENT
/begin MEASUREMENT EGSDO2_IdnSigB1_I.ratLamRecprMdlLT_I.memory "Class for identification signals for lambda-based dynamics diagnosis of a wideband-sensor / Lowpass for reciprocal modelled lambda / current lowpass value" ULONG fak_q4p6566Em10 1 100 0.00 1.999999999534339 FORMAT "%17.15" ECU_ADDRESS 0x50001734 /end MEASUREMENT
/begin MEASUREMENT EGSDO2_mfExhOffsFastB1 "used exhaust gas mass flow for fast offset adaptation of bank 1" UWORD m_uw_b6553p5 1 100 0.00 6553.500 FORMAT "%8.3" ECU_ADDRESS 0x600072B6 /end MEASUREMENT
/begin MEASUREMENT EGSDO2_NEngTONV_I.outbit "TurnOn Delay engine speed / return value" UBYTE B_TRUE 1 100 0.00 1.00000000000 BIT_MASK 0x1 FORMAT "%13.11" ECU_ADDRESS 0x600072A4 /end MEASUREMENT
/begin MEASUREMENT EGSDO2_NEngTONV_I.time "TurnOn Delay engine speed / expired delay time" UBYTE t_q0p1 1 100 0.00 25.50 FORMAT "%5.2" ECU_ADDRESS 0x600072A5 /end MEASUREMENT
/begin MEASUREMENT EGSDO2_NoCatPurgOffsB1FF_I.status "switch to minimal exhaust mass threshold if no catalyst purge donebefore / current value of RS-FF" UBYTE B_TRUE 1 100 0.00 1.00000000000 BIT_MASK 0x1 FORMAT "%13.11" ECU_ADDRESS 0x6000B1F1 /end MEASUREMENT
/begin MEASUREMENT EGSDO2_NoCatPurgOffsVirtB1FF_I.status "switch to minimal exhaust mass threshold if no catalyst purge donebefore for IUMPR simulation / current value of RS-FF" UBYTE B_TRUE 1 100 0.00 1.00000000000 BIT_MASK 0x1 FORMAT "%13.11" ECU_ADDRESS 0x6000B1F0 /end MEASUREMENT
/begin MEASUREMENT EGSDO2_ralLamOffsDeltaExchS1B1_s32 "Delta lambda offset for neutral exchange of I-part of lambda controller downstream catalyst (sensor 1, bank 1)" SLONG fak_sl_b1 1 100 -1.00000000000 0.99999999953 FORMAT "%13.11" ECU_ADDRESS 0x60003798 /end MEASUREMENT
/begin MEASUREMENT EGSDO2_ratLamOffsFastDeltaS1B1 "Fast adaptation step for lambda offset (sensor 1, bank 1)" SWORD fak_sw_b1 1 100 -1.000000 0.999969 FORMAT "%8.6" ECU_ADDRESS 0x600089BE /end MEASUREMENT
/begin MEASUREMENT EGSDO2_ratLamOffsFastPredS1B1 "expected Lambda offset" SWORD fak_sw_b1 1 100 -1.000000 0.999969 FORMAT "%8.6" ECU_ADDRESS 0x60013E96 /end MEASUREMENT
/begin MEASUREMENT EGSDO2_ratLamOffsPredRawB1 "predicted Offset" SWORD fak_sw_b1 1 100 -1.000000 0.999969 FORMAT "%8.6" ECU_ADDRESS 0x6001335C /end MEASUREMENT
/begin MEASUREMENT EGSDO2_ratLamOffsS1B1 "Lambda offset (sensor 1, bank 1)" SWORD fak_sw_b1 1 100 -1.000000 0.999969 FORMAT "%8.6" ECU_ADDRESS 0x60013E98 /end MEASUREMENT
/begin MEASUREMENT EGSDO2_ratLamOffsSrvS1B1 "Lambda offset for Service 01 (sensor 1, bank 1)" SWORD fak_sw_b1 1 100 -1.000000 0.999969 FORMAT "%8.6" ECU_ADDRESS 0x60013E9A /end MEASUREMENT
/begin MEASUREMENT EGSDO2_ratLamRecprBpLtrS1B1 "Reciprocal lambda (bandpass filtered in lean-rich direction)" UWORD fak_q3p0518Em5 1 100 0.00 1.999969 FORMAT "%8.6" ECU_ADDRESS 0x60008C76 /end MEASUREMENT
/begin MEASUREMENT EGSDO2_ratLamRecprBpRtlS1B1 "Reciprocal lambda (bandpass filtered in rich-lean direction)" UWORD fak_q3p0518Em5 1 100 0.00 1.999969 FORMAT "%8.6" ECU_ADDRESS 0x60008C74 /end MEASUREMENT
/begin MEASUREMENT EGSDO2_ratLamRecprBpS1B1 "Reciprocal lambda (bandpass filtered)" SWORD fak_q3p0518Em5 1 100 -1.000000 0.999969 FORMAT "%8.6" ECU_ADDRESS 0x600091DC /end MEASUREMENT
/begin MEASUREMENT EGSDO2_ratLamRecprFildS1B1 "Reciprocal lambda (filtered)" UWORD fak_q3p0518Em5 1 100 0.00 1.999969 FORMAT "%8.6" ECU_ADDRESS 0x60008C72 /end MEASUREMENT
/begin MEASUREMENT EGSDO2_ratLamRecprMdlBpLtrS1B1 "modelbased reciprocal lambda lean to rich" UWORD fak_q3p0518Em5 1 100 0.00 1.999969 FORMAT "%8.6" ECU_ADDRESS 0x60013E9C /end MEASUREMENT
/begin MEASUREMENT EGSDO2_ratLamRecprMdlBpRtlS1B1 "modelbased reciprocal lambda rich to lean" UWORD fak_q3p0518Em5 1 100 0.00 1.999969 FORMAT "%8.6" ECU_ADDRESS 0x60008C70 /end MEASUREMENT
/begin MEASUREMENT EGSDO2_ratLamRecprMdlBpS1B1 "Reciprocal modelled lambda (bandpass filtered)" SWORD fak_q3p0518Em5 1 100 -1.000000 0.999969 FORMAT "%8.6" ECU_ADDRESS 0x600091DA /end MEASUREMENT
/begin MEASUREMENT EGSDO2_ratLamRecprMdlFltBpLtrS1B1 "Reciprocal modelled lambda with fault model (bandpass filtered in lean-rich direction)" UWORD fak_q3p0518Em5 1 100 0.00 1.999969 FORMAT "%8.6" ECU_ADDRESS 0x60008C6E /end MEASUREMENT
/begin MEASUREMENT EGSDO2_ratLamRecprMdlFltBpRtlS1B1 "Reciprocal modelled lambda with fault model (bandpass filtered in rich-lean direction)" UWORD fak_q3p0518Em5 1 100 0.00 1.999969 FORMAT "%8.6" ECU_ADDRESS 0x60008C6C /end MEASUREMENT
/begin MEASUREMENT EGSDO2_ratLamRecprMdlFltBpS1B1 "Reciprocal modelled lambda with fault model (bandpass filtered)" SWORD fak_q3p0518Em5 1 100 -1.000000 0.999969 FORMAT "%8.6" ECU_ADDRESS 0x600091D8 /end MEASUREMENT
/begin MEASUREMENT EGSDO2_SnsrMntdDiagS1B1_I.flgDSMClrReq "SnsrMntdDiag Class sensor 1 bank 1 / Condition DSM clear" UBYTE B_TRUE 1 100 0.00 1.00000000000 BIT_MASK 0x1 FORMAT "%13.11" ECU_ADDRESS 0x6000728C /end MEASUREMENT
/begin MEASUREMENT EGSDO2_SnsrMntdDiagS1B1_I.flgErr "SnsrMntdDiag Class sensor 1 bank 1 / error detected" UBYTE B_TRUE 1 100 0.00 1.00000000000 BIT_MASK 0x1 FORMAT "%13.11" ECU_ADDRESS 0x6000728D /end MEASUREMENT
/begin MEASUREMENT EGSDO2_SnsrMntdDiagS1B1_I.flgRdy "SnsrMntdDiag Class sensor 1 bank 1 / function ready for diagnose" UBYTE B_TRUE 1 100 0.00 1.00000000000 BIT_MASK 0x1 FORMAT "%13.11" ECU_ADDRESS 0x6000728E /end MEASUREMENT
/begin MEASUREMENT EGSDO2_SnsrMntdDiagS1B1_I.flgRels "SnsrMntdDiag Class sensor 1 bank 1 / result exist" UBYTE B_TRUE 1 100 0.00 1.00000000000 BIT_MASK 0x1 FORMAT "%13.11" ECU_ADDRESS 0x6000728F /end MEASUREMENT
/begin MEASUREMENT EGSDO2_SnsrMntdDiagS1B1_I.flgRes "SnsrMntdDiag Class sensor 1 bank 1 / result exist" UBYTE B_TRUE 1 100 0.00 1.00000000000 BIT_MASK 0x1 FORMAT "%13.11" ECU_ADDRESS 0x60007290 /end MEASUREMENT
/begin MEASUREMENT EGSDO2_SnsrMntdDiagS1B1_I.SnsrMntdDiagNoErrTONV_I.outbit "SnsrMntdDiag Class sensor 1 bank 1 / Debouncing of no error / return value" UBYTE B_TRUE 1 100 0.00 1.00000000000 BIT_MASK 0x1 FORMAT "%13.11" ECU_ADDRESS 0x60007292 /end MEASUREMENT
/begin MEASUREMENT EGSDO2_SnsrMntdDiagS1B1_I.SnsrMntdDiagNoErrTONV_I.time "SnsrMntdDiag Class sensor 1 bank 1 / Debouncing of no error / expired delay time" UBYTE t_q0p1 1 100 0.00 25.50 FORMAT "%5.2" ECU_ADDRESS 0x60007293 /end MEASUREMENT
/begin MEASUREMENT EGSDO2_SnsrMntdDiagS1B1_I.SnsrMntdErrSuspcTONV_I.outbit "SnsrMntdDiag Class sensor 1 bank 1 / Debouncing of error suspicion / return value" UBYTE B_TRUE 1 100 0.00 1.00000000000 BIT_MASK 0x1 FORMAT "%13.11" ECU_ADDRESS 0x60007294 /end MEASUREMENT
/begin MEASUREMENT EGSDO2_SnsrMntdDiagS1B1_I.SnsrMntdErrSuspcTONV_I.time "SnsrMntdDiag Class sensor 1 bank 1 / Debouncing of error suspicion / expired delay time" UBYTE t_q0p1 1 100 0.00 25.50 FORMAT "%5.2" ECU_ADDRESS 0x60007295 /end MEASUREMENT
/begin MEASUREMENT EGSDO2_tiSumRefCtrlActvOffsFastB1 "Time activated cat control" UWORD t_q0p1 1 100 0.00 6553.500 FORMAT "%8.3" ECU_ADDRESS 0x600072B4 /end MEASUREMENT
/begin MEASUREMENT EGSDU_ctReIni10msDlyDs "ReIni counter" UBYTE OneToOne 1 100 0.00 255.0 FORMAT "%5.1" ECU_ADDRESS 0x6000B1EE /end MEASUREMENT
/begin MEASUREMENT EGSDU_DlyMeasS2B1_I.duLtrCorrGrdt "Measurement of delay time, sensor 2 (binary sensor) / Gradient for correction of delay measurement Lean-Rich due to catalyst storage capacity" UWORD spgg_q0p00488_V_DIV_s 1 100 0.00 319.9951 FORMAT "%8.4" ECU_ADDRESS 0x60002CB6 /end MEASUREMENT
/begin MEASUREMENT EGSDU_DlyMeasS2B1_I.duRtlCorrGrdt "Measurement of delay time, sensor 2 (binary sensor) / Gradient for correction of delay measurement Rich-Lean due to catalyst storage capacity" UWORD spgg_q0p00488_V_DIV_s 1 100 0.00 319.9951 FORMAT "%8.4" ECU_ADDRESS 0x60002CB8 /end MEASUREMENT
/begin MEASUREMENT EGSDU_DlyMeasS2B1_I.flgInhbRi "Measurement of delay time, sensor 2 (binary sensor) / Condition: Inhibit measurement of internal resistance for delay measurement" UBYTE B_TRUE 1 100 0.00 1.00000000000 BIT_MASK 0x1 FORMAT "%13.11" ECU_ADDRESS 0x60002CBA /end MEASUREMENT
/begin MEASUREMENT EGSDU_DlyMeasS2B1_I.flgLtrMeasFinshd "Measurement of delay time, sensor 2 (binary sensor) / flag denoting Lean to Rich measurement completion" UBYTE B_TRUE 1 100 0.00 1.00000000000 BIT_MASK 0x40 FORMAT "%13.11" ECU_ADDRESS 0x60002CB4 /end MEASUREMENT
/begin MEASUREMENT EGSDU_DlyMeasS2B1_I.flgLtrRes "Measurement of delay time, sensor 2 (binary sensor) / Condition: Delay measurement rich-lean carried out" UBYTE B_TRUE 1 100 0.00 1.00000000000 BIT_MASK 0x1 FORMAT "%13.11" ECU_ADDRESS 0x60002CBB /end MEASUREMENT
/begin MEASUREMENT EGSDU_DlyMeasS2B1_I.flgLtrTout "Measurement of delay time, sensor 2 (binary sensor) / time out flag during Lean to Rich measurement" UBYTE B_TRUE 1 100 0.00 1.00000000000 BIT_MASK 0x4 FORMAT "%13.11" ECU_ADDRESS 0x60002CB4 /end MEASUREMENT
/begin MEASUREMENT EGSDU_DlyMeasS2B1_I.flgRtlMeasFinshd "Measurement of delay time, sensor 2 (binary sensor) / flag denoting Rich to Lean measurement completion" UBYTE B_TRUE 1 100 0.00 1.00000000000 BIT_MASK 0x1 FORMAT "%13.11" ECU_ADDRESS 0x60002CB4 /end MEASUREMENT
/begin MEASUREMENT EGSDU_DlyMeasS2B1_I.flgRtlRes "Measurement of delay time, sensor 2 (binary sensor) / Condition: Delay measurement rich-lean carried out" UBYTE B_TRUE 1 100 0.00 1.00000000000 BIT_MASK 0x1 FORMAT "%13.11" ECU_ADDRESS 0x60002CBC /end MEASUREMENT
/begin MEASUREMENT EGSDU_DlyMeasS2B1_I.flgRtlTout "Measurement of delay time, sensor 2 (binary sensor) / time out flag during Lean to Rich measurement" UBYTE B_TRUE 1 100 0.00 1.00000000000 BIT_MASK 0x20 FORMAT "%13.11" ECU_ADDRESS 0x60002CB4 /end MEASUREMENT
/begin MEASUREMENT EGSDU_DlyMeasS2B1_I.flgUFall "Measurement of delay time, sensor 2 (binary sensor) / Sensor voltage is falling" UBYTE B_TRUE 1 100 0.00 1.00000000000 BIT_MASK 0x80 FORMAT "%13.11" ECU_ADDRESS 0x60002CB4 /end MEASUREMENT
/begin MEASUREMENT EGSDU_DlyMeasS2B1_I.flgURise "Measurement of delay time, sensor 2 (binary sensor) / Sensor voltage is rising" UBYTE B_TRUE 1 100 0.00 1.00000000000 BIT_MASK 0x8 FORMAT "%13.11" ECU_ADDRESS 0x60002CB4 /end MEASUREMENT
/begin MEASUREMENT EGSDU_DlyMeasS2B1_I.mfAvrgMeasRtlDly "Measurement of delay time, sensor 2 (binary sensor) / average exhaust gas mass flow during the diagnosis" UWORD m_q0p1 1 100 0.00 6553.500 FORMAT "%8.3" ECU_ADDRESS 0x60002CBE /end MEASUREMENT
/begin MEASUREMENT EGSDU_DlyMeasS2B1_I.mfEgCatParl "Measurement of delay time, sensor 2 (binary sensor) / Exhaust gas mass flow into catalyst" UWORD m_q0p1 1 100 0.00 6553.500 FORMAT "%8.3" ECU_ADDRESS 0x60002CC0 /end MEASUREMENT
/begin MEASUREMENT EGSDU_DlyMeasS2B1_I.stParlOld "Measurement of delay time, sensor 2 (binary sensor) / old state index of state machine from coordinate function" UBYTE dez 1 100 0.00 255.0 FORMAT "%5.1" ECU_ADDRESS 0x60002CC2 /end MEASUREMENT
/begin MEASUREMENT EGSDU_DlyMeasS2B1_I.tiLtrCorrGrdt "Measurement of delay time, sensor 2 (binary sensor) / Correction time lean-rich via voltage gradient" SWORD t_q0p01 1 100 -327.6800 327.6700 FORMAT "%8.4" ECU_ADDRESS 0x60002CC4 /end MEASUREMENT
/begin MEASUREMENT EGSDU_DlyMeasS2B1_I.tiLtrCorrGrdtMax "Measurement of delay time, sensor 2 (binary sensor) / maximal correction time lean-rich via voltage gradient" UWORD t_q0p01 1 100 0.00 655.3500 FORMAT "%8.4" ECU_ADDRESS 0x60002CC6 /end MEASUREMENT
/begin MEASUREMENT EGSDU_DlyMeasS2B1_I.tiLtrCorrGrdtPre "Measurement of delay time, sensor 2 (binary sensor) / preliminary correction time lean-rich via voltage gradient" UWORD t_q0p01 1 100 0.00 655.3500 FORMAT "%8.4" ECU_ADDRESS 0x60002CC8 /end MEASUREMENT
/begin MEASUREMENT EGSDU_DlyMeasS2B1_I.tiLtrCorrGrdtTmp "Measurement of delay time, sensor 2 (binary sensor) / temporary correction time lean-rich via voltage gradient" UWORD t_q0p01 1 100 0.00 655.3500 FORMAT "%8.4" ECU_ADDRESS 0x60002CCA /end MEASUREMENT
/begin MEASUREMENT EGSDU_DlyMeasS2B1_I.tiLtrDly "Measurement of delay time, sensor 2 (binary sensor) / Delay lean-rich" UWORD t_q0p01 1 100 0.00 655.3500 FORMAT "%8.4" ECU_ADDRESS 0x60002CCC /end MEASUREMENT
/begin MEASUREMENT EGSDU_DlyMeasS2B1_I.tiLtrDlyMeas "Measurement of delay time, sensor 2 (binary sensor) / Lean to Rich delay time Measured" UWORD t_q0p01 1 100 0.00 655.3500 FORMAT "%8.4" ECU_ADDRESS 0x60002CCE /end MEASUREMENT
/begin MEASUREMENT EGSDU_DlyMeasS2B1_I.tiRtlCorrGrdt "Measurement of delay time, sensor 2 (binary sensor) / Correction time rich-lean via voltage gradient" SWORD t_q0p01 1 100 -327.6800 327.6700 FORMAT "%8.4" ECU_ADDRESS 0x60002CD0 /end MEASUREMENT
/begin MEASUREMENT EGSDU_DlyMeasS2B1_I.tiRtlCorrGrdtMax "Measurement of delay time, sensor 2 (binary sensor) / maximal correction time rich-lean via voltage gradient" UWORD t_q0p01 1 100 0.00 655.3500 FORMAT "%8.4" ECU_ADDRESS 0x60002CD2 /end MEASUREMENT
/begin MEASUREMENT EGSDU_DlyMeasS2B1_I.tiRtlCorrGrdtPre "Measurement of delay time, sensor 2 (binary sensor) / preliminary correction time rich-lean via voltage gradient" UWORD t_q0p01 1 100 0.00 655.3500 FORMAT "%8.4" ECU_ADDRESS 0x60002CD4 /end MEASUREMENT
/begin MEASUREMENT EGSDU_DlyMeasS2B1_I.tiRtlCorrGrdtTmp "Measurement of delay time, sensor 2 (binary sensor) / temporary correction time rich-lean via voltage gradient" UWORD t_q0p01 1 100 0.00 655.3500 FORMAT "%8.4" ECU_ADDRESS 0x60002CD6 /end MEASUREMENT
/begin MEASUREMENT EGSDU_DlyMeasS2B1_I.tiRtlDly "Measurement of delay time, sensor 2 (binary sensor) / Delay rich-lean" UWORD t_q0p01 1 100 0.00 655.3500 FORMAT "%8.4" ECU_ADDRESS 0x60002CD8 /end MEASUREMENT
/begin MEASUREMENT EGSDU_DlyMeasS2B1_I.tiRtlDlyMeas "Measurement of delay time, sensor 2 (binary sensor) / Rich to Lean delay time Measured" UWORD t_q0p01 1 100 0.00 655.3500 FORMAT "%8.4" ECU_ADDRESS 0x60002CDA /end MEASUREMENT
/begin MEASUREMENT EGSDU_DlyMeasS2B1_I.uMax "Measurement of delay time, sensor 2 (binary sensor) / Maximum value sensor voltage for delay measurement" UWORD spg_q1p221Em3_V 1 100 0.00 4.998779 FORMAT "%8.6" ECU_ADDRESS 0x60002CDC /end MEASUREMENT
/begin MEASUREMENT EGSDU_DlyMeasS2B1_I.uMin "Measurement of delay time, sensor 2 (binary sensor) / Minimum value sensor voltage for delay measurement" UWORD spg_q1p221Em3_V 1 100 0.00 4.998779 FORMAT "%8.6" ECU_ADDRESS 0x60002CDE /end MEASUREMENT
/begin MEASUREMENT EGSDU_DlyMeasS2B1_I.EndTiCntrLtrERNM_I.oldSignal "Measurement of delay time, sensor 2 (binary sensor) / edge rising element denoting counter end time for Lean to rich transtition / value of input signal last calculation" UBYTE B_TRUE 1 100 0.00 1.00000000000 BIT_MASK 0x1 FORMAT "%13.11" ECU_ADDRESS 0x60002CE0 /end MEASUREMENT
/begin MEASUREMENT EGSDU_DlyMeasS2B1_I.EndTiCntrRtlERNM_I.oldSignal "Measurement of delay time, sensor 2 (binary sensor) / edge rising element denoting counter end time for Lean to rich transtition / value of input signal last calculation" UBYTE B_TRUE 1 100 0.00 1.00000000000 BIT_MASK 0x1 FORMAT "%13.11" ECU_ADDRESS 0x60002CE1 /end MEASUREMENT
/begin MEASUREMENT EGSDU_DlyMeasS2B1_I.flgLtrDurFF_I.status "Measurement of delay time, sensor 2 (binary sensor) / lean to rich delay measurement is active / current value of RS-FF" UBYTE B_TRUE 1 100 0.00 1.00000000000 BIT_MASK 0x1 FORMAT "%13.11" ECU_ADDRESS 0x60002CE2 /end MEASUREMENT
/begin MEASUREMENT EGSDU_DlyMeasS2B1_I.flgRtlDurFF_I.status "Measurement of delay time, sensor 2 (binary sensor) / NVRAM contains valid rich to lean transition measurement result / current value of RS-FF" UBYTE B_TRUE 1 100 0.00 1.00000000000 BIT_MASK 0x1 FORMAT "%13.11" ECU_ADDRESS 0x60002CE3 /end MEASUREMENT
/begin MEASUREMENT EGSDU_DlyMeasS2B1_I.mfAvrgMeasRtlDlyDL_I.memory "Measurement of delay time, sensor 2 (binary sensor) / low pass for the calculation of the average exhaust gas mass flow during the diagnosis / current lowpass value" ULONG mgrad_q1p526Em6_kg_DIV_h 1 100 0.00 6553.59999847 FORMAT "%13.8" ECU_ADDRESS 0x60002CE4 /end MEASUREMENT
/begin MEASUREMENT EGSDU_flgDSMClrDlyDs "Indication of clearing of error memory" UBYTE B_TRUE 1 100 0.00 1.00000000000 BIT_MASK 0x1 FORMAT "%13.11" ECU_ADDRESS 0x700002E5 /end MEASUREMENT
/begin MEASUREMENT EGSDU_flgS2B1InhbRiDly "Inhibit RI measurement for measurement of delay time of sensor voltage, sensor 2, bank 1" UBYTE B_TRUE 1 100 0.00 1.00000000000 BIT_MASK 0x1 FORMAT "%13.11" ECU_ADDRESS 0x700009D2 /end MEASUREMENT
/begin MEASUREMENT EGSDU_flgS2B1ResLtrDly "Single measurement delay time of sensor voltage at transition lean-rich is finished, sensor 2, bank 1" UBYTE B_TRUE 1 100 0.00 1.00000000000 BIT_MASK 0x1 FORMAT "%13.11" ECU_ADDRESS 0x700009CD /end MEASUREMENT
/begin MEASUREMENT EGSDU_flgS2B1ResRtlDly "Single measurement delay time of sensor voltage at transition rich-lean is finished, sensor 2, bank 1" UBYTE B_TRUE 1 100 0.00 1.00000000000 BIT_MASK 0x1 FORMAT "%13.11" ECU_ADDRESS 0x700009C9 /end MEASUREMENT
/begin MEASUREMENT EGSDU_flgS2B1ResVirtLtrDly "IUMPR simulation of single measurement delay time of sensor voltage at transition lean-rich is finished, sensor 2, bank 1" UBYTE B_TRUE 1 100 0.00 1.00000000000 BIT_MASK 0x1 FORMAT "%13.11" ECU_ADDRESS 0x700009C5 /end MEASUREMENT
/begin MEASUREMENT EGSDU_flgS2B1ResVirtRtlDly "IUMPR simulation of single measurement delay time of sensor voltage at transition rich-lean is finished, sensor 2, bank 1" UBYTE B_TRUE 1 100 0.00 1.00000000000 BIT_MASK 0x1 FORMAT "%13.11" ECU_ADDRESS 0x700009C1 /end MEASUREMENT
/begin MEASUREMENT EGSDU_mfAvrgS2B1MeasRtlDly "Average exhaust gas mass flow through catalyst 1 bank 1 during delay diagnosis of sensor 2 bank 1" UWORD m_q0p1 1 100 0.00 6553.500 FORMAT "%8.3" ECU_ADDRESS 0x60008C62 /end MEASUREMENT
/begin MEASUREMENT EGSDU_tiS2B1LenLtrDly "Expected delay time of sensor voltage at transition lean to rich in system without fault, sensor 2, bank 1" UWORD t_q0p01 1 100 0.00 655.3500 FORMAT "%8.4" ECU_ADDRESS 0x6000872E /end MEASUREMENT
/begin MEASUREMENT EGSDU_tiS2B1LenRtlDly "Expected delay time of sensor voltage at transition rich to lean in system without fault, sensor 2, bank 1" UWORD t_q0p01 1 100 0.00 655.3500 FORMAT "%8.4" ECU_ADDRESS 0x6000872C /end MEASUREMENT
/begin MEASUREMENT EGSDU_tiS2B1LtrNrmDly "normalized delay time (single measuremement) of sensor voltage at transition lean to rich, sensor 2, bank 1" SWORD t_q0p01 1 100 -327.6800 327.6700 FORMAT "%8.4" ECU_ADDRESS 0x600091D2 /end MEASUREMENT
/begin MEASUREMENT EGSDU_tiS2B1LtrRawDly "Raw value delay time (single measuremement) of sensor voltage at transition lean to rich, sensor 2, bank 1" UWORD t_q0p01 1 100 0.00 655.3500 FORMAT "%8.4" ECU_ADDRESS 0x60008C60 /end MEASUREMENT
/begin MEASUREMENT EGSDU_tiS2B1RtlNrmDly "normalized delay time (single measurement) of sensor voltage at transition rich to lean, sensor 2, bank 1" SWORD t_q0p01 1 100 -327.6800 327.6700 FORMAT "%8.4" ECU_ADDRESS 0x600091CA /end MEASUREMENT
/begin MEASUREMENT EGSDU_tiS2B1RtlRawDly "Raw value delay time (single measuremement) of sensor voltage at transition rich to lean, sensor 2, bank 1" UWORD t_q0p01 1 100 0.00 655.3500 FORMAT "%8.4" ECU_ADDRESS 0x60008C5E /end MEASUREMENT
/begin MEASUREMENT LamOffsFastB1_I.cntrExhM "Class instance for fast adaptation of lambda offset (bank 1) / Counter for exhaust masses to debounce fault with fast offset adaptation" UBYTE dez 1 100 0.00 255.0 FORMAT "%5.1" ECU_ADDRESS 0x60002CE9 /end MEASUREMENT
/begin MEASUREMENT LamOffsFastB1_I.cntrExhMVirt "Class instance for fast adaptation of lambda offset (bank 1) / Counter for virtual exhaust masses for IUMPR simulation of fast offset adaptation" UBYTE dez 1 100 0.00 255.0 FORMAT "%5.1" ECU_ADDRESS 0x60002CEA /end MEASUREMENT
/begin MEASUREMENT LamOffsFastB1_I.cntrNoStepIncRow "Class instance for fast adaptation of lambda offset (bank 1) / Counter for no step in offset or increasing offset in a row" UBYTE dez 1 100 0.00 255.0 FORMAT "%5.1" ECU_ADDRESS 0x60002CEB /end MEASUREMENT
/begin MEASUREMENT LamOffsFastB1_I.cntrNoStepRow "Class instance for fast adaptation of lambda offset (bank 1) / Counter for no step in offset in a row" UBYTE dez 1 100 0.00 255.0 FORMAT "%5.1" ECU_ADDRESS 0x60002CEC /end MEASUREMENT
/begin MEASUREMENT LamOffsFastB1_I.cntrOffsPredAbvThd "Class instance for fast adaptation of lambda offset (bank 1) / Counter for predicted offset above threshold" UWORD dez 1 100 0.00 65535.00 FORMAT "%8.2" ECU_ADDRESS 0x60002CEE /end MEASUREMENT
/begin MEASUREMENT LamOffsFastB1_I.flgDebFltOffsFast "Class instance for fast adaptation of lambda offset (bank 1) / Debounce condition for fault confirmation by fast offset adaptation" UBYTE B_TRUE 1 100 0.00 1.00000000000 BIT_MASK 0x1 FORMAT "%13.11" ECU_ADDRESS 0x60002CF0 /end MEASUREMENT
/begin MEASUREMENT LamOffsFastB1_I.flgDebFltOffsFastVirt "Class instance for fast adaptation of lambda offset (bank 1) / Virtual debounce condition (for IUMPR simulation) for fault confirmation by fast offset adaptation" UBYTE B_TRUE 1 100 0.00 1.00000000000 BIT_MASK 0x1 FORMAT "%13.11" ECU_ADDRESS 0x60002CF1 /end MEASUREMENT
/begin MEASUREMENT LamOffsFastB1_I.flgDebHealOffsFast "Class instance for fast adaptation of lambda offset (bank 1) / Debounce condition for fault healing by fast offset adaptation" UBYTE B_TRUE 1 100 0.00 1.00000000000 BIT_MASK 0x1 FORMAT "%13.11" ECU_ADDRESS 0x60002CF2 /end MEASUREMENT
/begin MEASUREMENT LamOffsFastB1_I.flgEna "Class instance for fast adaptation of lambda offset (bank 1) / Enabling of fast offset adaptation" UBYTE B_TRUE 1 100 0.00 1.00000000000 BIT_MASK 0x1 FORMAT "%13.11" ECU_ADDRESS 0x60002CE8 /end MEASUREMENT
/begin MEASUREMENT LamOffsFastB1_I.flgEnaExhM "Class instance for fast adaptation of lambda offset (bank 1) / Sufficient exhaust mass to enable fast offset adaptation" UBYTE B_TRUE 1 100 0.00 1.00000000000 BIT_MASK 0x2 FORMAT "%13.11" ECU_ADDRESS 0x60002CE8 /end MEASUREMENT
/begin MEASUREMENT LamOffsFastB1_I.flgEnaExhMVirt "Class instance for fast adaptation of lambda offset (bank 1) / Sufficient virtual exhaust mass to enable fast offset adaptation in context of IUMPR simulation" UBYTE B_TRUE 1 100 0.00 1.00000000000 BIT_MASK 0x10 FORMAT "%13.11" ECU_ADDRESS 0x60002CE8 /end MEASUREMENT
/begin MEASUREMENT LamOffsFastB1_I.flgEnaGnrlOffsFastVirt "Class instance for fast adaptation of lambda offset (bank 1) / General enabling condition for IUMPR simulation of fast offset adaptation fulfilled" UBYTE B_TRUE 1 100 0.00 1.00000000000 BIT_MASK 0x1 FORMAT "%13.11" ECU_ADDRESS 0x60002CF3 /end MEASUREMENT
/begin MEASUREMENT LamOffsFastB1_I.flgExhMNoSignChgOffsFastS1 "Class instance for fast adaptation of lambda offset (bank 1) / exhaust mass and no sign change enabling conditions for fast offset adaption are fulfilled" UBYTE B_TRUE 1 100 0.00 1.00000000000 BIT_MASK 0x1 FORMAT "%13.11" ECU_ADDRESS 0x60002CF4 /end MEASUREMENT
/begin MEASUREMENT LamOffsFastB1_I.flgLamOffsFastFltSuspc "Class instance for fast adaptation of lambda offset (bank 1) / fault suspicion from fast offset adaptation" UBYTE B_TRUE 1 100 0.00 1.00000000000 BIT_MASK 0x1 FORMAT "%13.11" ECU_ADDRESS 0x60002CF5 /end MEASUREMENT
/begin MEASUREMENT LamOffsFastB1_I.flgNoSignChgOffsPred "Class instance for fast adaptation of lambda offset (bank 1) / No sign change in raw value of predicted offset during exhaust mass interval" UBYTE B_TRUE 1 100 0.00 1.00000000000 BIT_MASK 0x40 FORMAT "%13.11" ECU_ADDRESS 0x60002CE8 /end MEASUREMENT
/begin MEASUREMENT LamOffsFastB1_I.ratLamOffsAbslt "Class instance for fast adaptation of lambda offset (bank 1) / Absolute value of lambda offset" UWORD fak_uw_b2 1 100 0.00 1.999969 FORMAT "%8.6" ECU_ADDRESS 0x60002CF6 /end MEASUREMENT
/begin MEASUREMENT LamOffsFastB1_I.ratLamOffsDeltaAbsPred "Class instance for fast adaptation of lambda offset (bank 1) / absolute value of expected really done adaptation step" SLONG fak_sw_b1 1 100 -65536.0000000 65535.9999695 FORMAT "%13.7" ECU_ADDRESS 0x60002CF8 /end MEASUREMENT
/begin MEASUREMENT LamOffsFastB1_I.ratLamOffsDeltaPred "Class instance for fast adaptation of lambda offset (bank 1) / expected really done adaptation step" SLONG fak_sw_b1 1 100 -65536.0000000 65535.9999695 FORMAT "%13.7" ECU_ADDRESS 0x60002CFC /end MEASUREMENT
/begin MEASUREMENT LamOffsFastB1_I.ratLamOffsFastDelta "Class instance for fast adaptation of lambda offset (bank 1) / Fast adaptation step for lambda offset" SWORD fak_sw_b1 1 100 -1.000000 0.999969 FORMAT "%8.6" ECU_ADDRESS 0x60002D00 /end MEASUREMENT
/begin MEASUREMENT LamOffsFastB1_I.ratLamOffsFastPred "Class instance for fast adaptation of lambda offset (bank 1) / expected Lambda offset" SWORD fak_sw_b1 1 100 -1.000000 0.999969 FORMAT "%8.6" ECU_ADDRESS 0x60002D02 /end MEASUREMENT
/begin MEASUREMENT LamOffsFastB1_I.ratLamOffsPred "Class instance for fast adaptation of lambda offset (bank 1) / expected Lambda offset" SWORD fak_sw_b1 1 100 -1.000000 0.999969 FORMAT "%8.6" ECU_ADDRESS 0x60002D04 /end MEASUREMENT
/begin MEASUREMENT LamOffsFastB1_I.ratLamOffsPredAbslt "Class instance for fast adaptation of lambda offset (bank 1) / Absolute value of predicted lambda offset" SWORD fak_sw_b1 1 100 -1.000000 0.999969 FORMAT "%8.6" ECU_ADDRESS 0x60002D06 /end MEASUREMENT
/begin MEASUREMENT LamOffsFastB1_I.tiPt1OffsPred "Class instance for fast adaptation of lambda offset (bank 1) / Filter time constant (PT1) for predicted offset" UWORD zk100msxs_uw_b6553 1 100 0.1000015 6553.6000000 FORMAT "%12.7" ECU_ADDRESS 0x60002D08 /end MEASUREMENT
/begin MEASUREMENT LamOffsFastB1_I.ExhMEnaGnrlVirtIK_I.memory "Class instance for fast adaptation of lambda offset (bank 1) / Virtual exhaust mass for general enabling of fast offset adaptation for IUMPR / current integrator value" ULONG m_q4p239Em7_g 1 100 0.00 1820.44907366 FORMAT "%13.8" ECU_ADDRESS 0x60002D0C /end MEASUREMENT
/begin MEASUREMENT LamOffsFastB1_I.ExhMEnaIK_I.memory "Class instance for fast adaptation of lambda offset (bank 1) / Exhaust mass to enable fast offset adaptation / current integrator value" ULONG m_q4p239Em7_g 1 100 0.00 1820.44907366 FORMAT "%13.8" ECU_ADDRESS 0x60002D10 /end MEASUREMENT
/begin MEASUREMENT LamOffsFastB1_I.ExhMEnaVirtIK_I.memory "Class instance for fast adaptation of lambda offset (bank 1) / Virtual exhaust mass to enable fast offset adaptation in context of IUMPR simulation / current integrator value" ULONG m_q4p239Em7_g 1 100 0.00 1820.44907366 FORMAT "%13.8" ECU_ADDRESS 0x60002D14 /end MEASUREMENT
/begin MEASUREMENT LamOffsFastB1_I.LamOffsPredLT_I.memory "Class instance for fast adaptation of lambda offset (bank 1) / Predicted lambda offset / current lowpass value" SLONG fak_q4p6566Em10 1 100 -1.000000000000000 0.999999999534339 FORMAT "%17.15" ECU_ADDRESS 0x60002D18 /end MEASUREMENT
/begin MEASUREMENT LamOffsFastB1_I.LamOffsPredRawSignChgEB_I.buffer "Class instance for fast adaptation of lambda offset (bank 1) / Bi-directional edge to detect sign change of predicted raw lambda offset / EdgeBi.buffer" UBYTE B_TRUE 1 100 0.00 1.00000000000 BIT_MASK 0x1 FORMAT "%13.11" ECU_ADDRESS 0x60002D1C /end MEASUREMENT
/begin MEASUREMENT LamOffsFastB1_I.LamOffsPredRawSignChgEB_I.oldSignal "Class instance for fast adaptation of lambda offset (bank 1) / Bi-directional edge to detect sign change of predicted raw lambda offset / EdgeBi.odlSignal" UBYTE B_TRUE 1 100 0.00 1.00000000000 BIT_MASK 0x1 FORMAT "%13.11" ECU_ADDRESS 0x60002D1D /end MEASUREMENT
/begin MEASUREMENT LamOffsFastB1_I.LamOffsPredSignChgEB_I.buffer "Class instance for fast adaptation of lambda offset (bank 1) / Bi-directional edge to detect sign change of predicted lambda offset / EdgeBi.buffer" UBYTE B_TRUE 1 100 0.00 1.00000000000 BIT_MASK 0x1 FORMAT "%13.11" ECU_ADDRESS 0x60002D1E /end MEASUREMENT
/begin MEASUREMENT LamOffsFastB1_I.LamOffsPredSignChgEB_I.oldSignal "Class instance for fast adaptation of lambda offset (bank 1) / Bi-directional edge to detect sign change of predicted lambda offset / EdgeBi.odlSignal" UBYTE B_TRUE 1 100 0.00 1.00000000000 BIT_MASK 0x1 FORMAT "%13.11" ECU_ADDRESS 0x60002D1F /end MEASUREMENT
/begin MEASUREMENT LamOffsFastB1_I.LamPlausFltSuspcOffsB1EFNM_I.oldSignal "Class instance for fast adaptation of lambda offset (bank 1) / EdgeFalling: Fault suspicion from lambda plausibility diagnosis / memory to detect falling edge" UBYTE B_TRUE 1 100 0.00 1.00000000000 BIT_MASK 0x1 FORMAT "%13.11" ECU_ADDRESS 0x60002D20 /end MEASUREMENT
/begin MEASUREMENT LamOffsFastB1_I.flgCtrlrLimNoOffsFF_I.status "Class instance for fast adaptation of lambda offset (bank 1) / Flipflop: the error suspicion due to mixture error leads to reset of UEGO offset error / current value of RS-FF" UBYTE B_TRUE 1 100 0.00 1.00000000000 BIT_MASK 0x1 FORMAT "%13.11" ECU_ADDRESS 0x60002D21 /end MEASUREMENT
/begin MEASUREMENT LamOffsFastB1_I.flgCtrlrLimNoOffsTONV_I.outbit "Class instance for fast adaptation of lambda offset (bank 1) / FID for the calculation of the reset condition for the offset fault suspicion / return value" UBYTE B_TRUE 1 100 0.00 1.00000000000 BIT_MASK 0x1 FORMAT "%13.11" ECU_ADDRESS 0x60002D22 /end MEASUREMENT
/begin MEASUREMENT LamOffsFastB1_I.flgCtrlrLimNoOffsTONV_I.time "Class instance for fast adaptation of lambda offset (bank 1) / FID for the calculation of the reset condition for the offset fault suspicion / expired delay time" UBYTE t_q0p1 1 100 0.00 25.50 FORMAT "%5.2" ECU_ADDRESS 0x60002D23 /end MEASUREMENT
/begin MEASUREMENT LamOffsFastB1_I.flgCtrlrLimOffsER_I.buffer "Class instance for fast adaptation of lambda offset (bank 1) / EdgeRising: enabling condition of fast offset adaptation due to lambda control / rising edge detected" UBYTE B_TRUE 1 100 0.00 1.00000000000 BIT_MASK 0x1 FORMAT "%13.11" ECU_ADDRESS 0x60002D24 /end MEASUREMENT
/begin MEASUREMENT LamOffsFastB1_I.flgCtrlrLimOffsER_I.oldSignal "Class instance for fast adaptation of lambda offset (bank 1) / EdgeRising: enabling condition of fast offset adaptation due to lambda control / flag rising edge" UBYTE B_TRUE 1 100 0.00 1.00000000000 BIT_MASK 0x1 FORMAT "%13.11" ECU_ADDRESS 0x60002D25 /end MEASUREMENT
/begin MEASUREMENT LamOffsFastB1_I.flgFltSuspcOffsFF_I.status "Class instance for fast adaptation of lambda offset (bank 1) / FlipFlop: fault suspicion of fast offset adaptation / current value of RS-FF" UBYTE B_TRUE 1 100 0.00 1.00000000000 BIT_MASK 0x1 FORMAT "%13.11" ECU_ADDRESS 0x60002D26 /end MEASUREMENT
/begin MEASUREMENT LamPlausB1_I.facOffsSlowPlaus "Class instance of lambda-based plausibility diagnosis (offset) of a wideband sensor (bank 1) / Offset adaption factor in the slow path" UWORD fak_uw_b1 1 100 0.00 0.9999847 FORMAT "%9.7" ECU_ADDRESS 0x50001ACC /end MEASUREMENT
/begin MEASUREMENT LamPlausB1_I.flgDebFltFuTrm "Class instance of lambda-based plausibility diagnosis (offset) of a wideband sensor (bank 1) / Fuel-trim-fault debounced" UBYTE B_TRUE 1 100 0.00 1.00000000000 BIT_MASK 0x1 FORMAT "%13.11" ECU_ADDRESS 0x50001AF5 /end MEASUREMENT
/begin MEASUREMENT LamPlausB1_I.flgDebFltOffs "Class instance of lambda-based plausibility diagnosis (offset) of a wideband sensor (bank 1) / Lambda-offset-fault debounced" UBYTE B_TRUE 1 100 0.00 1.00000000000 BIT_MASK 0x1 FORMAT "%13.11" ECU_ADDRESS 0x50001AF4 /end MEASUREMENT
/begin MEASUREMENT LamPlausB1_I.flgDebHealFuTrm "Class instance of lambda-based plausibility diagnosis (offset) of a wideband sensor (bank 1) / Fuel-trim-fault healed" UBYTE B_TRUE 1 100 0.00 1.00000000000 BIT_MASK 0x2 FORMAT "%13.11" ECU_ADDRESS 0x50001AF5 /end MEASUREMENT
/begin MEASUREMENT LamPlausB1_I.flgDebHealOffs "Class instance of lambda-based plausibility diagnosis (offset) of a wideband sensor (bank 1) / Lambda-offset-fault healed" UBYTE B_TRUE 1 100 0.00 1.00000000000 BIT_MASK 0x2 FORMAT "%13.11" ECU_ADDRESS 0x50001AF4 /end MEASUREMENT
/begin MEASUREMENT LamPlausB1_I.flgDfcFuTrmActvd "Class instance of lambda-based plausibility diagnosis (offset) of a wideband sensor (bank 1) / DFCs for fuel-trim fault activated" UBYTE B_TRUE 1 100 0.00 1.00000000000 BIT_MASK 0x1 FORMAT "%13.11" ECU_ADDRESS 0x50001AF3 /end MEASUREMENT
/begin MEASUREMENT LamPlausB1_I.flgDiumprRlsNumFuTrm "Class instance of lambda-based plausibility diagnosis (offset) of a wideband sensor (bank 1) / Release of IUMPR numerator of the fuel trim diagnosis" UBYTE B_TRUE 1 100 0.00 1.00000000000 BIT_MASK 0x1 FORMAT "%13.11" ECU_ADDRESS 0x50001ACE /end MEASUREMENT
/begin MEASUREMENT LamPlausB1_I.flgDiumprRlsNumOffs "Class instance of lambda-based plausibility diagnosis (offset) of a wideband sensor (bank 1) / Release of IUMPR numerator of the offset diagnosis" UBYTE B_TRUE 1 100 0.00 1.00000000000 BIT_MASK 0x1 FORMAT "%13.11" ECU_ADDRESS 0x50001ACF /end MEASUREMENT
/begin MEASUREMENT LamPlausB1_I.flgEnaAddOffsSlow "Class instance of lambda-based plausibility diagnosis (offset) of a wideband sensor (bank 1) / Enabling of addition of lambda offset of slow offset adaptation" UBYTE B_TRUE 1 100 0.00 1.00000000000 BIT_MASK 0x1 FORMAT "%13.11" ECU_ADDRESS 0x50001AD0 /end MEASUREMENT
/begin MEASUREMENT LamPlausB1_I.flgEnaDebSlow "Class instance of lambda-based plausibility diagnosis (offset) of a wideband sensor (bank 1) / I-part of TWC controller active, fuel condition fulfilled, P-part plausible at desired operating point" UBYTE B_TRUE 1 100 0.00 1.00000000000 BIT_MASK 0x1 FORMAT "%13.11" ECU_ADDRESS 0x50001AF6 /end MEASUREMENT
/begin MEASUREMENT LamPlausB1_I.flgEnaFuTrmFrzFrm "Class instance of lambda-based plausibility diagnosis (offset) of a wideband sensor (bank 1) / Condition FreezeFrame for fueltrim" UBYTE B_TRUE 1 100 0.00 1.00000000000 BIT_MASK 0x1 FORMAT "%13.11" ECU_ADDRESS 0x50001AF8 /end MEASUREMENT
/begin MEASUREMENT LamPlausB1_I.flgEnaOffsFastPlaus "Class instance of lambda-based plausibility diagnosis (offset) of a wideband sensor (bank 1) / Fast offset-adaption enable for slow adaption" UBYTE B_TRUE 1 100 0.00 1.00000000000 BIT_MASK 0x1 FORMAT "%13.11" ECU_ADDRESS 0x600390FC /end MEASUREMENT
/begin MEASUREMENT LamPlausB1_I.flgFltFtdlaMax "Class instance of lambda-based plausibility diagnosis (offset) of a wideband sensor (bank 1) / FTDLA max error detected" UBYTE B_TRUE 1 100 0.00 1.00000000000 BIT_MASK 0x4 FORMAT "%13.11" ECU_ADDRESS 0x50001AF5 /end MEASUREMENT
/begin MEASUREMENT LamPlausB1_I.flgFltFtdlaMin "Class instance of lambda-based plausibility diagnosis (offset) of a wideband sensor (bank 1) / FTDLA min error detected" UBYTE B_TRUE 1 100 0.00 1.00000000000 BIT_MASK 0x8 FORMAT "%13.11" ECU_ADDRESS 0x50001AF5 /end MEASUREMENT
/begin MEASUREMENT LamPlausB1_I.flgFltFuTrm "Class instance of lambda-based plausibility diagnosis (offset) of a wideband sensor (bank 1) / fuel-trim offset error of oxygen sensor exists" UBYTE B_TRUE 1 100 0.00 1.00000000000 BIT_MASK 0x2 FORMAT "%13.11" ECU_ADDRESS 0x50001AF3 /end MEASUREMENT
/begin MEASUREMENT LamPlausB1_I.flgFltOffs "Class instance of lambda-based plausibility diagnosis (offset) of a wideband sensor (bank 1) / LSU plausibility error exists" UBYTE B_TRUE 1 100 0.00 1.00000000000 BIT_MASK 0x4 FORMAT "%13.11" ECU_ADDRESS 0x50001AF4 /end MEASUREMENT
/begin MEASUREMENT LamPlausB1_I.flgFltPllsuMax "Class instance of lambda-based plausibility diagnosis (offset) of a wideband sensor (bank 1) / Offset max error" UBYTE B_TRUE 1 100 0.00 1.00000000000 BIT_MASK 0x1 FORMAT "%13.11" ECU_ADDRESS 0x50001AF7 /end MEASUREMENT
/begin MEASUREMENT LamPlausB1_I.flgFltPllsuMin "Class instance of lambda-based plausibility diagnosis (offset) of a wideband sensor (bank 1) / Offset min error" UBYTE B_TRUE 1 100 0.00 1.00000000000 BIT_MASK 0x2 FORMAT "%13.11" ECU_ADDRESS 0x50001AF7 /end MEASUREMENT
/begin MEASUREMENT LamPlausB1_I.flgFltPrevTrip "Class instance of lambda-based plausibility diagnosis (offset) of a wideband sensor (bank 1) / Error status from last trip" UBYTE B_TRUE 1 100 0.00 1.00000000000 BIT_MASK 0x4 FORMAT "%13.11" ECU_ADDRESS 0x50001AF6 /end MEASUREMENT
/begin MEASUREMENT LamPlausB1_I.flgFltSuspcLeanRamp "Class instance of lambda-based plausibility diagnosis (offset) of a wideband sensor (bank 1) / Offset error suspicion, triggered by lambda ramp" UBYTE B_TRUE 1 100 0.00 1.00000000000 BIT_MASK 0x8 FORMAT "%13.11" ECU_ADDRESS 0x50001AF6 /end MEASUREMENT
/begin MEASUREMENT LamPlausB1_I.flgFltSuspcRichRamp "Class instance of lambda-based plausibility diagnosis (offset) of a wideband sensor (bank 1) / Offset error suspicion, triggered by lambda ramp" UBYTE B_TRUE 1 100 0.00 1.00000000000 BIT_MASK 0x10 FORMAT "%13.11" ECU_ADDRESS 0x50001AF6 /end MEASUREMENT
/begin MEASUREMENT LamPlausB1_I.flgFltVirtFuTrm "Class instance of lambda-based plausibility diagnosis (offset) of a wideband sensor (bank 1) / virtual error simulation of fuel trim diagnosis is finished" UBYTE B_TRUE 1 100 0.00 1.00000000000 BIT_MASK 0x10 FORMAT "%13.11" ECU_ADDRESS 0x50001AF5 /end MEASUREMENT
/begin MEASUREMENT LamPlausB1_I.flgFrzFrmAvl "Class instance of lambda-based plausibility diagnosis (offset) of a wideband sensor (bank 1) / FreezeFrame available" UBYTE B_TRUE 1 100 0.00 1.00000000000 BIT_MASK 0x2 FORMAT "%13.11" ECU_ADDRESS 0x50001AF8 /end MEASUREMENT
/begin MEASUREMENT LamPlausB1_I.flgFrzFrmFuTrmMax "Class instance of lambda-based plausibility diagnosis (offset) of a wideband sensor (bank 1) / FreezeFrame for fuel-trim fault max available" UBYTE B_TRUE 1 100 0.00 1.00000000000 BIT_MASK 0x1 FORMAT "%13.11" ECU_ADDRESS 0x60039102 /end MEASUREMENT
/begin MEASUREMENT LamPlausB1_I.flgFrzFrmFuTrmMin "Class instance of lambda-based plausibility diagnosis (offset) of a wideband sensor (bank 1) / FreezeFrame for fuel-trim fault min available" UBYTE B_TRUE 1 100 0.00 1.00000000000 BIT_MASK 0x2 FORMAT "%13.11" ECU_ADDRESS 0x60039102 /end MEASUREMENT
/begin MEASUREMENT LamPlausB1_I.flgFrzFrmOffsMax "Class instance of lambda-based plausibility diagnosis (offset) of a wideband sensor (bank 1) / FreezeFrame for offset fault max available" UBYTE B_TRUE 1 100 0.00 1.00000000000 BIT_MASK 0x4 FORMAT "%13.11" ECU_ADDRESS 0x60039102 /end MEASUREMENT
/begin MEASUREMENT LamPlausB1_I.flgFrzFrmOffsMin "Class instance of lambda-based plausibility diagnosis (offset) of a wideband sensor (bank 1) / FreezeFrame for offset fault min available" UBYTE B_TRUE 1 100 0.00 1.00000000000 BIT_MASK 0x8 FORMAT "%13.11" ECU_ADDRESS 0x60039102 /end MEASUREMENT
/begin MEASUREMENT LamPlausB1_I.flgFuTrmDsmPrms "Class instance of lambda-based plausibility diagnosis (offset) of a wideband sensor (bank 1) / DSM permission for fuel trim diagnosis" UBYTE B_TRUE 1 100 0.00 1.00000000000 BIT_MASK 0x4 FORMAT "%13.11" ECU_ADDRESS 0x50001AF3 /end MEASUREMENT
/begin MEASUREMENT LamPlausB1_I.flgFuTrmFltHeal "Class instance of lambda-based plausibility diagnosis (offset) of a wideband sensor (bank 1) / Fuel trim fault healing" UBYTE B_TRUE 1 100 0.00 1.00000000000 BIT_MASK 0x8 FORMAT "%13.11" ECU_ADDRESS 0x50001AF3 /end MEASUREMENT
/begin MEASUREMENT LamPlausB1_I.flgFuTrmFltMax "Class instance of lambda-based plausibility diagnosis (offset) of a wideband sensor (bank 1) / Fuel trim fault maximum" UBYTE B_TRUE 1 100 0.00 1.00000000000 BIT_MASK 0x10 FORMAT "%13.11" ECU_ADDRESS 0x50001AF3 /end MEASUREMENT
/begin MEASUREMENT LamPlausB1_I.flgFuTrmFltMaxTmp "Class instance of lambda-based plausibility diagnosis (offset) of a wideband sensor (bank 1) / Fuel trim fault maximum (temporary)" UBYTE B_TRUE 1 100 0.00 1.00000000000 BIT_MASK 0x20 FORMAT "%13.11" ECU_ADDRESS 0x50001AF3 /end MEASUREMENT
/begin MEASUREMENT LamPlausB1_I.flgFuTrmFltMin "Class instance of lambda-based plausibility diagnosis (offset) of a wideband sensor (bank 1) / Fuel trim fault minimum" UBYTE B_TRUE 1 100 0.00 1.00000000000 BIT_MASK 0x40 FORMAT "%13.11" ECU_ADDRESS 0x50001AF3 /end MEASUREMENT
/begin MEASUREMENT LamPlausB1_I.flgFuTrmFltMinTmp "Class instance of lambda-based plausibility diagnosis (offset) of a wideband sensor (bank 1) / Fuel trim fault minimum (temporary)" UBYTE B_TRUE 1 100 0.00 1.00000000000 BIT_MASK 0x80 FORMAT "%13.11" ECU_ADDRESS 0x50001AF3 /end MEASUREMENT
/begin MEASUREMENT LamPlausB1_I.flgFuTrmFltTmp "Class instance of lambda-based plausibility diagnosis (offset) of a wideband sensor (bank 1) / temporary fueltrim fault" UBYTE B_TRUE 1 100 0.00 1.00000000000 BIT_MASK 0x20 FORMAT "%13.11" ECU_ADDRESS 0x50001AF5 /end MEASUREMENT
/begin MEASUREMENT LamPlausB1_I.flgLamDynTstdOk "Class instance of lambda-based plausibility diagnosis (offset) of a wideband sensor (bank 1) / Lambda dynamic tested ok" UBYTE B_TRUE 1 100 0.00 1.00000000000 BIT_MASK 0x20 FORMAT "%13.11" ECU_ADDRESS 0x50001AF6 /end MEASUREMENT
/begin MEASUREMENT LamPlausB1_I.flgLamOffsDsmPrms "Class instance of lambda-based plausibility diagnosis (offset) of a wideband sensor (bank 1) / DSM permission for lambda offset diagnosis" UBYTE B_TRUE 1 100 0.00 1.00000000000 BIT_MASK 0x8 FORMAT "%13.11" ECU_ADDRESS 0x50001AF4 /end MEASUREMENT
/begin MEASUREMENT LamPlausB1_I.flgLamOffsFltHeal "Class instance of lambda-based plausibility diagnosis (offset) of a wideband sensor (bank 1) / Lambda offset fault healing" UBYTE B_TRUE 1 100 0.00 1.00000000000 BIT_MASK 0x10 FORMAT "%13.11" ECU_ADDRESS 0x50001AF4 /end MEASUREMENT
/begin MEASUREMENT LamPlausB1_I.flgLamOffsFltMax "Class instance of lambda-based plausibility diagnosis (offset) of a wideband sensor (bank 1) / Lambda offset fault maximum" UBYTE B_TRUE 1 100 0.00 1.00000000000 BIT_MASK 0x20 FORMAT "%13.11" ECU_ADDRESS 0x50001AF4 /end MEASUREMENT
/begin MEASUREMENT LamPlausB1_I.flgLamOffsFltMin "Class instance of lambda-based plausibility diagnosis (offset) of a wideband sensor (bank 1) / Lambda offset fault minimum" UBYTE B_TRUE 1 100 0.00 1.00000000000 BIT_MASK 0x40 FORMAT "%13.11" ECU_ADDRESS 0x50001AF4 /end MEASUREMENT
/begin MEASUREMENT LamPlausB1_I.flgLamOffsSlowDebFuTrm "Class instance of lambda-based plausibility diagnosis (offset) of a wideband sensor (bank 1) / Debouncing of fuel trim fault by slow offset adaptation" UBYTE B_TRUE 1 100 0.00 1.00000000000 BIT_MASK 0x40 FORMAT "%13.11" ECU_ADDRESS 0x50001AF5 /end MEASUREMENT
/begin MEASUREMENT LamPlausB1_I.flgLamOffsSlowDebOffs "Class instance of lambda-based plausibility diagnosis (offset) of a wideband sensor (bank 1) / Debouncing of offset fault by slow offset adaptation" UBYTE B_TRUE 1 100 0.00 1.00000000000 BIT_MASK 0x80 FORMAT "%13.11" ECU_ADDRESS 0x50001AF4 /end MEASUREMENT
/begin MEASUREMENT LamPlausB1_I.flgLamPlausDsmPrms "Class instance of lambda-based plausibility diagnosis (offset) of a wideband sensor (bank 1) / DSM permission for fuel trim or lambda offset diagnosis" UBYTE B_TRUE 1 100 0.00 1.00000000000 BIT_MASK 0x8 FORMAT "%13.11" ECU_ADDRESS 0x50001AF7 /end MEASUREMENT
/begin MEASUREMENT LamPlausB1_I.flgLamPlausFltMax "Class instance of lambda-based plausibility diagnosis (offset) of a wideband sensor (bank 1) / max-error of lambda offset diagnosis is found" UBYTE B_TRUE 1 100 0.00 1.00000000000 BIT_MASK 0x1 FORMAT "%13.11" ECU_ADDRESS 0x50001AD1 /end MEASUREMENT
/begin MEASUREMENT LamPlausB1_I.flgLamPlausFltMin "Class instance of lambda-based plausibility diagnosis (offset) of a wideband sensor (bank 1) / min-error of lambda offset diagnosis is found" UBYTE B_TRUE 1 100 0.00 1.00000000000 BIT_MASK 0x1 FORMAT "%13.11" ECU_ADDRESS 0x50001AD2 /end MEASUREMENT
/begin MEASUREMENT LamPlausB1_I.flgLamPlausFltSuspc "Class instance of lambda-based plausibility diagnosis (offset) of a wideband sensor (bank 1) / Fault suspicion of lambda plausibility diagnosis" UBYTE B_TRUE 1 100 0.00 1.00000000000 BIT_MASK 0x1 FORMAT "%13.11" ECU_ADDRESS 0x50001AD3 /end MEASUREMENT
/begin MEASUREMENT LamPlausB1_I.flgLamPlausFltVirt "Class instance of lambda-based plausibility diagnosis (offset) of a wideband sensor (bank 1) / virtual error simulation of lambda offset diagnosis is finished" UBYTE B_TRUE 1 100 0.00 1.00000000000 BIT_MASK 0x1 FORMAT "%13.11" ECU_ADDRESS 0x50001AD4 /end MEASUREMENT
/begin MEASUREMENT LamPlausB1_I.flgLamPlausInhbParl "Class instance of lambda-based plausibility diagnosis (offset) of a wideband sensor (bank 1) / Inhibit of parallelization by LSU plausibility diagnosis" UBYTE B_TRUE 1 100 0.00 1.00000000000 BIT_MASK 0x1 FORMAT "%13.11" ECU_ADDRESS 0x50001AD5 /end MEASUREMENT
/begin MEASUREMENT LamPlausB1_I.flgLamPlausParlDneOnce "Class instance of lambda-based plausibility diagnosis (offset) of a wideband sensor (bank 1) / Parallelization done at least once from LSU plausibility diagnosis point of view" UBYTE B_TRUE 1 100 0.00 1.00000000000 BIT_MASK 0x1 FORMAT "%13.11" ECU_ADDRESS 0x50001AD6 /end MEASUREMENT
/begin MEASUREMENT LamPlausB1_I.flgLamPlausTstd "Class instance of lambda-based plausibility diagnosis (offset) of a wideband sensor (bank 1) / Lambda based plausibility diagnosis tested" UBYTE B_TRUE 1 100 0.00 1.00000000000 BIT_MASK 0x1 FORMAT "%13.11" ECU_ADDRESS 0x50001AD7 /end MEASUREMENT
/begin MEASUREMENT LamPlausB1_I.flgNEngSimrCnd "Class instance of lambda-based plausibility diagnosis (offset) of a wideband sensor (bank 1) / SimilarConditions for engine speed fulfilled" UBYTE B_TRUE 1 100 0.00 1.00000000000 BIT_MASK 0x4 FORMAT "%13.11" ECU_ADDRESS 0x50001AF8 /end MEASUREMENT
/begin MEASUREMENT LamPlausB1_I.flgOperPntActvInter "Class instance of lambda-based plausibility diagnosis (offset) of a wideband sensor (bank 1) / Operating point active (bank-specific intermediate variable)" UBYTE B_TRUE 1 100 0.00 1.00000000000 BIT_MASK 0x1 FORMAT "%13.11" ECU_ADDRESS 0x50001AD8 /end MEASUREMENT
/begin MEASUREMENT LamPlausB1_I.flgPassdFtdla "Class instance of lambda-based plausibility diagnosis (offset) of a wideband sensor (bank 1) / Fueltrim tested ok" UBYTE B_TRUE 1 100 0.00 1.00000000000 BIT_MASK 0x80 FORMAT "%13.11" ECU_ADDRESS 0x50001AF5 /end MEASUREMENT
/begin MEASUREMENT LamPlausB1_I.flgPassdPllsu "Class instance of lambda-based plausibility diagnosis (offset) of a wideband sensor (bank 1) / Offset tested ok" UBYTE B_TRUE 1 100 0.00 1.00000000000 BIT_MASK 0x10 FORMAT "%13.11" ECU_ADDRESS 0x50001AF7 /end MEASUREMENT
/begin MEASUREMENT LamPlausB1_I.flgRatLoadSimrCnd "Class instance of lambda-based plausibility diagnosis (offset) of a wideband sensor (bank 1) / SimilarConditions for relative load fulfilled" UBYTE B_TRUE 1 100 0.00 1.00000000000 BIT_MASK 0x8 FORMAT "%13.11" ECU_ADDRESS 0x50001AF8 /end MEASUREMENT
/begin MEASUREMENT LamPlausB1_I.flgRepLamOffsTstRes "Class instance of lambda-based plausibility diagnosis (offset) of a wideband sensor (bank 1) / Report lambda offset test result to Service 06" UBYTE B_TRUE 1 100 0.00 1.00000000000 BIT_MASK 0x1 FORMAT "%13.11" ECU_ADDRESS 0x50001AD9 /end MEASUREMENT
/begin MEASUREMENT LamPlausB1_I.flgSimrCnd "Class instance of lambda-based plausibility diagnosis (offset) of a wideband sensor (bank 1) / SimilarConditions fulfilled" UBYTE B_TRUE 1 100 0.00 1.00000000000 BIT_MASK 0x10 FORMAT "%13.11" ECU_ADDRESS 0x50001AF8 /end MEASUREMENT
/begin MEASUREMENT LamPlausB1_I.flgTEngSimrCnd "Class instance of lambda-based plausibility diagnosis (offset) of a wideband sensor (bank 1) / SimilarConditions for engine temperature fulfilled" UBYTE B_TRUE 1 100 0.00 1.00000000000 BIT_MASK 0x20 FORMAT "%13.11" ECU_ADDRESS 0x50001AF8 /end MEASUREMENT
/begin MEASUREMENT LamPlausB1_I.flgTstdPllsu "Class instance of lambda-based plausibility diagnosis (offset) of a wideband sensor (bank 1) / Offset tested" UBYTE B_TRUE 1 100 0.00 1.00000000000 BIT_MASK 0x20 FORMAT "%13.11" ECU_ADDRESS 0x50001AF7 /end MEASUREMENT
/begin MEASUREMENT LamPlausB1_I.flgVldLamPlausMax "Class instance of lambda-based plausibility diagnosis (offset) of a wideband sensor (bank 1) / Offset Validation Max" UBYTE B_TRUE 1 100 0.00 1.00000000000 BIT_MASK 0x40 FORMAT "%13.11" ECU_ADDRESS 0x50001AF6 /end MEASUREMENT
/begin MEASUREMENT LamPlausB1_I.flgVldLamPlausMin "Class instance of lambda-based plausibility diagnosis (offset) of a wideband sensor (bank 1) / Offset Validation Min" UBYTE B_TRUE 1 100 0.00 1.00000000000 BIT_MASK 0x80 FORMAT "%13.11" ECU_ADDRESS 0x50001AF6 /end MEASUREMENT
/begin MEASUREMENT LamPlausB1_I.nEngSimrCnd "Class instance of lambda-based plausibility diagnosis (offset) of a wideband sensor (bank 1) / SimilarConditions reference for engine speed" UWORD nmot_uw_q0p25 1 100 0.00 16383.75 FORMAT "%8.2" ECU_ADDRESS 0x50001ADA /end MEASUREMENT
/begin MEASUREMENT LamPlausB1_I.nEngSrv01 "Class instance of lambda-based plausibility diagnosis (offset) of a wideband sensor (bank 1) / Current engine speed according to Service 01" UWORD nmot_uw_q0p25 1 100 0.00 16383.75 FORMAT "%8.2" ECU_ADDRESS 0x50001ADC /end MEASUREMENT
/begin MEASUREMENT LamPlausB1_I.nEngThdSrv01 "Class instance of lambda-based plausibility diagnosis (offset) of a wideband sensor (bank 1) / engine speed threshold for service 1" UWORD nmot_uw_q0p25 1 100 0.00 16383.75 FORMAT "%8.2" ECU_ADDRESS 0x50001ADE /end MEASUREMENT
/begin MEASUREMENT LamPlausB1_I.ratLamOffs "Class instance of lambda-based plausibility diagnosis (offset) of a wideband sensor (bank 1) / Lambda offset" SWORD fak_sw_b1 1 100 -1.000000 0.999969 FORMAT "%8.6" ECU_ADDRESS 0x600390FE /end MEASUREMENT
/begin MEASUREMENT LamPlausB1_I.ratLamOffsCycBgn "Class instance of lambda-based plausibility diagnosis (offset) of a wideband sensor (bank 1) / Lambda offset at beginning of driving cycle" SWORD fak_sw_b1 1 100 -1.000000 0.999969 FORMAT "%8.6" ECU_ADDRESS 0x50001AE0 /end MEASUREMENT
/begin MEASUREMENT LamPlausB1_I.ratLamOffsDeltaExch_s32 "Class instance of lambda-based plausibility diagnosis (offset) of a wideband sensor (bank 1) / Delta lambda offset to exchange I-part of lambda controller downstream catalyst with lambda offset" SLONG fak_sl_b1 1 100 -1.00000000000 0.99999999953 FORMAT "%13.11" ECU_ADDRESS 0x50001AE4 /end MEASUREMENT
/begin MEASUREMENT LamPlausB1_I.ratLamOffsSlowFastAdpt "Class instance of lambda-based plausibility diagnosis (offset) of a wideband sensor (bank 1) / Target offset for the accelerated slow adpation" SWORD fak_sw_b1 1 100 -1.000000 0.999969 FORMAT "%8.6" ECU_ADDRESS 0x60039100 /end MEASUREMENT
/begin MEASUREMENT LamPlausB1_I.ratLamOffsValRes "Class instance of lambda-based plausibility diagnosis (offset) of a wideband sensor (bank 1) / lambda offset test result" SWORD fak_sw_b1 1 100 -1.000000 0.999969 FORMAT "%8.6" ECU_ADDRESS 0x50001AE8 /end MEASUREMENT
/begin MEASUREMENT LamPlausB1_I.ratLoadSimrCnd "Class instance of lambda-based plausibility diagnosis (offset) of a wideband sensor (bank 1) / SimilarConditions reference for relative load" UBYTE fak_ub_b100 1 100 0.00 100.0 FORMAT "%5.1" ECU_ADDRESS 0x50001AF0 /end MEASUREMENT
/begin MEASUREMENT LamPlausB1_I.ratLoadSrv01 "Class instance of lambda-based plausibility diagnosis (offset) of a wideband sensor (bank 1) / Current relative load according to Service 01" UBYTE fak_ub_b100 1 100 0.00 100.0 FORMAT "%5.1" ECU_ADDRESS 0x50001AF1 /end MEASUREMENT
/begin MEASUREMENT LamPlausB1_I.ratLoadThdSrv01 "Class instance of lambda-based plausibility diagnosis (offset) of a wideband sensor (bank 1) / engine load threshold for service 1" UBYTE fak_ub_b100 1 100 0.00 100.0 FORMAT "%5.1" ECU_ADDRESS 0x50001AF2 /end MEASUREMENT
/begin MEASUREMENT LamPlausB1_I.tEngSimrCnd "Class instance of lambda-based plausibility diagnosis (offset) of a wideband sensor (bank 1) / SimilarConditions reference for engine temperature" UBYTE temp_ub_q1_o40 1 100 -40.0 215.0 FORMAT "%5.1" ECU_ADDRESS 0x50001AF9 /end MEASUREMENT
/begin MEASUREMENT LamPlausB1_I.tEngSrv01 "Class instance of lambda-based plausibility diagnosis (offset) of a wideband sensor (bank 1) / Current engine temperature according to Service 01" UBYTE temp_ub_q1_o40 1 100 -40.0 215.0 FORMAT "%5.1" ECU_ADDRESS 0x50001AFA /end MEASUREMENT
/begin MEASUREMENT LamPlausB1_I.tEngThdSrv01 "Class instance of lambda-based plausibility diagnosis (offset) of a wideband sensor (bank 1) / Engine temperature threshold for service 1" UBYTE temp_ub_q1_o40 1 100 -40.0 215.0 FORMAT "%5.1" ECU_ADDRESS 0x50001AFB /end MEASUREMENT
/begin MEASUREMENT LamPlausB1_I.tiLamOffsSlowActv "Class instance of lambda-based plausibility diagnosis (offset) of a wideband sensor (bank 1) / Cumulated time in which slow offset adaptation was active" UWORD t_q0p01 1 100 0.00 655.3500 FORMAT "%8.4" ECU_ADDRESS 0x50001AFC /end MEASUREMENT
/begin MEASUREMENT LamPlausB1_I.EGSDO2_EnaAddOffsFastPlausER_I.buffer "Class instance of lambda-based plausibility diagnosis (offset) of a wideband sensor (bank 1) / EdgeRising for the original value of lambda offset / rising edge detected" UBYTE B_TRUE 1 100 0.00 1.00000000000 BIT_MASK 0x1 FORMAT "%13.11" ECU_ADDRESS 0x50001AFE /end MEASUREMENT
/begin MEASUREMENT LamPlausB1_I.EGSDO2_EnaAddOffsFastPlausER_I.oldSignal "Class instance of lambda-based plausibility diagnosis (offset) of a wideband sensor (bank 1) / EdgeRising for the original value of lambda offset / flag rising edge" UBYTE B_TRUE 1 100 0.00 1.00000000000 BIT_MASK 0x1 FORMAT "%13.11" ECU_ADDRESS 0x50001AFF /end MEASUREMENT
/begin MEASUREMENT LamPlausB1_I.FTDLADltSusFrzFrmERNM_I.oldSignal "Class instance of lambda-based plausibility diagnosis (offset) of a wideband sensor (bank 1) / Edge rising to delete suspected freeze frame of FTDLA fault / value of input signal last calculation" UBYTE B_TRUE 1 100 0.00 1.00000000000 BIT_MASK 0x1 FORMAT "%13.11" ECU_ADDRESS 0x50001B00 /end MEASUREMENT
/begin MEASUREMENT LamPlausB1_I.FrzFrmFuTrmMaxERNM_I.oldSignal "Class instance of lambda-based plausibility diagnosis (offset) of a wideband sensor (bank 1) / Edge rising for freeze frame of fuel trim max fault / value of input signal last calculation" UBYTE B_TRUE 1 100 0.00 1.00000000000 BIT_MASK 0x1 FORMAT "%13.11" ECU_ADDRESS 0x50001B01 /end MEASUREMENT
/begin MEASUREMENT LamPlausB1_I.FrzFrmFuTrmMinERNM_I.oldSignal "Class instance of lambda-based plausibility diagnosis (offset) of a wideband sensor (bank 1) / Edge rising for freeze frame of fuel trim min fault / value of input signal last calculation" UBYTE B_TRUE 1 100 0.00 1.00000000000 BIT_MASK 0x1 FORMAT "%13.11" ECU_ADDRESS 0x50001B02 /end MEASUREMENT
/begin MEASUREMENT LamPlausB1_I.LamDynErrER_I.buffer "Class instance of lambda-based plausibility diagnosis (offset) of a wideband sensor (bank 1) / ErrorTrigger / rising edge detected" UBYTE B_TRUE 1 100 0.00 1.00000000000 BIT_MASK 0x1 FORMAT "%13.11" ECU_ADDRESS 0x50001B04 /end MEASUREMENT
/begin MEASUREMENT LamPlausB1_I.LamDynErrER_I.oldSignal "Class instance of lambda-based plausibility diagnosis (offset) of a wideband sensor (bank 1) / ErrorTrigger / flag rising edge" UBYTE B_TRUE 1 100 0.00 1.00000000000 BIT_MASK 0x1 FORMAT "%13.11" ECU_ADDRESS 0x50001B05 /end MEASUREMENT
/begin MEASUREMENT LamPlausB1_I.LamPlausParlDneERNM_I.oldSignal "Class instance of lambda-based plausibility diagnosis (offset) of a wideband sensor (bank 1) / Edge rise for setting info: parallelization done for LamPlaus / value of input signal last calculation" UBYTE B_TRUE 1 100 0.00 1.00000000000 BIT_MASK 0x1 FORMAT "%13.11" ECU_ADDRESS 0x50001B06 /end MEASUREMENT
/begin MEASUREMENT LamPlausB1_I.PLLSUDltSusFrzFrmERNM_I.oldSignal "Class instance of lambda-based plausibility diagnosis (offset) of a wideband sensor (bank 1) / Edge rising to delete suspected freeze frame of PLLSU fault / value of input signal last calculation" UBYTE B_TRUE 1 100 0.00 1.00000000000 BIT_MASK 0x1 FORMAT "%13.11" ECU_ADDRESS 0x50001B07 /end MEASUREMENT
/begin MEASUREMENT LamPlausB1_I.flgFltSuspcER_I.buffer "Class instance of lambda-based plausibility diagnosis (offset) of a wideband sensor (bank 1) / There is a offset- or target error suspicion / rising edge detected" UBYTE B_TRUE 1 100 0.00 1.00000000000 BIT_MASK 0x1 FORMAT "%13.11" ECU_ADDRESS 0x50001B08 /end MEASUREMENT
/begin MEASUREMENT LamPlausB1_I.flgFltSuspcER_I.oldSignal "Class instance of lambda-based plausibility diagnosis (offset) of a wideband sensor (bank 1) / There is a offset- or target error suspicion / flag rising edge" UBYTE B_TRUE 1 100 0.00 1.00000000000 BIT_MASK 0x1 FORMAT "%13.11" ECU_ADDRESS 0x50001B09 /end MEASUREMENT
/begin MEASUREMENT LamPlausB1_I.flgFltSuspcFF_I.status "Class instance of lambda-based plausibility diagnosis (offset) of a wideband sensor (bank 1) / There is a offset- or target error suspicion / current value of RS-FF" UBYTE B_TRUE 1 100 0.00 1.00000000000 BIT_MASK 0x1 FORMAT "%13.11" ECU_ADDRESS 0x50001B0A /end MEASUREMENT
/begin MEASUREMENT LamPlausB1_I.flgInhbParlER_I.buffer "Class instance of lambda-based plausibility diagnosis (offset) of a wideband sensor (bank 1) / Parallelization is inhibited, due to present offset error suspicion / rising edge detected" UBYTE B_TRUE 1 100 0.00 1.00000000000 BIT_MASK 0x1 FORMAT "%13.11" ECU_ADDRESS 0x50001B0C /end MEASUREMENT
/begin MEASUREMENT LamPlausB1_I.flgInhbParlER_I.oldSignal "Class instance of lambda-based plausibility diagnosis (offset) of a wideband sensor (bank 1) / Parallelization is inhibited, due to present offset error suspicion / flag rising edge" UBYTE B_TRUE 1 100 0.00 1.00000000000 BIT_MASK 0x1 FORMAT "%13.11" ECU_ADDRESS 0x50001B0D /end MEASUREMENT
/begin MEASUREMENT LamPlausB1_I.flgInhbParlFF_I.status "Class instance of lambda-based plausibility diagnosis (offset) of a wideband sensor (bank 1) / Parallelization is inhibited, due to present offset error suspicion / current value of RS-FF" UBYTE B_TRUE 1 100 0.00 1.00000000000 BIT_MASK 0x1 FORMAT "%13.11" ECU_ADDRESS 0x50001B0E /end MEASUREMENT
/begin MEASUREMENT LamPlausB1_I.mfExhEnaIK_I.memory "Class instance of lambda-based plausibility diagnosis (offset) of a wideband sensor (bank 1) / Integrator for exhaust gas after I-part of TWC controller active, fuel condition fulfilled, P-part plausible at desired operating point / current integrator value" ULONG m_q1p5259Em8_kg 1 100 0.00 65.5359999847 FORMAT "%13.10" ECU_ADDRESS 0x50001B10 /end MEASUREMENT
/begin FUNCTION EGSDO2_LamOffsFast "1.46.0    Fast detection of a lambda offset of a wideband sensor"
 /begin DEF_CHARACTERISTIC EGSDO2_facOffsFast_C EGSDO2_flgEnaCnsdrCtrlrLim_C EGSDO2_mExhEnaOffsFast_T EGSDO2_mExhEnaShtrp_C EGSDO2_mExhMEnaVirt_T EGSDO2_nrCntrOffsPredAbvThd_C EGSDO2_nrExhMOffsFastVirt_C EGSDO2_nrExhMOffsFast_C EGSDO2_nrNoStepRowOffsFast_C EGSDO2_ofsCntrNegOffsFast_C EGSDO2_ratLamDeltaActMax_C EGSDO2_ratLamOffsPredCntr_C EGSDO2_ratLamOffsPredCtrlrLim_C EGSDO2_ratLamOffsPredNeg_T EGSDO2_ratLamOffsPredPos_T EGSDO2_tiPt1OffsPred_T EGSDO2_tiTurnOnCtrlrLimNoOffs_C EGSDO2_cntrLoad_C EGSDO2_dratFillgEnaOffs_C EGSDO2_flgActvnRedCondVirt_C EGSDO2_flgEnaChkOnceOffsFast_CW EGSDO2_flgEnaDebRatLamOffs_CW EGSDO2_mExhEnaGnrlNoCatPurge_C EGSDO2_mExhEnaGnrlShtrp_C EGSDO2_mExhEnaGnrl_C EGSDO2_mfExhCatVirtHev_C EGSDO2_mfExhMaxOffsFast_C EGSDO2_mfExhMinOffsFastShtrp_C EGSDO2_mfExhMinOffsFast_C EGSDO2_mfExhTmpMaxOffsFast_C EGSDO2_mfExhTmpMinOffsFast_C EGSDO2_nEngMinEnaOffsFast_C EGSDO2_ofsCntrLoad_C EGSDO2_ratLoadMinEnaOffsFastShtrp_C EGSDO2_ratLoadMinEnaOffsFast_T EGSDO2_ratLoadThdOffsFast_C EGSDO2_stLamOffsFast_C EGSDO2_tCatMaxEnaOffsFast_C EGSDO2_tCatMinEnaOffsFast_C EGSDO2_tEngEnaOffsFast_C EGSDO2_tEngMdlEnaOffsFast_C EGSDO2_tiDlyCatPurgEnd_C EGSDO2_tiDlyFlgNoPurg_C EGSDO2_tiMflowExhTmpMax_T EGSDO2_tiMflowExhTmpMin_C EGSDO2_tiSumRefCtrlActv_C EGSDO2_tiTurnOffCtrlrSt_C EGSDO2_tiTurnOnCatTShtrp_C EGSDO2_tiTurnOnCatT_C EGSDO2_tiTurnOnCtrlrLim_C EGSDO2_tiTurnOnCtrlrSt_C EGSDO2_tiTurnOnNEng_C /end DEF_CHARACTERISTIC
 /begin REF_CHARACTERISTIC EGSDO2_flgLamOffsFastAftParl_CW EGSDO2_flgLimLamOffsDynErr_CW EGSDO2_ratLamOffsMaxDynErr_C EGSDO2_ratLamOffsMax_C EGSDO2_ratLamOffsMinDynErr_C EGSDO2_ratLamOffsMin_C EGSDO2_flgLamOffsFastPreParl_CW /end REF_CHARACTERISTIC
 /begin IN_MEASUREMENT B_bag_msg B_frmax_msg B_frmin_msg B_khakt_msg B_kh_msg B_lasostc_msg B_lr_msg B_sa_msg B_vag_msg CEngDsT_t CEngDsT_tReplMdl drlas_w_msg EGSDCmn_flgEnaEthParl EGSDCmn_flgRmnProdModParl EGSDCmn_flgS1B1O2PlausResVirtParl EGSDCmn_flgS1B1VldParl EGSDCmn_flgS2B1VldParl EGSDCmn_flgShtrpParl EGSDCmn_ratLamActS1B1 EGSDCmn_stVirtTarLeanOffsParlB1 EGSDCmn_stVirtTarRichOffsParlB1 EGSDO2_flgLamDynDFCErrB1 EGSDO2_flgLamPlausFltSuspcS1B1 EGSDO2_flgLamPlausParlDneOnceS1B1 EGSDO2_flgLamPlausTstdS1B1 EGSDO2_ratLamOffsS1B1 EngStrt_bFrstStrtEnd Epm_nEng ExhMod_mfExhCat1B1 ExhMod_tCat1B1 HEGO_uS2B1 rlmin_w_msg rl_w_msg SyC_ctPostDrvLeave SyC_stSub TWCC_bEnaRichPurgB1 TWCC_bIPriB1 TWCC_bPPriB1 TWCC_rCtlErrPriB1 TWCC_rCtlPriB1 zlamko_msg /end IN_MEASUREMENT
 /begin OUT_MEASUREMENT EGSDO2_flgDebFltOffsFastS1B1 EGSDO2_flgDebFltOffsFastVirtS1B1 EGSDO2_flgDebHealOffsFastS1B1 EGSDO2_flgEnaGnrlOffsFastB1 EGSDO2_flgEnaGnrlOffsFastVirtB1 EGSDO2_flgEnaGnrlReldOffsFastB1 EGSDO2_flgExhMNoSignChgOffsFastS1B1 EGSDO2_flgLamOffsFastFltSuspcS1B1 EGSDO2_ratLamOffsFastDeltaS1B1 EGSDO2_ratLamOffsFastPredS1B1 /end OUT_MEASUREMENT
 /begin LOC_MEASUREMENT B_saTONV_I.outbit B_saTONV_I.time EGSDO2_cntrLoad EGSDO2_ctReIni100msLamOffsFast EGSDO2_CtrlrLimOffsB1TONV_I.outbit EGSDO2_CtrlrLimOffsB1TONV_I.time EGSDO2_CtrlrStOffsB1TOFFV_I.outbit EGSDO2_CtrlrStOffsB1TOFFV_I.time EGSDO2_CtrlrStOffsB1TONV_I.outbit EGSDO2_CtrlrStOffsB1TONV_I.time EGSDO2_EnaCatOffsB1TTONV_I.outbit EGSDO2_EnaCatOffsB1TTONV_I.time EGSDO2_EnaCondDurgParlB1FF_I.status EGSDO2_EnaMflowExhTmpMaxOffsB1TONV_I.outbit EGSDO2_EnaMflowExhTmpMaxOffsB1TONV_I.time EGSDO2_EnaMflowExhTmpMinOffsB1TONV_I.outbit EGSDO2_EnaMflowExhTmpMinOffsB1TONV_I.time EGSDO2_ExhMEnaGnrlOffsB1IK_I.memory EGSDO2_ExhMEnaGnrlOffsVirtB1IK_I.memory EGSDO2_flgCatPurgAftParlOffsB1 EGSDO2_flgCatPurgEndB1EF_I.buffer EGSDO2_flgCatPurgEndB1EF_I.oldSignal EGSDO2_flgCatPurgEndB1TOFFV_I.outbit EGSDO2_flgCatPurgEndB1TOFFV_I.time EGSDO2_flgCtrlrLimMaxOffsFastB1 EGSDO2_flgCtrlrLimMinOffsFastB1 EGSDO2_flgCtrlrLimNoOffsB1 EGSDO2_flgCtrlrLimNoOffsSuspcB1 EGSDO2_flgCtrlrLimOffsFastB1 EGSDO2_flgCtrlrLimSnsrOppOffsFastB1 EGSDO2_flgDiOffsBnkIndpdt EGSDO2_flgDiOffsBnkIndpdtVirt EGSDO2_flgDiOffsEngT EGSDO2_flgEnaGnrlCatTOffsFastB1 EGSDO2_flgEnaGnrlCdnOffsFastB1 EGSDO2_flgEnaGnrlCdnOffsFastVirtB1 EGSDO2_flgEnaGnrlExhMOffsFastB1 EGSDO2_flgEnaGnrlExhMOffsVirtB1 EGSDO2_flgEnaGnrlMflowExhOffsFastB1 EGSDO2_flgEnaGnrlPhyOffsFastB1 EGSDO2_flgEnaGnrlPhyOffsFastVirtB1 EGSDO2_flgEnaMflowExhTmpMaxOffsFastB1 EGSDO2_flgEnaMflowExhTmpMinOffsFastB1 EGSDO2_flgEnaOffsFastBnkIndpdt EGSDO2_flgEnaRedCondDurgParlB1 EGSDO2_flgEnaRefCtrlOffsFastB1 EGSDO2_flgNoPurgAftParlB1EF_I.buffer EGSDO2_flgNoPurgAftParlB1EF_I.oldSignal EGSDO2_flgNoPurgAftParlB1TOFFV_I.outbit EGSDO2_flgNoPurgAftParlB1TOFFV_I.time EGSDO2_flgParlEndB1TOFFV_I.outbit EGSDO2_flgParlEndB1TOFFV_I.time EGSDO2_flgParlEndDlydB1EF_I.buffer EGSDO2_flgParlEndDlydB1EF_I.oldSignal EGSDO2_flgRstCondDurgParlB1 EGSDO2_flgRstDneVirtOffsB1EF_I.buffer EGSDO2_flgRstDneVirtOffsB1EF_I.oldSignal EGSDO2_flgRstExhMIntglOffsFastB1 EGSDO2_flgRstExhMIntglOffsVirtB1 EGSDO2_mfExhOffsFastB1 EGSDO2_NEngTONV_I.outbit EGSDO2_NEngTONV_I.time EGSDO2_NoCatPurgOffsB1FF_I.status EGSDO2_NoCatPurgOffsVirtB1FF_I.status EGSDO2_ratLamOffsPredRawB1 EGSDO2_tiSumRefCtrlActvOffsFastB1 LamOffsFastB1_I.cntrExhM LamOffsFastB1_I.cntrExhMVirt LamOffsFastB1_I.cntrNoStepIncRow LamOffsFastB1_I.cntrNoStepRow LamOffsFastB1_I.cntrOffsPredAbvThd LamOffsFastB1_I.flgDebFltOffsFast LamOffsFastB1_I.flgDebFltOffsFastVirt LamOffsFastB1_I.flgDebHealOffsFast LamOffsFastB1_I.flgEna LamOffsFastB1_I.flgEnaExhM LamOffsFastB1_I.flgEnaExhMVirt LamOffsFastB1_I.flgEnaGnrlOffsFastVirt LamOffsFastB1_I.flgExhMNoSignChgOffsFastS1 LamOffsFastB1_I.flgLamOffsFastFltSuspc LamOffsFastB1_I.flgNoSignChgOffsPred LamOffsFastB1_I.ratLamOffsAbslt LamOffsFastB1_I.ratLamOffsDeltaAbsPred LamOffsFastB1_I.ratLamOffsDeltaPred LamOffsFastB1_I.ratLamOffsFastDelta LamOffsFastB1_I.ratLamOffsFastPred LamOffsFastB1_I.ratLamOffsPred LamOffsFastB1_I.ratLamOffsPredAbslt LamOffsFastB1_I.tiPt1OffsPred LamOffsFastB1_I.ExhMEnaGnrlVirtIK_I.memory LamOffsFastB1_I.ExhMEnaIK_I.memory LamOffsFastB1_I.ExhMEnaVirtIK_I.memory LamOffsFastB1_I.LamOffsPredLT_I.memory LamOffsFastB1_I.LamOffsPredRawSignChgEB_I.buffer LamOffsFastB1_I.LamOffsPredRawSignChgEB_I.oldSignal LamOffsFastB1_I.LamOffsPredSignChgEB_I.buffer LamOffsFastB1_I.LamOffsPredSignChgEB_I.oldSignal LamOffsFastB1_I.LamPlausFltSuspcOffsB1EFNM_I.oldSignal LamOffsFastB1_I.flgCtrlrLimNoOffsFF_I.status LamOffsFastB1_I.flgCtrlrLimNoOffsTONV_I.outbit LamOffsFastB1_I.flgCtrlrLimNoOffsTONV_I.time LamOffsFastB1_I.flgCtrlrLimOffsER_I.buffer LamOffsFastB1_I.flgCtrlrLimOffsER_I.oldSignal LamOffsFastB1_I.flgFltSuspcOffsFF_I.status /end LOC_MEASUREMENT
 FUNCTION_VERSION "1.46.0" /end FUNCTION
/begin FUNCTION EGSDO2_LamPlaus "1.48.0    Lambda-based plausibility diagnosis (offset) of a wideband sensor"
 /begin DEF_CHARACTERISTIC EGSDO2_facFuByFpcPlaus_T EGSDO2_facOffsFastNegPlaus_C EGSDO2_facOffsFastPosPlaus_C EGSDO2_facOffsSlowNegPlaus_C EGSDO2_facOffsSlowPosPlaus_C EGSDO2_flgITwcHiResl_C EGSDO2_flgLimLamOffsDynErr_CW EGSDO2_flgRstLamOffsDynErr_CW EGSDO2_ratLamOffsChgFuTrmCfm_C EGSDO2_ratLamOffsFastMaxDePlaus_C EGSDO2_ratLamOffsMaxDynErr_C EGSDO2_ratLamOffsMax_C EGSDO2_ratLamOffsMinDynErr_C EGSDO2_ratLamOffsMin_C EGSDO2_tiLamOffsSlowDebFuTrmShrtp_C EGSDO2_tiLamOffsSlowDebFuTrm_C EGSDO2_tiLamOffsSlowDebOffsShrtp_C EGSDO2_tiLamOffsSlowDebOffs_C EGSDO2_facScaOffsSlow_T EGSDO2_flgLamOffsFastAftParl_CW EGSDO2_flgLamOffsFastPreParl_CW EGSDO2_mExhEnaOffsFastPlaus_C EGSDO2_mExhEnaOffsSlowPlaus_C EGSDO2_nEngSlowOffsMax_C EGSDO2_nEngSlowOffsMin_C EGSDO2_ratFuTrmFltMax_C EGSDO2_ratFuTrmFltMin_C EGSDO2_ratLamOffsFltMax_C EGSDO2_ratLamOffsFltMin_C EGSDO2_ratLoadSlowOffsMax_T EGSDO2_ratLoadSlowOffsMin_T EGSDO2_rPCtlPriMaxPlaus_C EGSDO2_rPCtlPriMinPlaus_C EGSDO2_stLamPlaus_C LamPlausB1_I.EGSDO2_ratLamOffsInin_C /end DEF_CHARACTERISTIC
 /begin IN_MEASUREMENT B_lrs_msg EGSDCmn_flgCat1EmptTOutParlB1 EGSDCmn_flgCat1FullTOutParlB1 EGSDCmn_flgEnvtlDiPID41Parl EGSDCmn_flgS1B1O2PlausResVirtParl EGSDCmn_flgS2B1TarLeanOkOnceParl EGSDCmn_flgS2B1TarRichOkOnceParl EGSDCmn_flgShtrpParl EGSDO2_flgDebFltOffsFastS1B1 EGSDO2_flgDebFltOffsFastVirtS1B1 EGSDO2_flgDebHealOffsFastS1B1 EGSDO2_flgEnaGnrlOffsFastB1 EGSDO2_flgLamDynDFCErrB1 EGSDO2_flgLamDynDFCTstdB1 EGSDO2_flgLamOffsFastFltSuspcS1B1 EGSDO2_ratLamOffsFastDeltaS1B1 Epm_nEng ExhMod_mfExhCat1B1 fteadf_msg InjSys_ratFuMTot rkte_w_msg rl_w_msg SyC_ctPostDrvLeave SyC_stSub TWCC_bIPriB1 TWCC_rICtlHiReslPriB1 TWCC_rICtlPriB1 TWCC_rPCtlPriB1 /end IN_MEASUREMENT
 /begin OUT_MEASUREMENT ddltrmo_l dlatrmo_w EGSDO2_flgDfcFuTrmActvd EGSDO2_flgLamPlausFltMaxS1B1 EGSDO2_flgLamPlausFltMinS1B1 EGSDO2_flgLamPlausFltSuspcS1B1 EGSDO2_flgLamPlausFltVirtS1B1 EGSDO2_flgLamPlausInhbParlS1B1 EGSDO2_flgLamPlausParlDneOnceS1B1 EGSDO2_flgLamPlausTstdS1B1 EGSDO2_ralLamOffsDeltaExchS1B1_s32 EGSDO2_ratLamOffsS1B1 EGSDO2_ratLamOffsSrvS1B1 /end OUT_MEASUREMENT
 /begin LOC_MEASUREMENT EGSDO2_ctReIni100msLamPlaus EGSDO2_flgEnaDiagPlaus EGSDO2_flgOperPntRelsDiag LamPlausB1_I.facOffsSlowPlaus LamPlausB1_I.flgDebFltFuTrm LamPlausB1_I.flgDebFltOffs LamPlausB1_I.flgDebHealFuTrm LamPlausB1_I.flgDebHealOffs LamPlausB1_I.flgDfcFuTrmActvd LamPlausB1_I.flgDiumprRlsNumFuTrm LamPlausB1_I.flgDiumprRlsNumOffs LamPlausB1_I.flgEnaAddOffsSlow LamPlausB1_I.flgEnaDebSlow LamPlausB1_I.flgEnaFuTrmFrzFrm LamPlausB1_I.flgEnaOffsFastPlaus LamPlausB1_I.flgFltFtdlaMax LamPlausB1_I.flgFltFtdlaMin LamPlausB1_I.flgFltFuTrm LamPlausB1_I.flgFltOffs LamPlausB1_I.flgFltPllsuMax LamPlausB1_I.flgFltPllsuMin LamPlausB1_I.flgFltPrevTrip LamPlausB1_I.flgFltSuspcLeanRamp LamPlausB1_I.flgFltSuspcRichRamp LamPlausB1_I.flgFltVirtFuTrm LamPlausB1_I.flgFrzFrmAvl LamPlausB1_I.flgFrzFrmFuTrmMax LamPlausB1_I.flgFrzFrmFuTrmMin LamPlausB1_I.flgFrzFrmOffsMax LamPlausB1_I.flgFrzFrmOffsMin LamPlausB1_I.flgFuTrmDsmPrms LamPlausB1_I.flgFuTrmFltHeal LamPlausB1_I.flgFuTrmFltMax LamPlausB1_I.flgFuTrmFltMaxTmp LamPlausB1_I.flgFuTrmFltMin LamPlausB1_I.flgFuTrmFltMinTmp LamPlausB1_I.flgFuTrmFltTmp LamPlausB1_I.flgLamDynTstdOk LamPlausB1_I.flgLamOffsDsmPrms LamPlausB1_I.flgLamOffsFltHeal LamPlausB1_I.flgLamOffsFltMax LamPlausB1_I.flgLamOffsFltMin LamPlausB1_I.flgLamOffsSlowDebFuTrm LamPlausB1_I.flgLamOffsSlowDebOffs LamPlausB1_I.flgLamPlausDsmPrms LamPlausB1_I.flgLamPlausFltMax LamPlausB1_I.flgLamPlausFltMin LamPlausB1_I.flgLamPlausFltSuspc LamPlausB1_I.flgLamPlausFltVirt LamPlausB1_I.flgLamPlausInhbParl LamPlausB1_I.flgLamPlausParlDneOnce LamPlausB1_I.flgLamPlausTstd LamPlausB1_I.flgNEngSimrCnd LamPlausB1_I.flgOperPntActvInter LamPlausB1_I.flgPassdFtdla LamPlausB1_I.flgPassdPllsu LamPlausB1_I.flgRatLoadSimrCnd LamPlausB1_I.flgRepLamOffsTstRes LamPlausB1_I.flgSimrCnd LamPlausB1_I.flgTEngSimrCnd LamPlausB1_I.flgTstdPllsu LamPlausB1_I.flgVldLamPlausMax LamPlausB1_I.flgVldLamPlausMin LamPlausB1_I.nEngSimrCnd LamPlausB1_I.nEngSrv01 LamPlausB1_I.nEngThdSrv01 LamPlausB1_I.ratLamOffs LamPlausB1_I.ratLamOffsCycBgn LamPlausB1_I.ratLamOffsDeltaExch_s32 LamPlausB1_I.ratLamOffsSlowFastAdpt LamPlausB1_I.ratLamOffsValRes LamPlausB1_I.ratLoadSimrCnd LamPlausB1_I.ratLoadSrv01 LamPlausB1_I.ratLoadThdSrv01 LamPlausB1_I.tEngSimrCnd LamPlausB1_I.tEngSrv01 LamPlausB1_I.tEngThdSrv01 LamPlausB1_I.tiLamOffsSlowActv LamPlausB1_I.EGSDO2_EnaAddOffsFastPlausER_I.buffer LamPlausB1_I.EGSDO2_EnaAddOffsFastPlausER_I.oldSignal LamPlausB1_I.FTDLADltSusFrzFrmERNM_I.oldSignal LamPlausB1_I.FrzFrmFuTrmMaxERNM_I.oldSignal LamPlausB1_I.FrzFrmFuTrmMinERNM_I.oldSignal LamPlausB1_I.LamDynErrER_I.buffer LamPlausB1_I.LamDynErrER_I.oldSignal LamPlausB1_I.LamPlausParlDneERNM_I.oldSignal LamPlausB1_I.PLLSUDltSusFrzFrmERNM_I.oldSignal LamPlausB1_I.flgFltSuspcER_I.buffer LamPlausB1_I.flgFltSuspcER_I.oldSignal LamPlausB1_I.flgFltSuspcFF_I.status LamPlausB1_I.flgInhbParlER_I.buffer LamPlausB1_I.flgInhbParlER_I.oldSignal LamPlausB1_I.flgInhbParlFF_I.status LamPlausB1_I.mfExhEnaIK_I.memory /end LOC_MEASUREMENT
 FUNCTION_VERSION "1.48.0" /end FUNCTION
/begin FUNCTION EGSDO2_SigPrepn "1.1.0     Signal preparation for lambda signal based system diagnoses"
 /begin DEF_CHARACTERISTIC EGSDO2_facInertGasEgr_C EGSDO2_tiDt1HipFlt_C EGSDO2_tiDt1Hip_C EGSDO2_tiMdlAsymPreFilt_C EGSDO2_tiTranBpNarrow_C EGSDO2_tiTranBpWide_C EGSDO2_flgSlopChgIni_C EGSDO2_numGrdtPnt_C EGSDO2_tiPt1LamDerS1_C /end DEF_CHARACTERISTIC
 /begin IN_MEASUREMENT EGSDCmn_ratLamActS1B1 EGSDO2_tiDlyIdnLtrB1 EGSDO2_tiDlyIdnRtlB1 EGSDO2_tiTranIdnLtrB1 EGSDO2_tiTranIdnRtlB1 fra_w_msg fr_w_msg InjSys_ratPrdcAirLamDes lamsbg_w_msg redistb1_msg rir_w_msg SyC_ctPostDrvLeave tlrslb_w_msg zlrsb_w_msg /end IN_MEASUREMENT
 /begin OUT_MEASUREMENT EGSDO2_dratLamRecprFildS1B1 EGSDO2_flgBpWideS1B1 EGSDO2_ratLamRecprBpLtrS1B1 EGSDO2_ratLamRecprBpRtlS1B1 EGSDO2_ratLamRecprBpS1B1 EGSDO2_ratLamRecprFildS1B1 EGSDO2_ratLamRecprMdlBpLtrS1B1 EGSDO2_ratLamRecprMdlBpRtlS1B1 EGSDO2_ratLamRecprMdlBpS1B1 EGSDO2_ratLamRecprMdlFltBpLtrS1B1 EGSDO2_ratLamRecprMdlFltBpRtlS1B1 EGSDO2_ratLamRecprMdlFltBpS1B1 /end OUT_MEASUREMENT
 /begin LOC_MEASUREMENT EGSDO2_ctReIni10msSigPrepn EGSDO2_DerFilB1_I.dratLamRecpr EGSDO2_DerFilB1_I.dratLamRecprFild EGSDO2_DerFilB1_I.dratLamRecprSum EGSDO2_DerFilB1_I.idxInp EGSDO2_DerFilB1_I.ratLamRecpr EGSDO2_DerFilB1_I.ratLamRecprFild EGSDO2_DerFilB1_I.ratlam_a EGSDO2_DerFilB1_I.tiFildDly EGSDO2_DerFilB1_I.LamRecprLT_I.memory EGSDO2_flgClrSigPrepn10msB1 EGSDO2_IdnSigB1_I.flgBpWide EGSDO2_IdnSigB1_I.ratLamRecprBp EGSDO2_IdnSigB1_I.ratLamRecprBpLtr EGSDO2_IdnSigB1_I.ratLamRecprBpRtl EGSDO2_IdnSigB1_I.ratLamRecprMdl EGSDO2_IdnSigB1_I.ratLamRecprMdlBp EGSDO2_IdnSigB1_I.ratLamRecprMdlBpLtr EGSDO2_IdnSigB1_I.ratLamRecprMdlBpRtl EGSDO2_IdnSigB1_I.ratLamRecprMdlChmb EGSDO2_IdnSigB1_I.ratLamRecprMdlFlt EGSDO2_IdnSigB1_I.ratLamRecprMdlFltBp EGSDO2_IdnSigB1_I.ratLamRecprMdlFltBpLtr EGSDO2_IdnSigB1_I.ratLamRecprMdlFltBpRtl EGSDO2_IdnSigB1_I.ratLamRecprSpChmbCorrd EGSDO2_IdnSigB1_I.LamLtrFF_I.status EGSDO2_IdnSigB1_I.MdlAsymLT_I.memory EGSDO2_IdnSigB1_I.MdlAsymPreFilLT_I.memory EGSDO2_IdnSigB1_I.SlopChgEBNM_I.oldSignal EGSDO2_IdnSigB1_I.dratLamRecprFildLT_I.memory EGSDO2_IdnSigB1_I.ratLamRecprMdlChmbLT_I.memory EGSDO2_IdnSigB1_I.ratLamRecprMdlDt1LT_I.memory EGSDO2_IdnSigB1_I.ratLamRecprMdlFltDt1LT_I.memory EGSDO2_IdnSigB1_I.ratLamRecprMdlFltLT_I.memory EGSDO2_IdnSigB1_I.ratLamRecprMdlLT_I.memory /end LOC_MEASUREMENT
 FUNCTION_VERSION "1.1.0" /end FUNCTION
/begin FUNCTION EGSDO2_SnsrMntdDiag "1.12.0    Diagnosis Oxygen Sensors at Air"
 /begin DEF_CHARACTERISTIC EGSDO2_ratLamSpMaxMntdDiag_C EGSDO2_tiDebMntdDiagErr_C UEGO_ratLamMaxMntdDiag_C /end DEF_CHARACTERISTIC
 /begin IN_MEASUREMENT B_evloc_msg EGSDCmn_flgS1B1VldParl EGSSig_ratLamTCorrdS1B1 EngStrt_bStrtEnd lamsons_w_msg SyC_ctPostDrvLeave /end IN_MEASUREMENT
 /begin LOC_MEASUREMENT EGSDO2_SnsrMntdDiagS1B1_I.flgDSMClrReq EGSDO2_SnsrMntdDiagS1B1_I.flgErr EGSDO2_SnsrMntdDiagS1B1_I.flgRdy EGSDO2_SnsrMntdDiagS1B1_I.flgRels EGSDO2_SnsrMntdDiagS1B1_I.flgRes EGSDO2_SnsrMntdDiagS1B1_I.SnsrMntdDiagNoErrTONV_I.outbit EGSDO2_SnsrMntdDiagS1B1_I.SnsrMntdDiagNoErrTONV_I.time EGSDO2_SnsrMntdDiagS1B1_I.SnsrMntdErrSuspcTONV_I.outbit EGSDO2_SnsrMntdDiagS1B1_I.SnsrMntdErrSuspcTONV_I.time /end LOC_MEASUREMENT
 FUNCTION_VERSION "1.12.0" /end FUNCTION
/begin FUNCTION EGSDU_DlyDs "1.21.0    Dynamic diagnosis binary oxygen sensor downstream - delay"
 /begin DEF_CHARACTERISTIC EGSDU_DlyMeasS2B1_I.ticorrCatEftLtr_M EGSDU_DlyMeasS2B1_I.ticorrCatEftRtl_M EGSDU_duFallDly_C EGSDU_duFallGrdtDly_C EGSDU_duRiseDly_C EGSDU_duRiseGrdtDly_C EGSDU_duS2StrtLtrInflTranDly_C EGSDU_duS2StrtRtlInflTranDly_C EGSDU_flgCorrCatEftDly_CW EGSDU_ratLamNoiseLtrDly_C EGSDU_ratLamNoiseRtlDly_C EGSDU_S2TiLenLtrDly_CUR EGSDU_S2TiLenRtlDly_CUR EGSDU_tiToutLtrDly_C EGSDU_tiToutRtlDly_C /end DEF_CHARACTERISTIC
 /begin REF_CHARACTERISTIC EGSDCmn_flgSymTranOnly_CW /end REF_CHARACTERISTIC
 /begin IN_MEASUREMENT EGSDCmn_duS2B1Parl EGSDCmn_mfEgCat1B1Parl EGSDCmn_ratLamReqParlB1 EGSDCmn_stLamGenrParlB1 EGSDCmn_stVirtUDlyParlB1 EGSDCmn_uS2B1FildParl EGSDU_flgS2B1LtrInflDlyTran EGSDU_flgS2B1RtlInflDlyTran lamsons_w_msg SyC_ctPostDrvLeave /end IN_MEASUREMENT
 /begin OUT_MEASUREMENT EGSDU_flgS2B1InhbRiDly EGSDU_flgS2B1ResLtrDly EGSDU_flgS2B1ResRtlDly EGSDU_flgS2B1ResVirtLtrDly EGSDU_flgS2B1ResVirtRtlDly EGSDU_mfAvrgS2B1MeasRtlDly EGSDU_tiS2B1LtrNrmDly EGSDU_tiS2B1LtrRawDly EGSDU_tiS2B1RtlNrmDly EGSDU_tiS2B1RtlRawDly /end OUT_MEASUREMENT
 /begin LOC_MEASUREMENT EGSDU_ctReIni10msDlyDs EGSDU_DlyMeasS2B1_I.duLtrCorrGrdt EGSDU_DlyMeasS2B1_I.duRtlCorrGrdt EGSDU_DlyMeasS2B1_I.flgInhbRi EGSDU_DlyMeasS2B1_I.flgLtrMeasFinshd EGSDU_DlyMeasS2B1_I.flgLtrRes EGSDU_DlyMeasS2B1_I.flgLtrTout EGSDU_DlyMeasS2B1_I.flgRtlMeasFinshd EGSDU_DlyMeasS2B1_I.flgRtlRes EGSDU_DlyMeasS2B1_I.flgRtlTout EGSDU_DlyMeasS2B1_I.flgUFall EGSDU_DlyMeasS2B1_I.flgURise EGSDU_DlyMeasS2B1_I.mfAvrgMeasRtlDly EGSDU_DlyMeasS2B1_I.mfEgCatParl EGSDU_DlyMeasS2B1_I.stParlOld EGSDU_DlyMeasS2B1_I.tiLtrCorrGrdt EGSDU_DlyMeasS2B1_I.tiLtrCorrGrdtMax EGSDU_DlyMeasS2B1_I.tiLtrCorrGrdtPre EGSDU_DlyMeasS2B1_I.tiLtrCorrGrdtTmp EGSDU_DlyMeasS2B1_I.tiLtrDly EGSDU_DlyMeasS2B1_I.tiLtrDlyMeas EGSDU_DlyMeasS2B1_I.tiRtlCorrGrdt EGSDU_DlyMeasS2B1_I.tiRtlCorrGrdtMax EGSDU_DlyMeasS2B1_I.tiRtlCorrGrdtPre EGSDU_DlyMeasS2B1_I.tiRtlCorrGrdtTmp EGSDU_DlyMeasS2B1_I.tiRtlDly EGSDU_DlyMeasS2B1_I.tiRtlDlyMeas EGSDU_DlyMeasS2B1_I.uMax EGSDU_DlyMeasS2B1_I.uMin EGSDU_DlyMeasS2B1_I.EndTiCntrLtrERNM_I.oldSignal EGSDU_DlyMeasS2B1_I.EndTiCntrRtlERNM_I.oldSignal EGSDU_DlyMeasS2B1_I.flgLtrDurFF_I.status EGSDU_DlyMeasS2B1_I.flgRtlDurFF_I.status EGSDU_DlyMeasS2B1_I.mfAvrgMeasRtlDlyDL_I.memory EGSDU_flgDSMClrDlyDs EGSDU_tiS2B1LenLtrDly EGSDU_tiS2B1LenRtlDly /end LOC_MEASUREMENT
 FUNCTION_VERSION "1.21.0" /end FUNCTION
/begin COMPU_METHOD AirMassPerTime_float "" RAT_FUNC "%6.2" "Kg/h" COEFFS 0 1 0 0 0 1 /end COMPU_METHOD
/begin COMPU_METHOD B_TRUE "" TAB_VERB "%6.3" "" COMPU_TAB_REF B_TRUE /end COMPU_METHOD
/begin COMPU_VTAB B_TRUE "" TAB_VERB 2 0 "FALSE" 1 "TRUE" /end COMPU_VTAB
/begin COMPU_METHOD dez "" RAT_FUNC "%6.2" "" COEFFS 0 1 0 0 0 1 /end COMPU_METHOD
/begin COMPU_METHOD EngN "" RAT_FUNC "%6.3" "rpm" COEFFS 0 2 0 0 0 1 /end COMPU_METHOD
/begin COMPU_METHOD fak_q3p0518Em5 "" RAT_FUNC "%7.6" "" COEFFS 0 32768 0 0 0 1 /end COMPU_METHOD
/begin COMPU_METHOD fak_q4p6566Em10 "" RAT_FUNC "%18.17" "" COEFFS 0 2147483648 0 0 0 1 /end COMPU_METHOD
/begin COMPU_METHOD fak_sb_b64 "" RAT_FUNC "%6.3" "-" COEFFS 0 256 0 0 0 128 /end COMPU_METHOD
/begin COMPU_METHOD fak_sl_b1 "" RAT_FUNC "%12.11" "-" COEFFS 0 4294967296 0 0 0 2 /end COMPU_METHOD
/begin COMPU_METHOD fak_sw_b1 "" RAT_FUNC "%7.6" "-" COEFFS 0 65536 0 0 0 2 /end COMPU_METHOD
/begin COMPU_METHOD fak_ub_b100 "" RAT_FUNC "%6.3" "" COEFFS 0 255 0 0 0 100 /end COMPU_METHOD
/begin COMPU_METHOD fak_uw_b1 "" RAT_FUNC "%7.6" "-" COEFFS 0 65536 0 0 0 1 /end COMPU_METHOD
/begin COMPU_METHOD fak_uw_b16 "" RAT_FUNC "%6.5" "-" COEFFS 0 65536 0 0 0 16 /end COMPU_METHOD
/begin COMPU_METHOD fak_uw_b2 "" RAT_FUNC "%7.6" "-" COEFFS 0 65536 0 0 0 2 /end COMPU_METHOD
/begin COMPU_METHOD fak_uw_b4 "" RAT_FUNC "%7.6" "-" COEFFS 0 65536 0 0 0 4 /end COMPU_METHOD
/begin COMPU_METHOD FLSPLG_VAR_SY_Compu "" TAB_VERB "%6.3" "" COMPU_TAB_REF FLSPLG_VAR_SY_Compu /end COMPU_METHOD
/begin COMPU_VTAB FLSPLG_VAR_SY_Compu "" TAB_VERB 42 1 "DAI" 3 "VWW" 4 "POR" 5 "AUD" 6 "OPE" 9 "FIA" 11 "BMW" 14 "PSA" 15 "REN" 17 "ALF" 18 "SAB" 19 "VOL" 20 "NIS" 21 "GMU" 22 "FOR" 26 "IMJ" 51 "SEA" 53 "CHR" 54 "JAG" 55 "ROL" 69 "FER" 72 "TOY" 123 "MIT" 147 "HYU" 159 "HON" 160 "MAZ" 183 "CU" 190 "LRG" 204 "VVW" 214 "AVT" 242 "Iveco" 243 "DMC" 248 "SUZ" 267 "SSANGYONG" 270 "KEF" 289 "AMG" 308 "TAT" 319 "MVM" 385 "UAES" 828 "RBCD" 999 "ALL" 9454 "Fuso" /end COMPU_VTAB
/begin COMPU_METHOD FLSPLSYSTST_SC_Compu "" TAB_VERB "%6.3" "" COMPU_TAB_REF FLSPLSYSTST_SC_Compu /end COMPU_METHOD
/begin COMPU_VTAB FLSPLSYSTST_SC_Compu "" TAB_VERB 3 0 "0" 1 "1" 2 "2" /end COMPU_VTAB
/begin COMPU_METHOD FLSPLY_FUPSNSRTYP_SC_Compu "" TAB_VERB "%6.3" "" COMPU_TAB_REF FLSPLY_FUPSNSRTYP_SC_Compu /end COMPU_METHOD
/begin COMPU_VTAB FLSPLY_FUPSNSRTYP_SC_Compu "" TAB_VERB 4 0 "NOSNSR" 1 "ANALOG" 2 "DIGITAL" 3 "SENT" /end COMPU_VTAB
/begin COMPU_METHOD FLSYS_RUNDRYPRV_SY_Compu "" TAB_VERB "%6.3" "" COMPU_TAB_REF FLSYS_RUNDRYPRV_SY_Compu /end COMPU_METHOD
/begin COMPU_VTAB FLSYS_RUNDRYPRV_SY_Compu "" TAB_VERB 2 0 "False" 1 "True" /end COMPU_VTAB
/begin COMPU_METHOD FLT_IALCK_SY_Compu "" TAB_VERB "%6.3" "" COMPU_TAB_REF FLT_IALCK_SY_Compu /end COMPU_METHOD
/begin COMPU_VTAB FLT_IALCK_SY_Compu "" TAB_VERB 2 0 "0" 1 "1" /end COMPU_VTAB
/begin COMPU_METHOD FLT_IARLS_SY_Compu "" TAB_VERB "%6.3" "" COMPU_TAB_REF FLT_IARLS_SY_Compu /end COMPU_METHOD
/begin COMPU_VTAB FLT_IARLS_SY_Compu "" TAB_VERB 2 0 "0" 1 "1" /end COMPU_VTAB
/begin COMPU_METHOD FlVolFlw_COMPU "" RAT_FUNC "%6.3" "l/h" COEFFS 0 10 0 0 0 1 /end COMPU_METHOD
/begin COMPU_METHOD FLXR_SY_Compu "" TAB_VERB "%6.3" "" COMPU_TAB_REF FLXR_SY_Compu /end COMPU_METHOD
/begin COMPU_VTAB FLXR_SY_Compu "" TAB_VERB 2 0 "FALSE" 1 "TRUE" /end COMPU_VTAB
/begin COMPU_METHOD Fl_2 "" RAT_FUNC "%6.1" "l" COEFFS 0 0.1 0 0 0 1 /end COMPU_METHOD
/begin COMPU_METHOD Fl_Half_L "" RAT_FUNC "%6.3" "l" COEFFS 0 2 0 0 0 1 /end COMPU_METHOD
/begin COMPU_METHOD Fl_L "" RAT_FUNC "%6.4" "l" COEFFS 0 100 0 0 0 1 /end COMPU_METHOD
/begin COMPU_METHOD Fl_Vol "" RAT_FUNC "%6.5" "l/100km" COEFFS 0 1000 0 0 0 1 /end COMPU_METHOD
/begin COMPU_METHOD Fl_Vol_q0p05 "" RAT_FUNC "%6.4" "l" COEFFS 0 20 0 0 0 1 /end COMPU_METHOD
/begin COMPU_METHOD freq_q9p1553Em5 "" RAT_FUNC "%7.6" "1/s" COEFFS 0 65536 0 0 0 6 /end COMPU_METHOD
/begin COMPU_METHOD mgrad_q1p526Em6_kg_DIV_h "" RAT_FUNC "%8.7" "kg/h" COEFFS 0 65536 0 0 0 0.1 /end COMPU_METHOD
/begin COMPU_METHOD m_q0p001_kg "" RAT_FUNC "%6.5" "kg" COEFFS 0 1000 0 0 0 1 /end COMPU_METHOD
/begin COMPU_METHOD m_q0p0277_g "" RAT_FUNC "%6.4" "g" COEFFS 0 36 0 0 0 1 /end COMPU_METHOD
/begin COMPU_METHOD m_q0p1 "" RAT_FUNC "%6.3" "kg/h" COEFFS 0 10 0 0 0 1 /end COMPU_METHOD
/begin COMPU_METHOD m_q1p5259Em8_kg "" RAT_FUNC "%10.9" "kg" COEFFS 0 65536000 0 0 0 1 /end COMPU_METHOD
/begin COMPU_METHOD m_q4p239Em7_g "" RAT_FUNC "%9.8" "g" COEFFS 0 2359290 0 0 0 1 /end COMPU_METHOD
/begin COMPU_METHOD m_uw_b6553p5 "" RAT_FUNC "%6.3" "kg/h" COEFFS 0 1 0 0 0 0.1 /end COMPU_METHOD
/begin COMPU_METHOD nmot_uw_q0p25 "" RAT_FUNC "%6.3" "1/min" COEFFS 0 1 0 0 0 0.25 /end COMPU_METHOD
/begin COMPU_METHOD OneToOne "" RAT_FUNC "%6.2" "-" COEFFS 0 1 0 0 0 1 /end COMPU_METHOD
/begin COMPU_METHOD RBPtCel_du_7p62939em4 "" RAT_FUNC "%6.5" "V/s" COEFFS 0 65536 0 0 0 50 /end COMPU_METHOD
/begin COMPU_METHOD relNWU_q0p0234 "" RAT_FUNC "%6.4" "%/NWU" COEFFS 0 32 0 0 0 0.75 /end COMPU_METHOD
/begin COMPU_METHOD rel_q0p0234 "" RAT_FUNC "%6.4" "%" COEFFS 0 128 0 0 0 3 /end COMPU_METHOD
/begin COMPU_METHOD rel_uw_q0p0234 "" RAT_FUNC "%6.4" "%" COEFFS 0 32 0 0 0 0.75 /end COMPU_METHOD
/begin COMPU_METHOD spgg_q0p00488_V_DIV_s "" RAT_FUNC "%6.4" "V/s" COEFFS 0 1024 0 0 0 5 /end COMPU_METHOD
/begin COMPU_METHOD spg_q1p221Em3_V "" RAT_FUNC "%6.4" "V" COEFFS 0 65536 0 0 0 80 /end COMPU_METHOD
/begin COMPU_METHOD Temp_Cels "" RAT_FUNC "%6.1" "deg C" COEFFS 0 10 2731.4 0 0 1 /end COMPU_METHOD
/begin COMPU_METHOD temp_ub_q1_o40 "" RAT_FUNC "%6.2" "Grad C" COEFFS 0 1 40 0 0 1 /end COMPU_METHOD
/begin COMPU_METHOD t_q0p01 "" RAT_FUNC "%6.4" "s" COEFFS 0 100 0 0 0 1 /end COMPU_METHOD
/begin COMPU_METHOD t_q0p1 "" RAT_FUNC "%6.3" "s" COEFFS 0 10 0 0 0 1 /end COMPU_METHOD
/begin COMPU_METHOD zk100msxs_uw_b6553 "" RAT_FUNC "%6.1" "s" COEFFS 0 0 65536 0 10 0 /end COMPU_METHOD
/begin COMPU_METHOD zk10msxs_uw_b655 "" RAT_FUNC "%6.2" "s" COEFFS 0 0 65536 0 100 0 /end COMPU_METHOD
/begin RECORD_LAYOUT RB_Curve_R32_U16_Static NO_AXIS_PTS_X 1 ULONG AXIS_PTS_X 2 FLOAT32_IEEE INDEX_INCR DIRECT FNC_VALUES 3 UWORD COLUMN_DIR DIRECT STATIC_RECORD_LAYOUT /end RECORD_LAYOUT
/begin RECORD_LAYOUT RB_Curve_S16_U16_Static NO_AXIS_PTS_X 1 SWORD AXIS_PTS_X 2 SWORD INDEX_INCR DIRECT FNC_VALUES 3 UWORD COLUMN_DIR DIRECT STATIC_RECORD_LAYOUT /end RECORD_LAYOUT
/begin RECORD_LAYOUT RB_Curve_S8_U16_Static NO_AXIS_PTS_X 1 SBYTE AXIS_PTS_X 2 SBYTE INDEX_INCR DIRECT FNC_VALUES 3 UWORD COLUMN_DIR DIRECT STATIC_RECORD_LAYOUT /end RECORD_LAYOUT
/begin RECORD_LAYOUT RB_Curve_U16_U16 NO_AXIS_PTS_X 1 UWORD AXIS_PTS_X 2 UWORD INDEX_INCR DIRECT FNC_VALUES 3 UWORD COLUMN_DIR DIRECT /end RECORD_LAYOUT
/begin RECORD_LAYOUT RB_Curve_U16_U8_Static NO_AXIS_PTS_X 1 UWORD AXIS_PTS_X 2 UWORD INDEX_INCR DIRECT FNC_VALUES 3 UBYTE COLUMN_DIR DIRECT STATIC_RECORD_LAYOUT /end RECORD_LAYOUT
/begin RECORD_LAYOUT RB_Curve_U8_U16_Static NO_AXIS_PTS_X 1 UBYTE AXIS_PTS_X 2 UBYTE INDEX_INCR DIRECT FNC_VALUES 3 UWORD COLUMN_DIR DIRECT STATIC_RECORD_LAYOUT /end RECORD_LAYOUT
/begin RECORD_LAYOUT RB_Map_U16U16_S16 NO_AXIS_PTS_X 1 UWORD NO_AXIS_PTS_Y 2 UWORD AXIS_PTS_X 3 UWORD INDEX_INCR DIRECT AXIS_PTS_Y 4 UWORD INDEX_INCR DIRECT FNC_VALUES 5 SWORD COLUMN_DIR DIRECT /end RECORD_LAYOUT
/begin RECORD_LAYOUT RB_Val_Ws16 FNC_VALUES 1 SWORD COLUMN_DIR DIRECT /end RECORD_LAYOUT
/begin RECORD_LAYOUT RB_Val_Ws32 FNC_VALUES 1 SLONG COLUMN_DIR DIRECT /end RECORD_LAYOUT
/begin RECORD_LAYOUT RB_Val_Wu16 FNC_VALUES 1 UWORD COLUMN_DIR DIRECT /end RECORD_LAYOUT
/begin RECORD_LAYOUT RB_Val_Wu8 FNC_VALUES 1 UBYTE COLUMN_DIR DIRECT /end RECORD_LAYOUT
/end MODULE
/end PROJECT
