ASAP2_VERSION 1 60
/begin PROJECT MG1CS022 "MG1CS022"
/begin HEADER "" VERSION "MG1CS022_62XSC_V036_TPROT" PROJECT_NO MG1CS022 /end HEADER
/begin MODULE DIM ""
/begin MOD_COMMON "" BYTE_ORDER MSB_LAST ALIGNMENT_BYTE 1 ALIGNMENT_WORD 2 ALIGNMENT_LONG 4 ALIGNMENT_INT64 4 ALIGNMENT_FLOAT32_IEEE 4 ALIGNMENT_FLOAT64_IEEE 4 DATA_SIZE 32 /end MOD_COMMON
/begin CHARACTERISTIC EGRVlv_drGradLim_CUR "DutyCycle based maximum and minimum value for Desired value gradient limitation" CURVE 0x8053C494 RB_Curve_S16_S16 1562.476 RmpPrc16 -781.2500 781.2262 FORMAT "%8.4"
 /begin AXIS_DESCR STD_AXIS EGRVlv_rPs DtyCyc 25 -327.6800 327.6700 FORMAT "%8.4" DEPOSIT ABSOLUTE /end AXIS_DESCR
/end CHARACTERISTIC
/begin CHARACTERISTIC EGRVlv_EndStopDetCal.uRawThdEndStopMax_C "Endstop detection parameter structure / e_:Calibration voltage threshold at maximum position above which endstop is detected:_e;d_:Schwelle der Applikationsspannung bei der Maximum-Position, oberhalb derer der Endanschlag erkannt wird:_d" VALUE 0x8058C294 Val_Ws16 13107.00 Volt -6553.600 6553.400 FORMAT "%8.3" /end CHARACTERISTIC
/begin CHARACTERISTIC EGRVlv_EndStopDetCal.uRawThdEndStopMin_C "Endstop detection parameter structure / e_:Calibration voltage threshold at minimum position below which endstop is detected:_e;d_:Schwelle der Applikationsspannung bei der Minimum-Position, unterhalb derer der Endanschlag erkannt wird:_d" VALUE 0x8058C296 Val_Ws16 13107.00 Volt -6553.600 6553.400 FORMAT "%8.3" /end CHARACTERISTIC
/begin CHARACTERISTIC EGRVlv_EndStopDetCal.stEndStopSetMask_C "Endstop detection parameter structure / e_:Bit masking calibration to select conditions for detecting mechanical endstop:_e;d_:Bitmasken-Applikation zur Auswahl der Bedingungen zur Erkennung des mechanischen Endanschlags:_d" VALUE 0x8058C298 Val_Wu8 255.0 OneToOne 0.00 255.0 FORMAT "%5.1" /end CHARACTERISTIC
/begin CHARACTERISTIC EGRVlv_EndStopDetCal.stEndStopRstMask_C "Endstop detection parameter structure / e_:Bit masking calibration to select conditions to reset mechanical endstop detection:_e;d_:Bitmasken-Applikation zur Auswahl der Bedingungen zum Reset der Erkennung des mechanischen Endanschlags:_d" VALUE 0x8058C299 Val_Wu8 255.0 OneToOne 0.00 255.0 FORMAT "%5.1" /end CHARACTERISTIC
/begin CHARACTERISTIC EGRVlv_EndStopDetCal.tqMaxEndStopRstThd_C "Endstop detection parameter structure / e_:torque threshold at maximum position where acutator is not in endstop:_e;d_:Schwelle des Applikationsdrehmoments bei der Maximum-Position, unterhalb derer der Steller nicht im Endanschlag ist:_d" VALUE 0x8058C29A Val_Ws16 65535.00 q1_Ncm -32768.00 32767.00 FORMAT "%8.2" /end CHARACTERISTIC
/begin CHARACTERISTIC EGRVlv_EndStopDetCal.tqMinEndStopRstThd_C "Endstop detection parameter structure / e_:torque threshold at minimum position where acutator is not in endstop:_e;d_:Schwelle des Applikationsdrehmoments bei der Minimum-Position, oberhalb derer der Steller nicht im Endanschlag ist:_d" VALUE 0x8058C29C Val_Ws16 65535.00 q1_Ncm -32768.00 32767.00 FORMAT "%8.2" /end CHARACTERISTIC
/begin CHARACTERISTIC EGRVlv_EndStopDetCal.tqThdMaxEndStopSus_C "Endstop detection parameter structure / e_:torque maximum threshold where actuator is suspected in endstop:_e;d_:Maximale Schwelle des Applikationsdrehmoments, oberhalb derer es Verdacht darauf besteht, dass der Steller im Bereich des mechanischen Anschlags ist:_d" VALUE 0x8058C29E Val_Ws16 65535.00 q1_Ncm -32768.00 32767.00 FORMAT "%8.2" /end CHARACTERISTIC
/begin CHARACTERISTIC EGRVlv_EndStopDetCal.tqThdMinEndStopSus_C "Endstop detection parameter structure / e_:torque minimum threshold where actuator is suspected in endstop:_e;d_:Minimale Schwelle des Applikationsdrehmoments, unterhalb derer es Verdacht darauf besteht, dass der Steller im Betriebsbereich ist:_d" VALUE 0x8058C2A0 Val_Ws16 65535.00 q1_Ncm -32768.00 32767.00 FORMAT "%8.2" /end CHARACTERISTIC
/begin CHARACTERISTIC EGRVlv_EndStopDetCal.tiNoMoveClr_C "Endstop detection parameter structure / e_:Calibration debounce time for no movement detection to clear:_e;d_:Applikation Entprellzeit zum Löschen von der keine-Bewegung Erkennung:_d" VALUE 0x8058C2A2 Val_Wu16 655350.0 Time_ms 0.00 655350.0 FORMAT "%8.1" /end CHARACTERISTIC
/begin CHARACTERISTIC EGRVlv_EndStopDetCal.tiNoMoveDet_C "Endstop detection parameter structure / e_:Calibration debounce time for no movement detection to set:_e;d_:Applikation Entprellzeit zum Setzen von der keine-Bewegung Erkennung:_d" VALUE 0x8058C2A4 Val_Wu16 655350.0 Time_ms 0.00 655350.0 FORMAT "%8.1" /end CHARACTERISTIC
/begin CHARACTERISTIC EGRVlv_facFrcCorr_MAP "factor for correction of self-learning friction compensation" MAP 0x8058C2A6 RB_Map_S16S16_S16 7.999878 Fact -4.000000 3.999878 FORMAT "%8.6"
 /begin AXIS_DESCR STD_AXIS EGRVlv_rGovDvt Prc 25 -400.0000 399.9878 FORMAT "%8.4" DEPOSIT ABSOLUTE /end AXIS_DESCR
 /begin AXIS_DESCR STD_AXIS EGRVlv_duRaw q10_mV_DIV_s 25 -327680.0 327670.0 FORMAT "%8.1" DEPOSIT ABSOLUTE /end AXIS_DESCR
/end CHARACTERISTIC
/begin CHARACTERISTIC EGRVlv_facGear_CUR "Gear factor curve" CURVE 0x8058C7F0 RB_Curve_S16_S16 655.3500 Fact100 -327.6800 327.6700 FORMAT "%8.4"
 /begin AXIS_DESCR STD_AXIS EGRVlv_uRaw Volt 25 -6553.600 6553.400 FORMAT "%8.3" DEPOSIT ABSOLUTE /end AXIS_DESCR
/end CHARACTERISTIC
/begin CHARACTERISTIC EGRVlv_facKdDwn_CUR "Weight factor curve for Kd controller parameter" CURVE 0x8058C856 RB_Curve_S16_S16 7.999878 Fact -4.000000 3.999878 FORMAT "%8.6"
 /begin AXIS_DESCR STD_AXIS EGRVlv_rCurIn Prc 25 -400.0000 399.9878 FORMAT "%8.4" DEPOSIT ABSOLUTE /end AXIS_DESCR
/end CHARACTERISTIC
/begin CHARACTERISTIC EGRVlv_facKdUp_CUR "Weight factor curve for Kd controller parameter" CURVE 0x8058C8BC RB_Curve_S16_S16 7.999878 Fact -4.000000 3.999878 FORMAT "%8.6"
 /begin AXIS_DESCR STD_AXIS EGRVlv_rCurIn Prc 25 -400.0000 399.9878 FORMAT "%8.4" DEPOSIT ABSOLUTE /end AXIS_DESCR
/end CHARACTERISTIC
/begin CHARACTERISTIC EGRVlv_facKiDwn_CUR "Weight factor curve for Ki controller parameter" CURVE 0x8058C922 RB_Curve_S16_S16 7.999878 Fact -4.000000 3.999878 FORMAT "%8.6"
 /begin AXIS_DESCR STD_AXIS EGRVlv_rCurIn Prc 25 -400.0000 399.9878 FORMAT "%8.4" DEPOSIT ABSOLUTE /end AXIS_DESCR
/end CHARACTERISTIC
/begin CHARACTERISTIC EGRVlv_facKiUp_CUR "Weight factor curve for Ki controller parameter" CURVE 0x8058C988 RB_Curve_S16_S16 7.999878 Fact -4.000000 3.999878 FORMAT "%8.6"
 /begin AXIS_DESCR STD_AXIS EGRVlv_rCurIn Prc 25 -400.0000 399.9878 FORMAT "%8.4" DEPOSIT ABSOLUTE /end AXIS_DESCR
/end CHARACTERISTIC
/begin CHARACTERISTIC EGRVlv_facKp2_CUR "Correction factor for Kp controller parameter" CURVE 0x8058C9EE RB_Curve_S16_S16 655.3500 Fact100 -327.6800 327.6700 FORMAT "%8.4"
 /begin AXIS_DESCR STD_AXIS EGRVlv_dpDsbc dPres_hPa_p_s 25 -32768.00 32767.00 FORMAT "%8.2" DEPOSIT ABSOLUTE /end AXIS_DESCR
/end CHARACTERISTIC
/begin CHARACTERISTIC EGRVlv_facKpDwn_CUR "Weight factor curve for Kp controller parameter" CURVE 0x8058CA54 RB_Curve_S16_S16 7.999878 Fact -4.000000 3.999878 FORMAT "%8.6"
 /begin AXIS_DESCR STD_AXIS EGRVlv_rCurIn Prc 25 -400.0000 399.9878 FORMAT "%8.4" DEPOSIT ABSOLUTE /end AXIS_DESCR
/end CHARACTERISTIC
/begin CHARACTERISTIC EGRVlv_facKpUp_CUR "Weight factor curve for Kp controller parameter" CURVE 0x8058CABA RB_Curve_S16_S16 7.999878 Fact -4.000000 3.999878 FORMAT "%8.6"
 /begin AXIS_DESCR STD_AXIS EGRVlv_rCurIn Prc 25 -400.0000 399.9878 FORMAT "%8.4" DEPOSIT ABSOLUTE /end AXIS_DESCR
/end CHARACTERISTIC
/begin CHARACTERISTIC EGRVlv_facMotSpd_CUR "Factor curve to calculate the dc actuator motor speed dependent on uRaw" CURVE 0x8058CB20 RB_Curve_S16_S16 655.3500 Fact100 -327.6800 327.6700 FORMAT "%8.4"
 /begin AXIS_DESCR STD_AXIS EGRVlv_uRaw Volt 25 -6553.600 6553.400 FORMAT "%8.3" DEPOSIT ABSOLUTE /end AXIS_DESCR
/end CHARACTERISTIC
/begin CHARACTERISTIC EGRVlv_facPreCtl_CUR "Correction factor for precontrol value" CURVE 0x8058CB86 RB_Curve_S16_S16 655.3500 Fact100 -327.6800 327.6700 FORMAT "%8.4"
 /begin AXIS_DESCR STD_AXIS EGRVlv_dpDsbc dPres_hPa_p_s 25 -32768.00 32767.00 FORMAT "%8.2" DEPOSIT ABSOLUTE /end AXIS_DESCR
/end CHARACTERISTIC
/begin CHARACTERISTIC EGRVlv_gArmtr_CUR "Temperature dependent conductance" CURVE 0x8058CBEC RB_Curve_S16_S16 655.3500 Cndctn_q0p01_COMPU -327.6800 327.6700 FORMAT "%8.4"
 /begin AXIS_DESCR STD_AXIS EGRVlv_tArmtr Temp_Cels 25 -3549.940 3003.560 FORMAT "%8.3" DEPOSIT ABSOLUTE /end AXIS_DESCR
/end CHARACTERISTIC
/begin CHARACTERISTIC EGRVlv_GovDvtMonCal.pDsbcMaxLimn_C "Governor deviation monitoring parameter structure / Maximale Grenze des Stördrucks zur Deaktivierung der Reglerabweichungsüberwachung" VALUE 0x8053C4FC Val_Ws16 65535.00 Pres_hPa -32768.00 32767.00 FORMAT "%8.2" /end CHARACTERISTIC
/begin CHARACTERISTIC EGRVlv_GovDvtMonCal.tiRstJamVlvClsd_C "Governor deviation monitoring parameter structure / e_:Time till jammed valve closed error will be reset after change to error path jammed valve open:_e;d_:Zeit bis zum Zurücksetzen des Fehlers verklemmtes geschlossenes Ventil, nach dem Wechsel zum Fehlerpfad verklemmtes offenes Ventil:_d" VALUE 0x8053C4FE Val_Ws16 655350.0 Time_ms -327680.0 327670.0 FORMAT "%8.1" /end CHARACTERISTIC
/begin CHARACTERISTIC EGRVlv_GovDvtMonCal.tiRstJamVlvOpn_C "Governor deviation monitoring parameter structure / e_:Time till jammed valve open error will be reset after change to error path jammed valve closed:_e;d_:Zeit bis zum Zurücksetzen des Fehlers verklemmtes offenes Ventil, nach dem Wechsel zum Fehlerpfad verklemmtes geschlossenes Ventil:_d" VALUE 0x8053C500 Val_Ws16 655350.0 Time_ms -327680.0 327670.0 FORMAT "%8.1" /end CHARACTERISTIC
/begin CHARACTERISTIC EGRVlv_GovDvtMonCal.tiDesValFltMon_C "Governor deviation monitoring parameter structure / Filter time constant for setpoint to calculate controller deviation" VALUE 0x8053C504 Val_Ws32 4294.9672940000000 TimeDelay_s 0.0000020000000 4294.9672959999998 FORMAT "%19.14" EXTENDED_LIMITS 0.000002000000001 4294.9672959999998 /end CHARACTERISTIC
/begin CHARACTERISTIC EGRVlv_GovDvtMonCal.tiDebJamVlv_C "Governor deviation monitoring parameter structure / Time to reach rest position of actuator to differentiate between open/closed and jammed" VALUE 0x8053C508 Val_Wu16 655350.0 Time_ms 0.00 655350.0 FORMAT "%8.1" /end CHARACTERISTIC
/begin CHARACTERISTIC EGRVlv_GovDvtMonCal.rActLow_C "Governor deviation monitoring parameter structure / Actual value threshold to detect cold start (frozen actuator)" VALUE 0x8053C50A Val_Ws16 799.9878 Prc -400.0000 399.9878 FORMAT "%8.4" /end CHARACTERISTIC
/begin CHARACTERISTIC EGRVlv_GovDvtMonCal.tExhCld_C "Governor deviation monitoring parameter structure / Maximum temperature from Exh_tFld to start setpoint ramp after cold start detection" VALUE 0x8053C50C Val_Ws16 6553.500 Temp_Cels -3549.940 3003.560 FORMAT "%8.3" /end CHARACTERISTIC
/begin CHARACTERISTIC EGRVlv_GovDvtMonCal.tAirSysFldMinCld_C "Governor deviation monitoring parameter structure / Maximum temperature from AirSys_tFld to start setpoint ramp after cold start detection" VALUE 0x8053C50E Val_Ws16 6553.500 Temp_Cels -3549.940 3003.560 FORMAT "%8.3" /end CHARACTERISTIC
/begin CHARACTERISTIC EGRVlv_GovDvtMonCal.rActJamClsd_C "Governor deviation monitoring parameter structure / Actual value threshold to detect an stucked actuator in closed position" VALUE 0x8053C510 Val_Ws16 799.9878 Prc -400.0000 399.9878 FORMAT "%8.4" /end CHARACTERISTIC
/begin CHARACTERISTIC EGRVlv_GovDvtMonCal.numEngTemp_C "Governor deviation monitoring parameter structure / Index to select temperature of the engine temperature field (EngDa_tFld) to enable cold start monitoring" VALUE 0x8053C512 Val_Wu16 255.000000000 DELIB_ALLTEMP_VERB_COMPU 0.00 255.000000000 FORMAT "%13.9" /end CHARACTERISTIC
/begin CHARACTERISTIC EGRVlv_GovDvtMonCal.numExhTemp_C "Governor deviation monitoring parameter structure / Index to select temperature in exhaust temperature field (Exh_tFld) to enable cold start monitoring" VALUE 0x8053C514 Val_Wu16 255.000000000 DELIB_ALLTEMP_VERB_COMPU 0.00 255.000000000 FORMAT "%13.9" /end CHARACTERISTIC
/begin CHARACTERISTIC EGRVlv_GovDvtMonCal.numAirTemp_C "Governor deviation monitoring parameter structure / Index to select temperature in airsys temperature field (AirSys_tFld) to enable cold start monitoring" VALUE 0x8053C516 Val_Wu16 255.000000000 DELIB_ALLTEMP_VERB_COMPU 0.00 255.000000000 FORMAT "%13.9" /end CHARACTERISTIC
/begin CHARACTERISTIC EGRVlv_GovDvtMonCal.numColdStrtTSel_C "Governor deviation monitoring parameter structure / Index to select temperature when cold start monitoring is enabled" VALUE 0x8053C518 Val_Wu16 255.000000000 DELIB_ALLTEMP_VERB_COMPU 0.00 255.000000000 FORMAT "%13.9" /end CHARACTERISTIC
/begin CHARACTERISTIC EGRVlv_GovDvtMonCal.tiEngRunRlsLim_C "Governor deviation monitoring parameter structure / Governor deviation monitoring parameter structure" VALUE 0x8053C51A Val_Wu16 655350.0 Time_ms 0.00 655350.0 FORMAT "%8.1" /end CHARACTERISTIC
/begin CHARACTERISTIC EGRVlv_GovDvtMonCal.rGovDvtLimThd_C "Governor deviation monitoring parameter structure / governor deviation threshold when the extended governor deviation monitoring is active" VALUE 0x8053C51C Val_Ws16 799.9878 Prc -400.0000 399.9878 FORMAT "%8.4" /end CHARACTERISTIC
/begin CHARACTERISTIC EGRVlv_GovDvtMonCal.tidebActrPosReaOk_C "Governor deviation monitoring parameter structure / Healing debounce time when the extended governor deviation monitoring is active" VALUE 0x8053C51E Val_Ws16 655350.0 Time_ms -327680.0 327670.0 FORMAT "%8.1" /end CHARACTERISTIC
/begin CHARACTERISTIC EGRVlv_GovDvtMonCal.tidebActrPosReaDef_C "Governor deviation monitoring parameter structure / Defect debounce time when the extended governor deviation monitoring is active" VALUE 0x8053C520 Val_Ws16 655350.0 Time_ms -327680.0 327670.0 FORMAT "%8.1" /end CHARACTERISTIC
/begin CHARACTERISTIC EGRVlv_GovDvtMonCal.swtDesVal_C "Governor deviation monitoring parameter structure / Governor deviation monitoring set point switch position selector" VALUE 0x8053C522 Val_Wu8 255.0 OneToOne 0.00 255.0 FORMAT "%5.1" /end CHARACTERISTIC
/begin CHARACTERISTIC EGRVlv_GovDvtMonCal.swtGovDvtMon_C "Governor deviation monitoring parameter structure / Governor deviation monitoring function switch" VALUE 0x8053C523 Val_Wu8 255.0 OneToOne 0.00 255.0 FORMAT "%5.1" /end CHARACTERISTIC
/begin CHARACTERISTIC EGRVlv_GovDvtMonCal.swtGovDvtRlsFuncStrt_C "Governor deviation monitoring parameter structure / calibration for release function trigger for the Negative Governor Deviation and Positive Governor Deviation" VALUE 0x8053C524 Val_Wu8 2.00000000000 DELibRelsStrt_VERB 0.00 2.00000000000 FORMAT "%13.11" /end CHARACTERISTIC
/begin CHARACTERISTIC EGRVlv_GovDvtMonCal.tiGovDeCldRlsStrtDly_C "Governor deviation monitoring parameter structure / calibratable of governor deviation for a delay time" VALUE 0x8053C526 Val_Wu16 655350.0 Time_ms 0.00 655350.0 FORMAT "%8.1" /end CHARACTERISTIC
/begin CHARACTERISTIC EGRVlv_GovDvtMonCal.tiGovDeOK_C "Governor deviation monitoring parameter structure / Governor deviation monitoring parameter structure" VALUE 0x8053C528 Val_Ws16 655350.0 Time_ms -327680.0 327670.0 FORMAT "%8.1" /end CHARACTERISTIC
/begin CHARACTERISTIC EGRVlv_GovDvtMonCal.tiIUMPRIncDnr_C "Governor deviation monitoring parameter structure / Governor deviation monitoring parameter structure" VALUE 0x8053C52A Val_Ws16 655350.0 Time_ms -327680.0 327670.0 FORMAT "%8.1" /end CHARACTERISTIC
/begin CHARACTERISTIC EGRVlv_GovDvtMonCal.tiDebExtGovDvtDef_C "Governor deviation monitoring parameter structure / Governor deviation monitoring parameter structure" VALUE 0x8053C52C Val_Ws16 655350.0 Time_ms -327680.0 327670.0 FORMAT "%8.1" /end CHARACTERISTIC
/begin CHARACTERISTIC EGRVlv_GovDvtMonCal.numRepActvn_C "Governor deviation monitoring parameter structure / Governor deviation monitoring parameter structure" VALUE 0x8053C52E Val_Wu8 255.0 OneToOne 0.00 255.0 FORMAT "%5.1" /end CHARACTERISTIC
/begin CHARACTERISTIC EGRVlv_GovDvtMonCal.tiRepActvn_C "Governor deviation monitoring parameter structure / Governor deviation monitoring parameter structure" VALUE 0x8053C530 Val_Wu16 6553500. q100_ms 0.00 6553500. FORMAT "%8.0" /end CHARACTERISTIC
/begin CHARACTERISTIC EGRVlv_GovDvtMonCal.tiJamVlvHeal_C "Governor deviation monitoring parameter structure / Governor deviation monitoring parameter structure" VALUE 0x8053C532 Val_Wu16 655350.0 Time_ms 0.00 655350.0 FORMAT "%8.1" /end CHARACTERISTIC
/begin CHARACTERISTIC EGRVlv_GovDvtMonCal.stActrMonDis_C "Governor deviation monitoring parameter structure / calibratable bit mask for active powerstage disable" VALUE 0x8053C534 Val_Wu16 65535.00 OneToOne 0.00 65535.00 FORMAT "%8.2" /end CHARACTERISTIC
/begin CHARACTERISTIC EGRVlv_GovDvtMonCal.mskCEngDsTSq_C "Governor deviation monitoring parameter structure / Governor deviation monitoring parameter structure" VALUE 0x8053C536 Val_Wu16 65535.00 OneToOne 0.00 65535.00 FORMAT "%8.2" /end CHARACTERISTIC
/begin CHARACTERISTIC EGRVlv_GovDvtMonCal.mskEnvTSq_C "Governor deviation monitoring parameter structure / Governor deviation monitoring parameter structure" VALUE 0x8053C538 Val_Wu16 65535.00 OneToOne 0.00 65535.00 FORMAT "%8.2" /end CHARACTERISTIC
/begin CHARACTERISTIC EGRVlv_GovDvtMonCal.tEngCold_C "Governor deviation monitoring parameter structure / Governor deviation monitoring parameter structure" VALUE 0x8053C53A Val_Ws16 6553.500 Temp_Cels -3549.940 3003.560 FORMAT "%8.3" /end CHARACTERISTIC
/begin CHARACTERISTIC EGRVlv_HystComp2.drDesValFltHi_C "Hystersis compensation Class / upper limit for setpoint gradient at hysteresis compensation" VALUE 0x80505204 Val_Ws16 799.9878 PrcSec -400.0000 399.9878 FORMAT "%8.4" /end CHARACTERISTIC
/begin CHARACTERISTIC EGRVlv_HystComp2.drDesValFltLo_C "Hystersis compensation Class / Lower hysteresis limit for the setpoint gradient to detect movement towards the default position" VALUE 0x80505206 Val_Ws16 799.9878 PrcSec -400.0000 399.9878 FORMAT "%8.4" /end CHARACTERISTIC
/begin CHARACTERISTIC EGRVlv_HystComp2.drGovDvtDwn_C "Hystersis compensation Class / Lower limit for change in governor deviation" VALUE 0x80505208 Val_Ws16 7999.878 VlvVel -4000.000 3999.878 FORMAT "%8.3" /end CHARACTERISTIC
/begin CHARACTERISTIC EGRVlv_HystComp2.drGovDvtUp_C "Hystersis compensation Class / Higher limit for change in governor deviation" VALUE 0x8050520A Val_Ws16 7999.878 VlvVel -4000.000 3999.878 FORMAT "%8.3" /end CHARACTERISTIC
/begin CHARACTERISTIC EGRVlv_HystComp2.facPreCtlDwnTempCorr_CUR "Hystersis compensation Class / Temperature based hysteresis compensation correction factor in direction towards default position" CURVE 0x8050520C Cur_Xs16Ws16 7.999878 Fact -4.000000 3.999878 FORMAT "%8.6"
 /begin AXIS_DESCR STD_AXIS EGRVlv_HystComp2.numPreCtlTempCurInp Temp_Cels 8 -3549.940 3003.560 FORMAT "%8.3" DEPOSIT ABSOLUTE /end AXIS_DESCR
/end CHARACTERISTIC
/begin CHARACTERISTIC EGRVlv_HystComp2.facPreCtlUpTempCorr_CUR "Hystersis compensation Class / Temperature based hysteresis compensation correction factor in direction against default position" CURVE 0x8050522E Cur_Xs16Ws16 7.999878 Fact -4.000000 3.999878 FORMAT "%8.6"
 /begin AXIS_DESCR STD_AXIS EGRVlv_HystComp2.numPreCtlTempCurInp Temp_Cels 4 -3549.940 3003.560 FORMAT "%8.3" DEPOSIT ABSOLUTE /end AXIS_DESCR
/end CHARACTERISTIC
/begin CHARACTERISTIC EGRVlv_HystComp2.rGovDvtDwn_C "Hystersis compensation Class / Governor deviation thresholds to detect movement towards the default position" VALUE 0x80505240 Val_Ws16 799.9878 Prc -400.0000 399.9878 FORMAT "%8.4" /end CHARACTERISTIC
/begin CHARACTERISTIC EGRVlv_HystComp2.rGovDvtHi_C "Hystersis compensation Class / upper limit for governor deviation" VALUE 0x80505242 Val_Ws16 799.9878 Prc -400.0000 399.9878 FORMAT "%8.4" /end CHARACTERISTIC
/begin CHARACTERISTIC EGRVlv_HystComp2.rGovDvtLo_C "Hystersis compensation Class / Governor deviation thresholds to detect movement towards the default position" VALUE 0x80505244 Val_Ws16 799.9878 Prc -400.0000 399.9878 FORMAT "%8.4" /end CHARACTERISTIC
/begin CHARACTERISTIC EGRVlv_HystComp2.rGovDvtUp_C "Hystersis compensation Class / upper limit for governor deviation" VALUE 0x80505246 Val_Ws16 799.9878 Prc -400.0000 399.9878 FORMAT "%8.4" /end CHARACTERISTIC
/begin CHARACTERISTIC EGRVlv_HystComp2.rPreCtlDwnMain_MAP "Hystersis compensation Class / Main precontrol value for downward direction" MAP 0x80505248 Map_Xs16Ys16Ws16 799.9878 Prc -400.0000 399.9878 FORMAT "%8.4"
 /begin AXIS_DESCR STD_AXIS EGRVlv_HystComp2.rPreCtlValMapInp Prc 8 -400.0000 399.9878 FORMAT "%8.4" DEPOSIT ABSOLUTE /end AXIS_DESCR
 /begin AXIS_DESCR STD_AXIS EGRVlv_HystComp2.BattU_uMapInp Volt_Batt 8 -655360.0 655340.0 FORMAT "%8.1" DEPOSIT ABSOLUTE /end AXIS_DESCR
/end CHARACTERISTIC
/begin CHARACTERISTIC EGRVlv_HystComp2.rPreCtlDwn_MAP "Hystersis compensation Class / Precontrol value for downward direction" MAP 0x805052EC Map_Xs16Ys16Ws16 799.9878 Prc -400.0000 399.9878 FORMAT "%8.4"
 /begin AXIS_DESCR STD_AXIS EGRVlv_HystComp2.rPreCtlValMapInp Prc 10 -400.0000 399.9878 FORMAT "%8.4" DEPOSIT ABSOLUTE /end AXIS_DESCR
 /begin AXIS_DESCR STD_AXIS EGRVlv_HystComp2.pDsbcMapInp Pres_hPa 10 -32768.00 32767.00 FORMAT "%8.2" DEPOSIT ABSOLUTE /end AXIS_DESCR
/end CHARACTERISTIC
/begin CHARACTERISTIC EGRVlv_HystComp2.rPreCtlUpMain_MAP "Hystersis compensation Class / Main precontrol value for upward direction" MAP 0x805053E0 Map_Xs16Ys16Ws16 799.9878 Prc -400.0000 399.9878 FORMAT "%8.4"
 /begin AXIS_DESCR STD_AXIS EGRVlv_HystComp2.rPreCtlValMapInp Prc 8 -400.0000 399.9878 FORMAT "%8.4" DEPOSIT ABSOLUTE /end AXIS_DESCR
 /begin AXIS_DESCR STD_AXIS EGRVlv_HystComp2.BattU_uMapInp Volt_Batt 8 -655360.0 655340.0 FORMAT "%8.1" DEPOSIT ABSOLUTE /end AXIS_DESCR
/end CHARACTERISTIC
/begin CHARACTERISTIC EGRVlv_HystComp2.rPreCtlUp_MAP "Hystersis compensation Class / Precontrol value for upward direction" MAP 0x80505484 Map_Xs16Ys16Ws16 799.9878 Prc -400.0000 399.9878 FORMAT "%8.4"
 /begin AXIS_DESCR STD_AXIS EGRVlv_HystComp2.rPreCtlValMapInp Prc 10 -400.0000 399.9878 FORMAT "%8.4" DEPOSIT ABSOLUTE /end AXIS_DESCR
 /begin AXIS_DESCR STD_AXIS EGRVlv_HystComp2.pDsbcMapInp Pres_hPa 10 -32768.00 32767.00 FORMAT "%8.2" DEPOSIT ABSOLUTE /end AXIS_DESCR
/end CHARACTERISTIC
/begin CHARACTERISTIC EGRVlv_HystComp2.tiDesValFlt_C "Hystersis compensation Class / TIme constant for the PT1 (desired value) filter of the closing behaviour of the real actuator." VALUE 0x80505578 Val_Ws32 4294.9672940000000 TimeDelay_s 0.0000020000000 4294.9672959999998 FORMAT "%19.14" EXTENDED_LIMITS 0.000002000000001 4294.9672959999998 /end CHARACTERISTIC
/begin CHARACTERISTIC EGRVlv_iEffLimn_MAP "Map for calculation of effective current of the actuator dependent on rActr and dc actuator motor speed" MAP 0x8058CC52 RB_Map_S16S16_S16 2047.969 Curr_A_q0p03125_COMPU -1024.000 1023.969 FORMAT "%8.3"
 /begin AXIS_DESCR STD_AXIS EGRVlv_rAbsActr_mp Prc 25 -400.0000 399.9878 FORMAT "%8.4" DEPOSIT ABSOLUTE /end AXIS_DESCR
 /begin AXIS_DESCR STD_AXIS EGRVlv_duMotSpd q10_mV_DIV_s 25 -327680.0 327670.0 FORMAT "%8.1" DEPOSIT ABSOLUTE /end AXIS_DESCR
/end CHARACTERISTIC
/begin CHARACTERISTIC EGRVlv_ILimnCal.ratThdMax_C "Set of parameters for High Power Attempt Detection based current limitation / High Power Attempt Detection threshold for duty cycle" VALUE 0x8058D19C Val_Ws16 799.9878 Prc -400.0000 399.9878 FORMAT "%8.4" /end CHARACTERISTIC
/begin CHARACTERISTIC EGRVlv_ILimnCal.tiNoLimn_C "Set of parameters for High Power Attempt Detection based current limitation / High Power Attempt Detection threshold for time" VALUE 0x8058D19E Val_Ws16 655350.0 Time_ms -327680.0 327670.0 FORMAT "%8.1" /end CHARACTERISTIC
/begin CHARACTERISTIC EGRVlv_ILimnCal.tiLimn_C "Set of parameters for High Power Attempt Detection based current limitation / Cooling Time after High Power Attempt" VALUE 0x8058D1A0 Val_Ws32 2147480.00000 Time_ms 0.00 2147480.00000 FORMAT "%13.5" EXTENDED_LIMITS -21474836480.0 21474836470.0 /end CHARACTERISTIC
/begin CHARACTERISTIC EGRVlv_ILimnCal.nrILimnDrvCyc_C "Set of parameters for High Power Attempt Detection based current limitation / Maximum number of High Power Attempts in a driving cycle before reporting a jammed actuator" VALUE 0x8058D1A4 Val_Wu8 255.0 OneToOne 0.00 255.0 FORMAT "%5.1" /end CHARACTERISTIC
/begin CHARACTERISTIC EGRVlv_ILimnCal.tiBtwConsctvILimn_C "Set of parameters for High Power Attempt Detection based current limitation / Consecutive High Power Attempt Detection time window before reporting a jammed actuator" VALUE 0x8058D1A8 Val_Ws32 42949672950.0 Time_ms -21474836480.0 21474836470.0 FORMAT "%13.1" /end CHARACTERISTIC
/begin CHARACTERISTIC EGRVlv_ILimnCal.ratGovrLim_C "Set of parameters for High Power Attempt Detection based current limitation / Value of current limitation by High Power Attempt Detection" VALUE 0x8058D1AC Val_Ws16 799.9878 Prc -400.0000 399.9878 FORMAT "%8.4" /end CHARACTERISTIC
/begin CHARACTERISTIC EGRVlv_ILimnCal.flgSwtInpSeln_C "Set of parameters for High Power Attempt Detection based current limitation / Input selection for High Power Attempt Detection" VALUE 0x8058D1AE Val_Wu8 1.00000000000 HiPwrAtmptDetnInpSeln_VERB 0.00 1.00000000000 FORMAT "%13.11" /end CHARACTERISTIC
/begin CHARACTERISTIC EGRVlv_ILimnCal.swtTGovrLimActv_C "Set of parameters for High Power Attempt Detection based current limitation / Switch to activate the temperature based governor limitation" VALUE 0x8058D1AF Val_Wu8 255.0 OneToOne 0.00 255.0 FORMAT "%5.1" /end CHARACTERISTIC
/begin CHARACTERISTIC EGRVlv_Kd_CUR "Curve for Kd controller parameter" CURVE 0x8058D1B0 RB_Curve_S16_S16 127.9980 Kd_1 -64.00000 63.99805 FORMAT "%8.5"
 /begin AXIS_DESCR STD_AXIS EGRVlv_rGovDvt Prc 25 -400.0000 399.9878 FORMAT "%8.4" DEPOSIT ABSOLUTE /end AXIS_DESCR
/end CHARACTERISTIC
/begin CHARACTERISTIC EGRVlv_Kd_MAP "Map for Kd controller parameter" MAP 0x8058D216 RB_Map_S16S16_S16 127.9980 Kd_1 -64.00000 63.99805 FORMAT "%8.5"
 /begin AXIS_DESCR STD_AXIS EGRVlv_rGovDvt Prc 25 -400.0000 399.9878 FORMAT "%8.4" DEPOSIT ABSOLUTE /end AXIS_DESCR
 /begin AXIS_DESCR STD_AXIS EGRVlv_pDsbc Pres_hPa 25 -32768.00 32767.00 FORMAT "%8.2" DEPOSIT ABSOLUTE /end AXIS_DESCR
/end CHARACTERISTIC
/begin CHARACTERISTIC EGRVlv_Ki_CUR "Curve for Ki (integration time) controller parameter" CURVE 0x8058D760 RB_Curve_S16_S16 976.5476 Ki_1 -488.2813 488.2663 FORMAT "%8.4"
 /begin AXIS_DESCR STD_AXIS EGRVlv_rGovDvt Prc 25 -400.0000 399.9878 FORMAT "%8.4" DEPOSIT ABSOLUTE /end AXIS_DESCR
/end CHARACTERISTIC
/begin CHARACTERISTIC EGRVlv_Ki_MAP "Map for Ki (integration time) controller parameter" MAP 0x8058D7C6 RB_Map_S16S16_S16 976.5476 Ki_1 -488.2813 488.2663 FORMAT "%8.4"
 /begin AXIS_DESCR STD_AXIS EGRVlv_rGovDvt Prc 25 -400.0000 399.9878 FORMAT "%8.4" DEPOSIT ABSOLUTE /end AXIS_DESCR
 /begin AXIS_DESCR STD_AXIS EGRVlv_pDsbc Pres_hPa 25 -32768.00 32767.00 FORMAT "%8.2" DEPOSIT ABSOLUTE /end AXIS_DESCR
/end CHARACTERISTIC
/begin CHARACTERISTIC EGRVlv_Kp_CUR "Curve for Kp (gain) controller parameter" CURVE 0x8058DD10 RB_Curve_S16_S16 1023.984 Kp_1 -512.0000 511.9844 FORMAT "%8.4"
 /begin AXIS_DESCR STD_AXIS EGRVlv_rGovDvt Prc 25 -400.0000 399.9878 FORMAT "%8.4" DEPOSIT ABSOLUTE /end AXIS_DESCR
/end CHARACTERISTIC
/begin CHARACTERISTIC EGRVlv_Kp_MAP "Map for Kp (gain) controller parameter" MAP 0x8058DD76 RB_Map_S16S16_S16 1023.984 Kp_1 -512.0000 511.9844 FORMAT "%8.4"
 /begin AXIS_DESCR STD_AXIS EGRVlv_rGovDvt Prc 25 -400.0000 399.9878 FORMAT "%8.4" DEPOSIT ABSOLUTE /end AXIS_DESCR
 /begin AXIS_DESCR STD_AXIS EGRVlv_pDsbc Pres_hPa 25 -32768.00 32767.00 FORMAT "%8.2" DEPOSIT ABSOLUTE /end AXIS_DESCR
/end CHARACTERISTIC
/begin CHARACTERISTIC EGRVlv_LrnTstCal.rDesValMaxLrnATS_C "" VALUE 0x8058E2C0 Val_Ws16 799.9878 Prc -400.0000 399.9878 FORMAT "%8.4" /end CHARACTERISTIC
/begin CHARACTERISTIC EGRVlv_LrnTstCal.rDesValMinLrnATS_C "" VALUE 0x8058E2C2 Val_Ws16 799.9878 Prc -400.0000 399.9878 FORMAT "%8.4" /end CHARACTERISTIC
/begin CHARACTERISTIC EGRVlv_LrnTstCal.rCtlRngMaxATS_C "" VALUE 0x8058E2C4 Val_Ws16 799.9878 Prc -400.0000 399.9878 FORMAT "%8.4" /end CHARACTERISTIC
/begin CHARACTERISTIC EGRVlv_LrnTstCal.rCtlRngMinATS_C "" VALUE 0x8058E2C6 Val_Ws16 799.9878 Prc -400.0000 399.9878 FORMAT "%8.4" /end CHARACTERISTIC
/begin CHARACTERISTIC EGRVlv_LrnTstCal.tiPerFrstLrn_C "" VALUE 0x8058E2C8 Val_Ws16 65535.00 Time_usec_q1_COMPU -32768.00 32767.00 FORMAT "%8.2" /end CHARACTERISTIC
/begin CHARACTERISTIC EGRVlv_LrnTstCal.tiPerResetLrn_C "" VALUE 0x8058E2CA Val_Ws16 65535.00 Time_usec_q1_COMPU -32768.00 32767.00 FORMAT "%8.2" /end CHARACTERISTIC
/begin CHARACTERISTIC EGRVlv_numSelPdsbc1_C "Index value to select the first pressure for disturbance pressure calculation from DELib_Snsr_Read function" VALUE 0x8058E2CC Val_Wu16 255.000000000 DELIB_ALLPRES_VERB_COMPU 256.000000000 511.000000000 FORMAT "%13.9" /end CHARACTERISTIC
/begin CHARACTERISTIC EGRVlv_numSelPdsbc2_C "Index value to select the second pressure for disturbance pressure calculation from DELib_Snsr_Read function" VALUE 0x8058E2CE Val_Wu16 255.000000000 DELIB_ALLPRES_VERB_COMPU 256.000000000 511.000000000 FORMAT "%13.9" /end CHARACTERISTIC
/begin CHARACTERISTIC EGRVlv_OfsLearnCal.nEngMax_C "Offset learning calculation Calibration structure / Maximum engine speed for offsetlearning" VALUE 0x8053C440 RB_Val_Ws16 32767.50 EngN -16384.00 16383.50 FORMAT "%8.2" /end CHARACTERISTIC
/begin CHARACTERISTIC EGRVlv_OfsLearnCal.nEngMin_C "Offset learning calculation Calibration structure / e_:Minimum engine speed for offsetlearning:_e;d_:Minimale Motordrehzahl zum Offset-Lernen:_d" VALUE 0x8053C442 RB_Val_Ws16 32767.50 EngN -16384.00 16383.50 FORMAT "%8.2" /end CHARACTERISTIC
/begin CHARACTERISTIC EGRVlv_OfsLearnCal.numClnVerifyMin_C "Offset learning calculation Calibration structure / Minimum number of clean verify attempts before offset learning is released" VALUE 0x8053C444 RB_Val_Wu8 255.0 OneToOne 0.00 255.0 FORMAT "%5.1" /end CHARACTERISTIC
/begin CHARACTERISTIC EGRVlv_OfsLearnCal.numTOfsLrnAdj_C "Offset learning calculation Calibration structure / Calibration to select the temperature from the sensor array for drift compensation due to temperature of the actuator" VALUE 0x8053C445 RB_Val_Wu8 255.000000000 DELIB_ALLTEMP_VERB_COMPU 0.00 255.000000000 FORMAT "%13.9" /end CHARACTERISTIC
/begin CHARACTERISTIC EGRVlv_OfsLearnCal.pDsbcMax_C "Offset learning calculation Calibration structure / Maximum disturbance pressure for offsetlearning" VALUE 0x8053C446 RB_Val_Ws16 65535.00 Pres_hPa -32768.00 32767.00 FORMAT "%8.2" /end CHARACTERISTIC
/begin CHARACTERISTIC EGRVlv_OfsLearnCal.qSetUnBalQntyMax_C "Offset learning calculation Calibration structure / e_:Maximum injection mass for offsetlearning:_e;d_:Maximale Einspritzmenge beim Offset Lernen:_d" VALUE 0x8053C448 RB_Val_Ws16 655.3500 InjMass -327.6800 327.6700 FORMAT "%8.4" /end CHARACTERISTIC
/begin CHARACTERISTIC EGRVlv_OfsLearnCal.rOfsLrnAvlMinHi_C "Offset learning calculation Calibration structure / Minimum torque required to perform offset learning at not default position" VALUE 0x8053C44A RB_Val_Ws16 799.9878 Prc -400.0000 399.9878 FORMAT "%8.4" /end CHARACTERISTIC
/begin CHARACTERISTIC EGRVlv_OfsLearnCal.rOfsLrnAvlMinLo_C "Offset learning calculation Calibration structure / Minimum torque required to perform offset learning at default position" VALUE 0x8053C44C RB_Val_Ws16 799.9878 Prc -400.0000 399.9878 FORMAT "%8.4" /end CHARACTERISTIC
/begin CHARACTERISTIC EGRVlv_OfsLearnCal.swtLrn_C "Offset learning calculation Calibration structure / Configuration switch to enable offset learning" VALUE 0x8053C44E RB_Val_Wu16 65535.00 OneToOne 0.00 65535.00 FORMAT "%8.2" /end CHARACTERISTIC
/begin CHARACTERISTIC EGRVlv_OfsLearnCal.tiAvrg_C "Offset learning calculation Calibration structure / Time for averaging sensor values during offset learning for closed and open position" VALUE 0x8053C450 RB_Val_Ws16 655350.0 Time_ms -327680.0 327670.0 FORMAT "%8.1" /end CHARACTERISTIC
/begin CHARACTERISTIC EGRVlv_OfsLearnCal.tiOfsLrnStrt_C "Offset learning calculation Calibration structure / Timer for starting offset learning" VALUE 0x8053C452 RB_Val_Ws16 655350.0 Time_ms -327680.0 327670.0 FORMAT "%8.1" /end CHARACTERISTIC
/begin CHARACTERISTIC EGRVlv_OfsLearnCal.tiStFlgDsplLrn_C "Offset learning calculation Calibration structure / Time to display a succesful offset learning attempt" VALUE 0x8053C454 RB_Val_Wu8 25500. q100_ms 0.00 25500. FORMAT "%5.0" /end CHARACTERISTIC
/begin CHARACTERISTIC EGRVlv_OfsLearnCal.tiZycOffSetLrn_C "Offset learning calculation Calibration structure / Time between cyclic offset learning" VALUE 0x8053C456 RB_Val_Ws16 655350.0 Time_ms -327680.0 327670.0 FORMAT "%8.1" /end CHARACTERISTIC
/begin CHARACTERISTIC EGRVlv_OfsLearnCal.uDstCalcClsd_C "Offset learning calculation Calibration structure / Voltage difference from fully opened to fully closed mechanical position" VALUE 0x8053C458 RB_Val_Ws16 13107.00 Volt -6553.600 6553.400 FORMAT "%8.3" /end CHARACTERISTIC
/begin CHARACTERISTIC EGRVlv_OfsLearnCal.uDstCalcOpn_C "Offset learning calculation Calibration structure / Voltage difference from fully closed to fully open mechanical position" VALUE 0x8053C45A RB_Val_Ws16 13107.00 Volt -6553.600 6553.400 FORMAT "%8.3" /end CHARACTERISTIC
/begin CHARACTERISTIC EGRVlv_OfsLearnCal.uMaxDrftConscClsd_C "Offset learning calculation Calibration structure / The learned values at closed position are limited to the range of the last learned value at closed position +- this calibration value" VALUE 0x8053C45C RB_Val_Ws16 13107.00 Volt -6553.600 6553.400 FORMAT "%8.3" /end CHARACTERISTIC
/begin CHARACTERISTIC EGRVlv_OfsLearnCal.uMaxDrftConscOpn_C "Offset learning calculation Calibration structure / the learned values at open position are limited to the range of the last learned value at closed position +- this calibration value" VALUE 0x8053C45E RB_Val_Ws16 13107.00 Volt -6553.600 6553.400 FORMAT "%8.3" /end CHARACTERISTIC
/begin CHARACTERISTIC EGRVlv_OfsLearnCal.uNewActrDetnThd_C "Offset learning calculation Calibration structure / Threshold for reset drag indicator for closed position to calibratable average closed position" VALUE 0x8053C460 RB_Val_Ws16 13107.00 Volt -6553.600 6553.400 FORMAT "%8.3" /end CHARACTERISTIC
/begin CHARACTERISTIC EGRVlv_OfsLearnCal.uOffsClsd_C "Offset learning calculation Calibration structure / Distance electrical to mechanical at closed position" VALUE 0x8053C462 RB_Val_Ws16 13107.00 Volt -6553.600 6553.400 FORMAT "%8.3" /end CHARACTERISTIC
/begin CHARACTERISTIC EGRVlv_OfsLearnCal.uOffsOpn_C "Offset learning calculation Calibration structure / Distance electrical to mechanical at open position" VALUE 0x8053C464 RB_Val_Ws16 13107.00 Volt -6553.600 6553.400 FORMAT "%8.3" /end CHARACTERISTIC
/begin CHARACTERISTIC EGRVlv_OfsLearnCal.uTempOfsAdjClsd_CUR "Offset learning calculation Calibration structure / Drift compensation values based on temperature of the actuator at closed postion" CURVE 0x8053C466 RB_Curve_S16_S16 13107.00 Volt -6553.600 6553.400 FORMAT "%8.3"
 /begin AXIS_DESCR STD_AXIS EGRVlv_OfsLearnCal.tOfsAdjuTempOfsAdjClsdCurInp Temp_Cels 5 -3549.940 3003.560 FORMAT "%8.3" DEPOSIT ABSOLUTE /end AXIS_DESCR
/end CHARACTERISTIC
/begin CHARACTERISTIC EGRVlv_OfsLearnCal.uTempOfsAdjOpn_CUR "Offset learning calculation Calibration structure / Drift compensation values based on temperature of the actuator at open postion" CURVE 0x8053C47C RB_Curve_S16_S16 13107.00 Volt -6553.600 6553.400 FORMAT "%8.3"
 /begin AXIS_DESCR STD_AXIS EGRVlv_OfsLearnCal.tOfsAdjuTempOfsAdjOpnCurInp Temp_Cels 5 -3549.940 3003.560 FORMAT "%8.3" DEPOSIT ABSOLUTE /end AXIS_DESCR
/end CHARACTERISTIC
/begin CHARACTERISTIC EGRVlv_PosGovExtdCal.drDesValDwn_C "Position Governor parameter structure for direction dependend governor features / " VALUE 0x8058E2D0 Val_Ws16 7999.878 VlvVel -4000.000 3999.878 FORMAT "%8.3" /end CHARACTERISTIC
/begin CHARACTERISTIC EGRVlv_PosGovExtdCal.drDesValUp_C "Position Governor parameter structure for direction dependend governor features / " VALUE 0x8058E2D2 Val_Ws16 7999.878 VlvVel -4000.000 3999.878 FORMAT "%8.3" /end CHARACTERISTIC
/begin CHARACTERISTIC EGRVlv_PosGovExtdCal.rGovDvtDwn_C "Position Governor parameter structure for direction dependend governor features / " VALUE 0x8058E2D4 Val_Ws16 799.9878 Prc -400.0000 399.9878 FORMAT "%8.4" /end CHARACTERISTIC
/begin CHARACTERISTIC EGRVlv_PosGovExtdCal.rGovDvtUp_C "Position Governor parameter structure for direction dependend governor features / " VALUE 0x8058E2D6 Val_Ws16 799.9878 Prc -400.0000 399.9878 FORMAT "%8.4" /end CHARACTERISTIC
/begin CHARACTERISTIC EGRVlv_PosGovExtdCal.numGainCorrCurIn_C "Position Governor parameter structure for direction dependend governor features / " VALUE 0x8058E2D8 Val_Wu8 2.00000000000 DELibGainCorrCurIn_VERB 0.00 2.00000000000 FORMAT "%13.11" /end CHARACTERISTIC
/begin CHARACTERISTIC EGRVlv_rDeMax_MAP "MAP to calibrate Governor Deviation maximum Threshold" MAP 0x8053C53C Map_Xs16Ys16Ws16 799.9878 Prc -400.0000 399.9878 FORMAT "%8.4"
 /begin AXIS_DESCR STD_AXIS EGRVlv_duRaw q10_mV_DIV_s 25 -327680.0 327670.0 FORMAT "%8.1" DEPOSIT ABSOLUTE /end AXIS_DESCR
 /begin AXIS_DESCR STD_AXIS EGRVlv_rAct Prc 25 -400.0000 399.9878 FORMAT "%8.4" DEPOSIT ABSOLUTE /end AXIS_DESCR
/end CHARACTERISTIC
/begin CHARACTERISTIC EGRVlv_rDeMin_MAP "MAP to calibrate Governor Deviation minimum Threshold" MAP 0x8053CA86 Map_Xs16Ys16Ws16 799.9878 Prc -400.0000 399.9878 FORMAT "%8.4"
 /begin AXIS_DESCR STD_AXIS EGRVlv_duRaw q10_mV_DIV_s 25 -327680.0 327670.0 FORMAT "%8.1" DEPOSIT ABSOLUTE /end AXIS_DESCR
 /begin AXIS_DESCR STD_AXIS EGRVlv_rAct Prc 25 -400.0000 399.9878 FORMAT "%8.4" DEPOSIT ABSOLUTE /end AXIS_DESCR
/end CHARACTERISTIC
/begin CHARACTERISTIC EGRVlv_rFric_CUR "Friction compensation curve in block friction handling and large signal behaviour of hysteresis compensation curve" CURVE 0x8058E2DA RB_Curve_S16_S16 799.9878 Prc -400.0000 399.9878 FORMAT "%8.4"
 /begin AXIS_DESCR STD_AXIS EGRVlv_rAct Prc 25 -400.0000 399.9878 FORMAT "%8.4" DEPOSIT ABSOLUTE /end AXIS_DESCR
/end CHARACTERISTIC
/begin CHARACTERISTIC EGRVlv_rGovDvtLimI_CUR "Limit for governor deviation dependent on the governor desired value" CURVE 0x8058E340 RB_Curve_S16_S16 799.9878 Prc -400.0000 399.9878 FORMAT "%8.4"
 /begin AXIS_DESCR STD_AXIS EGRVlv_rGovDesVal Prc 25 -400.0000 399.9878 FORMAT "%8.4" DEPOSIT ABSOLUTE /end AXIS_DESCR
/end CHARACTERISTIC
/begin CHARACTERISTIC EGRVlv_rGovMaxLrn_CUR "Maximum output duty cycle during active offset learning based on temperature" CURVE 0x8058E3A6 RB_Curve_S16_S16 799.9878 Prc -400.0000 399.9878 FORMAT "%8.4"
 /begin AXIS_DESCR STD_AXIS EGRVlv_tActr Temp_Cels 25 -3549.940 3003.560 FORMAT "%8.3" DEPOSIT ABSOLUTE /end AXIS_DESCR
/end CHARACTERISTIC
/begin CHARACTERISTIC EGRVlv_rGovMaxMechBnd_CUR "Maximum force to be limited at the mechanical boundary based on temperature" CURVE 0x8058E40C RB_Curve_S16_S16 799.9878 Prc -400.0000 399.9878 FORMAT "%8.4"
 /begin AXIS_DESCR STD_AXIS EGRVlv_tActr Temp_Cels 25 -3549.940 3003.560 FORMAT "%8.3" DEPOSIT ABSOLUTE /end AXIS_DESCR
/end CHARACTERISTIC
/begin CHARACTERISTIC EGRVlv_rGovMaxMechBnd_MAP "Maximum force to be limited at the mechanical boundary based on temperature" MAP 0x8058E472 RB_Map_S16S16_S16 799.9878 Prc -400.0000 399.9878 FORMAT "%8.4"
 /begin AXIS_DESCR STD_AXIS EGRVlv_tActr Temp_Cels 25 -3549.940 3003.560 FORMAT "%8.3" DEPOSIT ABSOLUTE /end AXIS_DESCR
 /begin AXIS_DESCR STD_AXIS EGRVlv_pDsbc Pres_hPa 25 -32768.00 32767.00 FORMAT "%8.2" DEPOSIT ABSOLUTE /end AXIS_DESCR
/end CHARACTERISTIC
/begin CHARACTERISTIC EGRVlv_rGovMax_MAP "Map for the actuator Governor limitation" MAP 0x8058E9BC RB_Map_S16S16_S16 799.9878 Prc -400.0000 399.9878 FORMAT "%8.4"
 /begin AXIS_DESCR STD_AXIS EGRVlv_iEffMdlFlt Curr_A_q0p03125_COMPU 25 -1024.000 1023.969 FORMAT "%8.3" DEPOSIT ABSOLUTE /end AXIS_DESCR
 /begin AXIS_DESCR STD_AXIS EGRVlv_tArmtrFlt_mp Temp_Cels 25 -3549.940 3003.560 FORMAT "%8.3" DEPOSIT ABSOLUTE /end AXIS_DESCR
/end CHARACTERISTIC
/begin CHARACTERISTIC EGRVlv_rGovMinLrn_CUR "Minimum output duty cycle during active offset learning based on temperature" CURVE 0x8058EF06 RB_Curve_S16_S16 799.9878 Prc -400.0000 399.9878 FORMAT "%8.4"
 /begin AXIS_DESCR STD_AXIS EGRVlv_tActr Temp_Cels 25 -3549.940 3003.560 FORMAT "%8.3" DEPOSIT ABSOLUTE /end AXIS_DESCR
/end CHARACTERISTIC
/begin CHARACTERISTIC EGRVlv_rGovMinMechBnd_CUR "Minimum force to be limited at the mechanical boundary based on temperature" CURVE 0x8058EF6C RB_Curve_S16_S16 799.9878 Prc -400.0000 399.9878 FORMAT "%8.4"
 /begin AXIS_DESCR STD_AXIS EGRVlv_tActr Temp_Cels 25 -3549.940 3003.560 FORMAT "%8.3" DEPOSIT ABSOLUTE /end AXIS_DESCR
/end CHARACTERISTIC
/begin CHARACTERISTIC EGRVlv_rGovMinMechBnd_MAP "Minimum force to be limited at the mechanical boundary based on temperature" MAP 0x8058EFD2 RB_Map_S16S16_S16 799.9878 Prc -400.0000 399.9878 FORMAT "%8.4"
 /begin AXIS_DESCR STD_AXIS EGRVlv_tActr Temp_Cels 25 -3549.940 3003.560 FORMAT "%8.3" DEPOSIT ABSOLUTE /end AXIS_DESCR
 /begin AXIS_DESCR STD_AXIS EGRVlv_pDsbc Pres_hPa 25 -32768.00 32767.00 FORMAT "%8.2" DEPOSIT ABSOLUTE /end AXIS_DESCR
/end CHARACTERISTIC
/begin CHARACTERISTIC EGRVlv_RmpSlp.Pos_C "Structure for Ramp slope / Slope if the ramp has to be increased" VALUE 0x8058F51C Kw_Ws32 399999.999814 RmpPrc 0.00 399999.999814 FORMAT "%13.6" EXTENDED_LIMITS -400000.000000 399999.999814 /end CHARACTERISTIC
/begin CHARACTERISTIC EGRVlv_RmpSlp.Neg_C "Structure for Ramp slope / negative ramp slope" VALUE 0x8058F520 Kw_Ws32 399999.999814 RmpPrc 0.00 399999.999814 FORMAT "%13.6" EXTENDED_LIMITS -400000.000000 399999.999814 /end CHARACTERISTIC
/begin CHARACTERISTIC EGRVlv_rPIDGovDvtMax_MAP "Map for the actuator Governor limitation based on the filtered effective current and the governor deviation" MAP 0x8058F524 RB_Map_S16S16_S16 799.9878 Prc -400.0000 399.9878 FORMAT "%8.4"
 /begin AXIS_DESCR STD_AXIS EGRVlv_iEffMdlFlt Curr_A_q0p03125_COMPU 25 -1024.000 1023.969 FORMAT "%8.3" DEPOSIT ABSOLUTE /end AXIS_DESCR
 /begin AXIS_DESCR STD_AXIS EGRVlv_rGovDvt Prc 25 -400.0000 399.9878 FORMAT "%8.4" DEPOSIT ABSOLUTE /end AXIS_DESCR
/end CHARACTERISTIC
/begin CHARACTERISTIC EGRVlv_rPreCtl2_MAP "Precontrol Curve 2" MAP 0x8058FA6E RB_Map_S16S16_S16 799.9878 Prc -400.0000 399.9878 FORMAT "%8.4"
 /begin AXIS_DESCR STD_AXIS EGRVlv_rPreCtl2MapIn_mp Prc 25 -400.0000 399.9878 FORMAT "%8.4" DEPOSIT ABSOLUTE /end AXIS_DESCR
 /begin AXIS_DESCR STD_AXIS EGRVlv_pDsbc_mp Pres_hPa 25 -32768.00 32767.00 FORMAT "%8.2" DEPOSIT ABSOLUTE /end AXIS_DESCR
/end CHARACTERISTIC
/begin CHARACTERISTIC EGRVlv_rPreCtl_MAP "Precontrol Map" MAP 0x8058FFB8 RB_Map_S16S16_S16 799.9878 Prc -400.0000 399.9878 FORMAT "%8.4"
 /begin AXIS_DESCR STD_AXIS EGRVlv_rPreCtlCurIn_mp Prc 25 -400.0000 399.9878 FORMAT "%8.4" DEPOSIT ABSOLUTE /end AXIS_DESCR
 /begin AXIS_DESCR STD_AXIS EGRVlv_rAct Prc 25 -400.0000 399.9878 FORMAT "%8.4" DEPOSIT ABSOLUTE /end AXIS_DESCR
/end CHARACTERISTIC
/begin CHARACTERISTIC EGRVlv_SensCal.uCtlRngMax_C "" VALUE 0x80590738 Val_Ws16 13107.00 Volt -6553.600 6553.400 FORMAT "%8.3" /end CHARACTERISTIC
/begin CHARACTERISTIC EGRVlv_SensCal.uCtlRngMin_C "" VALUE 0x8059073A Val_Ws16 13107.00 Volt -6553.600 6553.400 FORMAT "%8.3" /end CHARACTERISTIC
/begin CHARACTERISTIC EGRVlv_SensCal.uMin_C "" VALUE 0x8059073C Val_Ws16 13107.00 Volt -6553.600 6553.400 FORMAT "%8.3" /end CHARACTERISTIC
/begin CHARACTERISTIC EGRVlv_SensCal.uMax_C "" VALUE 0x8059073E Val_Ws16 13107.00 Volt -6553.600 6553.400 FORMAT "%8.3" /end CHARACTERISTIC
/begin CHARACTERISTIC EGRVlv_SensCal.uAvrgOpn_C "" VALUE 0x80590740 Val_Ws16 13107.00 Volt -6553.600 6553.400 FORMAT "%8.3" /end CHARACTERISTIC
/begin CHARACTERISTIC EGRVlv_SensCal.uAvrgClsd_C "" VALUE 0x80590742 Val_Ws16 13107.00 Volt -6553.600 6553.400 FORMAT "%8.3" /end CHARACTERISTIC
/begin CHARACTERISTIC EGRVlv_SensCal.uRefSens_C "" VALUE 0x80590744 Val_Ws16 5200.000 Volt 0.00 5200.000 FORMAT "%8.3" EXTENDED_LIMITS -6553.600 6553.400 /end CHARACTERISTIC
/begin CHARACTERISTIC EGRVlv_SensCal.uRawMinClsd_C "" VALUE 0x80590746 Val_Ws16 13107.00 Volt -6553.600 6553.400 FORMAT "%8.3" /end CHARACTERISTIC
/begin CHARACTERISTIC EGRVlv_SensCal.uRawMaxClsd_C "" VALUE 0x80590748 Val_Ws16 13107.00 Volt -6553.600 6553.400 FORMAT "%8.3" /end CHARACTERISTIC
/begin CHARACTERISTIC EGRVlv_SensCal.uRawMinOpn_C "" VALUE 0x8059074A Val_Ws16 13107.00 Volt -6553.600 6553.400 FORMAT "%8.3" /end CHARACTERISTIC
/begin CHARACTERISTIC EGRVlv_SensCal.uRawMaxOpn_C "" VALUE 0x8059074C Val_Ws16 13107.00 Volt -6553.600 6553.400 FORMAT "%8.3" /end CHARACTERISTIC
/begin CHARACTERISTIC EGRVlv_SensCal.uRawMinMechBnd_C "" VALUE 0x8059074E Val_Ws16 13107.00 Volt -6553.600 6553.400 FORMAT "%8.3" /end CHARACTERISTIC
/begin CHARACTERISTIC EGRVlv_SensCal.uRawMaxMechBnd_C "" VALUE 0x80590750 Val_Ws16 13107.00 Volt -6553.600 6553.400 FORMAT "%8.3" /end CHARACTERISTIC
/begin CHARACTERISTIC EGRVlv_SensCal.uRawMaxElecClsd_C "" VALUE 0x80590752 Val_Ws16 13107.00 Volt -6553.600 6553.400 FORMAT "%8.3" /end CHARACTERISTIC
/begin CHARACTERISTIC EGRVlv_SensCal.uRawMinElecClsd_C "" VALUE 0x80590754 Val_Ws16 13107.00 Volt -6553.600 6553.400 FORMAT "%8.3" /end CHARACTERISTIC
/begin CHARACTERISTIC EGRVlv_SensCal.uRawMaxElecOpn_C "" VALUE 0x80590756 Val_Ws16 13107.00 Volt -6553.600 6553.400 FORMAT "%8.3" /end CHARACTERISTIC
/begin CHARACTERISTIC EGRVlv_SensCal.uRawMinElecOpn_C "" VALUE 0x80590758 Val_Ws16 13107.00 Volt -6553.600 6553.400 FORMAT "%8.3" /end CHARACTERISTIC
/begin CHARACTERISTIC EGRVlv_StcFctActrCal.swtConf_C "Actuator statistic functions calibration class / e_:Configuration switch to activate actuator statistic functions:_e;d_:Konfigurationsschalter zum Aktivieren der Aktuator Statistikfunktionen:_d" VALUE 0x8053E07C RB_Val_Wu8 255.0 OneToOne 0.00 255.0 FORMAT "%5.1" /end CHARACTERISTIC
/begin CHARACTERISTIC EGRVlv_StcFctActrCal.rDesValFildThd_C "Actuator statistic functions calibration class / e_:Threshold of the desired actuator value:_e;d_:Grenze des Stellers Sollwerts:_d" VALUE 0x8053E07E RB_Val_Ws16 799.9878 Prc -400.0000 399.9878 FORMAT "%8.4" /end CHARACTERISTIC
/begin CHARACTERISTIC EGRVlv_StcFctActrCal.nEngMax_C "Actuator statistic functions calibration class / e_:Engine speed threshold for trailing pointer calculation:_e;d_:Motor-Drehzahlschwelle zur Berechnung des Schleppzeigers:_d" VALUE 0x8053E080 RB_Val_Ws16 32767.50 EngN -16384.00 16383.50 FORMAT "%8.2" /end CHARACTERISTIC
/begin CHARACTERISTIC EGRVlv_StcFctActrCal.tiDesValFild_C "Actuator statistic functions calibration class / e_:Filter time constant for setpoint:_e;d_:Filterzeitkonstante für Sollwert:_d" VALUE 0x8053E084 RB_Val_Ws32 4294.9672940000000 TimeDelay_s 0.0000020000000 4294.9672959999998 FORMAT "%19.14" EXTENDED_LIMITS 0.000002000000001 4294.9672959999998 /end CHARACTERISTIC
/begin CHARACTERISTIC EGRVlv_tiAftEngStrtLim_CUR "Time after T15 on for release of cold-start detection" CURVE 0x8053CFD0 RB_Curve_S16_U16_Static 655.3500 Time_s 0.00 655.3500 FORMAT "%8.4"
 /begin AXIS_DESCR STD_AXIS EGRVlv_tEngColdStrt Temp_Cels 25 -3549.940 3003.560 FORMAT "%8.3" DEPOSIT ABSOLUTE /end AXIS_DESCR
/end CHARACTERISTIC
/begin CHARACTERISTIC EGRVlv_tiAftStrtRedLim_CUR "Time after T15 on for release of cold-start detection" CURVE 0x8053D036 RB_Curve_S16_U16_Static 655.3500 Time_s 0.00 655.3500 FORMAT "%8.4"
 /begin AXIS_DESCR STD_AXIS EGRVlv_tColdStrt Temp_Cels 25 -3549.940 3003.560 FORMAT "%8.3" DEPOSIT ABSOLUTE /end AXIS_DESCR
/end CHARACTERISTIC
/begin CHARACTERISTIC EGRVlv_tiBckEMFConst_CUR "Position dependent back EMF constant curve" CURVE 0x80590502 RB_Curve_S16_S16 131.0700 t_q0p002 -65.53600 65.53400 FORMAT "%8.5"
 /begin AXIS_DESCR STD_AXIS EGRVlv_uRaw Volt 25 -6553.600 6553.400 FORMAT "%8.3" DEPOSIT ABSOLUTE /end AXIS_DESCR
/end CHARACTERISTIC
/begin CHARACTERISTIC EGRVlv_tiCrntEffLpFltPar_T "Curve to set PT1 parameters of current model to limitate effective current" CURVE 0x80590568 RB_Curve_S16_S32_Static 42949672.9500 Time_s -21474836.4800 21474836.4700 FORMAT "%13.4"
 /begin AXIS_DESCR STD_AXIS EGRVlv_rAbsActr_mp Prc 25 -400.0000 399.9878 FORMAT "%8.4" DEPOSIT ABSOLUTE /end AXIS_DESCR
/end CHARACTERISTIC
/begin CHARACTERISTIC EGRVlv_tiFltSnsr_MAP "Map to calibrate Time constant for PT1 filter" MAP 0x8053DB30 RB_Map_S16S16_S16 6.553500 q1Em4_s -3.276800 3.276700 FORMAT "%8.6"
 /begin AXIS_DESCR STD_AXIS EGRVlv_rGovDvtAbs Prc 25 -400.0000 399.9878 FORMAT "%8.4" DEPOSIT ABSOLUTE /end AXIS_DESCR
 /begin AXIS_DESCR STD_AXIS PCR_pDesVal Pres_hPa 25 -32768.00 32767.00 FORMAT "%8.2" DEPOSIT ABSOLUTE /end AXIS_DESCR
/end CHARACTERISTIC
/begin CHARACTERISTIC EGRVlv_tiGovrDeErr_MAP "Debounce time for Governor Deviation detection during normal operation" MAP 0x8053D09C RB_Map_S16S16_S16 655350.0 Time_ms -327680.0 327670.0 FORMAT "%8.1"
 /begin AXIS_DESCR STD_AXIS EGRVlv_rActSign Prc 25 -400.0000 399.9878 FORMAT "%8.4" DEPOSIT ABSOLUTE /end AXIS_DESCR
 /begin AXIS_DESCR STD_AXIS EGRVlv_rGovDvtFltMon Prc 25 -400.0000 399.9878 FORMAT "%8.4" DEPOSIT ABSOLUTE /end AXIS_DESCR
/end CHARACTERISTIC
/begin CHARACTERISTIC EGRVlv_tiRlsStrtDly_MAP "Calibratable delay time to start the Release function." MAP 0x8053D5E6 RB_Map_S16S16_U16 655350.0 Time_ms 0.00 655350.0 FORMAT "%8.1"
 /begin AXIS_DESCR STD_AXIS EGRVlv_rAct Prc 25 -400.0000 399.9878 FORMAT "%8.4" DEPOSIT ABSOLUTE /end AXIS_DESCR
 /begin AXIS_DESCR STD_AXIS EGRVlv_rGovDvtFltMon Prc 25 -400.0000 399.9878 FORMAT "%8.4" DEPOSIT ABSOLUTE /end AXIS_DESCR
/end CHARACTERISTIC
/begin CHARACTERISTIC EGRVlv_TransStg.Dfl_C "Structure for TransStage / Fixed replacement value" VALUE 0x80590600 Kw_Ws16 799.9878 Prc -400.0000 399.9878 FORMAT "%8.4" /end CHARACTERISTIC
/begin CHARACTERISTIC EGRVlv_TransStg.stSensId_C "Structure for TransStage / Sensor Id word" VALUE 0x80590602 Kw_Wu8 255.0 OneToOne 0.00 255.0 FORMAT "%5.1" /end CHARACTERISTIC
/begin CHARACTERISTIC EGRVlv_trqActrMax_CUR "The torque value at endstop to detect closed position based on temperature" CURVE 0x80590604 RB_Curve_S16_S16 65535.00 q1_Ncm -32768.00 32767.00 FORMAT "%8.2"
 /begin AXIS_DESCR STD_AXIS EGRVlv_tActr Temp_Cels 25 -3549.940 3003.560 FORMAT "%8.3" DEPOSIT ABSOLUTE /end AXIS_DESCR
/end CHARACTERISTIC
/begin CHARACTERISTIC EGRVlv_trqActrMin_CUR "The torque value at endstop to detect open position based on temperature" CURVE 0x8059066A RB_Curve_S16_S16 65535.00 q1_Ncm -32768.00 32767.00 FORMAT "%8.2"
 /begin AXIS_DESCR STD_AXIS EGRVlv_tActr Temp_Cels 25 -3549.940 3003.560 FORMAT "%8.3" DEPOSIT ABSOLUTE /end AXIS_DESCR
/end CHARACTERISTIC
/begin CHARACTERISTIC EGRVlv_trqMotCnvn_CUR "Motor torque curve" CURVE 0x805906D0 RB_Curve_S16_S16 65535.00 q1_Ncm -32768.00 32767.00 FORMAT "%8.2"
 /begin AXIS_DESCR STD_AXIS EGRVlv_rActr Prc 25 -400.0000 399.9878 FORMAT "%8.4" DEPOSIT ABSOLUTE /end AXIS_DESCR
/end CHARACTERISTIC
/begin MEASUREMENT EGRVlv_cntrEepReadFail "Failed EEP read counter" UBYTE OneToOne 1 100 0.00 255.0 FORMAT "%5.1" ECU_ADDRESS 0x60039146 /end MEASUREMENT
/begin MEASUREMENT EGRVlv_ctGovrDeMonDSMClr "Function specific variable for DSM clear counter" UBYTE OneToOne 1 100 0.00 255.0 FORMAT "%5.1" ECU_ADDRESS 0x6000F45D /end MEASUREMENT
/begin MEASUREMENT EGRVlv_ctGovrDeMonDSMClrOld "Function specific variable for dsm clear counter old" UBYTE OneToOne 1 100 0.00 255.0 FORMAT "%5.1" ECU_ADDRESS 0x6000B217 /end MEASUREMENT
/begin MEASUREMENT EGRVlv_ctGovrDemonReIni "Function specific variable for global drive cycle counter" UBYTE OneToOne 1 100 0.00 255.0 FORMAT "%5.1" ECU_ADDRESS 0x7000371A /end MEASUREMENT
/begin MEASUREMENT EGRVlv_ctVdSnsrReIni "Function specific variable for global drive cycle counter" UBYTE OneToOne 1 100 0.00 255.0 FORMAT "%5.1" ECU_ADDRESS 0x70003719 /end MEASUREMENT
/begin MEASUREMENT EGRVlv_dHtArmtrExtn "Heat dissipated in armature windings range extend" SLONG Pwr_q0p01_COMPU 1 100 -21474836.4800 21474836.4700 FORMAT "%13.4" ECU_ADDRESS 0x60003974 /end MEASUREMENT
/begin MEASUREMENT EGRVlv_dHtArmtr_mp "Heat dissipated in armature windings" SWORD Pwr_q0p01_COMPU 1 100 -327.6800 327.6700 FORMAT "%8.4" ECU_ADDRESS 0x70009D4A /end MEASUREMENT
/begin MEASUREMENT EGRVlv_dpDsbc "Average rate of change of disturbance pressure" SWORD dPres_hPa_p_s 1 100 -32768.00 32767.00 FORMAT "%8.2" ECU_ADDRESS 0x600095B2 /end MEASUREMENT
/begin MEASUREMENT EGRVlv_drDesVal "gradient of desired position" SWORD VlvVel 1 100 -4000.000 3999.878 FORMAT "%8.3" ECU_ADDRESS 0x600095B0 /end MEASUREMENT
/begin MEASUREMENT EGRVlv_drDesValFlt "Filtered gradient of desired position" SWORD VlvVel 1 100 -4000.000 3999.878 FORMAT "%8.3" ECU_ADDRESS 0x600095AE /end MEASUREMENT
/begin MEASUREMENT EGRVlv_drFildHysDesVal_mp "Rate of change of desired value" SWORD PrcSec 1 100 -400.0000 399.9878 FORMAT "%8.4" ECU_ADDRESS 0x70009D48 /end MEASUREMENT
/begin MEASUREMENT EGRVlv_drGovDvt "control deviation" SWORD VlvVel 1 100 -4000.000 3999.878 FORMAT "%8.3" ECU_ADDRESS 0x600095AC /end MEASUREMENT
/begin MEASUREMENT EGRVlv_duMotSpd "Actuator dc motor speed" SWORD q10_mV_DIV_s 1 100 -327680.0 327670.0 FORMAT "%8.1" ECU_ADDRESS 0x60007348 /end MEASUREMENT
/begin MEASUREMENT EGRVlv_facCorFlt "Message for battery correction factor for single flow implementation." SWORD Fact 1 100 -4.000000 3.999878 FORMAT "%8.6" ECU_ADDRESS 0x600095A6 /end MEASUREMENT
/begin MEASUREMENT EGRVlv_facGear_mp "Current gear factor" SWORD Fact100 1 100 -327.6800 327.6700 FORMAT "%8.4" ECU_ADDRESS 0x70009D46 /end MEASUREMENT
/begin MEASUREMENT EGRVlv_facKd_mp "Gain for Differentiator" SWORD Fact 1 100 -4.000000 3.999878 FORMAT "%8.6" ECU_ADDRESS 0x70009D44 /end MEASUREMENT
/begin MEASUREMENT EGRVlv_facKi_mp "Gain for Integrator" SWORD Fact 1 100 -4.000000 3.999878 FORMAT "%8.6" ECU_ADDRESS 0x70009D42 /end MEASUREMENT
/begin MEASUREMENT EGRVlv_facKp_mp "Gain for P-Part" SWORD Fact 1 100 -4.000000 3.999878 FORMAT "%8.6" ECU_ADDRESS 0x70009D40 /end MEASUREMENT
/begin MEASUREMENT EGRVlv_FirCalc.cntrAvrgZr " / Counter for 0-division in FIR (indicates failure)" UBYTE OneToOne 1 100 0.00 255.0 FORMAT "%5.1" ECU_ADDRESS 0x5000549A /end MEASUREMENT
/begin MEASUREMENT EGRVlv_FirCalc.flgRdDne " / FIR: reading from uRaw-sum done" UBYTE OneToOne 1 100 0.00 1.000 BIT_MASK 0x1 FORMAT "%5.3" ECU_ADDRESS 0x5000549B /end MEASUREMENT
/begin MEASUREMENT EGRVlv_FirCalc.uRawAvrg " / FIR: simple average calculated uRaw" SWORD Volt 1 100 -6553.600 6553.400 FORMAT "%8.3" ECU_ADDRESS 0x5000549C /end MEASUREMENT
/begin MEASUREMENT EGRVlv_FirCalc.uRawFir " / FIR: Calculated uRaw" SWORD Volt 1 100 -6553.600 6553.400 FORMAT "%8.3" ECU_ADDRESS 0x5000549E /end MEASUREMENT
/begin MEASUREMENT EGRVlv_FirRead.cntr " / Counter for simple average FIR" UBYTE OneToOne 1 100 0.00 255.0 FORMAT "%5.1" ECU_ADDRESS 0x5000149C /end MEASUREMENT
/begin MEASUREMENT EGRVlv_FirRead.flgFirstRun " / FIR: 1st run after init" UBYTE OneToOne 1 100 0.00 1.000 BIT_MASK 0x1 FORMAT "%5.3" ECU_ADDRESS 0x5000149D /end MEASUREMENT
/begin MEASUREMENT EGRVlv_FirRead.idxArr " / FIR ringbuffer: actual index" UBYTE OneToOne 1 100 0.00 255.0 FORMAT "%5.1" ECU_ADDRESS 0x5000149E /end MEASUREMENT
/begin MEASUREMENT EGRVlv_FirRead.uSum " / Simple average FIR: sum of uRaws" SLONG Volt 1 100 -429496729.600 429496729.400 FORMAT "%13.3" ECU_ADDRESS 0x500014A0 /end MEASUREMENT
/begin MEASUREMENT EGRVlv_flgTrlPtrLrnEepReadErr "EEP read error at position sensor raw value trailing pointer" UBYTE B_TRUE 1 100 0.00 1.00000000000 BIT_MASK 0x1 FORMAT "%13.11" ECU_ADDRESS 0x70003624 /end MEASUREMENT
/begin MEASUREMENT EGRVlv_HystComp2.BattU_uMapInp "Hystersis compensation Class / Battery voltage for hysteresis compensation" SWORD Volt_Batt 1 100 -655360.0 655340.0 FORMAT "%8.1" ECU_ADDRESS 0x60002F30 /end MEASUREMENT
/begin MEASUREMENT EGRVlv_HystComp2.bDesValSwt_mp "Hystersis compensation Class / status of switch in desired value direction for hysteresis compensation" UBYTE OneToOne 1 100 0.00 1.000 BIT_MASK 0x1 FORMAT "%5.3" ECU_ADDRESS 0x7000A2DC /end MEASUREMENT
/begin MEASUREMENT EGRVlv_HystComp2.bGovrDeHys_mp "Hystersis compensation Class / status of switch in governor output direction for hysteresis compensation" UBYTE OneToOne 1 100 0.00 1.000 BIT_MASK 0x1 FORMAT "%5.3" ECU_ADDRESS 0x7000A2DD /end MEASUREMENT
/begin MEASUREMENT EGRVlv_HystComp2.bPreCtlSwt_mp "Hystersis compensation Class / status of pre control switch for hysteresis compensation" UBYTE OneToOne 1 100 0.00 1.000 BIT_MASK 0x1 FORMAT "%5.3" ECU_ADDRESS 0x7000A2DE /end MEASUREMENT
/begin MEASUREMENT EGRVlv_HystComp2.numPreCtlTempCurInp "Hystersis compensation Class / Precontrol temperature for hysteresis compensation" SWORD Temp_Cels 1 100 -3549.940 3003.560 FORMAT "%8.3" ECU_ADDRESS 0x60002F38 /end MEASUREMENT
/begin MEASUREMENT EGRVlv_HystComp2.pDsbcMapInp "Hystersis compensation Class / Disturbance pressure for hysteresis compensation" SWORD Pres_hPa 1 100 -32768.00 32767.00 FORMAT "%8.2" ECU_ADDRESS 0x60002F3A /end MEASUREMENT
/begin MEASUREMENT EGRVlv_HystComp2.rPreCtlVal2_mp "Hystersis compensation Class / precontrol value" SWORD Prc 1 100 -400.0000 399.9878 FORMAT "%8.4" ECU_ADDRESS 0x7000A2E0 /end MEASUREMENT
/begin MEASUREMENT EGRVlv_HystComp2.rPreCtlValMapInp "Hystersis compensation Class / Precontrol value for hysteresis compensation" SWORD Prc 1 100 -400.0000 399.9878 FORMAT "%8.4" ECU_ADDRESS 0x60002F3C /end MEASUREMENT
/begin MEASUREMENT EGRVlv_iEff "Unfiltered effective current" SWORD Curr_A_q0p03125_COMPU 1 100 -1024.000 1023.969 FORMAT "%8.3" ECU_ADDRESS 0x60007346 /end MEASUREMENT
/begin MEASUREMENT EGRVlv_iEffMdlFlt "Filtered value of modelled current" SWORD Curr_A_q0p03125_COMPU 1 100 -1024.000 1023.969 FORMAT "%8.3" ECU_ADDRESS 0x600095A4 /end MEASUREMENT
/begin MEASUREMENT EGRVlv_numCntBrk "Number of cycles since brake active" SBYTE OneToOne 1 100 -128.0 127.0 FORMAT "%5.1" ECU_ADDRESS 0x6000F8AC /end MEASUREMENT
/begin MEASUREMENT EGRVlv_numReaMechBnd "Total number of reached mechanical endstops" ULONG OneToOne 1 100 0.00 4294967295.00 FORMAT "%13.2" ECU_ADDRESS 0x60003A7C /end MEASUREMENT
/begin MEASUREMENT EGRVlv_numRepActvn_mp "Number of repeated reactivation" UBYTE OneToOne 1 100 0.00 255.0 FORMAT "%5.1" ECU_ADDRESS 0x6000B214 /end MEASUREMENT
/begin MEASUREMENT EGRVlv_OfsLearn.d_mp "Offset learning calculation class / Offset(d) of the sensor curve (y=kx+d)" FLOAT32_IEEE Pos_Prc_float 1 100 -1.00000000E+037 1.00000000E+037 FORMAT "%13.3" ECU_ADDRESS 0x7000A2CC /end MEASUREMENT
/begin MEASUREMENT EGRVlv_OfsLearn.k_mp "Offset learning calculation class / Slope(k) of the sensor curve (y=kx+d)" SLONG q9p313226Em10_Perc_DIV_mV 1 100 -2.00000000000 1.99999999907 FORMAT "%13.11" ECU_ADDRESS 0x7000A2D0 /end MEASUREMENT
/begin MEASUREMENT EGRVlv_OfsLearn.uRelPosClsdLrnFst_mp "Offset learning calculation class / First learned closed position" SWORD Volt 1 100 -6553.600 6553.400 FORMAT "%8.3" ECU_ADDRESS 0x7000A2D4 /end MEASUREMENT
/begin MEASUREMENT EGRVlv_OfsLearn.uRelPosClsdLrnLst_mp "Offset learning calculation class / Last learned closed position" SWORD Volt 1 100 -6553.600 6553.400 FORMAT "%8.3" ECU_ADDRESS 0x7000A2D6 /end MEASUREMENT
/begin MEASUREMENT EGRVlv_OfsLearn.uRelPosOpnLrnFst_mp "Offset learning calculation class / First learned open position" SWORD Volt 1 100 -6553.600 6553.400 FORMAT "%8.3" ECU_ADDRESS 0x7000A2D8 /end MEASUREMENT
/begin MEASUREMENT EGRVlv_OfsLearn.uRelPosOpnLrnLst_mp "Offset learning calculation class / Last learned closed position" SWORD Volt 1 100 -6553.600 6553.400 FORMAT "%8.3" ECU_ADDRESS 0x7000A2DA /end MEASUREMENT
/begin MEASUREMENT EGRVlv_OfsLearnCal.locvar "Offset learning calculation Calibration structure / dummy variable" SWORD InjMass 1 100 -327.6800 327.6700 FORMAT "%8.4" ECU_ADDRESS 0x500054A0 /end MEASUREMENT
/begin MEASUREMENT EGRVlv_OfsLearnCal.tOfsAdjuTempOfsAdjClsdCurInp "Offset learning calculation Calibration structure / Bestmögliche Temperatur des Stellers" SWORD Temp_Cels 1 100 -3549.940 3003.560 FORMAT "%8.3" ECU_ADDRESS 0x500054A2 /end MEASUREMENT
/begin MEASUREMENT EGRVlv_OfsLearnCal.tOfsAdjuTempOfsAdjOpnCurInp "Offset learning calculation Calibration structure / Bestmögliche Temperatur des Stellers" SWORD Temp_Cels 1 100 -3549.940 3003.560 FORMAT "%8.3" ECU_ADDRESS 0x500054A4 /end MEASUREMENT
/begin MEASUREMENT EGRVlv_pDsbc "disturbance pressure" SWORD Pres_hPa 1 100 -32768.00 32767.00 FORMAT "%8.2" ECU_ADDRESS 0x600095A2 /end MEASUREMENT
/begin MEASUREMENT EGRVlv_pDsbc_mp "Input of disturbance pressure compensation" SWORD Pres_hPa 1 100 -32768.00 32767.00 FORMAT "%8.2" ECU_ADDRESS 0x70009D3E /end MEASUREMENT
/begin MEASUREMENT EGRVlv_rAbsActr_mp "Absolute value of controller output" SWORD Prc 1 100 -400.0000 399.9878 FORMAT "%8.4" ECU_ADDRESS 0x70009D3C /end MEASUREMENT
/begin MEASUREMENT EGRVlv_rAct "" SWORD Prc 1 100 -400.0000 399.9878 FORMAT "%8.4" ECU_ADDRESS 0x70003C02 /end MEASUREMENT
/begin MEASUREMENT EGRVlv_rActInv "Actuatorposition inverted (100% - rAct)" SWORD Prc 1 100 -400.0000 399.9878 FORMAT "%8.4" ECU_ADDRESS 0x6000959E /end MEASUREMENT
/begin MEASUREMENT EGRVlv_rActOld "Previous Actuatorposition" SWORD Prc 1 100 -400.0000 399.9878 FORMAT "%8.4" ECU_ADDRESS 0x70003C00 /end MEASUREMENT
/begin MEASUREMENT EGRVlv_rActSign "Actuatorposition full range" SWORD Prc 1 100 -400.0000 399.9878 FORMAT "%8.4" ECU_ADDRESS 0x70003BFE /end MEASUREMENT
/begin MEASUREMENT EGRVlv_rActTrans "Actuator position calculated from transtage" SWORD Prc 1 100 -400.0000 399.9878 FORMAT "%8.4" ECU_ADDRESS 0x6000959A /end MEASUREMENT
/begin MEASUREMENT EGRVlv_rActTrans_Sq "Signal quality for actuator position calculated from transtage" UBYTE SigQly_COMPU_VERB 1 100 0.00 15.0000000000 FORMAT "%13.10" ECU_ADDRESS 0x6000F860 /end MEASUREMENT
/begin MEASUREMENT EGRVlv_rAct_Sq "Signal quality of position feedback" UBYTE SigQly_COMPU_VERB 1 100 0.00 15.0000000000 FORMAT "%13.10" ECU_ADDRESS 0x70003718 /end MEASUREMENT
/begin MEASUREMENT EGRVlv_rCurIn "Input based on rAct or desired value or govdesval for the calculation of weight of the gain parameter for PID governor" SWORD Prc 1 100 -400.0000 399.9878 FORMAT "%8.4" ECU_ADDRESS 0x60009590 /end MEASUREMENT
/begin MEASUREMENT EGRVlv_rDesValFild "Filtered position setpoint" SWORD Prc 1 100 -400.0000 399.9878 FORMAT "%8.4" ECU_ADDRESS 0x70003BFA /end MEASUREMENT
/begin MEASUREMENT EGRVlv_rDesValFltMon "PT1 filtered desired position" SWORD Prc 1 100 -400.0000 399.9878 FORMAT "%8.4" ECU_ADDRESS 0x60007344 /end MEASUREMENT
/begin MEASUREMENT EGRVlv_rDesValHystFild_mp "Filtered desired value for Hystersis compensatio functionality" SWORD Prc 1 100 -400.0000 399.9878 FORMAT "%8.4" ECU_ADDRESS 0x70009D3A /end MEASUREMENT
/begin MEASUREMENT EGRVlv_rDesValTrlPtr "Setpoint trailing pointer from current driving cycle" SWORD Prc 1 100 -400.0000 399.9878 FORMAT "%8.4" ECU_ADDRESS 0x70003BF8 /end MEASUREMENT
/begin MEASUREMENT EGRVlv_rDesValTrlPtrLrnLst "Last learned position setpoint trailing pointer" SWORD Prc 1 100 -400.0000 399.9878 FORMAT "%8.4" ECU_ADDRESS 0x70003BF6 /end MEASUREMENT
/begin MEASUREMENT EGRVlv_rDesValTrlPtrLrnLstEepRead "Last learned position setpoint trailing pointer read from EEP" SWORD Prc 1 100 -400.0000 399.9878 FORMAT "%8.4" ECU_ADDRESS 0x70003BF4 /end MEASUREMENT
/begin MEASUREMENT EGRVlv_rDrftClsd "Actuator drift in ratio at closed position" SWORD Prc 1 100 -400.0000 399.9878 FORMAT "%8.4" ECU_ADDRESS 0x60009588 /end MEASUREMENT
/begin MEASUREMENT EGRVlv_rDrftOpn "Actuator drift in ratio at opened position" SWORD Prc 1 100 -400.0000 399.9878 FORMAT "%8.4" ECU_ADDRESS 0x60009586 /end MEASUREMENT
/begin MEASUREMENT EGRVlv_rEMFComp "Duty cycle for back electromotive force (EMF) compensation." SWORD Prc 1 100 -400.0000 399.9878 FORMAT "%8.4" ECU_ADDRESS 0x60009584 /end MEASUREMENT
/begin MEASUREMENT EGRVlv_rFricGovrInp "Part of Friction compensation calculated for governor" SWORD Prc 1 100 -400.0000 399.9878 FORMAT "%8.4" ECU_ADDRESS 0x60009580 /end MEASUREMENT
/begin MEASUREMENT EGRVlv_rGovDesLimMax "Maximum governor desired value for enabling governor monitoring" SWORD Prc 1 100 -400.0000 399.9878 FORMAT "%8.4" ECU_ADDRESS 0x6000957C /end MEASUREMENT
/begin MEASUREMENT EGRVlv_rGovDesLimMin "Minimum governor desired value for enabling governor monitoring" SWORD Prc 1 100 -400.0000 399.9878 FORMAT "%8.4" ECU_ADDRESS 0x6000957A /end MEASUREMENT
/begin MEASUREMENT EGRVlv_rGovDesVal "Internal desired value for governor" SWORD Prc 1 100 -400.0000 399.9878 FORMAT "%8.4" ECU_ADDRESS 0x60009578 /end MEASUREMENT
/begin MEASUREMENT EGRVlv_rGovDesValInv "Inverted internal desired value for governor" SWORD Prc 1 100 -400.0000 399.9878 FORMAT "%8.4" ECU_ADDRESS 0x60009576 /end MEASUREMENT
/begin MEASUREMENT EGRVlv_rGovDesValMon "Internal desired value for governor" SWORD Prc 1 100 -400.0000 399.9878 FORMAT "%8.4" ECU_ADDRESS 0x600091EC /end MEASUREMENT
/begin MEASUREMENT EGRVlv_rGovDvtFltMon "Governor deviation calculated with PT1-filtered desired value" SWORD Prc 1 100 -400.0000 399.9878 FORMAT "%8.4" ECU_ADDRESS 0x60007342 /end MEASUREMENT
/begin MEASUREMENT EGRVlv_rGovLimEffMax "Governor Maximum limitation ratio" SWORD Prc 1 100 -400.0000 399.9878 FORMAT "%8.4" ECU_ADDRESS 0x60009570 /end MEASUREMENT
/begin MEASUREMENT EGRVlv_rGovrMaxInp "Part of Governor maximum limitation calculated from governor input EGRVlv" SWORD Prc 1 100 -400.0000 399.9878 FORMAT "%8.4" ECU_ADDRESS 0x60009566 /end MEASUREMENT
/begin MEASUREMENT EGRVlv_rGovrMinInp "Part of Governor minimum limitation calculated from governor input EGRVlv" SWORD Prc 1 100 -400.0000 399.9878 FORMAT "%8.4" ECU_ADDRESS 0x60009564 /end MEASUREMENT
/begin MEASUREMENT EGRVlv_rHysCmpGovrInp "Part of Hysteresis compensation calculated for governor" SWORD Prc 1 100 -400.0000 399.9878 FORMAT "%8.4" ECU_ADDRESS 0x60009562 /end MEASUREMENT
/begin MEASUREMENT EGRVlv_rPreCtl2HystIn_mp "Input for Hystersis compensation maps" SWORD Prc 1 100 -400.0000 399.9878 FORMAT "%8.4" ECU_ADDRESS 0x70009D38 /end MEASUREMENT
/begin MEASUREMENT EGRVlv_rPreCtl2MapIn_mp "Input for rPreCtl2_MAP" SWORD Prc 1 100 -400.0000 399.9878 FORMAT "%8.4" ECU_ADDRESS 0x70009D36 /end MEASUREMENT
/begin MEASUREMENT EGRVlv_rPreCtlCurIn_mp "Input for rPreCtl_MAP" SWORD Prc 1 100 -400.0000 399.9878 FORMAT "%8.4" ECU_ADDRESS 0x70009D34 /end MEASUREMENT
/begin MEASUREMENT EGRVlv_rPreCtlVal "Precontrol value to the governor" SWORD Prc 1 100 -400.0000 399.9878 FORMAT "%8.4" ECU_ADDRESS 0x60009556 /end MEASUREMENT
/begin MEASUREMENT EGRVlv_rPreCtlVal1_mp "Precontrol value 1 to the governor" SWORD Prc 1 100 -400.0000 399.9878 FORMAT "%8.4" ECU_ADDRESS 0x70003062 /end MEASUREMENT
/begin MEASUREMENT EGRVlv_rPreCtlVal2_mp "Precontrol value 2 to the governor" SWORD Prc 1 100 -400.0000 399.9878 FORMAT "%8.4" ECU_ADDRESS 0x70003060 /end MEASUREMENT
/begin MEASUREMENT EGRVlv_rRmpDesVal_mp "Output of ramp function" SWORD Prc 1 100 -400.0000 399.9878 FORMAT "%8.4" ECU_ADDRESS 0x70009D32 /end MEASUREMENT
/begin MEASUREMENT EGRVlv_rSens "" SWORD Prc 1 100 -400.0000 399.9878 FORMAT "%8.4" ECU_ADDRESS 0x70003BE4 /end MEASUREMENT
/begin MEASUREMENT EGRVlv_rTransfCur "Sensor Curve" FLOAT32_IEEE OneToOne 1 100 -1.00000000E+037 1.00000000E+037 FORMAT "%13.3" ARRAY_SIZE 4 ECU_ADDRESS 0x50004E5C /end MEASUREMENT
/begin MEASUREMENT EGRVlv_stActrROM "Permanently stored actuator status (EEPROM)" UBYTE OneToOne 1 100 0.00 255.0 FORMAT "%5.1" ECU_ADDRESS 0x6000F85B /end MEASUREMENT
/begin MEASUREMENT EGRVlv_stCSERSActv "" UBYTE OneToOne 1 100 0.00 255.0 BIT_MASK 0x1 FORMAT "%5.1" ECU_ADDRESS 0x6000F145 /end MEASUREMENT
/begin MEASUREMENT EGRVlv_stEnhdGovrDeMon "Enhanced Governor deviation status." UBYTE OneToOne 1 100 0.00 255.0 FORMAT "%5.1" ECU_ADDRESS 0x6000F459 /end MEASUREMENT
/begin MEASUREMENT EGRVlv_stErrTrans "error status of the position sensor from transtage" UBYTE OneToOne 1 100 0.00 255.0 FORMAT "%5.1" ECU_ADDRESS 0x6000F856 /end MEASUREMENT
/begin MEASUREMENT EGRVlv_stGovrMonEnaCdn "Status of governor monitoring enable conditions" UBYTE OneToOne 1 100 0.00 255.0 FORMAT "%5.1" ECU_ADDRESS 0x6000B216 /end MEASUREMENT
/begin MEASUREMENT EGRVlv_stHealActv "Status of Healing" UBYTE OneToOne 1 100 0.00 255.0 BIT_MASK 0x1 FORMAT "%5.1" ECU_ADDRESS 0x6000B215 /end MEASUREMENT
/begin MEASUREMENT EGRVlv_stIniI "status of system monitoring" UWORD OneToOne 1 100 0.00 65535.00 FORMAT "%8.2" ECU_ADDRESS 0x600094CE /end MEASUREMENT
/begin MEASUREMENT EGRVlv_stIninEep "" UBYTE OneToOne 1 100 0.00 255.0 BIT_MASK 0x1 FORMAT "%5.1" ECU_ADDRESS 0x70003620 /end MEASUREMENT
/begin MEASUREMENT EGRVlv_stMaxEndStopRstCfg "Conditions for resetting the maximum-position mechanical endstop" UBYTE OneToOne 1 100 0.00 255.0 FORMAT "%5.1" ECU_ADDRESS 0x70003715 /end MEASUREMENT
/begin MEASUREMENT EGRVlv_stMaxEndStopSetCfg "Conditions for setting the maximum-position mechanical endstop" UBYTE OneToOne 1 100 0.00 255.0 FORMAT "%5.1" ECU_ADDRESS 0x70003714 /end MEASUREMENT
/begin MEASUREMENT EGRVlv_stMinEndStopRstCfg "Conditions for resetting the minimum-position mechanical endstop" UBYTE OneToOne 1 100 0.00 255.0 FORMAT "%5.1" ECU_ADDRESS 0x70003713 /end MEASUREMENT
/begin MEASUREMENT EGRVlv_stMinEndStopSetCfg "Conditions for setting the minimum-position mechanical endstop" UBYTE OneToOne 1 100 0.00 255.0 FORMAT "%5.1" ECU_ADDRESS 0x70003712 /end MEASUREMENT
/begin MEASUREMENT EGRVlv_stMon2 "status of system monitoring" ULONG OneToOne 1 100 0.00 4294967295.00 FORMAT "%13.2" ECU_ADDRESS 0x50004E70 /end MEASUREMENT
/begin MEASUREMENT EGRVlv_stMonGovrDe "Status of Governor Deviation Monitoring" ULONG OneToOne 1 100 0.00 4294967295.00 FORMAT "%13.2" ECU_ADDRESS 0x600038BC /end MEASUREMENT
/begin MEASUREMENT EGRVlv_stMonVdSens "status of system monitoring" ULONG OneToOne 1 100 0.00 4294967295.00 FORMAT "%13.2" ECU_ADDRESS 0x50004E7C /end MEASUREMENT
/begin MEASUREMENT EGRVlv_stOfsLrnEnvCond "state of environmental condition for offset learning" UWORD OneToOne 1 100 0.00 65535.00 FORMAT "%8.2" ECU_ADDRESS 0x600094CA /end MEASUREMENT
/begin MEASUREMENT EGRVlv_stSnsrPhyCnvnPT1Ini "Status for PT1 initialization" UBYTE B_TRUE 1 100 0.00 1.00000000000 BIT_MASK 0x1 FORMAT "%13.11" ECU_ADDRESS 0x7000305A /end MEASUREMENT
/begin MEASUREMENT EGRVlv_stVltgInctReqInhb_mp "Status of Voltage Increment Request Inhibition" UBYTE OneToOne 1 100 0.00 255.0 FORMAT "%5.1" ECU_ADDRESS 0x70009FBA /end MEASUREMENT
/begin MEASUREMENT EGRVlv_stVltgReq "Status of Voltage Request" UBYTE OneToOne 1 100 0.00 255.0 FORMAT "%5.1" ECU_ADDRESS 0x6000F852 /end MEASUREMENT
/begin MEASUREMENT EGRVlv_swtConfStcFctActrC "Internal configuration switch for actuator statistic functions" UBYTE OneToOne 1 100 0.00 255.0 FORMAT "%5.1" ECU_ADDRESS 0x7000370E /end MEASUREMENT
/begin MEASUREMENT EGRVlv_tActr "Actuator temperature" SWORD Temp_Cels 1 100 -3549.940 3003.560 FORMAT "%8.3" ECU_ADDRESS 0x60009552 /end MEASUREMENT
/begin MEASUREMENT EGRVlv_tArmtr "Modelled DC motor armature temperature" SWORD Temp_Cels 1 100 -3549.940 3003.560 FORMAT "%8.3" ECU_ADDRESS 0x60009550 /end MEASUREMENT
/begin MEASUREMENT EGRVlv_tArmtrFlt_mp "Filtered armature temperature of the actuator" SWORD Temp_Cels 1 100 -3549.940 3003.560 FORMAT "%8.3" ECU_ADDRESS 0x70009D30 /end MEASUREMENT
/begin MEASUREMENT EGRVlv_tColdStrt "PT1 filtered desired position" SWORD Temp_Cels 1 100 -3549.940 3003.560 FORMAT "%8.3" ECU_ADDRESS 0x60007340 /end MEASUREMENT
/begin MEASUREMENT EGRVlv_tEngColdStrt "PT1 filtered desired position" SWORD Temp_Cels 1 100 -3549.940 3003.560 FORMAT "%8.3" ECU_ADDRESS 0x6000733E /end MEASUREMENT
/begin MEASUREMENT EGRVlv_tiActrAdpClsd "Time between successful offset learns at closed position." UWORD Time_s 1 100 0.00 655.3500 FORMAT "%8.4" ECU_ADDRESS 0x600094C6 /end MEASUREMENT
/begin MEASUREMENT EGRVlv_tiActrAdpOpn "Time between successful offset learns at open position." UWORD Time_s 1 100 0.00 655.3500 FORMAT "%8.4" ECU_ADDRESS 0x600094C4 /end MEASUREMENT
/begin MEASUREMENT EGRVlv_tiCrntEffLpFltPar "Value of PT1 filter constant" SLONG Time_s 1 100 -21474836.4800 21474836.4700 FORMAT "%13.4" ECU_ADDRESS 0x7000305C /end MEASUREMENT
/begin MEASUREMENT EGRVlv_tOfsAdj "Best possible Temperature of the Actuator" SWORD Temp_Cels 1 100 -3549.940 3003.560 FORMAT "%8.3" ECU_ADDRESS 0x6000954A /end MEASUREMENT
/begin MEASUREMENT EGRVlv_tOfsAdjLstLrnClsd "Best possible Temperature of the Actuator during learning at closed position (EEPROM)" SWORD Temp_Cels 1 100 -3549.940 3003.560 FORMAT "%8.3" ECU_ADDRESS 0x60009548 /end MEASUREMENT
/begin MEASUREMENT EGRVlv_tOfsAdjLstLrnOpn "Best possible Temperature of the Actuator during learning at open position(EEPROM)" SWORD Temp_Cels 1 100 -3549.940 3003.560 FORMAT "%8.3" ECU_ADDRESS 0x60009546 /end MEASUREMENT
/begin MEASUREMENT EGRVlv_trqActrVal "Actuator torque" SWORD q1_Ncm 1 100 -32768.00 32767.00 FORMAT "%8.2" ECU_ADDRESS 0x60009542 /end MEASUREMENT
/begin MEASUREMENT EGRVlv_trqMotVal_mp "Current motor torque" SWORD q1_Ncm 1 100 -32768.00 32767.00 FORMAT "%8.2" ECU_ADDRESS 0x70009D2E /end MEASUREMENT
/begin MEASUREMENT EGRVlv_uDrftClsd "Actuator drift in Voltage at closed position" SWORD Volt 1 100 -6553.600 6553.400 FORMAT "%8.3" ECU_ADDRESS 0x60009540 /end MEASUREMENT
/begin MEASUREMENT EGRVlv_uDrftOpn "Actuator drift in Voltage at opened position" SWORD Volt 1 100 -6553.600 6553.400 FORMAT "%8.3" ECU_ADDRESS 0x6000953E /end MEASUREMENT
/begin MEASUREMENT EGRVlv_uEffVltg_mp "Effective voltage accross armature windings" SWORD Volt_Batt 1 100 -655360.0 655340.0 FORMAT "%8.1" ECU_ADDRESS 0x70009D2C /end MEASUREMENT
/begin MEASUREMENT EGRVlv_uOffsClsd "Mechanical to electrical gap at closed position" SWORD Volt 1 100 -6553.600 6553.400 FORMAT "%8.3" ECU_ADDRESS 0x6000953C /end MEASUREMENT
/begin MEASUREMENT EGRVlv_uOffsOpn "Mechanical to electrical gap at open position" SWORD Volt 1 100 -6553.600 6553.400 FORMAT "%8.3" ECU_ADDRESS 0x6000953A /end MEASUREMENT
/begin MEASUREMENT EGRVlv_uRaw "Raw voltage value of position sensor" SWORD Volt 1 100 -6553.600 6553.400 FORMAT "%8.3" ECU_ADDRESS 0x70003BDE /end MEASUREMENT
/begin MEASUREMENT EGRVlv_uRawAvrg "average filtered raw voltage value of position sensor" SWORD Volt 1 100 -6553.600 6553.400 FORMAT "%8.3" ECU_ADDRESS 0x70003BDC /end MEASUREMENT
/begin MEASUREMENT EGRVlv_uRawDesValTrlPtrLrnLst "Raw voltage of last learned position setpoint trailing pointer" SWORD Volt 1 100 -6553.600 6553.400 FORMAT "%8.3" ECU_ADDRESS 0x70003BDA /end MEASUREMENT
/begin MEASUREMENT EGRVlv_uRawSeld "selected raw value" SWORD Volt 1 100 -6553.600 6553.400 FORMAT "%8.3" ECU_ADDRESS 0x70003058 /end MEASUREMENT
/begin MEASUREMENT EGRVlv_uRawTrlPtr "Position sensor raw voltage trailing pointer from current driving cycle" SWORD Volt 1 100 -6553.600 6553.400 FORMAT "%8.3" ECU_ADDRESS 0x70003BD8 /end MEASUREMENT
/begin MEASUREMENT EGRVlv_uRawTrlPtrLrnLst "Last learned position sensor raw voltage trailing pointer" SWORD Volt 1 100 -6553.600 6553.400 FORMAT "%8.3" ECU_ADDRESS 0x70003BD6 /end MEASUREMENT
/begin MEASUREMENT EGRVlv_uRawTrlPtrLrnLstEepRead "Last learned position sensor raw voltage trailing pointer read from EEP" SWORD Volt 1 100 -6553.600 6553.400 FORMAT "%8.3" ECU_ADDRESS 0x70003BD4 /end MEASUREMENT
/begin MEASUREMENT EGRVlv_uRawUnFltd "Raw voltage value of position sensor unfiltered" SWORD Volt 1 100 -6553.600 6553.400 FORMAT "%8.3" ECU_ADDRESS 0x70003BD2 /end MEASUREMENT
/begin MEASUREMENT EGRVlv_uRelPosClsd "Learned raw voltage value at closed position for sensor curve calculation" SWORD Volt 1 100 -6553.600 6553.400 FORMAT "%8.3" ECU_ADDRESS 0x60009536 /end MEASUREMENT
/begin MEASUREMENT EGRVlv_uRelPosClsdElecRaw "Closed learned value electrical raw" SWORD Volt 1 100 -6553.600 6553.400 FORMAT "%8.3" ECU_ADDRESS 0x600091E8 /end MEASUREMENT
/begin MEASUREMENT EGRVlv_uRelPosClsdLrnFst "First learned value at closed position (EEPROM)" SWORD Volt 1 100 -6553.600 6553.400 FORMAT "%8.3" ECU_ADDRESS 0x60009534 /end MEASUREMENT
/begin MEASUREMENT EGRVlv_uRelPosClsdLrnLst "Last learned value at closed position" SWORD Volt 1 100 -6553.600 6553.400 FORMAT "%8.3" ECU_ADDRESS 0x60009532 /end MEASUREMENT
/begin MEASUREMENT EGRVlv_uRelPosClsdMax "Maximum / Minimun learned raw voltage value at closed position" SWORD spg_q0p01_V 1 100 -327.6800 327.6700 FORMAT "%8.4" ECU_ADDRESS 0x60009530 /end MEASUREMENT
/begin MEASUREMENT EGRVlv_uRelPosClsdMaxRom "Maximum / Minimun learned raw voltage value at closed position (EEPROM)" SWORD Volt 1 100 -6553.600 6553.400 FORMAT "%8.3" ECU_ADDRESS 0x60000692 /end MEASUREMENT
/begin MEASUREMENT EGRVlv_uRelPosClsdRaw "Closed learned value raw" SWORD Volt 1 100 -6553.600 6553.400 FORMAT "%8.3" ECU_ADDRESS 0x600091E6 /end MEASUREMENT
/begin MEASUREMENT EGRVlv_uRelPosClsdRom "Learned raw voltage value at closed position for sensor curve calculation (EEPROM)" SWORD Volt 1 100 -6553.600 6553.400 FORMAT "%8.3" ECU_ADDRESS 0x6000069A /end MEASUREMENT
/begin MEASUREMENT EGRVlv_uRelPosnClsdLrn "Learned raw voltage value at closed position" SWORD Volt 1 100 -6553.600 6553.400 FORMAT "%8.3" ECU_ADDRESS 0x60009528 /end MEASUREMENT
/begin MEASUREMENT EGRVlv_uRelPosnElecClsdLrn "closed electrical endstop" SWORD Volt 1 100 -6553.600 6553.400 FORMAT "%8.3" ECU_ADDRESS 0x600091E4 /end MEASUREMENT
/begin MEASUREMENT EGRVlv_uRelPosnElecOpnLrn "open electrical endstop" SWORD Volt 1 100 -6553.600 6553.400 FORMAT "%8.3" ECU_ADDRESS 0x600091E2 /end MEASUREMENT
/begin MEASUREMENT EGRVlv_uRelPosnOpenLrn "Learned raw voltage value at opened position" SWORD Volt 1 100 -6553.600 6553.400 FORMAT "%8.3" ECU_ADDRESS 0x60009526 /end MEASUREMENT
/begin MEASUREMENT EGRVlv_uRelPosOpn "Learned raw voltage value at opened position for sensor curve calculation" SWORD Volt 1 100 -6553.600 6553.400 FORMAT "%8.3" ECU_ADDRESS 0x6000952E /end MEASUREMENT
/begin MEASUREMENT EGRVlv_uRelPosOpnLrnFst "First learned value at open position (EEPROM)" SWORD Volt 1 100 -6553.600 6553.400 FORMAT "%8.3" ECU_ADDRESS 0x6000952C /end MEASUREMENT
/begin MEASUREMENT EGRVlv_uRelPosOpnLrnLst "Last learned value at open position" SWORD Volt 1 100 -6553.600 6553.400 FORMAT "%8.3" ECU_ADDRESS 0x6000952A /end MEASUREMENT
/begin MEASUREMENT EGRVlv_uRelPosOpnRom "Learned raw voltage value at opened position for sensor curve calculation (EEPROM)" SWORD Volt 1 100 -6553.600 6553.400 FORMAT "%8.3" ECU_ADDRESS 0x600006A4 /end MEASUREMENT
/begin MEASUREMENT EGRVlv_uTempOfsAdjClsd "Temperature compensated offset value at closed position" SWORD Volt 1 100 -6553.600 6553.400 FORMAT "%8.3" ECU_ADDRESS 0x60009524 /end MEASUREMENT
/begin MEASUREMENT EGRVlv_uTempOfsAdjClsdCurr_mp "Measurement point for Temperature compensated offset value at closed position for current temperature of actuator" SWORD Volt 1 100 -6553.600 6553.400 FORMAT "%8.3" ECU_ADDRESS 0x70009D2A /end MEASUREMENT
/begin MEASUREMENT EGRVlv_uTempOfsAdjClsdLrn_mp "Measurement point for Temperature compensated offset value at closed position for temperature of actuator during learning" SWORD Volt 1 100 -6553.600 6553.400 FORMAT "%8.3" ECU_ADDRESS 0x70009D28 /end MEASUREMENT
/begin MEASUREMENT EGRVlv_uTempOfsAdjOpn "Temperature compensated offset value at open position" SWORD Volt 1 100 -6553.600 6553.400 FORMAT "%8.3" ECU_ADDRESS 0x60009522 /end MEASUREMENT
/begin MEASUREMENT EGRVlv_uTempOfsAdjOpnCurr_mp "Measurement point for Temperature compensated offset value at open position for current temperature of actuator" SWORD Volt 1 100 -6553.600 6553.400 FORMAT "%8.3" ECU_ADDRESS 0x70009D26 /end MEASUREMENT
/begin MEASUREMENT EGRVlv_uTempOfsAdjOpnLrn_mp "Measurement point for Temperature compensated offset value at open position for temperature of actuator during learning" SWORD Volt 1 100 -6553.600 6553.400 FORMAT "%8.3" ECU_ADDRESS 0x70009D24 /end MEASUREMENT
/begin MEASUREMENT EGSDCmn_B1LamStabParlIK_I.memory "Debouncing (by exhaust gas mass flow integration) before releasing the parallelized diagnoses, after an instable Lambda was detected / current integrator value" ULONG m_q1p5259Em8_kg 1 100 0.00 65.5359999847 FORMAT "%13.10" ECU_ADDRESS 0x60002F20 /end MEASUREMENT
/begin MEASUREMENT EGSDCmn_Cat1B1Empty_I.flgCatEmpty "Calculation of the transition condition for switching to lean lambda phase / Catalyst is empty from oxygen" UBYTE B_TRUE 1 100 0.00 1.00000000000 BIT_MASK 0x1 FORMAT "%13.11" ECU_ADDRESS 0x500014CC /end MEASUREMENT
/begin MEASUREMENT EGSDCmn_Cat1B1Empty_I.flgCatEmptyOK "Calculation of the transition condition for switching to lean lambda phase / Catalyst sufficiently free of oxygen for transition in second pre-conditioning phase" UBYTE B_TRUE 1 100 0.00 1.00000000000 BIT_MASK 0x1 FORMAT "%13.11" ECU_ADDRESS 0x500014CD /end MEASUREMENT
/begin MEASUREMENT EGSDCmn_Cat1B1Empty_I.flgCatEmptyTOut "Calculation of the transition condition for switching to lean lambda phase / Time Out Criterion while checking if catalyst is free of oxygen" UBYTE B_TRUE 1 100 0.00 1.00000000000 BIT_MASK 0x1 FORMAT "%13.11" ECU_ADDRESS 0x500014CE /end MEASUREMENT
/begin MEASUREMENT EGSDCmn_Cat1B1Empty_I.mRSCCatCp "Calculation of the transition condition for switching to lean lambda phase / Integrated rich gas mass flow for Time Out detection" FLOAT32_IEEE m_q1_mg 1 100 -1.0000E+037 1.0000E+037 FORMAT "%10.4" ECU_ADDRESS 0x500014D0 /end MEASUREMENT
/begin MEASUREMENT EGSDCmn_Cat1B1Empty_I.tiObsvrTOut "Calculation of the transition condition for switching to lean lambda phase / Time duration since reaching the threshold for integrated rich gas mass flow for Time Out detection" UWORD t_q0p01 1 100 0.00 655.3500 FORMAT "%8.4" ECU_ADDRESS 0x500014D4 /end MEASUREMENT
/begin MEASUREMENT EGSDCmn_Cat1B1Empty_I.DynErrRampTONV_I.outbit "Calculation of the transition condition for switching to lean lambda phase / Representation of sensor dynmics in Time out calculation / return value" UBYTE B_TRUE 1 100 0.00 1.00000000000 BIT_MASK 0x1 FORMAT "%13.11" ECU_ADDRESS 0x500014D6 /end MEASUREMENT
/begin MEASUREMENT EGSDCmn_Cat1B1Empty_I.DynErrRampTONV_I.time "Calculation of the transition condition for switching to lean lambda phase / Representation of sensor dynmics in Time out calculation / expired delay time" UWORD t_q0p01 1 100 0.00 655.3500 FORMAT "%8.4" ECU_ADDRESS 0x500014D8 /end MEASUREMENT
/begin MEASUREMENT EGSDCmn_Cat1B1Empty_I.UGrdtTONV_I.outbit "Calculation of the transition condition for switching to lean lambda phase / Debouncing after detection of flat sensor voltage gradient due to signal symmetrization / return value" UBYTE B_TRUE 1 100 0.00 1.00000000000 BIT_MASK 0x1 FORMAT "%13.11" ECU_ADDRESS 0x500014DA /end MEASUREMENT
/begin MEASUREMENT EGSDCmn_Cat1B1Empty_I.UGrdtTONV_I.time "Calculation of the transition condition for switching to lean lambda phase / Debouncing after detection of flat sensor voltage gradient due to signal symmetrization / expired delay time" UWORD t_q0p01 1 100 0.00 655.3500 FORMAT "%8.4" ECU_ADDRESS 0x500014DC /end MEASUREMENT
/begin MEASUREMENT EGSDCmn_Cat1B1Empty_I.duUMinOKFF_I.status "Calculation of the transition condition for switching to lean lambda phase / Check of binary voltage and voltage gradient to proceed to second pre-conditioning phase / current value of RS-FF" UBYTE B_TRUE 1 100 0.00 1.00000000000 BIT_MASK 0x1 FORMAT "%13.11" ECU_ADDRESS 0x500014DE /end MEASUREMENT
/begin MEASUREMENT EGSDCmn_Cat1B1Empty_I.mO2CatEmptyOKIKL_I.memory "Calculation of the transition condition for switching to lean lambda phase / Integrated exhaust gas mass flow for detection if catalyst is sufficiently empty from oxygen / Current Integrator value" FLOAT32_IEEE m_q1_mg 1 100 -1.0000E+037 1.0000E+037 FORMAT "%10.4" ECU_ADDRESS 0x500014E0 /end MEASUREMENT
/begin MEASUREMENT EGSDCmn_Cat1B1Empty_I.mO2EnaCatEmptyGrdtIKL_I.memory "Calculation of the transition condition for switching to lean lambda phase / Integrated exhaust gas mass flow for detection if catalyst is empty from oxygen (based on sensor voltage gradient) / Current Integrator value" FLOAT32_IEEE m_q1_mg 1 100 -1.0000E+037 1.0000E+037 FORMAT "%10.4" ECU_ADDRESS 0x500014E4 /end MEASUREMENT
/begin MEASUREMENT EGSDCmn_Cat1B1Empty_I.mRSCCatCpIK_I.memory "Calculation of the transition condition for switching to lean lambda phase / Integrated rich gas mass flow for Time Out detection / current integrator value" FLOAT32_IEEE m_q1_mg 1 100 -1.0000E+037 1.0000E+037 FORMAT "%10.4" ECU_ADDRESS 0x500014E8 /end MEASUREMENT
/begin MEASUREMENT EGSDCmn_Cat1B1Empty_I.mRichMinIKL_I.memory "Calculation of the transition condition for switching to lean lambda phase / exhaust gas integral for voltage criterion / Current Integrator value" FLOAT32_IEEE m_q1_mg 1 100 -1.0000E+037 1.0000E+037 FORMAT "%10.4" ECU_ADDRESS 0x500014EC /end MEASUREMENT
/begin MEASUREMENT EGSDCmn_Cat1B1Empty_I.tiObsvrTOutSW_I.timeCounter "Calculation of the transition condition for switching to lean lambda phase / Stop watch for Time duration since reaching the threshold for integrated rich gas mass flow for Time Out detection / expired time since start" UWORD t_q0p01 1 100 0.00 655.3500 FORMAT "%8.4" ECU_ADDRESS 0x500014F0 /end MEASUREMENT
/begin MEASUREMENT EGSDCmn_Cat1B1Empty_I.uSnsrGrdtFF_I.status "Calculation of the transition condition for switching to lean lambda phase / Check of voltage value (based on sensor voltage gradient) / current value of RS-FF" UBYTE B_TRUE 1 100 0.00 1.00000000000 BIT_MASK 0x1 FORMAT "%13.11" ECU_ADDRESS 0x500014F2 /end MEASUREMENT
/begin MEASUREMENT EGSDCmn_Cat1B1Full_I.flgCatFull "Calulation of the transition condition to rich / Catalyst is filled with oxygen" UBYTE B_TRUE 1 100 0.00 1.00000000000 BIT_MASK 0x1 FORMAT "%13.11" ECU_ADDRESS 0x500014F4 /end MEASUREMENT
/begin MEASUREMENT EGSDCmn_Cat1B1Full_I.flgCatFullTOut "Calulation of the transition condition to rich / Time Out Criterion while checking if the catalyst is filled with oxygen" UBYTE B_TRUE 1 100 0.00 1.00000000000 BIT_MASK 0x1 FORMAT "%13.11" ECU_ADDRESS 0x500014F5 /end MEASUREMENT
/begin MEASUREMENT EGSDCmn_Cat1B1Full_I.mOSCCatCp "Calulation of the transition condition to rich / Integrated lean gas mass flow for Time Out detection" FLOAT32_IEEE m_q1_mg 1 100 -1.0000E+037 1.0000E+037 FORMAT "%10.4" ECU_ADDRESS 0x500014F8 /end MEASUREMENT
/begin MEASUREMENT EGSDCmn_Cat1B1Full_I.tiObsvrTOut "Calulation of the transition condition to rich / Time duration since reaching the threshold for integrated lean gas mass flow for Time Out detection" UWORD t_q0p01 1 100 0.00 655.3500 FORMAT "%8.4" ECU_ADDRESS 0x500014FC /end MEASUREMENT
/begin MEASUREMENT EGSDCmn_Cat1B1Full_I.DynErrRampTONV_I.outbit "Calulation of the transition condition to rich / Representation of sensor dynmics in Time out calculation / return value" UBYTE B_TRUE 1 100 0.00 1.00000000000 BIT_MASK 0x1 FORMAT "%13.11" ECU_ADDRESS 0x500014FE /end MEASUREMENT
/begin MEASUREMENT EGSDCmn_Cat1B1Full_I.DynErrRampTONV_I.time "Calulation of the transition condition to rich / Representation of sensor dynmics in Time out calculation / expired delay time" UWORD t_q0p01 1 100 0.00 655.3500 FORMAT "%8.4" ECU_ADDRESS 0x50001500 /end MEASUREMENT
/begin MEASUREMENT EGSDCmn_Cat1B1Full_I.UGrdtTONV_I.outbit "Calulation of the transition condition to rich / Debouncing after detection of flat sensor voltage gradient due to signal symmetrization / return value" UBYTE B_TRUE 1 100 0.00 1.00000000000 BIT_MASK 0x1 FORMAT "%13.11" ECU_ADDRESS 0x50001502 /end MEASUREMENT
/begin MEASUREMENT EGSDCmn_Cat1B1Full_I.UGrdtTONV_I.time "Calulation of the transition condition to rich / Debouncing after detection of flat sensor voltage gradient due to signal symmetrization / expired delay time" UWORD t_q0p01 1 100 0.00 655.3500 FORMAT "%8.4" ECU_ADDRESS 0x50001504 /end MEASUREMENT
/begin MEASUREMENT EGSDCmn_Cat1B1Full_I.mO2EnaCatFullGrdtIKL_I.memory "Calulation of the transition condition to rich / Integrated exhaust gas mass flow for detection if catalyst is filled with oxygen (based on sensor voltage gradient) / Current Integrator value" FLOAT32_IEEE m_q1_mg 1 100 -1.0000E+037 1.0000E+037 FORMAT "%10.4" ECU_ADDRESS 0x50001508 /end MEASUREMENT
/begin MEASUREMENT EGSDCmn_Cat1B1Full_I.mOSCCatCpIK_I.memory "Calulation of the transition condition to rich / Integrated lean gas mass flow for Time Out detection / current integrator value" FLOAT32_IEEE m_q1_mg 1 100 -1.0000E+037 1.0000E+037 FORMAT "%10.4" ECU_ADDRESS 0x5000150C /end MEASUREMENT
/begin MEASUREMENT EGSDCmn_Cat1B1Full_I.tiObsvrTOutSW_I.timeCounter "Calulation of the transition condition to rich / Stop watch for time duration since reaching the threshold for integrated lean gas mass flow for Time Out detection / expired time since start" UWORD t_q0p01 1 100 0.00 655.3500 FORMAT "%8.4" ECU_ADDRESS 0x50001510 /end MEASUREMENT
/begin MEASUREMENT EGSDCmn_Cat1B1Full_I.uSnsrGrdtFF_I.status "Calulation of the transition condition to rich / Check of voltage value (based on sensor voltage gradient) / current value of RS-FF" UBYTE B_TRUE 1 100 0.00 1.00000000000 BIT_MASK 0x1 FORMAT "%13.11" ECU_ADDRESS 0x50001512 /end MEASUREMENT
/begin MEASUREMENT EGSDCmn_Cat1B1Full_I.uSnsrTONV_I.outbit "Calulation of the transition condition to rich / Debouncing for detection of sensor voltage level / return value" UBYTE B_TRUE 1 100 0.00 1.00000000000 BIT_MASK 0x1 FORMAT "%13.11" ECU_ADDRESS 0x50001514 /end MEASUREMENT
/begin MEASUREMENT EGSDCmn_Cat1B1Full_I.uSnsrTONV_I.time "Calulation of the transition condition to rich / Debouncing for detection of sensor voltage level / expired delay time" UWORD t_q0p01 1 100 0.00 655.3500 FORMAT "%8.4" ECU_ADDRESS 0x50001516 /end MEASUREMENT
/begin MEASUREMENT EGSDCmn_Cat1B1VirtParl_I.flgCatEmpty "state machine of virtual lambda shifting for IUMPR simulation of catalyst diagnosis, bank 1 / Check if catalyst is empty from oxygen" UBYTE B_TRUE 1 100 0.00 1.00000000000 BIT_MASK 0x1 FORMAT "%13.11" ECU_ADDRESS 0x60002ED4 /end MEASUREMENT
/begin MEASUREMENT EGSDCmn_Cat1B1VirtParl_I.flgCatFull "state machine of virtual lambda shifting for IUMPR simulation of catalyst diagnosis, bank 1 / Check if catalyst is filled with oxygen" UBYTE B_TRUE 1 100 0.00 1.00000000000 BIT_MASK 0x1 FORMAT "%13.11" ECU_ADDRESS 0x60002ED5 /end MEASUREMENT
/begin MEASUREMENT EGSDCmn_Cat1B1VirtParl_I.flgDynTripDneVirt "state machine of virtual lambda shifting for IUMPR simulation of catalyst diagnosis, bank 1 / Virtuell dynamic check for the upstream sensor" UBYTE B_TRUE 1 100 0.00 1.00000000000 BIT_MASK 0x1 FORMAT "%13.11" ECU_ADDRESS 0x60002ED6 /end MEASUREMENT
/begin MEASUREMENT EGSDCmn_Cat1B1VirtParl_I.flgIdnAdpnEnd "state machine of virtual lambda shifting for IUMPR simulation of catalyst diagnosis, bank 1 / Status of Online adaption" UBYTE B_TRUE 1 100 0.00 1.00000000000 BIT_MASK 0x1 FORMAT "%13.11" ECU_ADDRESS 0x60002ED7 /end MEASUREMENT
/begin MEASUREMENT EGSDCmn_Cat1B1VirtParl_I.flgIdnAdpnLean "state machine of virtual lambda shifting for IUMPR simulation of catalyst diagnosis, bank 1 / Status of Online adaptionfor lean lambda" UBYTE B_TRUE 1 100 0.00 1.00000000000 BIT_MASK 0x1 FORMAT "%13.11" ECU_ADDRESS 0x60002ED8 /end MEASUREMENT
/begin MEASUREMENT EGSDCmn_Cat1B1VirtParl_I.flgIdnAdpnRich "state machine of virtual lambda shifting for IUMPR simulation of catalyst diagnosis, bank 1 / Status of Online adaptionfor rich lambda" UBYTE B_TRUE 1 100 0.00 1.00000000000 BIT_MASK 0x1 FORMAT "%13.11" ECU_ADDRESS 0x60002ED9 /end MEASUREMENT
/begin MEASUREMENT EGSDCmn_Cat1B1VirtParl_I.flgReld "state machine of virtual lambda shifting for IUMPR simulation of catalyst diagnosis, bank 1 / lambda shifting is released" UBYTE B_TRUE 1 100 0.00 1.00000000000 BIT_MASK 0x1 FORMAT "%13.11" ECU_ADDRESS 0x60002EDA /end MEASUREMENT
/begin MEASUREMENT EGSDCmn_Cat1B1VirtParl_I.flgUHiEnaParl "state machine of virtual lambda shifting for IUMPR simulation of catalyst diagnosis, bank 1 / Sensor voltage downstream is high" UBYTE B_TRUE 1 100 0.00 1.00000000000 BIT_MASK 0x1 FORMAT "%13.11" ECU_ADDRESS 0x60002EDB /end MEASUREMENT
/begin MEASUREMENT EGSDCmn_Cat1B1VirtParl_I.flgUMid "state machine of virtual lambda shifting for IUMPR simulation of catalyst diagnosis, bank 1 / sensor voltage in medium range (two stage preconditioning required)" UBYTE B_TRUE 1 100 0.00 1.00000000000 BIT_MASK 0x1 FORMAT "%13.11" ECU_ADDRESS 0x60002EDC /end MEASUREMENT
/begin MEASUREMENT EGSDCmn_Cat1B1VirtParl_I.flgVirtLamDyn "state machine of virtual lambda shifting for IUMPR simulation of catalyst diagnosis, bank 1 / Activation of IUMPR simulation for UEGO dynamic diagnosis" UBYTE B_TRUE 1 100 0.00 1.00000000000 BIT_MASK 0x1 FORMAT "%13.11" ECU_ADDRESS 0x60002EDD /end MEASUREMENT
/begin MEASUREMENT EGSDCmn_Cat1B1VirtParl_I.mOSC "state machine of virtual lambda shifting for IUMPR simulation of catalyst diagnosis, bank 1 / Assumed oxygen storage capacity for first catalyst" FLOAT32_IEEE m_q1_mg 1 100 0.00 50000.0000 FORMAT "%10.4" ECU_ADDRESS 0x60002EE0 /end MEASUREMENT
/begin MEASUREMENT EGSDCmn_Cat1B1VirtParl_I.mRSC "state machine of virtual lambda shifting for IUMPR simulation of catalyst diagnosis, bank 1 / Assumed rich gas storage capacity for first catalyst" FLOAT32_IEEE m_q1_mg 1 100 0.00 50000.0000 FORMAT "%10.4" ECU_ADDRESS 0x60002EE4 /end MEASUREMENT
/begin MEASUREMENT EGSDCmn_Cat1B1VirtParl_I.mfVirtO2 "state machine of virtual lambda shifting for IUMPR simulation of catalyst diagnosis, bank 1 / Oxygen mass flow in catalyst 1, corrected by maximum possible mixture deviation in a fault free system" FLOAT32_IEEE mgrad_q1_mgdivs 1 100 0.00 50000.0000 FORMAT "%10.4" ECU_ADDRESS 0x60002EE8 /end MEASUREMENT
/begin MEASUREMENT EGSDCmn_Cat1B1VirtParl_I.mfVirtRich "state machine of virtual lambda shifting for IUMPR simulation of catalyst diagnosis, bank 1 / Rich Gas mass flow in catalyst 1, corrected by maximum possible mixture deviation in a fault free system" FLOAT32_IEEE mgrad_q1_mgdivs 1 100 0.00 50000.0000 FORMAT "%10.4" ECU_ADDRESS 0x60002EEC /end MEASUREMENT
/begin MEASUREMENT EGSDCmn_Cat1B1VirtParl_I.sm "state machine of virtual lambda shifting for IUMPR simulation of catalyst diagnosis, bank 1 / State number" UBYTE EGSDCmn_VirtLamGenrParl_sm_VERB 1 100 0.00 7.00000000000 FORMAT "%13.11" ECU_ADDRESS 0x60002EF0 /end MEASUREMENT
/begin MEASUREMENT EGSDCmn_Cat1B1VirtParl_I.stLamGenr "state machine of virtual lambda shifting for IUMPR simulation of catalyst diagnosis, bank 1 / State number" UBYTE dez 1 100 0.00 255.0 FORMAT "%5.1" ECU_ADDRESS 0x60002EF1 /end MEASUREMENT
/begin MEASUREMENT EGSDCmn_Cat1B1VirtParl_I.tiGas "state machine of virtual lambda shifting for IUMPR simulation of catalyst diagnosis, bank 1 / gas propagation time till first Lambda sensor" UWORD t_q0p1 1 100 0.00 6553.500 FORMAT "%8.3" ECU_ADDRESS 0x60002EF2 /end MEASUREMENT
/begin MEASUREMENT EGSDCmn_Cat1B1VirtParl_I.tiLamDynLtr "state machine of virtual lambda shifting for IUMPR simulation of catalyst diagnosis, bank 1 / Dynamic time lambda signal of upstream sensor 1 Lean-Rich" UWORD t_q0p1 1 100 0.00 6553.500 FORMAT "%8.3" ECU_ADDRESS 0x60002EF4 /end MEASUREMENT
/begin MEASUREMENT EGSDCmn_Cat1B1VirtParl_I.tiLamDynRtl "state machine of virtual lambda shifting for IUMPR simulation of catalyst diagnosis, bank 1 / Dynamic time lambda signal of upstream sensor 1 Rich-Lean" UWORD t_q0p1 1 100 0.00 6553.500 FORMAT "%8.3" ECU_ADDRESS 0x60002EF6 /end MEASUREMENT
/begin MEASUREMENT EGSDCmn_Cat1B1VirtParl_I.tiUDynLtr "state machine of virtual lambda shifting for IUMPR simulation of catalyst diagnosis, bank 1 / Dynamic reaction time of downstream sensor, Lean-Rich" UWORD t_q0p1 1 100 0.00 6553.500 FORMAT "%8.3" ECU_ADDRESS 0x60002EF8 /end MEASUREMENT
/begin MEASUREMENT EGSDCmn_Cat1B1VirtParl_I.tiUDynRtl "state machine of virtual lambda shifting for IUMPR simulation of catalyst diagnosis, bank 1 / Dynamic reaction time of downstream sensor, Rich-Lean" UWORD t_q0p1 1 100 0.00 6553.500 FORMAT "%8.3" ECU_ADDRESS 0x60002EFA /end MEASUREMENT
/begin MEASUREMENT EGSDCmn_Cat1B1VirtParl_I.u "state machine of virtual lambda shifting for IUMPR simulation of catalyst diagnosis, bank 1 / Sensor voltage of downstream sensor" UWORD spg_q1p221Em3_V 1 100 0.00 4.998779 FORMAT "%8.6" ECU_ADDRESS 0x60002EFC /end MEASUREMENT
/begin MEASUREMENT EGSDCmn_Cat1B1VirtParl_I.EnaReldEF_I.buffer "state machine of virtual lambda shifting for IUMPR simulation of catalyst diagnosis, bank 1 / EdgeFalling: loss of enable condition / memory to detect falling edge" UBYTE B_TRUE 1 100 0.00 1.00000000000 BIT_MASK 0x1 FORMAT "%13.11" ECU_ADDRESS 0x60002EFE /end MEASUREMENT
/begin MEASUREMENT EGSDCmn_Cat1B1VirtParl_I.EnaReldEF_I.oldSignal "state machine of virtual lambda shifting for IUMPR simulation of catalyst diagnosis, bank 1 / EdgeFalling: loss of enable condition / memory to detect falling edge" UBYTE B_TRUE 1 100 0.00 1.00000000000 BIT_MASK 0x1 FORMAT "%13.11" ECU_ADDRESS 0x60002EFF /end MEASUREMENT
/begin MEASUREMENT EGSDCmn_Cat1B1VirtParl_I.IdnAdpnCTR_I.counter "state machine of virtual lambda shifting for IUMPR simulation of catalyst diagnosis, bank 1 / Counter for lambda jumps for online adaption purposes / current counter value" UWORD dez 1 100 0.00 65535.00 FORMAT "%8.2" ECU_ADDRESS 0x60002F00 /end MEASUREMENT
/begin MEASUREMENT EGSDCmn_Cat1B1VirtParl_I.flgLeanLamStabTONV_I.outbit "state machine of virtual lambda shifting for IUMPR simulation of catalyst diagnosis, bank 1 / Waiting time for lean lambda stability criterion / return value" UBYTE B_TRUE 1 100 0.00 1.00000000000 BIT_MASK 0x1 FORMAT "%13.11" ECU_ADDRESS 0x60002F02 /end MEASUREMENT
/begin MEASUREMENT EGSDCmn_Cat1B1VirtParl_I.flgLeanLamStabTONV_I.time "state machine of virtual lambda shifting for IUMPR simulation of catalyst diagnosis, bank 1 / Waiting time for lean lambda stability criterion / expired delay time" UWORD t_q0p1 1 100 0.00 6553.500 FORMAT "%8.3" ECU_ADDRESS 0x60002F04 /end MEASUREMENT
/begin MEASUREMENT EGSDCmn_Cat1B1VirtParl_I.flgRichLamStabTONV_I.outbit "state machine of virtual lambda shifting for IUMPR simulation of catalyst diagnosis, bank 1 / Waiting time for rich lambda stability criterion / return value" UBYTE B_TRUE 1 100 0.00 1.00000000000 BIT_MASK 0x1 FORMAT "%13.11" ECU_ADDRESS 0x60002F06 /end MEASUREMENT
/begin MEASUREMENT EGSDCmn_Cat1B1VirtParl_I.flgRichLamStabTONV_I.time "state machine of virtual lambda shifting for IUMPR simulation of catalyst diagnosis, bank 1 / Waiting time for rich lambda stability criterion / expired delay time" UWORD t_q0p1 1 100 0.00 6553.500 FORMAT "%8.3" ECU_ADDRESS 0x60002F08 /end MEASUREMENT
/begin MEASUREMENT EGSDCmn_Cat1B1VirtParl_I.mO2EnaCatFullGrdtIK_I.memory "state machine of virtual lambda shifting for IUMPR simulation of catalyst diagnosis, bank 1 / Integrator for oxygen gas mass flow for detection if catalyst is filled with oxygen / current integrator value" FLOAT32_IEEE m_q1_mg 1 100 -1.0000E+037 1.0000E+037 FORMAT "%10.4" ECU_ADDRESS 0x60002F0C /end MEASUREMENT
/begin MEASUREMENT EGSDCmn_Cat1B1VirtParl_I.mO2IdnAdpnIKL_I.memory "state machine of virtual lambda shifting for IUMPR simulation of catalyst diagnosis, bank 1 / Integrator for oxygen or rich gas mass flow for lambda jumps for online adaption purposes / Current Integrator value" FLOAT32_IEEE m_q1_mg 1 100 -1.0000E+037 1.0000E+037 FORMAT "%10.4" ECU_ADDRESS 0x60002F10 /end MEASUREMENT
/begin MEASUREMENT EGSDCmn_Cat1B1VirtParl_I.mO2VirtEnaCatEmptyIK_I.memory "state machine of virtual lambda shifting for IUMPR simulation of catalyst diagnosis, bank 1 / Integrator for rich gas mass flow for detection if catalyst is emtpied from oxygen / current integrator value" FLOAT32_IEEE m_q1_mg 1 100 -1.0000E+037 1.0000E+037 FORMAT "%10.4" ECU_ADDRESS 0x60002F14 /end MEASUREMENT
/begin MEASUREMENT EGSDCmn_Cat1B1VirtParl_I.tiGasRtlTONV_I.outbit "state machine of virtual lambda shifting for IUMPR simulation of catalyst diagnosis, bank 1 / Simulation of gas propagation till first Lambda sensor / return value" UBYTE B_TRUE 1 100 0.00 1.00000000000 BIT_MASK 0x1 FORMAT "%13.11" ECU_ADDRESS 0x60002F18 /end MEASUREMENT
/begin MEASUREMENT EGSDCmn_Cat1B1VirtParl_I.tiGasRtlTONV_I.time "state machine of virtual lambda shifting for IUMPR simulation of catalyst diagnosis, bank 1 / Simulation of gas propagation till first Lambda sensor / expired delay time" UWORD t_q0p1 1 100 0.00 6553.500 FORMAT "%8.3" ECU_ADDRESS 0x60002F1A /end MEASUREMENT
/begin MEASUREMENT EGSDCmn_Cat1B1VirtParl_I.tiUDynTONV_I.outbit "state machine of virtual lambda shifting for IUMPR simulation of catalyst diagnosis, bank 1 / simulation time for sensor dynamic of downstream sensor / return value" UBYTE B_TRUE 1 100 0.00 1.00000000000 BIT_MASK 0x1 FORMAT "%13.11" ECU_ADDRESS 0x60002F1C /end MEASUREMENT
/begin MEASUREMENT EGSDCmn_Cat1B1VirtParl_I.tiUDynTONV_I.time "state machine of virtual lambda shifting for IUMPR simulation of catalyst diagnosis, bank 1 / simulation time for sensor dynamic of downstream sensor / expired delay time" UWORD t_q0p1 1 100 0.00 6553.500 FORMAT "%8.3" ECU_ADDRESS 0x60002F1E /end MEASUREMENT
/begin MEASUREMENT EGSDCmn_ctReIni100msCoorrParl "counter for reinitialization trigger after PostDrive leave" UBYTE OneToOne 1 100 0.00 255.0 FORMAT "%5.1" ECU_ADDRESS 0x600140AA /end MEASUREMENT
/begin MEASUREMENT EGSDCmn_ctReIni10msCoorrParl "counter for reinitialization trigger after PostDrive leave" UBYTE OneToOne 1 100 0.00 255.0 FORMAT "%5.1" ECU_ADDRESS 0x6000B213 /end MEASUREMENT
/begin MEASUREMENT EGSDCmn_flgB1LamNotStabParl "time out for switching between rich and lean is triggered due to lambda stable criterion" UBYTE B_TRUE 1 100 0.00 1.00000000000 BIT_MASK 0x1 FORMAT "%13.11" ECU_ADDRESS 0x70000A4F /end MEASUREMENT
/begin MEASUREMENT EGSDCmn_flgB1LamStabParl "Debouncing after detection of unstable Lambda during active diagnosis is finished" UBYTE B_TRUE 1 100 0.00 1.00000000000 BIT_MASK 0x1 FORMAT "%13.11" ECU_ADDRESS 0x70000338 /end MEASUREMENT
/begin MEASUREMENT EGSDCmn_flgB1TarLeanOk "Flag indicating that the downstream sensor has reached its Lean Target Voltage, Bank 1" UBYTE B_TRUE 1 100 0.00 1.00000000000 BIT_MASK 0x1 FORMAT "%13.11" ECU_ADDRESS 0x70000337 /end MEASUREMENT
/begin MEASUREMENT EGSDCmn_flgB1TarRichOk "Flag indicating that the downstream sensor has reached its Rich Target Voltage, Bank 1" UBYTE B_TRUE 1 100 0.00 1.00000000000 BIT_MASK 0x1 FORMAT "%13.11" ECU_ADDRESS 0x70000336 /end MEASUREMENT
/begin MEASUREMENT EGSDCmn_flgB1UHiEnaParl "Binary voltage of all parallelized sensors higher than a threshold" UBYTE B_TRUE 1 100 0.00 1.00000000000 BIT_MASK 0x1 FORMAT "%13.11" ECU_ADDRESS 0x70000A4E /end MEASUREMENT
/begin MEASUREMENT EGSDCmn_flgB1UMid "Flag indicating that the downstream sensor Voltage is towards the Rich Lambda, Bank 1" UBYTE B_TRUE 1 100 0.00 1.00000000000 BIT_MASK 0x1 FORMAT "%13.11" ECU_ADDRESS 0x70000A4D /end MEASUREMENT
/begin MEASUREMENT EGSDCmn_flgCat1EmptTOutParlB1 "Time-Out Criterion for recognition that catalyst is empty of oxygen" UBYTE B_TRUE 1 100 0.00 1.00000000000 BIT_MASK 0x1 FORMAT "%13.11" ECU_ADDRESS 0x70000A47 /end MEASUREMENT
/begin MEASUREMENT EGSDCmn_flgCat1FullTOutParlB1 "Time-Out Criterion for recognition that catalyst is filled with oxygen" UBYTE B_TRUE 1 100 0.00 1.00000000000 BIT_MASK 0x1 FORMAT "%13.11" ECU_ADDRESS 0x70000A46 /end MEASUREMENT
/begin MEASUREMENT EGSDCmn_flgCatEmptyB1 "catalyst B1 is empty of oxygen" UBYTE B_TRUE 1 100 0.00 1.00000000000 BIT_MASK 0x1 FORMAT "%13.11" ECU_ADDRESS 0x70000A45 /end MEASUREMENT
/begin MEASUREMENT EGSDCmn_flgCatEmptyOKB1 "Detection if catalyst was emptied sufficiently from oxygen" UBYTE B_TRUE 1 100 0.00 1.00000000000 BIT_MASK 0x1 FORMAT "%13.11" ECU_ADDRESS 0x70000A44 /end MEASUREMENT
/begin MEASUREMENT EGSDCmn_flgCatFullB1 "catalyst B1 is full of oxygen" UBYTE B_TRUE 1 100 0.00 1.00000000000 BIT_MASK 0x1 FORMAT "%13.11" ECU_ADDRESS 0x70000A43 /end MEASUREMENT
/begin MEASUREMENT EGSDCmn_flgDSMClrParl100msB1 "DSMClear for 100ms is requested, bank 1" UBYTE B_TRUE 1 100 0.00 1.00000000000 BIT_MASK 0x1 FORMAT "%13.11" ECU_ADDRESS 0x70000A42 /end MEASUREMENT
/begin MEASUREMENT EGSDCmn_flgDSMClrParlB1 "DSMClear is requested" UBYTE B_TRUE 1 100 0.00 1.00000000000 BIT_MASK 0x1 FORMAT "%13.11" ECU_ADDRESS 0x70000A41 /end MEASUREMENT
/begin MEASUREMENT EGSDCmn_flgIdnAdpnEndParlS1B1 "Online adaption done" UBYTE B_TRUE 1 100 0.00 1.00000000000 BIT_MASK 0x1 FORMAT "%13.11" ECU_ADDRESS 0x70000A39 /end MEASUREMENT
/begin MEASUREMENT EGSDCmn_flgIdnAdpnEndVirtParlS1B1 "Virtual online adaption done" UBYTE B_TRUE 1 100 0.00 1.00000000000 BIT_MASK 0x1 FORMAT "%13.11" ECU_ADDRESS 0x70000A38 /end MEASUREMENT
/begin MEASUREMENT EGSDCmn_flgLamReqParlB1 "lambda request for parallelization is active, bank 1" UBYTE B_TRUE 1 100 0.00 1.00000000000 BIT_MASK 0x1 FORMAT "%13.11" ECU_ADDRESS 0x70000A32 /end MEASUREMENT
/begin MEASUREMENT EGSDCmn_flgS1B1O2PlausResVirtParl "virtual lambda shifting in case of Lambda Signal offset error is done" UBYTE B_TRUE 1 100 0.00 1.00000000000 BIT_MASK 0x1 FORMAT "%13.11" ECU_ADDRESS 0x70000A2B /end MEASUREMENT
/begin MEASUREMENT EGSDCmn_flgS2B1TarLeanErrParl "Error check for lean target voltage during parallelized exhaust sensor diagnosis, sensor 2" UBYTE B_TRUE 1 100 0.00 1.00000000000 BIT_MASK 0x1 FORMAT "%13.11" ECU_ADDRESS 0x70000A28 /end MEASUREMENT
/begin MEASUREMENT EGSDCmn_flgS2B1TarLeanOkOnceParl "Check if lean target sensor voltage during active parallelization is once reached" UBYTE B_TRUE 1 100 0.00 1.00000000000 BIT_MASK 0x1 FORMAT "%13.11" ECU_ADDRESS 0x70000A27 /end MEASUREMENT
/begin MEASUREMENT EGSDCmn_flgS2B1TarLeanResParl "range check of lean target sensor voltage is completed, sensor 2, bank 1" UBYTE B_TRUE 1 100 0.00 1.00000000000 BIT_MASK 0x1 FORMAT "%13.11" ECU_ADDRESS 0x70000A26 /end MEASUREMENT
/begin MEASUREMENT EGSDCmn_flgS2B1TarLeanResParlER_I.buffer "Target Lean result triggered / rising edge detected" UBYTE B_TRUE 1 100 0.00 1.00000000000 BIT_MASK 0x1 FORMAT "%13.11" ECU_ADDRESS 0x60007330 /end MEASUREMENT
/begin MEASUREMENT EGSDCmn_flgS2B1TarLeanResParlER_I.oldSignal "Target Lean result triggered / flag rising edge" UBYTE B_TRUE 1 100 0.00 1.00000000000 BIT_MASK 0x1 FORMAT "%13.11" ECU_ADDRESS 0x60007331 /end MEASUREMENT
/begin MEASUREMENT EGSDCmn_flgS2B1TarLeanResVirtOffsParl "Virtual simulation of range check of lean target sensor voltage with Lambda Signal Offset is completed, sensor 2, bank 1" UBYTE B_TRUE 1 100 0.00 1.00000000000 BIT_MASK 0x1 FORMAT "%13.11" ECU_ADDRESS 0x70000A25 /end MEASUREMENT
/begin MEASUREMENT EGSDCmn_flgS2B1TarLeanResVirtParl "Virtual simulation of range check of lean target sensor voltage is completed, sensor 2, bank 1" UBYTE B_TRUE 1 100 0.00 1.00000000000 BIT_MASK 0x1 FORMAT "%13.11" ECU_ADDRESS 0x70000A24 /end MEASUREMENT
/begin MEASUREMENT EGSDCmn_flgS2B1TarRichErrParl "Error check for rich target voltage during parallelized exhaust sensor diagnosis, sensor 2" UBYTE B_TRUE 1 100 0.00 1.00000000000 BIT_MASK 0x1 FORMAT "%13.11" ECU_ADDRESS 0x70000A23 /end MEASUREMENT
/begin MEASUREMENT EGSDCmn_flgS2B1TarRichOkOnceParl "Check if rich target sensor voltage during active parallelization is once reached" UBYTE B_TRUE 1 100 0.00 1.00000000000 BIT_MASK 0x1 FORMAT "%13.11" ECU_ADDRESS 0x70000A22 /end MEASUREMENT
/begin MEASUREMENT EGSDCmn_flgS2B1TarRichResParl "range check of rich target sensor voltage is completed, sensor 2, bank 1" UBYTE B_TRUE 1 100 0.00 1.00000000000 BIT_MASK 0x1 FORMAT "%13.11" ECU_ADDRESS 0x70000A21 /end MEASUREMENT
/begin MEASUREMENT EGSDCmn_flgS2B1TarRichResParlER_I.buffer "Target Lean result triggered / rising edge detected" UBYTE B_TRUE 1 100 0.00 1.00000000000 BIT_MASK 0x1 FORMAT "%13.11" ECU_ADDRESS 0x6000732E /end MEASUREMENT
/begin MEASUREMENT EGSDCmn_flgS2B1TarRichResParlER_I.oldSignal "Target Lean result triggered / flag rising edge" UBYTE B_TRUE 1 100 0.00 1.00000000000 BIT_MASK 0x1 FORMAT "%13.11" ECU_ADDRESS 0x6000732F /end MEASUREMENT
/begin MEASUREMENT EGSDCmn_flgS2B1TarRichResVirtOffsParl "Virtual simulation of range check of rich target sensor voltage with Lambda Signal Offset is completed, sensor 2, bank 1" UBYTE B_TRUE 1 100 0.00 1.00000000000 BIT_MASK 0x1 FORMAT "%13.11" ECU_ADDRESS 0x70000A20 /end MEASUREMENT
/begin MEASUREMENT EGSDCmn_flgS2B1TarRichResVirtParl "Virtual simulation of range check of rich target sensor voltage is completed, sensor 2, bank 1" UBYTE B_TRUE 1 100 0.00 1.00000000000 BIT_MASK 0x1 FORMAT "%13.11" ECU_ADDRESS 0x70000A1F /end MEASUREMENT
/begin MEASUREMENT EGSDCmn_flgTarLeanOkS2B1 "Flag Indicating if the downstream sensor has reached its Lean Target Voltage, Sensor 2,Bank 1" UBYTE B_TRUE 1 100 0.00 1.00000000000 BIT_MASK 0x1 FORMAT "%13.11" ECU_ADDRESS 0x70000335 /end MEASUREMENT
/begin MEASUREMENT EGSDCmn_flgTarRichOkS2B1 "Flag Indicating if the downstream sensor has reached its Rich Target Voltage, Sensor 2, Bank 1" UBYTE B_TRUE 1 100 0.00 1.00000000000 BIT_MASK 0x1 FORMAT "%13.11" ECU_ADDRESS 0x70000334 /end MEASUREMENT
/begin MEASUREMENT EGSDCmn_flgUS2B1Mid "Flag indicating that the downstream sensor Voltage is towards the Rich Lambda, Sensor 2, Bank 1" UBYTE B_TRUE 1 100 0.00 1.00000000000 BIT_MASK 0x1 FORMAT "%13.11" ECU_ADDRESS 0x70000333 /end MEASUREMENT
/begin MEASUREMENT EGSDCmn_LamGenrParlB1_I.flgCat1EmptyTOut "state machine of lambda shifting from coordinator function of parallelization, bank 1 / Time out reached while checking for catalyst empty" UBYTE B_TRUE 1 100 0.00 1.00000000000 BIT_MASK 0x1 FORMAT "%13.11" ECU_ADDRESS 0x50001518 /end MEASUREMENT
/begin MEASUREMENT EGSDCmn_LamGenrParlB1_I.flgCat1FullTOut "state machine of lambda shifting from coordinator function of parallelization, bank 1 / Time out reached while checking for catalyst full" UBYTE B_TRUE 1 100 0.00 1.00000000000 BIT_MASK 0x1 FORMAT "%13.11" ECU_ADDRESS 0x50001519 /end MEASUREMENT
/begin MEASUREMENT EGSDCmn_LamGenrParlB1_I.flgCatEmpty "state machine of lambda shifting from coordinator function of parallelization, bank 1 / Flag active if oxygen storage empty in NOx storage catalyst" UBYTE B_TRUE 1 100 0.00 1.00000000000 BIT_MASK 0x1 FORMAT "%13.11" ECU_ADDRESS 0x5000151A /end MEASUREMENT
/begin MEASUREMENT EGSDCmn_LamGenrParlB1_I.flgCatEmptyOK "state machine of lambda shifting from coordinator function of parallelization, bank 1 / no unknown thin gas in cat" UBYTE B_TRUE 1 100 0.00 1.00000000000 BIT_MASK 0x1 FORMAT "%13.11" ECU_ADDRESS 0x5000151B /end MEASUREMENT
/begin MEASUREMENT EGSDCmn_LamGenrParlB1_I.flgCatFull "state machine of lambda shifting from coordinator function of parallelization, bank 1 / catalyst is full of oxygen" UBYTE B_TRUE 1 100 0.00 1.00000000000 BIT_MASK 0x1 FORMAT "%13.11" ECU_ADDRESS 0x5000151C /end MEASUREMENT
/begin MEASUREMENT EGSDCmn_LamGenrParlB1_I.flgDynTripDne "state machine of lambda shifting from coordinator function of parallelization, bank 1 / Dynamic check for the first sensor is done" UBYTE B_TRUE 1 100 0.00 1.00000000000 BIT_MASK 0x1 FORMAT "%13.11" ECU_ADDRESS 0x5000151D /end MEASUREMENT
/begin MEASUREMENT EGSDCmn_LamGenrParlB1_I.flgIdnAdpnEnd "state machine of lambda shifting from coordinator function of parallelization, bank 1 / Online adaption done" UBYTE B_TRUE 1 100 0.00 1.00000000000 BIT_MASK 0x1 FORMAT "%13.11" ECU_ADDRESS 0x5000151E /end MEASUREMENT
/begin MEASUREMENT EGSDCmn_LamGenrParlB1_I.flgIdnAdpnLean "state machine of lambda shifting from coordinator function of parallelization, bank 1 / Online adaption lean reached" UBYTE B_TRUE 1 100 0.00 1.00000000000 BIT_MASK 0x1 FORMAT "%13.11" ECU_ADDRESS 0x5000151F /end MEASUREMENT
/begin MEASUREMENT EGSDCmn_LamGenrParlB1_I.flgIdnAdpnRich "state machine of lambda shifting from coordinator function of parallelization, bank 1 / Online adaption rich reached" UBYTE B_TRUE 1 100 0.00 1.00000000000 BIT_MASK 0x1 FORMAT "%13.11" ECU_ADDRESS 0x50001520 /end MEASUREMENT
/begin MEASUREMENT EGSDCmn_LamGenrParlB1_I.flgLamNotStab "state machine of lambda shifting from coordinator function of parallelization, bank 1 / lambda value is not stable" UBYTE B_TRUE 1 100 0.00 1.00000000000 BIT_MASK 0x1 FORMAT "%13.11" ECU_ADDRESS 0x50001521 /end MEASUREMENT
/begin MEASUREMENT EGSDCmn_LamGenrParlB1_I.flgLamRels "state machine of lambda shifting from coordinator function of parallelization, bank 1 / Inhibiting by instable lambda value is abolished" UBYTE B_TRUE 1 100 0.00 1.00000000000 BIT_MASK 0x1 FORMAT "%13.11" ECU_ADDRESS 0x50001522 /end MEASUREMENT
/begin MEASUREMENT EGSDCmn_LamGenrParlB1_I.flgLamReq "state machine of lambda shifting from coordinator function of parallelization, bank 1 / lambda request is active" UBYTE B_TRUE 1 100 0.00 1.00000000000 BIT_MASK 0x1 FORMAT "%13.11" ECU_ADDRESS 0x50001523 /end MEASUREMENT
/begin MEASUREMENT EGSDCmn_LamGenrParlB1_I.flgLamStabLean "state machine of lambda shifting from coordinator function of parallelization, bank 1 / lambda value is not stable" UBYTE B_TRUE 1 100 0.00 1.00000000000 BIT_MASK 0x1 FORMAT "%13.11" ECU_ADDRESS 0x50001524 /end MEASUREMENT
/begin MEASUREMENT EGSDCmn_LamGenrParlB1_I.flgLamStabRich "state machine of lambda shifting from coordinator function of parallelization, bank 1 / lambda value in rich is stable" UBYTE B_TRUE 1 100 0.00 1.00000000000 BIT_MASK 0x1 FORMAT "%13.11" ECU_ADDRESS 0x50001525 /end MEASUREMENT
/begin MEASUREMENT EGSDCmn_LamGenrParlB1_I.flgLeanRampEnd "state machine of lambda shifting from coordinator function of parallelization, bank 1 / lean lambda ramp is expired" UBYTE B_TRUE 1 100 0.00 1.00000000000 BIT_MASK 0x1 FORMAT "%13.11" ECU_ADDRESS 0x50001526 /end MEASUREMENT
/begin MEASUREMENT EGSDCmn_LamGenrParlB1_I.flgOSCTestPassd "state machine of lambda shifting from coordinator function of parallelization, bank 1 / OSC partial measurement is complete" UBYTE B_TRUE 1 100 0.00 1.00000000000 BIT_MASK 0x1 FORMAT "%13.11" ECU_ADDRESS 0x50001527 /end MEASUREMENT
/begin MEASUREMENT EGSDCmn_LamGenrParlB1_I.flgQlyDeFltSuspc "state machine of lambda shifting from coordinator function of parallelization, bank 1 / Dynamic error suspicion from lossfunction" UBYTE B_TRUE 1 100 0.00 1.00000000000 BIT_MASK 0x1 FORMAT "%13.11" ECU_ADDRESS 0x50001528 /end MEASUREMENT
/begin MEASUREMENT EGSDCmn_LamGenrParlB1_I.flgRichRampEnd "state machine of lambda shifting from coordinator function of parallelization, bank 1 / rich lambda ramp is expired" UBYTE B_TRUE 1 100 0.00 1.00000000000 BIT_MASK 0x1 FORMAT "%13.11" ECU_ADDRESS 0x50001529 /end MEASUREMENT
/begin MEASUREMENT EGSDCmn_LamGenrParlB1_I.flgStMacReld "state machine of lambda shifting from coordinator function of parallelization, bank 1 / release condiiton for state machine" UBYTE B_TRUE 1 100 0.00 1.00000000000 BIT_MASK 0x1 FORMAT "%13.11" ECU_ADDRESS 0x5000152A /end MEASUREMENT
/begin MEASUREMENT EGSDCmn_LamGenrParlB1_I.flgTarLeanOK "state machine of lambda shifting from coordinator function of parallelization, bank 1 / Target sensor voltage in mager is reached" UBYTE B_TRUE 1 100 0.00 1.00000000000 BIT_MASK 0x1 FORMAT "%13.11" ECU_ADDRESS 0x5000152B /end MEASUREMENT
/begin MEASUREMENT EGSDCmn_LamGenrParlB1_I.flgTarRichOK "state machine of lambda shifting from coordinator function of parallelization, bank 1 / Target sensor voltage in rich is reached" UBYTE B_TRUE 1 100 0.00 1.00000000000 BIT_MASK 0x1 FORMAT "%13.11" ECU_ADDRESS 0x5000152C /end MEASUREMENT
/begin MEASUREMENT EGSDCmn_LamGenrParlB1_I.flgUHiEnaParl "state machine of lambda shifting from coordinator function of parallelization, bank 1 / sensor voltage is high" UBYTE B_TRUE 1 100 0.00 1.00000000000 BIT_MASK 0x1 FORMAT "%13.11" ECU_ADDRESS 0x5000152D /end MEASUREMENT
/begin MEASUREMENT EGSDCmn_LamGenrParlB1_I.flgUMid "state machine of lambda shifting from coordinator function of parallelization, bank 1 / Sensor Voltage at the Beginning of Parallelization in the middle range, preconditioning rich and lean" UBYTE B_TRUE 1 100 0.00 1.00000000000 BIT_MASK 0x1 FORMAT "%13.11" ECU_ADDRESS 0x5000152E /end MEASUREMENT
/begin MEASUREMENT EGSDCmn_LamGenrParlB1_I.mRampDurParl "state machine of lambda shifting from coordinator function of parallelization, bank 1 / amount of exhaust gas mass flow to hold on the ramp during ramp-test" UWORD m_q0p001_kg 1 100 0.00 65.53500 FORMAT "%8.5" ECU_ADDRESS 0x50001530 /end MEASUREMENT
/begin MEASUREMENT EGSDCmn_LamGenrParlB1_I.mfEg "state machine of lambda shifting from coordinator function of parallelization, bank 1 / Exhaust gas mass flow" UWORD m_q0p1 1 100 0.00 6553.500 FORMAT "%8.3" ECU_ADDRESS 0x50001532 /end MEASUREMENT
/begin MEASUREMENT EGSDCmn_LamGenrParlB1_I.mfO2 "state machine of lambda shifting from coordinator function of parallelization, bank 1 / Oxygen mass flow" FLOAT32_IEEE mgrad_q1_mgdivs 1 100 -50000.0000 50000.0000 FORMAT "%10.4" ECU_ADDRESS 0x50001534 /end MEASUREMENT
/begin MEASUREMENT EGSDCmn_LamGenrParlB1_I.ratLamAct "state machine of lambda shifting from coordinator function of parallelization, bank 1 / Lambda actual value of upstream sensor" UWORD fak_uw_b16 1 100 0.00 15.99976 FORMAT "%8.5" ECU_ADDRESS 0x50001538 /end MEASUREMENT
/begin MEASUREMENT EGSDCmn_LamGenrParlB1_I.ratLamCorr "state machine of lambda shifting from coordinator function of parallelization, bank 1 / lambda set point correction of lambda control downstream" SWORD fak_q3p0518Em5 1 100 -1.000000 0.999969 FORMAT "%8.6" ECU_ADDRESS 0x5000153A /end MEASUREMENT
/begin MEASUREMENT EGSDCmn_LamGenrParlB1_I.ratLamRampLeanParl "state machine of lambda shifting from coordinator function of parallelization, bank 1 / lambda limit in direction lean of ramp test for range check" UWORD fak_uw_b16 1 100 0.00 15.99976 FORMAT "%8.5" ECU_ADDRESS 0x5000153C /end MEASUREMENT
/begin MEASUREMENT EGSDCmn_LamGenrParlB1_I.ratLamRampRichParl "state machine of lambda shifting from coordinator function of parallelization, bank 1 / lambda limit in direction rich of ramp test for range check" UWORD fak_uw_b16 1 100 0.00 15.99976 FORMAT "%8.5" ECU_ADDRESS 0x5000153E /end MEASUREMENT
/begin MEASUREMENT EGSDCmn_LamGenrParlB1_I.ratLamReq "state machine of lambda shifting from coordinator function of parallelization, bank 1 / Requested lambda" UWORD fak_uw_b16 1 100 0.00 15.99976 FORMAT "%8.5" ECU_ADDRESS 0x50001540 /end MEASUREMENT
/begin MEASUREMENT EGSDCmn_LamGenrParlB1_I.ratLamSpNoDyn "state machine of lambda shifting from coordinator function of parallelization, bank 1 / Lambda setpoint at sensor position without dynamics" UWORD fak_q0p000244 1 100 0.00 15.99976 FORMAT "%8.5" ECU_ADDRESS 0x50001542 /end MEASUREMENT
/begin MEASUREMENT EGSDCmn_LamGenrParlB1_I.sm "state machine of lambda shifting from coordinator function of parallelization, bank 1 / State number" UBYTE EGSDCmn_LamGenrParl_sm_VERB 1 100 0.00 7.00000000000 FORMAT "%13.11" ECU_ADDRESS 0x50001544 /end MEASUREMENT
/begin MEASUREMENT EGSDCmn_LamGenrParlB1_I.stLamGenr "state machine of lambda shifting from coordinator function of parallelization, bank 1 / State number" UBYTE dez 1 100 0.00 255.0 FORMAT "%5.1" ECU_ADDRESS 0x50001545 /end MEASUREMENT
/begin MEASUREMENT EGSDCmn_LamGenrParlB1_I.EnaReldEFNM_I.oldSignal "state machine of lambda shifting from coordinator function of parallelization, bank 1 / Release condition / memory to detect falling edge" UBYTE B_TRUE 1 100 0.00 1.00000000000 BIT_MASK 0x1 FORMAT "%13.11" ECU_ADDRESS 0x50001546 /end MEASUREMENT
/begin MEASUREMENT EGSDCmn_LamGenrParlB1_I.IdnAdpnCTR_I.counter "state machine of lambda shifting from coordinator function of parallelization, bank 1 / Counter for online adaption changes / current counter value" UBYTE dez 1 100 0.00 255.0 FORMAT "%5.1" ECU_ADDRESS 0x50001547 /end MEASUREMENT
/begin MEASUREMENT EGSDCmn_LamGenrParlB1_I.LamLeanMonTOFFV_I.outbit "state machine of lambda shifting from coordinator function of parallelization, bank 1 / state machine of lambda shifting from coordinator function of parallelization / Output Bit" UBYTE B_TRUE 1 100 0.00 1.00000000000 BIT_MASK 0x1 FORMAT "%13.11" ECU_ADDRESS 0x50001548 /end MEASUREMENT
/begin MEASUREMENT EGSDCmn_LamGenrParlB1_I.LamLeanMonTOFFV_I.time "state machine of lambda shifting from coordinator function of parallelization, bank 1 / state machine of lambda shifting from coordinator function of parallelization / Occured Time" UBYTE t_q0p01 1 100 0.00 2.550 FORMAT "%5.3" ECU_ADDRESS 0x50001549 /end MEASUREMENT
/begin MEASUREMENT EGSDCmn_LamGenrParlB1_I.LamRampIKL_I.memory "state machine of lambda shifting from coordinator function of parallelization, bank 1 / lambda ramp / Current Integrator value" ULONG fak_q3p72529Em9 1 100 0.00 15.9999999963 FORMAT "%13.10" ECU_ADDRESS 0x5000154C /end MEASUREMENT
/begin MEASUREMENT EGSDCmn_LamGenrParlB1_I.LamRichMonTOFFV_I.outbit "state machine of lambda shifting from coordinator function of parallelization, bank 1 / state machine of lambda shifting from coordinator function of parallelization / Output Bit" UBYTE B_TRUE 1 100 0.00 1.00000000000 BIT_MASK 0x1 FORMAT "%13.11" ECU_ADDRESS 0x50001550 /end MEASUREMENT
/begin MEASUREMENT EGSDCmn_LamGenrParlB1_I.LamRichMonTOFFV_I.time "state machine of lambda shifting from coordinator function of parallelization, bank 1 / state machine of lambda shifting from coordinator function of parallelization / Occured Time" UBYTE t_q0p01 1 100 0.00 2.550 FORMAT "%5.3" ECU_ADDRESS 0x50001551 /end MEASUREMENT
/begin MEASUREMENT EGSDCmn_LamGenrParlB1_I.LamRichNotStabTONV_I.outbit "state machine of lambda shifting from coordinator function of parallelization, bank 1 / Wait for stable upstream Lambda when cat is empty / return value" UBYTE B_TRUE 1 100 0.00 1.00000000000 BIT_MASK 0x1 FORMAT "%13.11" ECU_ADDRESS 0x50001552 /end MEASUREMENT
/begin MEASUREMENT EGSDCmn_LamGenrParlB1_I.LamRichNotStabTONV_I.time "state machine of lambda shifting from coordinator function of parallelization, bank 1 / Wait for stable upstream Lambda when cat is empty / expired delay time" UWORD t_q0p01 1 100 0.00 655.3500 FORMAT "%8.4" ECU_ADDRESS 0x50001554 /end MEASUREMENT
/begin MEASUREMENT EGSDCmn_LamGenrParlB1_I.LamleanNotStabTONV_I.outbit "state machine of lambda shifting from coordinator function of parallelization, bank 1 / Wait for stable upstream Lambda when cat is full / return value" UBYTE B_TRUE 1 100 0.00 1.00000000000 BIT_MASK 0x1 FORMAT "%13.11" ECU_ADDRESS 0x50001556 /end MEASUREMENT
/begin MEASUREMENT EGSDCmn_LamGenrParlB1_I.LamleanNotStabTONV_I.time "state machine of lambda shifting from coordinator function of parallelization, bank 1 / Wait for stable upstream Lambda when cat is full / expired delay time" UWORD t_q0p01 1 100 0.00 655.3500 FORMAT "%8.4" ECU_ADDRESS 0x50001558 /end MEASUREMENT
/begin MEASUREMENT EGSDCmn_LamGenrParlB1_I.QlyDeFltSuspcER_I.buffer "state machine of lambda shifting from coordinator function of parallelization, bank 1 / Dynamic fault suspicion is detected / rising edge detected" UBYTE B_TRUE 1 100 0.00 1.00000000000 BIT_MASK 0x1 FORMAT "%13.11" ECU_ADDRESS 0x5000155A /end MEASUREMENT
/begin MEASUREMENT EGSDCmn_LamGenrParlB1_I.QlyDeFltSuspcER_I.oldSignal "state machine of lambda shifting from coordinator function of parallelization, bank 1 / Dynamic fault suspicion is detected / flag rising edge" UBYTE B_TRUE 1 100 0.00 1.00000000000 BIT_MASK 0x1 FORMAT "%13.11" ECU_ADDRESS 0x5000155B /end MEASUREMENT
/begin MEASUREMENT EGSDCmn_LamGenrParlB1_I.RampEndLimIK_I.memory "state machine of lambda shifting from coordinator function of parallelization, bank 1 / integrated exhaust gas mass flow during lambda rampe / current integrator value" ULONG m_q1p5259Em8_kg 1 100 0.00 65.5359999847 FORMAT "%13.10" ECU_ADDRESS 0x5000155C /end MEASUREMENT
/begin MEASUREMENT EGSDCmn_LamGenrParlB1_I.flgOSCTestPassdFF_I.status "state machine of lambda shifting from coordinator function of parallelization, bank 1 / OSC partial measurement is complete, waiting for lambda stability / current value of RS-FF" UBYTE B_TRUE 1 100 0.00 1.00000000000 BIT_MASK 0x1 FORMAT "%13.11" ECU_ADDRESS 0x50001560 /end MEASUREMENT
/begin MEASUREMENT EGSDCmn_LamGenrParlB1_I.mO2IdnAdpnIKL_I.memory "state machine of lambda shifting from coordinator function of parallelization, bank 1 / Oxygenmassflow integral for the online adaption / Current Integrator value" FLOAT32_IEEE m_q1_mg 1 100 -1.0000E+037 1.0000E+037 FORMAT "%10.4" ECU_ADDRESS 0x50001564 /end MEASUREMENT
/begin MEASUREMENT EGSDCmn_LamGenrParlB1_I.mfEgLeanLamStabIK_I.memory "state machine of lambda shifting from coordinator function of parallelization, bank 1 / Exhaust gas mass flow throughput for settiment criterium of lambda value in lean / current integrator value" ULONG m_q1p5259Em8_kg 1 100 0.00 65.5359999847 FORMAT "%13.10" ECU_ADDRESS 0x50001568 /end MEASUREMENT
/begin MEASUREMENT EGSDCmn_LamGenrParlB1_I.mfEgRichLamStabIK_I.memory "state machine of lambda shifting from coordinator function of parallelization, bank 1 / Exhaust gas mass flow throughput for settiment criterium of lambda value in rich / current integrator value" ULONG m_q1p5259Em8_kg 1 100 0.00 65.5359999847 FORMAT "%13.10" ECU_ADDRESS 0x5000156C /end MEASUREMENT
/begin MEASUREMENT EGSDCmn_LamGenrParlB1_I.tiDynWpaRampTONVNM_I.time "state machine of lambda shifting from coordinator function of parallelization, bank 1 / turn on delay class instance for ramping lambda / Delay Time" UWORD t_q0p01 1 100 0.00 655.3500 FORMAT "%8.4" ECU_ADDRESS 0x50001570 /end MEASUREMENT
/begin MEASUREMENT EGSDCmn_mCatEmptyGrdtParlB1 "Rich gas mass for the detection that catalyst is empty of oxygen, bank 1" FLOAT32_IEEE m_q1_mg 1 100 0.0000 50000.0000 FORMAT "%10.4" ECU_ADDRESS 0x60003A54 /end MEASUREMENT
/begin MEASUREMENT EGSDCmn_mCatEmptyGrdtPreCdnParlB1 "Rich gas mass for the detection if the catalyst is empty of oxygen, during pre conditioning phase bank 1" FLOAT32_IEEE m_q1_mg 1 100 0.0000 50000.0000 FORMAT "%10.4" ECU_ADDRESS 0x60002F2C /end MEASUREMENT
/begin MEASUREMENT EGSDCmn_mCatFullGrdtParlB1 "Oxygen mass for the detection if catalyst is filled with oxygen during measurement phase, bank 1" FLOAT32_IEEE m_q1_mg 1 100 0.0000 50000.0000 FORMAT "%10.4" ECU_ADDRESS 0x60003A50 /end MEASUREMENT
/begin MEASUREMENT EGSDCmn_mCatFullGrdtPreCdnParlB1 "Oxygen mass for the detection if catalyst 2 is filled with oxygen during pre-conditioning phase, bank 1" FLOAT32_IEEE m_q1_mg 1 100 0.0000 50000.0000 FORMAT "%10.4" ECU_ADDRESS 0x60002F28 /end MEASUREMENT
/begin MEASUREMENT EGSDCmn_mErrTarLeanS2B1Parl "Amount of oxygen mass flow before setting of a target- lean-error-suspicion for Sensor2, Bank1" FLOAT32_IEEE m_q1_mg 1 100 0.0000 50000.0000 FORMAT "%10.4" ECU_ADDRESS 0x60003A4C /end MEASUREMENT
/begin MEASUREMENT EGSDCmn_mErrTarRichS2B1Parl "Amount of oxygen mass flow before setting of a target- Rich error-suspicion for Sensor2, Bank1" FLOAT32_IEEE m_q1_mg 1 100 0.0000 50000.0000 FORMAT "%10.4" ECU_ADDRESS 0x60003A48 /end MEASUREMENT
/begin MEASUREMENT EGSDCmn_mOSCCatCpParlB1 "Oxygen integral lean operation for the calculation of the state transition condition to rich, bank 1" FLOAT32_IEEE m_q1_mg 1 100 -1.0000E+037 1.0000E+037 FORMAT "%10.4" ECU_ADDRESS 0x60003A44 /end MEASUREMENT
/begin MEASUREMENT EGSDCmn_mRampDurB1Parl "Maximum exhaust gas mass for the end of the lambda ramp" UWORD m_q0p001_kg 1 100 0.00 65.53500 FORMAT "%8.5" ECU_ADDRESS 0x60008C98 /end MEASUREMENT
/begin MEASUREMENT EGSDCmn_mRampDurS2B1Parl "Maximum exhaust gas mass for the end of the lambda ramp" UWORD m_q0p001_kg 1 100 0.00 65.53500 FORMAT "%8.5" ECU_ADDRESS 0x60008C96 /end MEASUREMENT
/begin MEASUREMENT EGSDCmn_mRampEndLimParlB1 "Oxygen integration during lambda ramp, bank 1" UWORD m_q0p001_kg 1 100 0.00 65.53500 FORMAT "%8.5" ECU_ADDRESS 0x60008C94 /end MEASUREMENT
/begin MEASUREMENT EGSDCmn_mRSCCatCpParlB1 "Oxygen integral rich operation for the calculation of the state transition condition to lean, bank 1" FLOAT32_IEEE m_q1_mg 1 100 -1.0000E+037 1.0000E+037 FORMAT "%10.4" ECU_ADDRESS 0x60003A40 /end MEASUREMENT
/begin MEASUREMENT EGSDCmn_mRSCNrmVirtParlB1 "Rich gas storage capacity of catalyst for IUMPR simulation in partial measurement, bank 1" ULONG m_q0p1_mg 1 100 0.0000 429496729.5000 FORMAT "%10.4" ECU_ADDRESS 0x60002F24 /end MEASUREMENT
/begin MEASUREMENT EGSDCmn_ratLamRampLeanParl "lambda limit in direction lean of ramp test for range check" UWORD fak_uw_b16 1 100 0.00 15.99976 FORMAT "%8.5" ECU_ADDRESS 0x60013E88 /end MEASUREMENT
/begin MEASUREMENT EGSDCmn_ratLamRampRichParl "lambda limit in direction rich of ramp test for range check" UWORD fak_uw_b16 1 100 0.00 15.99976 FORMAT "%8.5" ECU_ADDRESS 0x60013E8A /end MEASUREMENT
/begin MEASUREMENT EGSDCmn_ratLamReqParlB1 "lambda request for parallelization during check, bank 1" UWORD fak_uw_b16 1 100 0.00 15.99976 FORMAT "%8.5" ECU_ADDRESS 0x60008C8E /end MEASUREMENT
/begin MEASUREMENT EGSDCmn_S1B1VirtLamDynParl_I.flgCatEmpty "state machine of virtual lambda shifting for IUMPR simulation of upstream sensor 1 dynamic diagnosis, bank 1 / Check if catalyst is empty from oxygen" UBYTE B_TRUE 1 100 0.00 1.00000000000 BIT_MASK 0x1 FORMAT "%13.11" ECU_ADDRESS 0x60002E88 /end MEASUREMENT
/begin MEASUREMENT EGSDCmn_S1B1VirtLamDynParl_I.flgCatFull "state machine of virtual lambda shifting for IUMPR simulation of upstream sensor 1 dynamic diagnosis, bank 1 / Check if catalyst is filled with oxygen" UBYTE B_TRUE 1 100 0.00 1.00000000000 BIT_MASK 0x1 FORMAT "%13.11" ECU_ADDRESS 0x60002E89 /end MEASUREMENT
/begin MEASUREMENT EGSDCmn_S1B1VirtLamDynParl_I.flgDynTripDneVirt "state machine of virtual lambda shifting for IUMPR simulation of upstream sensor 1 dynamic diagnosis, bank 1 / Virtuell dynamic check for the upstream sensor" UBYTE B_TRUE 1 100 0.00 1.00000000000 BIT_MASK 0x1 FORMAT "%13.11" ECU_ADDRESS 0x60002E8A /end MEASUREMENT
/begin MEASUREMENT EGSDCmn_S1B1VirtLamDynParl_I.flgIdnAdpnEnd "state machine of virtual lambda shifting for IUMPR simulation of upstream sensor 1 dynamic diagnosis, bank 1 / Status of Online adaption" UBYTE B_TRUE 1 100 0.00 1.00000000000 BIT_MASK 0x1 FORMAT "%13.11" ECU_ADDRESS 0x60002E8B /end MEASUREMENT
/begin MEASUREMENT EGSDCmn_S1B1VirtLamDynParl_I.flgIdnAdpnLean "state machine of virtual lambda shifting for IUMPR simulation of upstream sensor 1 dynamic diagnosis, bank 1 / Status of Online adaptionfor lean lambda" UBYTE B_TRUE 1 100 0.00 1.00000000000 BIT_MASK 0x1 FORMAT "%13.11" ECU_ADDRESS 0x60002E8C /end MEASUREMENT
/begin MEASUREMENT EGSDCmn_S1B1VirtLamDynParl_I.flgIdnAdpnRich "state machine of virtual lambda shifting for IUMPR simulation of upstream sensor 1 dynamic diagnosis, bank 1 / Status of Online adaptionfor rich lambda" UBYTE B_TRUE 1 100 0.00 1.00000000000 BIT_MASK 0x1 FORMAT "%13.11" ECU_ADDRESS 0x60002E8D /end MEASUREMENT
/begin MEASUREMENT EGSDCmn_S1B1VirtLamDynParl_I.flgReld "state machine of virtual lambda shifting for IUMPR simulation of upstream sensor 1 dynamic diagnosis, bank 1 / lambda shifting is released" UBYTE B_TRUE 1 100 0.00 1.00000000000 BIT_MASK 0x1 FORMAT "%13.11" ECU_ADDRESS 0x60002E8E /end MEASUREMENT
/begin MEASUREMENT EGSDCmn_S1B1VirtLamDynParl_I.flgUHiEnaParl "state machine of virtual lambda shifting for IUMPR simulation of upstream sensor 1 dynamic diagnosis, bank 1 / Sensor voltage downstream is high" UBYTE B_TRUE 1 100 0.00 1.00000000000 BIT_MASK 0x1 FORMAT "%13.11" ECU_ADDRESS 0x60002E8F /end MEASUREMENT
/begin MEASUREMENT EGSDCmn_S1B1VirtLamDynParl_I.flgUMid "state machine of virtual lambda shifting for IUMPR simulation of upstream sensor 1 dynamic diagnosis, bank 1 / sensor voltage in medium range (two stage preconditioning required)" UBYTE B_TRUE 1 100 0.00 1.00000000000 BIT_MASK 0x1 FORMAT "%13.11" ECU_ADDRESS 0x60002E90 /end MEASUREMENT
/begin MEASUREMENT EGSDCmn_S1B1VirtLamDynParl_I.flgVirtLamDyn "state machine of virtual lambda shifting for IUMPR simulation of upstream sensor 1 dynamic diagnosis, bank 1 / Activation of IUMPR simulation for UEGO dynamic diagnosis" UBYTE B_TRUE 1 100 0.00 1.00000000000 BIT_MASK 0x1 FORMAT "%13.11" ECU_ADDRESS 0x60002E91 /end MEASUREMENT
/begin MEASUREMENT EGSDCmn_S1B1VirtLamDynParl_I.mOSC "state machine of virtual lambda shifting for IUMPR simulation of upstream sensor 1 dynamic diagnosis, bank 1 / Assumed oxygen storage capacity for first catalyst" FLOAT32_IEEE m_q1_mg 1 100 0.00 50000.0000 FORMAT "%10.4" ECU_ADDRESS 0x60002E94 /end MEASUREMENT
/begin MEASUREMENT EGSDCmn_S1B1VirtLamDynParl_I.mRSC "state machine of virtual lambda shifting for IUMPR simulation of upstream sensor 1 dynamic diagnosis, bank 1 / Assumed rich gas storage capacity for first catalyst" FLOAT32_IEEE m_q1_mg 1 100 0.00 50000.0000 FORMAT "%10.4" ECU_ADDRESS 0x60002E98 /end MEASUREMENT
/begin MEASUREMENT EGSDCmn_S1B1VirtLamDynParl_I.mfVirtO2 "state machine of virtual lambda shifting for IUMPR simulation of upstream sensor 1 dynamic diagnosis, bank 1 / Oxygen mass flow in catalyst 1, corrected by maximum possible mixture deviation in a fault free system" FLOAT32_IEEE mgrad_q1_mgdivs 1 100 0.00 50000.0000 FORMAT "%10.4" ECU_ADDRESS 0x60002E9C /end MEASUREMENT
/begin MEASUREMENT EGSDCmn_S1B1VirtLamDynParl_I.mfVirtRich "state machine of virtual lambda shifting for IUMPR simulation of upstream sensor 1 dynamic diagnosis, bank 1 / Rich Gas mass flow in catalyst 1, corrected by maximum possible mixture deviation in a fault free system" FLOAT32_IEEE mgrad_q1_mgdivs 1 100 0.00 50000.0000 FORMAT "%10.4" ECU_ADDRESS 0x60002EA0 /end MEASUREMENT
/begin MEASUREMENT EGSDCmn_S1B1VirtLamDynParl_I.sm "state machine of virtual lambda shifting for IUMPR simulation of upstream sensor 1 dynamic diagnosis, bank 1 / State number" UBYTE EGSDCmn_VirtLamGenrParl_sm_VERB 1 100 0.00 7.00000000000 FORMAT "%13.11" ECU_ADDRESS 0x60002EA4 /end MEASUREMENT
/begin MEASUREMENT EGSDCmn_S1B1VirtLamDynParl_I.stLamGenr "state machine of virtual lambda shifting for IUMPR simulation of upstream sensor 1 dynamic diagnosis, bank 1 / State number" UBYTE dez 1 100 0.00 255.0 FORMAT "%5.1" ECU_ADDRESS 0x60002EA5 /end MEASUREMENT
/begin MEASUREMENT EGSDCmn_S1B1VirtLamDynParl_I.tiGas "state machine of virtual lambda shifting for IUMPR simulation of upstream sensor 1 dynamic diagnosis, bank 1 / gas propagation time till first Lambda sensor" UWORD t_q0p1 1 100 0.00 6553.500 FORMAT "%8.3" ECU_ADDRESS 0x60002EA6 /end MEASUREMENT
/begin MEASUREMENT EGSDCmn_S1B1VirtLamDynParl_I.tiLamDynLtr "state machine of virtual lambda shifting for IUMPR simulation of upstream sensor 1 dynamic diagnosis, bank 1 / Dynamic time lambda signal of upstream sensor 1 Lean-Rich" UWORD t_q0p1 1 100 0.00 6553.500 FORMAT "%8.3" ECU_ADDRESS 0x60002EA8 /end MEASUREMENT
/begin MEASUREMENT EGSDCmn_S1B1VirtLamDynParl_I.tiLamDynRtl "state machine of virtual lambda shifting for IUMPR simulation of upstream sensor 1 dynamic diagnosis, bank 1 / Dynamic time lambda signal of upstream sensor 1 Rich-Lean" UWORD t_q0p1 1 100 0.00 6553.500 FORMAT "%8.3" ECU_ADDRESS 0x60002EAA /end MEASUREMENT
/begin MEASUREMENT EGSDCmn_S1B1VirtLamDynParl_I.tiUDynLtr "state machine of virtual lambda shifting for IUMPR simulation of upstream sensor 1 dynamic diagnosis, bank 1 / Dynamic reaction time of downstream sensor, Lean-Rich" UWORD t_q0p1 1 100 0.00 6553.500 FORMAT "%8.3" ECU_ADDRESS 0x60002EAC /end MEASUREMENT
/begin MEASUREMENT EGSDCmn_S1B1VirtLamDynParl_I.tiUDynRtl "state machine of virtual lambda shifting for IUMPR simulation of upstream sensor 1 dynamic diagnosis, bank 1 / Dynamic reaction time of downstream sensor, Rich-Lean" UWORD t_q0p1 1 100 0.00 6553.500 FORMAT "%8.3" ECU_ADDRESS 0x60002EAE /end MEASUREMENT
/begin MEASUREMENT EGSDCmn_S1B1VirtLamDynParl_I.u "state machine of virtual lambda shifting for IUMPR simulation of upstream sensor 1 dynamic diagnosis, bank 1 / Sensor voltage of downstream sensor" UWORD spg_q1p221Em3_V 1 100 0.00 4.998779 FORMAT "%8.6" ECU_ADDRESS 0x60002EB0 /end MEASUREMENT
/begin MEASUREMENT EGSDCmn_S1B1VirtLamDynParl_I.EnaReldEF_I.buffer "state machine of virtual lambda shifting for IUMPR simulation of upstream sensor 1 dynamic diagnosis, bank 1 / EdgeFalling: loss of enable condition / memory to detect falling edge" UBYTE B_TRUE 1 100 0.00 1.00000000000 BIT_MASK 0x1 FORMAT "%13.11" ECU_ADDRESS 0x60002EB2 /end MEASUREMENT
/begin MEASUREMENT EGSDCmn_S1B1VirtLamDynParl_I.EnaReldEF_I.oldSignal "state machine of virtual lambda shifting for IUMPR simulation of upstream sensor 1 dynamic diagnosis, bank 1 / EdgeFalling: loss of enable condition / memory to detect falling edge" UBYTE B_TRUE 1 100 0.00 1.00000000000 BIT_MASK 0x1 FORMAT "%13.11" ECU_ADDRESS 0x60002EB3 /end MEASUREMENT
/begin MEASUREMENT EGSDCmn_S1B1VirtLamDynParl_I.IdnAdpnCTR_I.counter "state machine of virtual lambda shifting for IUMPR simulation of upstream sensor 1 dynamic diagnosis, bank 1 / Counter for lambda jumps for online adaption purposes / current counter value" UWORD dez 1 100 0.00 65535.00 FORMAT "%8.2" ECU_ADDRESS 0x60002EB4 /end MEASUREMENT
/begin MEASUREMENT EGSDCmn_S1B1VirtLamDynParl_I.flgLeanLamStabTONV_I.outbit "state machine of virtual lambda shifting for IUMPR simulation of upstream sensor 1 dynamic diagnosis, bank 1 / Waiting time for lean lambda stability criterion / return value" UBYTE B_TRUE 1 100 0.00 1.00000000000 BIT_MASK 0x1 FORMAT "%13.11" ECU_ADDRESS 0x60002EB6 /end MEASUREMENT
/begin MEASUREMENT EGSDCmn_S1B1VirtLamDynParl_I.flgLeanLamStabTONV_I.time "state machine of virtual lambda shifting for IUMPR simulation of upstream sensor 1 dynamic diagnosis, bank 1 / Waiting time for lean lambda stability criterion / expired delay time" UWORD t_q0p1 1 100 0.00 6553.500 FORMAT "%8.3" ECU_ADDRESS 0x60002EB8 /end MEASUREMENT
/begin MEASUREMENT EGSDCmn_S1B1VirtLamDynParl_I.flgRichLamStabTONV_I.outbit "state machine of virtual lambda shifting for IUMPR simulation of upstream sensor 1 dynamic diagnosis, bank 1 / Waiting time for rich lambda stability criterion / return value" UBYTE B_TRUE 1 100 0.00 1.00000000000 BIT_MASK 0x1 FORMAT "%13.11" ECU_ADDRESS 0x60002EBA /end MEASUREMENT
/begin MEASUREMENT EGSDCmn_S1B1VirtLamDynParl_I.flgRichLamStabTONV_I.time "state machine of virtual lambda shifting for IUMPR simulation of upstream sensor 1 dynamic diagnosis, bank 1 / Waiting time for rich lambda stability criterion / expired delay time" UWORD t_q0p1 1 100 0.00 6553.500 FORMAT "%8.3" ECU_ADDRESS 0x60002EBC /end MEASUREMENT
/begin MEASUREMENT EGSDCmn_S1B1VirtLamDynParl_I.mO2EnaCatFullGrdtIK_I.memory "state machine of virtual lambda shifting for IUMPR simulation of upstream sensor 1 dynamic diagnosis, bank 1 / Integrator for oxygen gas mass flow for detection if catalyst is filled with oxygen / current integrator value" FLOAT32_IEEE m_q1_mg 1 100 -1.0000E+037 1.0000E+037 FORMAT "%10.4" ECU_ADDRESS 0x60002EC0 /end MEASUREMENT
/begin MEASUREMENT EGSDCmn_S1B1VirtLamDynParl_I.mO2IdnAdpnIKL_I.memory "state machine of virtual lambda shifting for IUMPR simulation of upstream sensor 1 dynamic diagnosis, bank 1 / Integrator for oxygen or rich gas mass flow for lambda jumps for online adaption purposes / Current Integrator value" FLOAT32_IEEE m_q1_mg 1 100 -1.0000E+037 1.0000E+037 FORMAT "%10.4" ECU_ADDRESS 0x60002EC4 /end MEASUREMENT
/begin MEASUREMENT EGSDCmn_S1B1VirtLamDynParl_I.mO2VirtEnaCatEmptyIK_I.memory "state machine of virtual lambda shifting for IUMPR simulation of upstream sensor 1 dynamic diagnosis, bank 1 / Integrator for rich gas mass flow for detection if catalyst is emtpied from oxygen / current integrator value" FLOAT32_IEEE m_q1_mg 1 100 -1.0000E+037 1.0000E+037 FORMAT "%10.4" ECU_ADDRESS 0x60002EC8 /end MEASUREMENT
/begin MEASUREMENT EGSDCmn_S1B1VirtLamDynParl_I.tiGasRtlTONV_I.outbit "state machine of virtual lambda shifting for IUMPR simulation of upstream sensor 1 dynamic diagnosis, bank 1 / Simulation of gas propagation till first Lambda sensor / return value" UBYTE B_TRUE 1 100 0.00 1.00000000000 BIT_MASK 0x1 FORMAT "%13.11" ECU_ADDRESS 0x60002ECC /end MEASUREMENT
/begin MEASUREMENT EGSDCmn_S1B1VirtLamDynParl_I.tiGasRtlTONV_I.time "state machine of virtual lambda shifting for IUMPR simulation of upstream sensor 1 dynamic diagnosis, bank 1 / Simulation of gas propagation till first Lambda sensor / expired delay time" UWORD t_q0p1 1 100 0.00 6553.500 FORMAT "%8.3" ECU_ADDRESS 0x60002ECE /end MEASUREMENT
/begin MEASUREMENT EGSDCmn_S1B1VirtLamDynParl_I.tiUDynTONV_I.outbit "state machine of virtual lambda shifting for IUMPR simulation of upstream sensor 1 dynamic diagnosis, bank 1 / simulation time for sensor dynamic of downstream sensor / return value" UBYTE B_TRUE 1 100 0.00 1.00000000000 BIT_MASK 0x1 FORMAT "%13.11" ECU_ADDRESS 0x60002ED0 /end MEASUREMENT
/begin MEASUREMENT EGSDCmn_S1B1VirtLamDynParl_I.tiUDynTONV_I.time "state machine of virtual lambda shifting for IUMPR simulation of upstream sensor 1 dynamic diagnosis, bank 1 / simulation time for sensor dynamic of downstream sensor / expired delay time" UWORD t_q0p1 1 100 0.00 6553.500 FORMAT "%8.3" ECU_ADDRESS 0x60002ED2 /end MEASUREMENT
/begin MEASUREMENT EGSDCmn_S2B1AsymcToSymc_I.flgLtrDly "Symmetrization of first downstream sensor signal, Bank1 / lean-rich delay dynamic pattern identified" UBYTE B_TRUE 1 100 0.00 1.00000000000 BIT_MASK 0x1 FORMAT "%13.11" ECU_ADDRESS 0x50001574 /end MEASUREMENT
/begin MEASUREMENT EGSDCmn_S2B1AsymcToSymc_I.flgLtrTran "Symmetrization of first downstream sensor signal, Bank1 / lean-rich transition dynamic pattern identified" UBYTE B_TRUE 1 100 0.00 1.00000000000 BIT_MASK 0x1 FORMAT "%13.11" ECU_ADDRESS 0x50001575 /end MEASUREMENT
/begin MEASUREMENT EGSDCmn_S2B1AsymcToSymc_I.flgRtlDly "Symmetrization of first downstream sensor signal, Bank1 / rich-lean delay dynamic pattern identified" UBYTE B_TRUE 1 100 0.00 1.00000000000 BIT_MASK 0x1 FORMAT "%13.11" ECU_ADDRESS 0x50001576 /end MEASUREMENT
/begin MEASUREMENT EGSDCmn_S2B1AsymcToSymc_I.flgRtlTran "Symmetrization of first downstream sensor signal, Bank1 / rich-lean transition dynamic pattern identified" UBYTE B_TRUE 1 100 0.00 1.00000000000 BIT_MASK 0x1 FORMAT "%13.11" ECU_ADDRESS 0x50001577 /end MEASUREMENT
/begin MEASUREMENT EGSDCmn_S2B1AsymcToSymc_I.flgSymcEna "Symmetrization of first downstream sensor signal, Bank1 / Status of enabling" UBYTE B_TRUE 1 100 0.00 1.00000000000 BIT_MASK 0x1 FORMAT "%13.11" ECU_ADDRESS 0x50001578 /end MEASUREMENT
/begin MEASUREMENT EGSDCmn_S2B1AsymcToSymc_I.tiLtrDlySymc "Symmetrization of first downstream sensor signal, Bank1 / lean-rich delay time for symmetrization" UWORD t_q0p01 1 100 0.00 655.3500 FORMAT "%8.4" ECU_ADDRESS 0x5000157A /end MEASUREMENT
/begin MEASUREMENT EGSDCmn_S2B1AsymcToSymc_I.tiLtrTranSymc "Symmetrization of first downstream sensor signal, Bank1 / lean-rich transition time for symmetrization" UWORD t_q0p01 1 100 0.00 655.3500 FORMAT "%8.4" ECU_ADDRESS 0x5000157C /end MEASUREMENT
/begin MEASUREMENT EGSDCmn_S2B1AsymcToSymc_I.tiRtlDlySymc "Symmetrization of first downstream sensor signal, Bank1 / rich-lean delay time for symmetrization" UWORD t_q0p01 1 100 0.00 655.3500 FORMAT "%8.4" ECU_ADDRESS 0x5000157E /end MEASUREMENT
/begin MEASUREMENT EGSDCmn_S2B1AsymcToSymc_I.tiRtlTranSymc "Symmetrization of first downstream sensor signal, Bank1 / rich-lean transition time for symmetrization" UWORD t_q0p01 1 100 0.00 655.3500 FORMAT "%8.4" ECU_ADDRESS 0x50001580 /end MEASUREMENT
/begin MEASUREMENT EGSDCmn_S2B1AsymcToSymc_I.uFildParlSymc "Symmetrization of first downstream sensor signal, Bank1 / Symmetrized sensor voltage of downstream sensor for parallelized diagnoses" UWORD spg_q1p221Em3_V 1 100 0.00 4.998779 FORMAT "%8.6" ECU_ADDRESS 0x50001582 /end MEASUREMENT
/begin MEASUREMENT EGSDCmn_S2B1AsymcToSymc_I.uNoSymcOld "Symmetrization of first downstream sensor signal, Bank1 / old sensor voltage value before symmetrization" UWORD spg_q1p221Em3_V 1 100 0.00 4.998779 FORMAT "%8.6" ECU_ADDRESS 0x50001584 /end MEASUREMENT
/begin MEASUREMENT EGSDCmn_S2B1AsymcToSymc_I.USymcActvFF_I.status "Symmetrization of first downstream sensor signal, Bank1 / FlipFlop : Symmetrization activated / current value of RS-FF" UBYTE B_TRUE 1 100 0.00 1.00000000000 BIT_MASK 0x1 FORMAT "%13.11" ECU_ADDRESS 0x50001586 /end MEASUREMENT
/begin MEASUREMENT EGSDCmn_S2B1AsymcToSymc_I.USymcEnaER_I.buffer "Symmetrization of first downstream sensor signal, Bank1 / EdgeRise : initialization of symmetrization elements / rising edge detected" UBYTE B_TRUE 1 100 0.00 1.00000000000 BIT_MASK 0x1 FORMAT "%13.11" ECU_ADDRESS 0x50001588 /end MEASUREMENT
/begin MEASUREMENT EGSDCmn_S2B1AsymcToSymc_I.USymcEnaER_I.oldSignal "Symmetrization of first downstream sensor signal, Bank1 / EdgeRise : initialization of symmetrization elements / flag rising edge" UBYTE B_TRUE 1 100 0.00 1.00000000000 BIT_MASK 0x1 FORMAT "%13.11" ECU_ADDRESS 0x50001589 /end MEASUREMENT
/begin MEASUREMENT EGSDCmn_S2B1AsymcToSymc_I.uDlyDTTtopt_I.buffer "Symmetrization of first downstream sensor signal, Bank1 / delay of sensor voltage signal / buffer for delay library element" UWORD spg_q1p221Em3_V 1 100 0.00 4.998779 FORMAT "%8.6" ARRAY_SIZE 21 ECU_ADDRESS 0x5000158A /end MEASUREMENT
/begin MEASUREMENT EGSDCmn_S2B1AsymcToSymc_I.uDlyDTTtopt_I.counter "Symmetrization of first downstream sensor signal, Bank1 / delay of sensor voltage signal / counter for delay library element" UWORD fak_uw_b2 1 100 0.00 1.000000 FORMAT "%8.6" ECU_ADDRESS 0x500015B4 /end MEASUREMENT
/begin MEASUREMENT EGSDCmn_S2B1AsymcToSymc_I.uDlyDTTtopt_I.pointer "Symmetrization of first downstream sensor signal, Bank1 / delay of sensor voltage signal / pointer for delay library element" UBYTE dez 1 100 0.00 255.0 FORMAT "%5.1" ECU_ADDRESS 0x500015B6 /end MEASUREMENT
/begin MEASUREMENT EGSDCmn_S2B1AsymcToSymc_I.uTranLT_I.memory "Symmetrization of first downstream sensor signal, Bank1 / filtering of sensor voltage signal / current lowpass value" ULONG spg_q1p8626Em8_V 1 100 0.00 4.99999998137 FORMAT "%13.11" ECU_ADDRESS 0x500015B8 /end MEASUREMENT
/begin MEASUREMENT EGSDCmn_S2B1VirtTarLeanOffsParl_I.flgCatEmptyTOut "Virtual lambda shifting for IUMPR simulation of range check of lean target sensor voltage with Lambda Offset, bank 1 / Time out while checking if catalyst is empty from oxygen" UBYTE B_TRUE 1 100 0.00 1.00000000000 BIT_MASK 0x1 FORMAT "%13.11" ECU_ADDRESS 0x500015BC /end MEASUREMENT
/begin MEASUREMENT EGSDCmn_S2B1VirtTarLeanOffsParl_I.flgCatFullTOut "Virtual lambda shifting for IUMPR simulation of range check of lean target sensor voltage with Lambda Offset, bank 1 / Time out while checking if catalyst is filled with oxygen" UBYTE B_TRUE 1 100 0.00 1.00000000000 BIT_MASK 0x1 FORMAT "%13.11" ECU_ADDRESS 0x500015BD /end MEASUREMENT
/begin MEASUREMENT EGSDCmn_S2B1VirtTarLeanOffsParl_I.flgReld "Virtual lambda shifting for IUMPR simulation of range check of lean target sensor voltage with Lambda Offset, bank 1 / lambda shifting is released" UBYTE B_TRUE 1 100 0.00 1.00000000000 BIT_MASK 0x1 FORMAT "%13.11" ECU_ADDRESS 0x500015BE /end MEASUREMENT
/begin MEASUREMENT EGSDCmn_S2B1VirtTarLeanOffsParl_I.flgTarLeanRes "Virtual lambda shifting for IUMPR simulation of range check of lean target sensor voltage with Lambda Offset, bank 1 / check of lean sensor voltage, result is available" UBYTE B_TRUE 1 100 0.00 1.00000000000 BIT_MASK 0x1 FORMAT "%13.11" ECU_ADDRESS 0x500015BF /end MEASUREMENT
/begin MEASUREMENT EGSDCmn_S2B1VirtTarLeanOffsParl_I.flgTarRich "Virtual lambda shifting for IUMPR simulation of range check of lean target sensor voltage with Lambda Offset, bank 1 / Target Rich check is activated" UBYTE B_TRUE 1 100 0.00 1.00000000000 BIT_MASK 0x1 FORMAT "%13.11" ECU_ADDRESS 0x500015C0 /end MEASUREMENT
/begin MEASUREMENT EGSDCmn_S2B1VirtTarLeanOffsParl_I.flgTarRichRes "Virtual lambda shifting for IUMPR simulation of range check of lean target sensor voltage with Lambda Offset, bank 1 / check of rich sensor voltage, result is available" UBYTE B_TRUE 1 100 0.00 1.00000000000 BIT_MASK 0x1 FORMAT "%13.11" ECU_ADDRESS 0x500015C1 /end MEASUREMENT
/begin MEASUREMENT EGSDCmn_S2B1VirtTarLeanOffsParl_I.flgUHiEnaParl "Virtual lambda shifting for IUMPR simulation of range check of lean target sensor voltage with Lambda Offset, bank 1 / Sensor voltage downstream is high" UBYTE B_TRUE 1 100 0.00 1.00000000000 BIT_MASK 0x1 FORMAT "%13.11" ECU_ADDRESS 0x500015C2 /end MEASUREMENT
/begin MEASUREMENT EGSDCmn_S2B1VirtTarLeanOffsParl_I.mOSC "Virtual lambda shifting for IUMPR simulation of range check of lean target sensor voltage with Lambda Offset, bank 1 / Assumed oxygen storage capacity for first catalyst" FLOAT32_IEEE m_q1_mg 1 100 0.00 50000.0000 FORMAT "%10.4" ECU_ADDRESS 0x500015C4 /end MEASUREMENT
/begin MEASUREMENT EGSDCmn_S2B1VirtTarLeanOffsParl_I.mRSC "Virtual lambda shifting for IUMPR simulation of range check of lean target sensor voltage with Lambda Offset, bank 1 / Assumed rich gas storage capacity for first catalyst" FLOAT32_IEEE m_q1_mg 1 100 0.00 50000.0000 FORMAT "%10.4" ECU_ADDRESS 0x500015C8 /end MEASUREMENT
/begin MEASUREMENT EGSDCmn_S2B1VirtTarLeanOffsParl_I.mRampDurParl "Virtual lambda shifting for IUMPR simulation of range check of lean target sensor voltage with Lambda Offset, bank 1 / Needed amount of exhaust mass during ramp-test" UWORD m_q0p001_kg 1 100 0.00 65.53500 FORMAT "%8.5" ECU_ADDRESS 0x500015CC /end MEASUREMENT
/begin MEASUREMENT EGSDCmn_S2B1VirtTarLeanOffsParl_I.mfEg "Virtual lambda shifting for IUMPR simulation of range check of lean target sensor voltage with Lambda Offset, bank 1 / Exhaust gas mass flow" UWORD m_q0p1 1 100 0.00 6553.500 FORMAT "%8.3" ECU_ADDRESS 0x500015CE /end MEASUREMENT
/begin MEASUREMENT EGSDCmn_S2B1VirtTarLeanOffsParl_I.mfVirtO2 "Virtual lambda shifting for IUMPR simulation of range check of lean target sensor voltage with Lambda Offset, bank 1 / Oxygen mass flow in catalyst 1, corrected by maximum possible mixture deviation in a fault free system" FLOAT32_IEEE mgrad_q1_mgdivs 1 100 0.00 50000.0000 FORMAT "%10.4" ECU_ADDRESS 0x500015D0 /end MEASUREMENT
/begin MEASUREMENT EGSDCmn_S2B1VirtTarLeanOffsParl_I.mfVirtRich "Virtual lambda shifting for IUMPR simulation of range check of lean target sensor voltage with Lambda Offset, bank 1 / Rich Gas mass flow in catalyst 1, corrected by maximum possible mixture deviation in a fault free system" FLOAT32_IEEE mgrad_q1_mgdivs 1 100 0.00 50000.0000 FORMAT "%10.4" ECU_ADDRESS 0x500015D4 /end MEASUREMENT
/begin MEASUREMENT EGSDCmn_stLamGenrParlB1 "status of state machine of lambda shifting from coordinator function of parallelization, bank 1" UBYTE dez 1 100 0.00 255.0 FORMAT "%5.1" ECU_ADDRESS 0x6000F456 /end MEASUREMENT
/begin MEASUREMENT EGSDCmn_stVirtCatParlB1 "status of virtual lambda shifting for IUMPR simulation of catalyst diagnosis" UBYTE dez 1 100 0.00 255.0 FORMAT "%5.1" ECU_ADDRESS 0x6000EFB4 /end MEASUREMENT
/begin MEASUREMENT EGSDCmn_stVirtLamDynParlB1 "status of virtual lambda shifting for IUMPR simulation of Lambda signal dynamic diagnosis" UBYTE dez 1 100 0.00 255.0 FORMAT "%5.1" ECU_ADDRESS 0x6000EFB3 /end MEASUREMENT
/begin MEASUREMENT EGSDCmn_stVirtTarLeanOffsParlB1 "status of virtual lambda shifting for IUMPR simulation of range check of lean target sensor voltage with Lambda Offset, bank 1" UBYTE dez 1 100 0.00 255.0 FORMAT "%5.1" ECU_ADDRESS 0x60014120 /end MEASUREMENT
/begin MEASUREMENT EGSDCmn_stVirtTarLeanParlB1 "status of virtual lambda shifting for IUMPR simulation of range check of lean target sensor voltage, bank 1" UBYTE dez 1 100 0.00 255.0 FORMAT "%5.1" ECU_ADDRESS 0x60014121 /end MEASUREMENT
/begin MEASUREMENT EGSDCmn_stVirtTarRichOffsParlB1 "status of virtual lambda shifting for IUMPR simulation of range check of rich target sensor voltage with Lambda Offset, bank 1" UBYTE dez 1 100 0.00 255.0 FORMAT "%5.1" ECU_ADDRESS 0x60014122 /end MEASUREMENT
/begin MEASUREMENT EGSDCmn_stVirtTarRichParlB1 "status of virtual lambda shifting for IUMPR simulation of range check of rich target sensor voltage, bank 1" UBYTE dez 1 100 0.00 255.0 FORMAT "%5.1" ECU_ADDRESS 0x60014123 /end MEASUREMENT
/begin MEASUREMENT EGSDCmn_stVirtUDlyParlB1 "status of virtual lambda shifting for IUMPR simulation of measurement of delay time of sensor voltage, bank 1" UBYTE dez 1 100 0.00 255.0 FORMAT "%5.1" ECU_ADDRESS 0x6000EFB2 /end MEASUREMENT
/begin MEASUREMENT EGSDCmn_stVirtUTranParlB1 "status of virtual lambda shifting for IUMPR simulation of transition time of sensor voltage" UBYTE dez 1 100 0.00 255.0 FORMAT "%5.1" ECU_ADDRESS 0x6000EFB1 /end MEASUREMENT
/begin MEASUREMENT EGSDCmn_tiObsvrTOutEmptyParlB1 "Duration of the rich measurement phase, bank 1" UWORD t_q0p01 1 100 0.00 655.3500 FORMAT "%8.4" ECU_ADDRESS 0x60008C8C /end MEASUREMENT
/begin MEASUREMENT EGSDCmn_tiObsvrTOutExtParlB1 "Duration of the external lambda ramp, bank 1" UWORD t_q0p01 1 100 0.00 655.3500 FORMAT "%8.4" ECU_ADDRESS 0x60008C8A /end MEASUREMENT
/begin MEASUREMENT EGSDCmn_tiObsvrTOutFullParlB1 "Duration of the lean measurement phase, bank 1" UWORD t_q0p01 1 100 0.00 655.3500 FORMAT "%8.4" ECU_ADDRESS 0x60008C88 /end MEASUREMENT
/begin MEASUREMENT EGSDCmn_uS2B1CatEmptMaxParl "Maximum sensor voltage during lambda shifting to rich, sensor 2" UWORD spg_q1p221Em3_V 1 100 0.00 4.998779 FORMAT "%8.6" ECU_ADDRESS 0x60013E8E /end MEASUREMENT
/begin MEASUREMENT EGSDCmn_uS2B1CatFullMinParl "Minimum sensor voltage during lambda shifting to rich, sensor 2" UWORD spg_q1p221Em3_V 1 100 0.00 4.998779 FORMAT "%8.6" ECU_ADDRESS 0x60013E90 /end MEASUREMENT
/begin FUNCTION EGRVlv_DELib_ElecActrVdPosnGovrInp "10.3.0"
 /begin DEF_CHARACTERISTIC EGRVlv_EndStopDetCal.uRawThdEndStopMax_C EGRVlv_EndStopDetCal.uRawThdEndStopMin_C EGRVlv_EndStopDetCal.stEndStopSetMask_C EGRVlv_EndStopDetCal.stEndStopRstMask_C EGRVlv_EndStopDetCal.tqMaxEndStopRstThd_C EGRVlv_EndStopDetCal.tqMinEndStopRstThd_C EGRVlv_EndStopDetCal.tqThdMaxEndStopSus_C EGRVlv_EndStopDetCal.tqThdMinEndStopSus_C EGRVlv_EndStopDetCal.tiNoMoveClr_C EGRVlv_EndStopDetCal.tiNoMoveDet_C EGRVlv_facFrcCorr_MAP EGRVlv_facGear_CUR EGRVlv_facKdDwn_CUR EGRVlv_facKdUp_CUR EGRVlv_facKiDwn_CUR EGRVlv_facKiUp_CUR EGRVlv_facKp2_CUR EGRVlv_facKpDwn_CUR EGRVlv_facKpUp_CUR EGRVlv_facMotSpd_CUR EGRVlv_facPreCtl_CUR EGRVlv_gArmtr_CUR EGRVlv_HystComp2.drDesValFltHi_C EGRVlv_HystComp2.drDesValFltLo_C EGRVlv_HystComp2.drGovDvtDwn_C EGRVlv_HystComp2.drGovDvtUp_C EGRVlv_HystComp2.facPreCtlDwnTempCorr_CUR EGRVlv_HystComp2.facPreCtlUpTempCorr_CUR EGRVlv_HystComp2.rGovDvtDwn_C EGRVlv_HystComp2.rGovDvtHi_C EGRVlv_HystComp2.rGovDvtLo_C EGRVlv_HystComp2.rGovDvtUp_C EGRVlv_HystComp2.rPreCtlDwnMain_MAP EGRVlv_HystComp2.rPreCtlDwn_MAP EGRVlv_HystComp2.rPreCtlUpMain_MAP EGRVlv_HystComp2.rPreCtlUp_MAP EGRVlv_HystComp2.tiDesValFlt_C EGRVlv_iEffLimn_MAP EGRVlv_ILimnCal.ratThdMax_C EGRVlv_ILimnCal.tiNoLimn_C EGRVlv_ILimnCal.tiLimn_C EGRVlv_ILimnCal.nrILimnDrvCyc_C EGRVlv_ILimnCal.tiBtwConsctvILimn_C EGRVlv_ILimnCal.ratGovrLim_C EGRVlv_ILimnCal.flgSwtInpSeln_C EGRVlv_ILimnCal.swtTGovrLimActv_C EGRVlv_Kd_CUR EGRVlv_Kd_MAP EGRVlv_Ki_CUR EGRVlv_Ki_MAP EGRVlv_Kp_CUR EGRVlv_Kp_MAP EGRVlv_LrnTstCal.rDesValMaxLrnATS_C EGRVlv_LrnTstCal.rDesValMinLrnATS_C EGRVlv_LrnTstCal.rCtlRngMaxATS_C EGRVlv_LrnTstCal.rCtlRngMinATS_C EGRVlv_LrnTstCal.tiPerFrstLrn_C EGRVlv_LrnTstCal.tiPerResetLrn_C EGRVlv_numSelPdsbc1_C EGRVlv_numSelPdsbc2_C EGRVlv_PosGovExtdCal.drDesValDwn_C EGRVlv_PosGovExtdCal.drDesValUp_C EGRVlv_PosGovExtdCal.rGovDvtDwn_C EGRVlv_PosGovExtdCal.rGovDvtUp_C EGRVlv_PosGovExtdCal.numGainCorrCurIn_C EGRVlv_rFric_CUR EGRVlv_rGovDvtLimI_CUR EGRVlv_rGovMaxLrn_CUR EGRVlv_rGovMaxMechBnd_CUR EGRVlv_rGovMaxMechBnd_MAP EGRVlv_rGovMax_MAP EGRVlv_rGovMinLrn_CUR EGRVlv_rGovMinMechBnd_CUR EGRVlv_rGovMinMechBnd_MAP EGRVlv_RmpSlp.Pos_C EGRVlv_RmpSlp.Neg_C EGRVlv_rPIDGovDvtMax_MAP EGRVlv_rPreCtl2_MAP EGRVlv_rPreCtl_MAP EGRVlv_tiBckEMFConst_CUR EGRVlv_tiCrntEffLpFltPar_T EGRVlv_TransStg.Dfl_C EGRVlv_TransStg.stSensId_C EGRVlv_trqActrMax_CUR EGRVlv_trqActrMin_CUR EGRVlv_trqMotCnvn_CUR /end DEF_CHARACTERISTIC
 /begin REF_CHARACTERISTIC EGRVlv_Cal.tiBattCorFacFlt_C EGRVlv_Cal.rDesValFailSafe_C EGRVlv_Cal.slpFailSafePos_C EGRVlv_Cal.slpFailSafeNeg_C EGRVlv_Cal.tiDesValFlt_C EGRVlv_Cal.tiduRawFlt_C EGRVlv_Cal.uFailSafeBattMin_C EGRVlv_Cal.uFailSafeBattMax_C EGRVlv_Cal.uBattMin_C EGRVlv_Cal.uBattMax_C EGRVlv_Cal.uBattMinNoLrn_C EGRVlv_Cal.uBattMaxNoLrn_C EGRVlv_Cal.facCorStrt_C EGRVlv_Cal.numTEng_C EGRVlv_Cal.tEngMin_C EGRVlv_Cal.tEngMax_C EGRVlv_Cal.rCtlRngMin_C EGRVlv_Cal.rCtlRngMax_C EGRVlv_Cal.tiTempErrOk_C EGRVlv_Cal.rActActrActv_C EGRVlv_Cal.tiSoftShOff_C EGRVlv_Cal.rDesValSoftShOff_C EGRVlv_Cal.stActrDiaDis_C EGRVlv_Cal.stActrDis_C EGRVlv_Cal.numTempErrDef_C EGRVlv_Cal.swtNrmInv_C EGRVlv_Cal.rPwrStgDis_C EGRVlv_Cal.tAirSysFldMin_C EGRVlv_Cal.tAirSysFldMax_C EGRVlv_Cal.tExhFldMin_C EGRVlv_Cal.tExhFldMax_C EGRVlv_Cal.tEngDaFldMin_C EGRVlv_Cal.tEngDaFldMax_C EGRVlv_Cal.numExhTempDesVal_C EGRVlv_Cal.numAirTempDesVal_C EGRVlv_Cal.numEngDaTempDesVal_C EGRVlv_Cal.numTemp4_C EGRVlv_Cal.tiIni_C EGRVlv_Cal.rDesValIniStdBy_C EGRVlv_Cal.rDesValIni_C EGRVlv_Cal.tiDflDtyCyc_C EGRVlv_Cal.tidrDesValFlt_C EGRVlv_Cal.rDesValCntMinThrd_C EGRVlv_Cal.swtRstrDesValCnt_C EGRVlv_Cal.swtActvn_C EGRVlv_Cal.swtDeactvnMask_C EGRVlv_Cal.duMovDet_C EGRVlv_Cal.tiNMinActActvDly_C EGRVlv_Cal.stTmpDeactv_C EGRVlv_EnhdPosGovCal.tiDebMinMechBnd_C EGRVlv_EnhdPosGovCal.tiDebMaxMechBnd_C EGRVlv_EnhdPosGovCal.rGovDvtThresGovOn_C EGRVlv_EnhdPosGovCal.rGovDvtThresGovDelta_C EGRVlv_EnhdPosGovCal.drDesValFltThresGovOn_C EGRVlv_EnhdPosGovCal.rGovMax_C EGRVlv_EnhdPosGovCal.rGovMin_C EGRVlv_EnhdPosGovCal.rGovLimEffMax_C EGRVlv_EnhdPosGovCal.duCldMov_C EGRVlv_EnhdPosGovCal.rGovMaxExtDem_C EGRVlv_EnhdPosGovCal.iEffMdlHeat_C EGRVlv_EnhdPosGovCal.iEffMdlCool_C EGRVlv_EnhdPosGovCal.stSpLimnDiMask_C EGRVlv_EnhdPosGovCal.numExtArmtrTSel_C EGRVlv_EnhdPosGovCal.tiArmtrFlt_C EGRVlv_EnhdPosGovCal.swtGovByp_C EGRVlv_EnhdPosGovCal.rDesValMaxOff_C EGRVlv_EnhdPosGovCal.rDesValMinOff_C EGRVlv_EnhdPosGovCal.rDesValMin_C EGRVlv_EnhdPosGovCal.rDesValMax_C EGRVlv_EnhdPosGovCal.rGovDesValMin_C EGRVlv_EnhdPosGovCal.rGovDesValMax_C EGRVlv_EnhdPosGovCal.numMdnAvrgSpd_C EGRVlv_EnhdPosGovCal.swtrGovDesVal_C EGRVlv_EnhdPosGovCal.rIniI_C EGRVlv_EnhdPosGovCal.swtRlsLimDeactv_C EGRVlv_PosGovCal.IKiFrcSlp_C EGRVlv_PosGovCal.tiGovDT1_C EGRVlv_PosGovCal.rOutDMax_C EGRVlv_PosGovCal.rGovDvtMaxFrcRmp_C EGRVlv_PosGovCal.rGovDvtFrcInactv_C EGRVlv_PosGovCal.rFrcMax_C EGRVlv_PosGovCal.tiEMFCompT1_C EGRVlv_PosGovCal.EMFCompKd_C EGRVlv_PosGovCal.duRawFrcRmpThres_C EGRVlv_PosGovCal.rOutDFrcRmpThres_C EGRVlv_PosGovCal.tiGovDesMaxIniI_C EGRVlv_PosGovCal.rGovDesMaxIniI_C EGRVlv_PosGovCal.rActMaxIniI_C EGRVlv_PosGovCal.rGovDesMinIniI_C EGRVlv_PosGovCal.rActMinIniI_C EGRVlv_PosGovCal.rGovDesValJmpMin_C EGRVlv_PosGovCal.tiSettle_C EGRVlv_PosGovCal.rGovDvtOscThres_C EGRVlv_PosGovCal.cntOscThres_C EGRVlv_PosGovCal.drGovDesValMinLimI_C EGRVlv_PosGovCal.cntLimI_C EGRVlv_PosGovCal.numTempSel_C EGRVlv_PosGovCal.numPreCtlMapIn_C EGRVlv_PosGovCal.numPreCtlHystIn_C EGRVlv_PosGovCal.numPreCtlCurIn_C EGRVlv_PosGovCal.stLimIniIMask_C EGRVlv_PosGovCal.tiLimIniIRstDly_C EGRVlv_PosGovCal.numPreCtlTemp_C EGRVlv_PosGovCal.tiGovDvtDT1_C EGRVlv_PosGovCal.KdGovDvtDT1_C EGRVlv_PosGovCal.rGovTstMin_C EGRVlv_PosGovCal.rGovTstMax_C EGRVlv_PwmOutCal.rMin_C EGRVlv_PwmOutCal.rMax_C EGRVlv_PwmOutCal.swtBattCor_C EGRVlv_RlsFuncCal.rIniI_C EGRVlv_RlsFuncCal.tiRlsMove_C EGRVlv_RlsFuncCal.tiRlsWait_C EGRVlv_RlsFuncCal.tiRlsMoveMax_C EGRVlv_RlsFuncCal.tiRlsMoveMin_C EGRVlv_RlsFuncCal.tiDesValMoveBack_C EGRVlv_RlsFuncCal.rDesValMoveBack_C EGRVlv_RlsFuncCal.swtRlsTrigCdn_C EGRVlv_RlsFuncCal.numRlsTryMax_C EGRVlv_RlsFuncCal.numRlsTryAbsMax_C EGRVlv_RlsFuncCal.numRlsTryAtmptMax_C EGRVlv_RlsFuncCal.numRlsTryAbsDrvCycMax_C EGRVlv_RlsFuncCal.numRlsAtmptVltgInctReqMax_C EGRVlv_RlsFuncCal.numRlsAbsltDcycVltgInctReqMax_C EGRVlv_RlsFuncCal.swtConf_C EGRVlv_RlsFuncCal.ratGovrLimRelsWait_C EGRVlv_SensCal.uCtlRngMax_C EGRVlv_SensCal.uCtlRngMin_C EGRVlv_SensCal.uMin_C EGRVlv_SensCal.uMax_C EGRVlv_SensCal.uAvrgOpn_C EGRVlv_SensCal.uAvrgClsd_C EGRVlv_SensCal.uRefSens_C EGRVlv_SensCal.uRawMinClsd_C EGRVlv_SensCal.uRawMaxClsd_C EGRVlv_SensCal.uRawMinOpn_C EGRVlv_SensCal.uRawMaxOpn_C EGRVlv_SensCal.uRawMinMechBnd_C EGRVlv_SensCal.uRawMaxMechBnd_C EGRVlv_SensCal.uRawMaxElecClsd_C EGRVlv_SensCal.uRawMinElecClsd_C EGRVlv_SensCal.uRawMaxElecOpn_C EGRVlv_SensCal.uRawMinElecOpn_C EGRVlv_TempModelCal.coefHtTransfArmtrHsng_C EGRVlv_TempModelCal.coefHtTransfEngHsng_C EGRVlv_TempModelCal.coefHtTransfExhHsng_C EGRVlv_TempModelCal.capHtHsng_C EGRVlv_TempModelCal.capHtArmtr_C EGRVlv_TempModelCal.tHsngMax_C EGRVlv_TempModelCal.tArmtrMax_C EGRVlv_TempModelCal.tDflArmtr_C EGRVlv_TempModelCal.tDflHsng_C EGRVlv_TempModelCal.facEngCEngDsT_C EGRVlv_TempModelCal.tiTempModInit_C EGRVlv_TempModelCal.tiEngTempGrad_C EGRVlv_TempModelCal.numAirTempSelHsng_C EGRVlv_TempModelCal.numEnvTempSelHsng_C EGRVlv_TempModelCal.numEngTempSelHsng_C EGRVlv_TempModelCal.numExhTempSelHsng_C EGRVlv_TempModelCal.tDiffEngMin_C EGRVlv_TempModelCal.tDiffEngOffEnvMin_C EGRVlv_TempModelCal.numInitArmtrAir_C EGRVlv_TempModelCal.numInitArmtrEng_C EGRVlv_TempModelCal.tArmtrThresHi_C EGRVlv_TempModelCal.tArmtrThresLo_C /end REF_CHARACTERISTIC
 /begin IN_MEASUREMENT BattU_facCor BattU_u CoEng_st DELib_idxArrSnsr DELib_xArrSnsr DSM_TripChgFinshd EGRVlv_dHtArmtrHsng EGRVlv_duRaw EGRVlv_numReaMechBndAVS EGRVlv_rAct EGRVlv_rActOld EGRVlv_rActr EGRVlv_rActSign EGRVlv_rArbnDesVal EGRVlv_rDesVal EGRVlv_rFildSpFil EGRVlv_rGovActr EGRVlv_rGovDvt EGRVlv_rOutDRaw EGRVlv_rOutI EGRVlv_rPs EGRVlv_rSens EGRVlv_stAVSRxRom EGRVlv_stMon EGRVlv_stMon3 EGRVlv_stMonGovr EGRVlv_stMonGovrDe EGRVlv_stMonJamHeal EGRVlv_stMonSpArbn EGRVlv_stMonVdSens EGRVlv_stTempModActv EGRVlv_stTstEnvActv EGRVlv_swtConf2C EGRVlv_swtConf3C EGRVlv_swtConfC EGRVlv_swtConfSwVersC EGRVlv_tArmtrInit EGRVlv_uRaw EnvT_t SyC_stSub T15_st /end IN_MEASUREMENT
 /begin OUT_MEASUREMENT EGRVlv_dpDsbc EGRVlv_drDesVal EGRVlv_drDesValFlt EGRVlv_drGovDvt EGRVlv_facCorFlt EGRVlv_HystComp2.BattU_uMapInp EGRVlv_HystComp2.bDesValSwt_mp EGRVlv_HystComp2.bGovrDeHys_mp EGRVlv_HystComp2.bPreCtlSwt_mp EGRVlv_HystComp2.numPreCtlTempCurInp EGRVlv_HystComp2.pDsbcMapInp EGRVlv_HystComp2.rPreCtlVal2_mp EGRVlv_HystComp2.rPreCtlValMapInp EGRVlv_iEffMdlFlt EGRVlv_numReaMechBnd EGRVlv_pDsbc EGRVlv_rActInv EGRVlv_rActTrans EGRVlv_rActTrans_Sq EGRVlv_rEMFComp EGRVlv_rFricGovrInp EGRVlv_rGovDesVal EGRVlv_rGovDesValMon EGRVlv_rGovLimEffMax EGRVlv_rGovrMaxInp EGRVlv_rGovrMinInp EGRVlv_rHysCmpGovrInp EGRVlv_rPreCtlVal EGRVlv_stErrTrans EGRVlv_stIniI EGRVlv_stMon2 EGRVlv_stVltgReq EGRVlv_tActr EGRVlv_tArmtr /end OUT_MEASUREMENT
 /begin LOC_MEASUREMENT EGRVlv_dHtArmtrExtn EGRVlv_dHtArmtr_mp EGRVlv_drFildHysDesVal_mp EGRVlv_duMotSpd EGRVlv_facGear_mp EGRVlv_facKd_mp EGRVlv_facKi_mp EGRVlv_facKp_mp EGRVlv_iEff EGRVlv_pDsbc_mp EGRVlv_rAbsActr_mp EGRVlv_rCurIn EGRVlv_rDesValHystFild_mp EGRVlv_rGovDesValInv EGRVlv_rPreCtl2HystIn_mp EGRVlv_rPreCtl2MapIn_mp EGRVlv_rPreCtlCurIn_mp EGRVlv_rPreCtlVal1_mp EGRVlv_rPreCtlVal2_mp EGRVlv_rRmpDesVal_mp EGRVlv_stMaxEndStopRstCfg EGRVlv_stMaxEndStopSetCfg EGRVlv_stMinEndStopRstCfg EGRVlv_stMinEndStopSetCfg EGRVlv_stVltgInctReqInhb_mp EGRVlv_tArmtrFlt_mp EGRVlv_tiCrntEffLpFltPar EGRVlv_trqActrVal EGRVlv_trqMotVal_mp EGRVlv_uEffVltg_mp /end LOC_MEASUREMENT
 FUNCTION_VERSION "10.3.0" /end FUNCTION
/begin FUNCTION EGRVlv_DELib_ElecActrVdSnsr "11.4.0"
 /begin DEF_CHARACTERISTIC EGRVlv_OfsLearnCal.nEngMax_C EGRVlv_OfsLearnCal.nEngMin_C EGRVlv_OfsLearnCal.numClnVerifyMin_C EGRVlv_OfsLearnCal.numTOfsLrnAdj_C EGRVlv_OfsLearnCal.pDsbcMax_C EGRVlv_OfsLearnCal.qSetUnBalQntyMax_C EGRVlv_OfsLearnCal.rOfsLrnAvlMinHi_C EGRVlv_OfsLearnCal.rOfsLrnAvlMinLo_C EGRVlv_OfsLearnCal.swtLrn_C EGRVlv_OfsLearnCal.tiAvrg_C EGRVlv_OfsLearnCal.tiOfsLrnStrt_C EGRVlv_OfsLearnCal.tiStFlgDsplLrn_C EGRVlv_OfsLearnCal.tiZycOffSetLrn_C EGRVlv_OfsLearnCal.uDstCalcClsd_C EGRVlv_OfsLearnCal.uDstCalcOpn_C EGRVlv_OfsLearnCal.uMaxDrftConscClsd_C EGRVlv_OfsLearnCal.uMaxDrftConscOpn_C EGRVlv_OfsLearnCal.uNewActrDetnThd_C EGRVlv_OfsLearnCal.uOffsClsd_C EGRVlv_OfsLearnCal.uOffsOpn_C EGRVlv_OfsLearnCal.uTempOfsAdjClsd_CUR EGRVlv_OfsLearnCal.uTempOfsAdjOpn_CUR EGRVlv_SensCal.uCtlRngMax_C EGRVlv_SensCal.uCtlRngMin_C EGRVlv_SensCal.uMin_C EGRVlv_SensCal.uMax_C EGRVlv_SensCal.uAvrgOpn_C EGRVlv_SensCal.uAvrgClsd_C EGRVlv_SensCal.uRefSens_C EGRVlv_SensCal.uRawMinClsd_C EGRVlv_SensCal.uRawMaxClsd_C EGRVlv_SensCal.uRawMinOpn_C EGRVlv_SensCal.uRawMaxOpn_C EGRVlv_SensCal.uRawMinMechBnd_C EGRVlv_SensCal.uRawMaxMechBnd_C EGRVlv_SensCal.uRawMaxElecClsd_C EGRVlv_SensCal.uRawMinElecClsd_C EGRVlv_SensCal.uRawMaxElecOpn_C EGRVlv_SensCal.uRawMinElecOpn_C /end DEF_CHARACTERISTIC
 /begin REF_CHARACTERISTIC EGRVlv_Cal.tiBattCorFacFlt_C EGRVlv_Cal.rDesValFailSafe_C EGRVlv_Cal.slpFailSafePos_C EGRVlv_Cal.slpFailSafeNeg_C EGRVlv_Cal.tiDesValFlt_C EGRVlv_Cal.tiduRawFlt_C EGRVlv_Cal.uFailSafeBattMin_C EGRVlv_Cal.uFailSafeBattMax_C EGRVlv_Cal.uBattMin_C EGRVlv_Cal.uBattMax_C EGRVlv_Cal.uBattMinNoLrn_C EGRVlv_Cal.uBattMaxNoLrn_C EGRVlv_Cal.facCorStrt_C EGRVlv_Cal.numTEng_C EGRVlv_Cal.tEngMin_C EGRVlv_Cal.tEngMax_C EGRVlv_Cal.rCtlRngMin_C EGRVlv_Cal.rCtlRngMax_C EGRVlv_Cal.tiTempErrOk_C EGRVlv_Cal.rActActrActv_C EGRVlv_Cal.tiSoftShOff_C EGRVlv_Cal.rDesValSoftShOff_C EGRVlv_Cal.stActrDiaDis_C EGRVlv_Cal.stActrDis_C EGRVlv_Cal.numTempErrDef_C EGRVlv_Cal.swtNrmInv_C EGRVlv_Cal.rPwrStgDis_C EGRVlv_Cal.tAirSysFldMin_C EGRVlv_Cal.tAirSysFldMax_C EGRVlv_Cal.tExhFldMin_C EGRVlv_Cal.tExhFldMax_C EGRVlv_Cal.tEngDaFldMin_C EGRVlv_Cal.tEngDaFldMax_C EGRVlv_Cal.numExhTempDesVal_C EGRVlv_Cal.numAirTempDesVal_C EGRVlv_Cal.numEngDaTempDesVal_C EGRVlv_Cal.numTemp4_C EGRVlv_Cal.tiIni_C EGRVlv_Cal.rDesValIniStdBy_C EGRVlv_Cal.rDesValIni_C EGRVlv_Cal.tiDflDtyCyc_C EGRVlv_Cal.tidrDesValFlt_C EGRVlv_Cal.rDesValCntMinThrd_C EGRVlv_Cal.swtRstrDesValCnt_C EGRVlv_Cal.swtActvn_C EGRVlv_Cal.swtDeactvnMask_C EGRVlv_Cal.duMovDet_C EGRVlv_Cal.tiNMinActActvDly_C EGRVlv_Cal.stTmpDeactv_C /end REF_CHARACTERISTIC
 /begin IN_MEASUREMENT CoEng_tiNormal DELib_idxArrSnsr DELib_xArrSnsr EGRVlv_ctrActrDst EGRVlv_flgDiagStrtClnVrfy EGRVlv_nrDesValCnt EGRVlv_numClnVerify EGRVlv_numReaMechBnd EGRVlv_pDsbc EGRVlv_rActr EGRVlv_rActrLim EGRVlv_stActrROMAVS EGRVlv_stAVSRxRom EGRVlv_stMon EGRVlv_stMon2 EGRVlv_stMon3 EGRVlv_swtConf2C EGRVlv_swtConf3C EGRVlv_swtConfC EGRVlv_swtConfSwVersC EGRVlv_tOfsAdjLstLrnClsdAVS EGRVlv_tOfsAdjLstLrnOpnAVS EGRVlv_uRaw EGRVlv_uRelPosClsdLrnFstAVS EGRVlv_uRelPosClsdMaxRomAVS EGRVlv_uRelPosClsdRomAVS EGRVlv_uRelPosOpnLrnFstAVS EGRVlv_uRelPosOpnRomAVS EnvT_t Epm_nEng InjCtl_qSetUnBal SyC_ctPostDrvLeave /end IN_MEASUREMENT
 /begin OUT_MEASUREMENT EGRVlv_cntrEepReadFail EGRVlv_OfsLearn.d_mp EGRVlv_OfsLearn.k_mp EGRVlv_OfsLearn.uRelPosClsdLrnFst_mp EGRVlv_OfsLearn.uRelPosClsdLrnLst_mp EGRVlv_OfsLearn.uRelPosOpnLrnFst_mp EGRVlv_OfsLearn.uRelPosOpnLrnLst_mp EGRVlv_OfsLearnCal.locvar EGRVlv_OfsLearnCal.tOfsAdjuTempOfsAdjClsdCurInp EGRVlv_OfsLearnCal.tOfsAdjuTempOfsAdjOpnCurInp EGRVlv_rDrftClsd EGRVlv_rGovDesLimMax EGRVlv_rGovDesLimMin EGRVlv_rTransfCur EGRVlv_stActrROM EGRVlv_stIninEep EGRVlv_stMonVdSens EGRVlv_stOfsLrnEnvCond EGRVlv_tiActrAdpClsd EGRVlv_tiActrAdpOpn EGRVlv_tOfsAdj EGRVlv_tOfsAdjLstLrnClsd EGRVlv_tOfsAdjLstLrnOpn EGRVlv_uDrftClsd EGRVlv_uDrftOpn EGRVlv_uOffsClsd EGRVlv_uOffsOpn EGRVlv_uRelPosClsd EGRVlv_uRelPosClsdElecRaw EGRVlv_uRelPosClsdLrnFst EGRVlv_uRelPosClsdLrnLst EGRVlv_uRelPosClsdMax EGRVlv_uRelPosClsdMaxRom EGRVlv_uRelPosClsdRom EGRVlv_uRelPosnClsdLrn EGRVlv_uRelPosnElecClsdLrn EGRVlv_uRelPosnElecOpnLrn EGRVlv_uRelPosnOpenLrn EGRVlv_uRelPosOpnLrnFst EGRVlv_uRelPosOpnLrnLst EGRVlv_uRelPosOpnRom EGRVlv_uTempOfsAdjClsd EGRVlv_uTempOfsAdjOpn /end OUT_MEASUREMENT
 /begin LOC_MEASUREMENT EGRVlv_ctVdSnsrReIni EGRVlv_numCntBrk EGRVlv_rDrftOpn EGRVlv_uRelPosClsdRaw EGRVlv_uRelPosOpn EGRVlv_uTempOfsAdjClsdCurr_mp EGRVlv_uTempOfsAdjClsdLrn_mp EGRVlv_uTempOfsAdjOpnCurr_mp EGRVlv_uTempOfsAdjOpnLrn_mp /end LOC_MEASUREMENT
 FUNCTION_VERSION "11.4.0" /end FUNCTION
/begin FUNCTION EGRVlv_DELib_Fir "1.2.0     EGRVlv" FUNCTION_VERSION "1.2.0" /end FUNCTION
/begin FUNCTION EGRVlv_DELib_GovrDeMon "3.2.0"
 /begin DEF_CHARACTERISTIC EGRVlv_drGradLim_CUR EGRVlv_GovDvtMonCal.pDsbcMaxLimn_C EGRVlv_GovDvtMonCal.tiRstJamVlvClsd_C EGRVlv_GovDvtMonCal.tiRstJamVlvOpn_C EGRVlv_GovDvtMonCal.tiDesValFltMon_C EGRVlv_GovDvtMonCal.tiDebJamVlv_C EGRVlv_GovDvtMonCal.rActLow_C EGRVlv_GovDvtMonCal.tExhCld_C EGRVlv_GovDvtMonCal.tAirSysFldMinCld_C EGRVlv_GovDvtMonCal.rActJamClsd_C EGRVlv_GovDvtMonCal.numEngTemp_C EGRVlv_GovDvtMonCal.numExhTemp_C EGRVlv_GovDvtMonCal.numAirTemp_C EGRVlv_GovDvtMonCal.numColdStrtTSel_C EGRVlv_GovDvtMonCal.tiEngRunRlsLim_C EGRVlv_GovDvtMonCal.rGovDvtLimThd_C EGRVlv_GovDvtMonCal.tidebActrPosReaOk_C EGRVlv_GovDvtMonCal.tidebActrPosReaDef_C EGRVlv_GovDvtMonCal.swtDesVal_C EGRVlv_GovDvtMonCal.swtGovDvtMon_C EGRVlv_GovDvtMonCal.swtGovDvtRlsFuncStrt_C EGRVlv_GovDvtMonCal.tiGovDeCldRlsStrtDly_C EGRVlv_GovDvtMonCal.tiGovDeOK_C EGRVlv_GovDvtMonCal.tiIUMPRIncDnr_C EGRVlv_GovDvtMonCal.tiDebExtGovDvtDef_C EGRVlv_GovDvtMonCal.numRepActvn_C EGRVlv_GovDvtMonCal.tiRepActvn_C EGRVlv_GovDvtMonCal.tiJamVlvHeal_C EGRVlv_GovDvtMonCal.stActrMonDis_C EGRVlv_GovDvtMonCal.mskCEngDsTSq_C EGRVlv_GovDvtMonCal.mskEnvTSq_C EGRVlv_GovDvtMonCal.tEngCold_C EGRVlv_rDeMax_MAP EGRVlv_rDeMin_MAP EGRVlv_tiAftEngStrtLim_CUR EGRVlv_tiAftStrtRedLim_CUR EGRVlv_tiGovrDeErr_MAP EGRVlv_tiRlsStrtDly_MAP /end DEF_CHARACTERISTIC
 /begin REF_CHARACTERISTIC EGRVlv_Cal.tiBattCorFacFlt_C EGRVlv_Cal.rDesValFailSafe_C EGRVlv_Cal.slpFailSafePos_C EGRVlv_Cal.slpFailSafeNeg_C EGRVlv_Cal.tiDesValFlt_C EGRVlv_Cal.tiduRawFlt_C EGRVlv_Cal.uFailSafeBattMin_C EGRVlv_Cal.uFailSafeBattMax_C EGRVlv_Cal.uBattMin_C EGRVlv_Cal.uBattMax_C EGRVlv_Cal.uBattMinNoLrn_C EGRVlv_Cal.uBattMaxNoLrn_C EGRVlv_Cal.facCorStrt_C EGRVlv_Cal.numTEng_C EGRVlv_Cal.tEngMin_C EGRVlv_Cal.tEngMax_C EGRVlv_Cal.rCtlRngMin_C EGRVlv_Cal.rCtlRngMax_C EGRVlv_Cal.tiTempErrOk_C EGRVlv_Cal.rActActrActv_C EGRVlv_Cal.tiSoftShOff_C EGRVlv_Cal.rDesValSoftShOff_C EGRVlv_Cal.stActrDiaDis_C EGRVlv_Cal.stActrDis_C EGRVlv_Cal.numTempErrDef_C EGRVlv_Cal.swtNrmInv_C EGRVlv_Cal.rPwrStgDis_C EGRVlv_Cal.tAirSysFldMin_C EGRVlv_Cal.tAirSysFldMax_C EGRVlv_Cal.tExhFldMin_C EGRVlv_Cal.tExhFldMax_C EGRVlv_Cal.tEngDaFldMin_C EGRVlv_Cal.tEngDaFldMax_C EGRVlv_Cal.numExhTempDesVal_C EGRVlv_Cal.numAirTempDesVal_C EGRVlv_Cal.numEngDaTempDesVal_C EGRVlv_Cal.numTemp4_C EGRVlv_Cal.tiIni_C EGRVlv_Cal.rDesValIniStdBy_C EGRVlv_Cal.rDesValIni_C EGRVlv_Cal.tiDflDtyCyc_C EGRVlv_Cal.tidrDesValFlt_C EGRVlv_Cal.rDesValCntMinThrd_C EGRVlv_Cal.swtRstrDesValCnt_C EGRVlv_Cal.swtActvn_C EGRVlv_Cal.swtDeactvnMask_C EGRVlv_Cal.duMovDet_C EGRVlv_Cal.tiNMinActActvDly_C EGRVlv_Cal.stTmpDeactv_C EGRVlv_LrnTstCal.rDesValMaxLrnATS_C EGRVlv_LrnTstCal.rDesValMinLrnATS_C EGRVlv_LrnTstCal.rCtlRngMaxATS_C EGRVlv_LrnTstCal.rCtlRngMinATS_C EGRVlv_LrnTstCal.tiPerFrstLrn_C EGRVlv_LrnTstCal.tiPerResetLrn_C EGRVlv_PosGovCal.IKiFrcSlp_C EGRVlv_PosGovCal.tiGovDT1_C EGRVlv_PosGovCal.rOutDMax_C EGRVlv_PosGovCal.rGovDvtMaxFrcRmp_C EGRVlv_PosGovCal.rGovDvtFrcInactv_C EGRVlv_PosGovCal.rFrcMax_C EGRVlv_PosGovCal.tiEMFCompT1_C EGRVlv_PosGovCal.EMFCompKd_C EGRVlv_PosGovCal.duRawFrcRmpThres_C EGRVlv_PosGovCal.rOutDFrcRmpThres_C EGRVlv_PosGovCal.tiGovDesMaxIniI_C EGRVlv_PosGovCal.rGovDesMaxIniI_C EGRVlv_PosGovCal.rActMaxIniI_C EGRVlv_PosGovCal.rGovDesMinIniI_C EGRVlv_PosGovCal.rActMinIniI_C EGRVlv_PosGovCal.rGovDesValJmpMin_C EGRVlv_PosGovCal.tiSettle_C EGRVlv_PosGovCal.rGovDvtOscThres_C EGRVlv_PosGovCal.cntOscThres_C EGRVlv_PosGovCal.drGovDesValMinLimI_C EGRVlv_PosGovCal.cntLimI_C EGRVlv_PosGovCal.numTempSel_C EGRVlv_PosGovCal.numPreCtlMapIn_C EGRVlv_PosGovCal.numPreCtlHystIn_C EGRVlv_PosGovCal.numPreCtlCurIn_C EGRVlv_PosGovCal.stLimIniIMask_C EGRVlv_PosGovCal.tiLimIniIRstDly_C EGRVlv_PosGovCal.numPreCtlTemp_C EGRVlv_PosGovCal.tiGovDvtDT1_C EGRVlv_PosGovCal.KdGovDvtDT1_C EGRVlv_PosGovCal.rGovTstMin_C EGRVlv_PosGovCal.rGovTstMax_C EGRVlv_tEngCld_CUR /end REF_CHARACTERISTIC
 /begin IN_MEASUREMENT CEngDsT_t_f CEngDsT_t_f_Sq CoEng_tiNormal DELib_idxArrSnsr DELib_xArrSnsr DevLib_stPwrStgEnaCond EGRVlv_duRaw EGRVlv_pDsbc EGRVlv_r EGRVlv_rAct EGRVlv_rActSign EGRVlv_rActStuck EGRVlv_rFildSpFil EGRVlv_rGovDesValMon EGRVlv_rPs EGRVlv_stGovDeMon EGRVlv_stMon2 EGRVlv_stMon3 EGRVlv_stMonVdSens EGRVlv_stTstEnvActv EGRVlv_swtConf2C EGRVlv_swtConf3C EGRVlv_swtConfC EGRVlv_swtConfSwVersC EnvT_t EnvT_t_f EnvT_t_f_Sq Epm_nEng SyC_ctPostDrvLeave /end IN_MEASUREMENT
 /begin OUT_MEASUREMENT EGRVlv_ctGovrDeMonDSMClr EGRVlv_stCSERSActv EGRVlv_stEnhdGovrDeMon EGRVlv_stMonGovrDe /end OUT_MEASUREMENT
 /begin LOC_MEASUREMENT EGRVlv_ctGovrDeMonDSMClrOld EGRVlv_ctGovrDemonReIni EGRVlv_numRepActvn_mp EGRVlv_rDesValFltMon EGRVlv_rGovDvtFltMon EGRVlv_stGovrMonEnaCdn EGRVlv_stHealActv EGRVlv_tColdStrt EGRVlv_tEngColdStrt /end LOC_MEASUREMENT
 FUNCTION_VERSION "3.2.0" /end FUNCTION
/begin FUNCTION EGRVlv_DELib_Pll "1.1.0     EGRVlv" FUNCTION_VERSION "1.1.0" /end FUNCTION
/begin FUNCTION EGRVlv_DELib_SnsrPhyCnvn "1.2.0" /begin DEF_CHARACTERISTIC EGRVlv_tiFltSnsr_MAP /end DEF_CHARACTERISTIC
 /begin IN_MEASUREMENT EGRVlv_rActTrans EGRVlv_rGovDvtAbs EGRVlv_rTransfCur EGRVlv_stActrDdReadCalc EGRVlv_stErrTrans EGRVlv_swtConf2C EGRVlv_swtConfC PCR_pDesVal /end IN_MEASUREMENT
 /begin OUT_MEASUREMENT EGRVlv_FirCalc.cntrAvrgZr EGRVlv_FirCalc.flgRdDne EGRVlv_FirCalc.uRawAvrg EGRVlv_FirCalc.uRawFir EGRVlv_FirRead.cntr EGRVlv_FirRead.flgFirstRun EGRVlv_FirRead.idxArr EGRVlv_FirRead.uSum EGRVlv_rAct EGRVlv_rActOld EGRVlv_rActSign EGRVlv_rAct_Sq EGRVlv_rSens EGRVlv_uRaw EGRVlv_uRawAvrg EGRVlv_uRawUnFltd /end OUT_MEASUREMENT
 /begin LOC_MEASUREMENT EGRVlv_stSnsrPhyCnvnPT1Ini EGRVlv_uRawSeld /end LOC_MEASUREMENT
 FUNCTION_VERSION "1.2.0" /end FUNCTION
/begin FUNCTION EGRVlv_DELib_StcFctActr "1.1.0     EGRVlv"
 /begin DEF_CHARACTERISTIC EGRVlv_StcFctActrCal.swtConf_C EGRVlv_StcFctActrCal.rDesValFildThd_C EGRVlv_StcFctActrCal.nEngMax_C EGRVlv_StcFctActrCal.tiDesValFild_C /end DEF_CHARACTERISTIC
 /begin IN_MEASUREMENT EGRVlv_rDesVal EGRVlv_rTransfCur EGRVlv_uRaw Epm_nEng /end IN_MEASUREMENT
 /begin OUT_MEASUREMENT EGRVlv_flgTrlPtrLrnEepReadErr EGRVlv_rDesValTrlPtrLrnLst EGRVlv_rDesValTrlPtrLrnLstEepRead EGRVlv_swtConfStcFctActrC EGRVlv_uRawDesValTrlPtrLrnLst EGRVlv_uRawTrlPtrLrnLst EGRVlv_uRawTrlPtrLrnLstEepRead /end OUT_MEASUREMENT
 /begin LOC_MEASUREMENT EGRVlv_rDesValFild EGRVlv_rDesValTrlPtr EGRVlv_uRawTrlPtr /end LOC_MEASUREMENT
 FUNCTION_VERSION "1.1.0" /end FUNCTION
/begin FUNCTION EGSDCmn_CoorrParl "1.62.0    Coordinator of parallelization of active exhaust gas sensor dynamic diagnosis and catalyst diagnosis"
 /begin REF_CHARACTERISTIC EGSDO2_flgIdnDurgParl_CW EGSDO2_flgSeqDyn_C EGSDO2_flgLamOffsFastPreParl_CW EGSDU_tiToutLtrDly_C EGSDU_tiToutRtlDly_C TWCD_facOSCRSC_C /end REF_CHARACTERISTIC
 /begin IN_MEASUREMENT EGSDCmn_flgSeg1B1PhyEnaParl EGSDCmn_flgSeg1B1RampEnaParl EGSDCmn_flgSeg1B1ReldFinalParl EGSDCmn_flgSeg1B1VirtReldFinalParl EGSDCmn_flgShtrpParl EGSDCmn_flgTarLeanSuspcParlB1 EGSDCmn_flgTarRichSuspcParlB1 EGSDCmn_flgTarSuspcB1 EGSDCmn_flgTarSuspcVirtParlB1 EGSDCmn_mfEgCat1B1Parl EGSDCmn_mfO2Cat1B1Parl EGSDCmn_mfSeg1B1O2Parl EGSDCmn_mfSeg1B1RichParl EGSDCmn_mfSeg1B1VirtO2Parl EGSDCmn_mfSeg1B1VirtRichParl EGSDCmn_ratLamActS1B1 EGSDCmn_uS2B1FildParl EGSDO2_flgDynLtrTripDneS1B1 EGSDO2_flgDynLtrTripDneVirtS1B1 EGSDO2_flgDynRtlTripDneS1B1 EGSDO2_flgDynRtlTripDneVirtS1B1 EGSDO2_flgLamMonOkVirtB1 EGSDO2_flgLossEvlnDneB1 EGSDO2_flgQlyDeFltSuspcB1 EGSDO2_tiDlyLtrS1B1 EGSDO2_tiDlyRtlS1B1 EGSDO2_tiTranLtrS1B1 EGSDO2_tiTranRtlS1B1 EGSDU_flgS2B1AsymcFltEvln EGSDU_flgS2B1TarLeanResVirtEvln EGSDU_flgS2B1TarRichResVirtEvln EGSDU_flgS2B1TripVirtLtrDlyEvln EGSDU_flgS2B1TripVirtLtrTranEvln EGSDU_flgS2B1TripVirtRtlDlyEvln EGSDU_flgS2B1TripVirtRtlTranEvln EGSDU_tiS2B1LtrDlyEvln EGSDU_tiS2B1LtrDlySymcEvln EGSDU_tiS2B1LtrTranEvln EGSDU_tiS2B1LtrTranSymcEvln EGSDU_tiS2B1RtlDlyEvln EGSDU_tiS2B1RtlDlySymcEvln EGSDU_tiS2B1RtlTranEvln EGSDU_tiS2B1RtlTranSymcEvln HEGO_bS2B1FrzRi LamCtrl_ratLamSpNoDynS1B1 SyC_ctPostDrvLeave tlrslb_w_msg TWCC_rCtlPriB1 TWCD_flgMeasFinshdVirtTripB1 TWCD_mOscExtdCat1B1 TWCD_mOSCNrmDiumprExtdB1 TWCD_mRSCNrmDiumprExtdB1 TWCD_rOSCAvrgPriB1 zlrslb_w_msg /end IN_MEASUREMENT
 /begin OUT_MEASUREMENT EGSDCmn_flgB1LamNotStabParl EGSDCmn_flgCat1EmptTOutParlB1 EGSDCmn_flgCat1FullTOutParlB1 EGSDCmn_flgIdnAdpnEndParlS1B1 EGSDCmn_flgIdnAdpnEndVirtParlS1B1 EGSDCmn_flgLamReqParlB1 EGSDCmn_flgS1B1O2PlausResVirtParl EGSDCmn_flgS2B1TarLeanErrParl EGSDCmn_flgS2B1TarLeanOkOnceParl EGSDCmn_flgS2B1TarLeanResParl EGSDCmn_flgS2B1TarLeanResVirtOffsParl EGSDCmn_flgS2B1TarLeanResVirtParl EGSDCmn_flgS2B1TarRichErrParl EGSDCmn_flgS2B1TarRichOkOnceParl EGSDCmn_flgS2B1TarRichResParl EGSDCmn_flgS2B1TarRichResVirtOffsParl EGSDCmn_flgS2B1TarRichResVirtParl EGSDCmn_mErrTarLeanS2B1Parl EGSDCmn_mErrTarRichS2B1Parl EGSDCmn_mOSCCatCpParlB1 EGSDCmn_mRampDurB1Parl EGSDCmn_mRampDurS2B1Parl EGSDCmn_mRampEndLimParlB1 EGSDCmn_mRSCCatCpParlB1 EGSDCmn_ratLamReqParlB1 EGSDCmn_stLamGenrParlB1 EGSDCmn_stVirtCatParlB1 EGSDCmn_stVirtLamDynParlB1 EGSDCmn_stVirtTarLeanOffsParlB1 EGSDCmn_stVirtTarLeanParlB1 EGSDCmn_stVirtTarRichOffsParlB1 EGSDCmn_stVirtTarRichParlB1 EGSDCmn_stVirtUDlyParlB1 EGSDCmn_stVirtUTranParlB1 EGSDCmn_tiObsvrTOutEmptyParlB1 EGSDCmn_tiObsvrTOutExtParlB1 EGSDCmn_tiObsvrTOutFullParlB1 EGSDCmn_uS2B1CatEmptMaxParl EGSDCmn_uS2B1CatFullMinParl /end OUT_MEASUREMENT
 /begin LOC_MEASUREMENT EGSDCmn_B1LamStabParlIK_I.memory EGSDCmn_Cat1B1Empty_I.flgCatEmpty EGSDCmn_Cat1B1Empty_I.flgCatEmptyOK EGSDCmn_Cat1B1Empty_I.flgCatEmptyTOut EGSDCmn_Cat1B1Empty_I.mRSCCatCp EGSDCmn_Cat1B1Empty_I.tiObsvrTOut EGSDCmn_Cat1B1Empty_I.DynErrRampTONV_I.outbit EGSDCmn_Cat1B1Empty_I.DynErrRampTONV_I.time EGSDCmn_Cat1B1Empty_I.UGrdtTONV_I.outbit EGSDCmn_Cat1B1Empty_I.UGrdtTONV_I.time EGSDCmn_Cat1B1Empty_I.duUMinOKFF_I.status EGSDCmn_Cat1B1Empty_I.mO2CatEmptyOKIKL_I.memory EGSDCmn_Cat1B1Empty_I.mO2EnaCatEmptyGrdtIKL_I.memory EGSDCmn_Cat1B1Empty_I.mRSCCatCpIK_I.memory EGSDCmn_Cat1B1Empty_I.mRichMinIKL_I.memory EGSDCmn_Cat1B1Empty_I.tiObsvrTOutSW_I.timeCounter EGSDCmn_Cat1B1Empty_I.uSnsrGrdtFF_I.status EGSDCmn_Cat1B1Full_I.flgCatFull EGSDCmn_Cat1B1Full_I.flgCatFullTOut EGSDCmn_Cat1B1Full_I.mOSCCatCp EGSDCmn_Cat1B1Full_I.tiObsvrTOut EGSDCmn_Cat1B1Full_I.DynErrRampTONV_I.outbit EGSDCmn_Cat1B1Full_I.DynErrRampTONV_I.time EGSDCmn_Cat1B1Full_I.UGrdtTONV_I.outbit EGSDCmn_Cat1B1Full_I.UGrdtTONV_I.time EGSDCmn_Cat1B1Full_I.mO2EnaCatFullGrdtIKL_I.memory EGSDCmn_Cat1B1Full_I.mOSCCatCpIK_I.memory EGSDCmn_Cat1B1Full_I.tiObsvrTOutSW_I.timeCounter EGSDCmn_Cat1B1Full_I.uSnsrGrdtFF_I.status EGSDCmn_Cat1B1Full_I.uSnsrTONV_I.outbit EGSDCmn_Cat1B1Full_I.uSnsrTONV_I.time EGSDCmn_Cat1B1VirtParl_I.flgCatEmpty EGSDCmn_Cat1B1VirtParl_I.flgCatFull EGSDCmn_Cat1B1VirtParl_I.flgDynTripDneVirt EGSDCmn_Cat1B1VirtParl_I.flgIdnAdpnEnd EGSDCmn_Cat1B1VirtParl_I.flgIdnAdpnLean EGSDCmn_Cat1B1VirtParl_I.flgIdnAdpnRich EGSDCmn_Cat1B1VirtParl_I.flgReld EGSDCmn_Cat1B1VirtParl_I.flgUHiEnaParl EGSDCmn_Cat1B1VirtParl_I.flgUMid EGSDCmn_Cat1B1VirtParl_I.flgVirtLamDyn EGSDCmn_Cat1B1VirtParl_I.mOSC EGSDCmn_Cat1B1VirtParl_I.mRSC EGSDCmn_Cat1B1VirtParl_I.mfVirtO2 EGSDCmn_Cat1B1VirtParl_I.mfVirtRich EGSDCmn_Cat1B1VirtParl_I.sm EGSDCmn_Cat1B1VirtParl_I.stLamGenr EGSDCmn_Cat1B1VirtParl_I.tiGas EGSDCmn_Cat1B1VirtParl_I.tiLamDynLtr EGSDCmn_Cat1B1VirtParl_I.tiLamDynRtl EGSDCmn_Cat1B1VirtParl_I.tiUDynLtr EGSDCmn_Cat1B1VirtParl_I.tiUDynRtl EGSDCmn_Cat1B1VirtParl_I.u EGSDCmn_Cat1B1VirtParl_I.EnaReldEF_I.buffer EGSDCmn_Cat1B1VirtParl_I.EnaReldEF_I.oldSignal EGSDCmn_Cat1B1VirtParl_I.IdnAdpnCTR_I.counter EGSDCmn_Cat1B1VirtParl_I.flgLeanLamStabTONV_I.outbit EGSDCmn_Cat1B1VirtParl_I.flgLeanLamStabTONV_I.time EGSDCmn_Cat1B1VirtParl_I.flgRichLamStabTONV_I.outbit EGSDCmn_Cat1B1VirtParl_I.flgRichLamStabTONV_I.time EGSDCmn_Cat1B1VirtParl_I.mO2EnaCatFullGrdtIK_I.memory EGSDCmn_Cat1B1VirtParl_I.mO2IdnAdpnIKL_I.memory EGSDCmn_Cat1B1VirtParl_I.mO2VirtEnaCatEmptyIK_I.memory EGSDCmn_Cat1B1VirtParl_I.tiGasRtlTONV_I.outbit EGSDCmn_Cat1B1VirtParl_I.tiGasRtlTONV_I.time EGSDCmn_Cat1B1VirtParl_I.tiUDynTONV_I.outbit EGSDCmn_Cat1B1VirtParl_I.tiUDynTONV_I.time EGSDCmn_ctReIni100msCoorrParl EGSDCmn_ctReIni10msCoorrParl EGSDCmn_flgB1LamStabParl EGSDCmn_flgB1TarLeanOk EGSDCmn_flgB1TarRichOk EGSDCmn_flgB1UHiEnaParl EGSDCmn_flgB1UMid EGSDCmn_flgCatEmptyB1 EGSDCmn_flgCatEmptyOKB1 EGSDCmn_flgCatFullB1 EGSDCmn_flgDSMClrParl100msB1 EGSDCmn_flgDSMClrParlB1 EGSDCmn_flgS2B1TarLeanResParlER_I.buffer EGSDCmn_flgS2B1TarLeanResParlER_I.oldSignal EGSDCmn_flgS2B1TarRichResParlER_I.buffer EGSDCmn_flgS2B1TarRichResParlER_I.oldSignal EGSDCmn_flgTarLeanOkS2B1 EGSDCmn_flgTarRichOkS2B1 EGSDCmn_flgUS2B1Mid EGSDCmn_LamGenrParlB1_I.flgCat1EmptyTOut EGSDCmn_LamGenrParlB1_I.flgCat1FullTOut EGSDCmn_LamGenrParlB1_I.flgCatEmpty EGSDCmn_LamGenrParlB1_I.flgCatEmptyOK EGSDCmn_LamGenrParlB1_I.flgCatFull EGSDCmn_LamGenrParlB1_I.flgDynTripDne EGSDCmn_LamGenrParlB1_I.flgIdnAdpnEnd EGSDCmn_LamGenrParlB1_I.flgIdnAdpnLean EGSDCmn_LamGenrParlB1_I.flgIdnAdpnRich EGSDCmn_LamGenrParlB1_I.flgLamNotStab EGSDCmn_LamGenrParlB1_I.flgLamRels EGSDCmn_LamGenrParlB1_I.flgLamReq EGSDCmn_LamGenrParlB1_I.flgLamStabLean EGSDCmn_LamGenrParlB1_I.flgLamStabRich EGSDCmn_LamGenrParlB1_I.flgLeanRampEnd EGSDCmn_LamGenrParlB1_I.flgOSCTestPassd EGSDCmn_LamGenrParlB1_I.flgQlyDeFltSuspc EGSDCmn_LamGenrParlB1_I.flgRichRampEnd EGSDCmn_LamGenrParlB1_I.flgStMacReld EGSDCmn_LamGenrParlB1_I.flgTarLeanOK EGSDCmn_LamGenrParlB1_I.flgTarRichOK EGSDCmn_LamGenrParlB1_I.flgUHiEnaParl EGSDCmn_LamGenrParlB1_I.flgUMid EGSDCmn_LamGenrParlB1_I.mRampDurParl EGSDCmn_LamGenrParlB1_I.mfEg EGSDCmn_LamGenrParlB1_I.mfO2 EGSDCmn_LamGenrParlB1_I.ratLamAct EGSDCmn_LamGenrParlB1_I.ratLamCorr EGSDCmn_LamGenrParlB1_I.ratLamRampLeanParl EGSDCmn_LamGenrParlB1_I.ratLamRampRichParl EGSDCmn_LamGenrParlB1_I.ratLamReq EGSDCmn_LamGenrParlB1_I.ratLamSpNoDyn EGSDCmn_LamGenrParlB1_I.sm EGSDCmn_LamGenrParlB1_I.stLamGenr EGSDCmn_LamGenrParlB1_I.EnaReldEFNM_I.oldSignal EGSDCmn_LamGenrParlB1_I.IdnAdpnCTR_I.counter EGSDCmn_LamGenrParlB1_I.LamLeanMonTOFFV_I.outbit EGSDCmn_LamGenrParlB1_I.LamLeanMonTOFFV_I.time EGSDCmn_LamGenrParlB1_I.LamRampIKL_I.memory EGSDCmn_LamGenrParlB1_I.LamRichMonTOFFV_I.outbit EGSDCmn_LamGenrParlB1_I.LamRichMonTOFFV_I.time EGSDCmn_LamGenrParlB1_I.LamRichNotStabTONV_I.outbit EGSDCmn_LamGenrParlB1_I.LamRichNotStabTONV_I.time EGSDCmn_LamGenrParlB1_I.LamleanNotStabTONV_I.outbit EGSDCmn_LamGenrParlB1_I.LamleanNotStabTONV_I.time EGSDCmn_LamGenrParlB1_I.QlyDeFltSuspcER_I.buffer EGSDCmn_LamGenrParlB1_I.QlyDeFltSuspcER_I.oldSignal EGSDCmn_LamGenrParlB1_I.RampEndLimIK_I.memory EGSDCmn_LamGenrParlB1_I.flgOSCTestPassdFF_I.status EGSDCmn_LamGenrParlB1_I.mO2IdnAdpnIKL_I.memory EGSDCmn_LamGenrParlB1_I.mfEgLeanLamStabIK_I.memory EGSDCmn_LamGenrParlB1_I.mfEgRichLamStabIK_I.memory EGSDCmn_LamGenrParlB1_I.tiDynWpaRampTONVNM_I.time EGSDCmn_mCatEmptyGrdtParlB1 EGSDCmn_mCatEmptyGrdtPreCdnParlB1 EGSDCmn_mCatFullGrdtParlB1 EGSDCmn_mCatFullGrdtPreCdnParlB1 EGSDCmn_mRSCNrmVirtParlB1 EGSDCmn_ratLamRampLeanParl EGSDCmn_ratLamRampRichParl EGSDCmn_S1B1VirtLamDynParl_I.flgCatEmpty EGSDCmn_S1B1VirtLamDynParl_I.flgCatFull EGSDCmn_S1B1VirtLamDynParl_I.flgDynTripDneVirt EGSDCmn_S1B1VirtLamDynParl_I.flgIdnAdpnEnd EGSDCmn_S1B1VirtLamDynParl_I.flgIdnAdpnLean EGSDCmn_S1B1VirtLamDynParl_I.flgIdnAdpnRich EGSDCmn_S1B1VirtLamDynParl_I.flgReld EGSDCmn_S1B1VirtLamDynParl_I.flgUHiEnaParl EGSDCmn_S1B1VirtLamDynParl_I.flgUMid EGSDCmn_S1B1VirtLamDynParl_I.flgVirtLamDyn EGSDCmn_S1B1VirtLamDynParl_I.mOSC EGSDCmn_S1B1VirtLamDynParl_I.mRSC EGSDCmn_S1B1VirtLamDynParl_I.mfVirtO2 EGSDCmn_S1B1VirtLamDynParl_I.mfVirtRich EGSDCmn_S1B1VirtLamDynParl_I.sm EGSDCmn_S1B1VirtLamDynParl_I.stLamGenr EGSDCmn_S1B1VirtLamDynParl_I.tiGas EGSDCmn_S1B1VirtLamDynParl_I.tiLamDynLtr EGSDCmn_S1B1VirtLamDynParl_I.tiLamDynRtl EGSDCmn_S1B1VirtLamDynParl_I.tiUDynLtr EGSDCmn_S1B1VirtLamDynParl_I.tiUDynRtl EGSDCmn_S1B1VirtLamDynParl_I.u EGSDCmn_S1B1VirtLamDynParl_I.EnaReldEF_I.buffer EGSDCmn_S1B1VirtLamDynParl_I.EnaReldEF_I.oldSignal EGSDCmn_S1B1VirtLamDynParl_I.IdnAdpnCTR_I.counter EGSDCmn_S1B1VirtLamDynParl_I.flgLeanLamStabTONV_I.outbit EGSDCmn_S1B1VirtLamDynParl_I.flgLeanLamStabTONV_I.time EGSDCmn_S1B1VirtLamDynParl_I.flgRichLamStabTONV_I.outbit EGSDCmn_S1B1VirtLamDynParl_I.flgRichLamStabTONV_I.time EGSDCmn_S1B1VirtLamDynParl_I.mO2EnaCatFullGrdtIK_I.memory EGSDCmn_S1B1VirtLamDynParl_I.mO2IdnAdpnIKL_I.memory EGSDCmn_S1B1VirtLamDynParl_I.mO2VirtEnaCatEmptyIK_I.memory EGSDCmn_S1B1VirtLamDynParl_I.tiGasRtlTONV_I.outbit EGSDCmn_S1B1VirtLamDynParl_I.tiGasRtlTONV_I.time EGSDCmn_S1B1VirtLamDynParl_I.tiUDynTONV_I.outbit EGSDCmn_S1B1VirtLamDynParl_I.tiUDynTONV_I.time EGSDCmn_S2B1AsymcToSymc_I.flgLtrDly EGSDCmn_S2B1AsymcToSymc_I.flgLtrTran EGSDCmn_S2B1AsymcToSymc_I.flgRtlDly EGSDCmn_S2B1AsymcToSymc_I.flgRtlTran EGSDCmn_S2B1AsymcToSymc_I.flgSymcEna EGSDCmn_S2B1AsymcToSymc_I.tiLtrDlySymc EGSDCmn_S2B1AsymcToSymc_I.tiLtrTranSymc EGSDCmn_S2B1AsymcToSymc_I.tiRtlDlySymc EGSDCmn_S2B1AsymcToSymc_I.tiRtlTranSymc EGSDCmn_S2B1AsymcToSymc_I.uFildParlSymc EGSDCmn_S2B1AsymcToSymc_I.uNoSymcOld EGSDCmn_S2B1AsymcToSymc_I.USymcActvFF_I.status EGSDCmn_S2B1AsymcToSymc_I.USymcEnaER_I.buffer EGSDCmn_S2B1AsymcToSymc_I.USymcEnaER_I.oldSignal EGSDCmn_S2B1AsymcToSymc_I.uDlyDTTtopt_I.buffer EGSDCmn_S2B1AsymcToSymc_I.uDlyDTTtopt_I.counter EGSDCmn_S2B1AsymcToSymc_I.uDlyDTTtopt_I.pointer EGSDCmn_S2B1AsymcToSymc_I.uTranLT_I.memory EGSDCmn_S2B1VirtTarLeanOffsParl_I.flgCatEmptyTOut EGSDCmn_S2B1VirtTarLeanOffsParl_I.flgCatFullTOut EGSDCmn_S2B1VirtTarLeanOffsParl_I.flgReld EGSDCmn_S2B1VirtTarLeanOffsParl_I.flgTarLeanRes EGSDCmn_S2B1VirtTarLeanOffsParl_I.flgTarRich EGSDCmn_S2B1VirtTarLeanOffsParl_I.flgTarRichRes EGSDCmn_S2B1VirtTarLeanOffsParl_I.flgUHiEnaParl EGSDCmn_S2B1VirtTarLeanOffsParl_I.mOSC EGSDCmn_S2B1VirtTarLeanOffsParl_I.mRSC EGSDCmn_S2B1VirtTarLeanOffsParl_I.mRampDurParl EGSDCmn_S2B1VirtTarLeanOffsParl_I.mfEg EGSDCmn_S2B1VirtTarLeanOffsParl_I.mfVirtO2 EGSDCmn_S2B1VirtTarLeanOffsParl_I.mfVirtRich /end LOC_MEASUREMENT
 FUNCTION_VERSION "1.62.0" /end FUNCTION
/begin COMPU_METHOD B_TRUE "" TAB_VERB "%6.3" "" COMPU_TAB_REF B_TRUE /end COMPU_METHOD
/begin COMPU_VTAB B_TRUE "" TAB_VERB 2 0 "FALSE" 1 "TRUE" /end COMPU_VTAB
/begin COMPU_METHOD Cndctn_q0p01_COMPU "" RAT_FUNC "%6.4" "1/Ohm" COEFFS 0 100 0 0 0 1 /end COMPU_METHOD
/begin COMPU_METHOD Curr_A_q0p03125_COMPU "" RAT_FUNC "%6.4" "A" COEFFS 0 32 0 0 0 1 /end COMPU_METHOD
/begin COMPU_METHOD DELibGainCorrCurIn_VERB "" TAB_VERB "%6.3" "" COMPU_TAB_REF DELibGainCorrCurIn_VERB /end COMPU_METHOD
/begin COMPU_VTAB DELibGainCorrCurIn_VERB "" TAB_VERB 3 0 "DESVAL" 1 "GOVDESVAL" 2 "RACT" /end COMPU_VTAB
/begin COMPU_METHOD DELibRelsStrt_VERB "" TAB_VERB "%6.3" "" COMPU_TAB_REF DELibRelsStrt_VERB /end COMPU_METHOD
/begin COMPU_VTAB DELibRelsStrt_VERB "" TAB_VERB 3 0 "RelsStrt_MinMaxDvt" 1 "RelsStrt_MinDvt" 2 "RelsStrt_MaxDvt" /end COMPU_VTAB
/begin COMPU_METHOD DELIB_ALLPRES_VERB_COMPU "" TAB_VERB "%6.3" "" COMPU_TAB_REF DELIB_ALLPRES_VERB_COMPU /end COMPU_METHOD
/begin COMPU_VTAB DELIB_ALLPRES_VERB_COMPU "" TAB_VERB 5 301 "MDLPPFLTDS" 267 "BRKBSTP" 256 "ENVP" 261 "OILP" 511 "NOPRES" /end COMPU_VTAB
/begin COMPU_METHOD DELIB_ALLTEMP_VERB_COMPU "" TAB_VERB "%6.3" "" COMPU_TAB_REF DELIB_ALLTEMP_VERB_COMPU /end COMPU_METHOD
/begin COMPU_VTAB DELIB_ALLTEMP_VERB_COMPU "" TAB_VERB 11 5 "CENGDST" 15 "CENGUST" 20 "ENGDATENG" 0 "ENVT" 7 "FUELT" 55 "INTKAIRT" 82 "OILSWMPT" 17 "TEGRCLRLPDS" 25 "NRCAT" 254 "DFLTEMP" 255 "NOTEMP" /end COMPU_VTAB
/begin COMPU_METHOD dez "" RAT_FUNC "%6.2" "" COEFFS 0 1 0 0 0 1 /end COMPU_METHOD
/begin COMPU_METHOD dPres_hPa_p_s "" RAT_FUNC "%6.2" "hPa/s" COEFFS 0 1 0 0 0 1 /end COMPU_METHOD
/begin COMPU_METHOD DtyCyc "" RAT_FUNC "%6.4" "%" COEFFS 0 100 0 0 0 1 /end COMPU_METHOD
/begin COMPU_METHOD EGSDCmn_LamGenrParl_sm_VERB "" TAB_VERB "%6.3" "" COMPU_TAB_REF EGSDCmn_LamGenrParl_sm_VERB /end COMPU_METHOD
/begin COMPU_VTAB EGSDCmn_LamGenrParl_sm_VERB "" TAB_VERB 8 0 "_0_Inactive" 1 "_1_InpCatEmptyCdng" 2 "_2_InpCatFullCdng" 3 "_3_TarCatFull" 4 "_4_TarCatEmpty" 5 "_6_LamRich" 6 "_7_LamLean" 7 "_99_hintergrund" /end COMPU_VTAB
/begin COMPU_METHOD EGSDCmn_VirtLamGenrParl_sm_VERB "" TAB_VERB "%6.3" "" COMPU_TAB_REF EGSDCmn_VirtLamGenrParl_sm_VERB /end COMPU_METHOD
/begin COMPU_VTAB EGSDCmn_VirtLamGenrParl_sm_VERB "" TAB_VERB 8 0 "_0_InactiveV" 1 "_1_InpCatEmptyCdngV" 2 "_2_InpCatFullCdngV" 3 "_3_TarCatFullV" 4 "_4_TarCatEmptyV" 5 "_6_LamRichV" 6 "_7_LamLeanV" 7 "_99_hintergrundV" /end COMPU_VTAB
/begin COMPU_METHOD EngN "" RAT_FUNC "%6.3" "rpm" COEFFS 0 2 0 0 0 1 /end COMPU_METHOD
/begin COMPU_METHOD Fact "" RAT_FUNC "%6.5" "-" COEFFS 0 8192 0 0 0 1 /end COMPU_METHOD
/begin COMPU_METHOD Fact100 "" RAT_FUNC "%6.4" "-" COEFFS 0 100 0 0 0 1 /end COMPU_METHOD
/begin COMPU_METHOD FAILSTRTDETN_SC_Compu "" TAB_VERB "%6.3" "" COMPU_TAB_REF FAILSTRTDETN_SC_Compu /end COMPU_METHOD
/begin COMPU_VTAB FAILSTRTDETN_SC_Compu "" TAB_VERB 2 0 "False" 1 "True" /end COMPU_VTAB
/begin COMPU_METHOD fak_q0p000244 "" RAT_FUNC "%6.5" "-" COEFFS 0 65536 0 0 0 16 /end COMPU_METHOD
/begin COMPU_METHOD fak_q3p0518Em5 "" RAT_FUNC "%7.6" "" COEFFS 0 32768 0 0 0 1 /end COMPU_METHOD
/begin COMPU_METHOD fak_q3p72529Em9 "" RAT_FUNC "%11.10" "" COEFFS 0 268435456 0 0 0 1 /end COMPU_METHOD
/begin COMPU_METHOD fak_uw_b16 "" RAT_FUNC "%6.5" "-" COEFFS 0 65536 0 0 0 16 /end COMPU_METHOD
/begin COMPU_METHOD fak_uw_b2 "" RAT_FUNC "%7.6" "-" COEFFS 0 65536 0 0 0 2 /end COMPU_METHOD
/begin COMPU_METHOD FAN1_TYPAVLDELIBSTDACTR_SY_Compu "" TAB_VERB "%6.3" "" COMPU_TAB_REF FAN1_TYPAVLDELIBSTDACTR_SY_Compu /end COMPU_METHOD
/begin COMPU_VTAB FAN1_TYPAVLDELIBSTDACTR_SY_Compu "" TAB_VERB 2 0 "FALSE" 1 "TRUE" /end COMPU_VTAB
/begin COMPU_METHOD FANCTL_SPD_SY_Compu "" TAB_VERB "%6.3" "" COMPU_TAB_REF FANCTL_SPD_SY_Compu /end COMPU_METHOD
/begin COMPU_VTAB FANCTL_SPD_SY_Compu "" TAB_VERB 2 0 "FANCTL_SPD_DISBL" 1 "FANCTL_SPD_ENBL" /end COMPU_VTAB
/begin COMPU_METHOD FAN_ATSINTVMOD_SY_Compu "" RAT_FUNC "%6.2" "" COEFFS 0 1 0 0 0 1 /end COMPU_METHOD
/begin COMPU_METHOD FAN_CODAVL_SY_Compu "" TAB_VERB "%6.3" "" COMPU_TAB_REF FAN_CODAVL_SY_Compu /end COMPU_METHOD
/begin COMPU_VTAB FAN_CODAVL_SY_Compu "" TAB_VERB 2 0 "False" 1 "True" /end COMPU_VTAB
/begin COMPU_METHOD FAN_NUMDIGOUT_SY_Compu "" RAT_FUNC "%6.2" "" COEFFS 0 1 0 0 0 1 /end COMPU_METHOD
/begin COMPU_METHOD FAN_NUMPWMOUT_SY_Compu "" RAT_FUNC "%6.2" "" COEFFS 0 1 0 0 0 1 /end COMPU_METHOD
/begin COMPU_METHOD FCOCDNABSFAIL_SC_Compu "" TAB_VERB "%6.3" "" COMPU_TAB_REF FCOCDNABSFAIL_SC_Compu /end COMPU_METHOD
/begin COMPU_VTAB FCOCDNABSFAIL_SC_Compu "" TAB_VERB 2 0 "FALSE" 1 "TRUE" /end COMPU_VTAB
/begin COMPU_METHOD FCOCMF_SY_Compu "" TAB_VERB "%6.3" "" COMPU_TAB_REF FCOCMF_SY_Compu /end COMPU_METHOD
/begin COMPU_VTAB FCOCMF_SY_Compu "" TAB_VERB 4 0 "0" 1 "1" 2 "2" 3 "3" /end COMPU_VTAB
/begin COMPU_METHOD FCONTHRES_SY_Compu "" TAB_VERB "%6.3" "" COMPU_TAB_REF FCONTHRES_SY_Compu /end COMPU_METHOD
/begin COMPU_VTAB FCONTHRES_SY_Compu "" TAB_VERB 2 0 "0" 1 "1" /end COMPU_VTAB
/begin COMPU_METHOD FCOREQ_INHOUSE_SC_Compu "" TAB_VERB "%6.3" "" COMPU_TAB_REF FCOREQ_INHOUSE_SC_Compu /end COMPU_METHOD
/begin COMPU_VTAB FCOREQ_INHOUSE_SC_Compu "" TAB_VERB 2 0 "False" 1 "True" /end COMPU_VTAB
/begin COMPU_METHOD FEA_ETS_MSG_Compu "" TAB_VERB "%6.3" "" COMPU_TAB_REF FEA_ETS_MSG_Compu /end COMPU_METHOD
/begin COMPU_VTAB FEA_ETS_MSG_Compu "" TAB_VERB 2 0 "False" 1 "True" /end COMPU_VTAB
/begin COMPU_METHOD FEA_SY_MX17_Compu "" TAB_VERB "%6.3" "" COMPU_TAB_REF FEA_SY_MX17_Compu /end COMPU_METHOD
/begin COMPU_VTAB FEA_SY_MX17_Compu "" TAB_VERB 2 0 "ECU:not ME(D)17" 1 "ECU: ME(D)17" /end COMPU_VTAB
/begin COMPU_METHOD FEBFNST_SC_Compu "" TAB_VERB "%6.3" "" COMPU_TAB_REF FEBFNST_SC_Compu /end COMPU_METHOD
/begin COMPU_VTAB FEBFNST_SC_Compu "" TAB_VERB 2 0 "False" 1 "True" /end COMPU_VTAB
/begin COMPU_METHOD FEBFST_SC_Compu "" TAB_VERB "%6.3" "" COMPU_TAB_REF FEBFST_SC_Compu /end COMPU_METHOD
/begin COMPU_VTAB FEBFST_SC_Compu "" TAB_VERB 2 0 "False" 1 "True" /end COMPU_VTAB
/begin COMPU_METHOD FEL_ENAACTRATS_SC_Compu "" TAB_VERB "%6.3" "" COMPU_TAB_REF FEL_ENAACTRATS_SC_Compu /end COMPU_METHOD
/begin COMPU_VTAB FEL_ENAACTRATS_SC_Compu "" TAB_VERB 2 0 "Disable" 1 "Enable" /end COMPU_VTAB
/begin COMPU_METHOD FEL_VAR_SY_Compu "" TAB_VERB "%6.3" "" COMPU_TAB_REF FEL_VAR_SY_Compu /end COMPU_METHOD
/begin COMPU_VTAB FEL_VAR_SY_Compu "" TAB_VERB 42 1 "DAI" 3 "VWW" 4 "POR" 5 "AUD" 6 "OPE" 9 "FIA" 11 "BMW" 14 "PSA" 15 "REN" 17 "ALF" 18 "SAB" 19 "VOL" 20 "NIS" 21 "GMU" 22 "FOR" 26 "IMJ" 51 "SEA" 53 "CHR" 54 "JAG" 55 "ROL" 69 "FER" 72 "TOY" 123 "MIT" 147 "HYU" 159 "HON" 160 "MAZ" 183 "CU" 190 "LRG" 204 "VVW" 214 "AVT" 242 "Iveco" 243 "DMC" 248 "SUZ" 267 "SSANGYONG" 270 "KEF" 289 "AMG" 308 "TAT" 319 "MVM" 385 "UAES" 828 "RBCD" 999 "ALL" 9454 "Fuso" /end COMPU_VTAB
/begin COMPU_METHOD FFVE100_SC_Compu "" TAB_VERB "%6.3" "" COMPU_TAB_REF FFVE100_SC_Compu /end COMPU_METHOD
/begin COMPU_VTAB FFVE100_SC_Compu "" TAB_VERB 2 0 "False" 1 "True" /end COMPU_VTAB
/begin COMPU_METHOD HiPwrAtmptDetnInpSeln_VERB "" TAB_VERB "%6.3" "" COMPU_TAB_REF HiPwrAtmptDetnInpSeln_VERB /end COMPU_METHOD
/begin COMPU_VTAB HiPwrAtmptDetnInpSeln_VERB "" TAB_VERB 2 0 "R_ACTR" 1 "R_OUT_I" /end COMPU_VTAB
/begin COMPU_METHOD InjMass "" RAT_FUNC "%6.4" "mg/hub" COEFFS 0 100 0 0 0 1 /end COMPU_METHOD
/begin COMPU_METHOD Kd_1 "" RAT_FUNC "%6.4" "1/1" COEFFS 0 512 0 0 0 1 /end COMPU_METHOD
/begin COMPU_METHOD Ki_1 "" RAT_FUNC "%6.4" "1/s" COEFFS 0 67.108864 0 0 0 1 /end COMPU_METHOD
/begin COMPU_METHOD Kp_1 "" RAT_FUNC "%6.4" "1/1" COEFFS 0 64 0 0 0 1 /end COMPU_METHOD
/begin COMPU_METHOD mgrad_q1_mgdivs "" RAT_FUNC "%6.2" "mg/s" COEFFS 0 1 0 0 0 1 /end COMPU_METHOD
/begin COMPU_METHOD m_q0p001_kg "" RAT_FUNC "%6.5" "kg" COEFFS 0 1000 0 0 0 1 /end COMPU_METHOD
/begin COMPU_METHOD m_q0p1 "" RAT_FUNC "%6.3" "kg/h" COEFFS 0 10 0 0 0 1 /end COMPU_METHOD
/begin COMPU_METHOD m_q0p1_mg "" RAT_FUNC "%6.3" "mg" COEFFS 0 1 0 0 0 0.1 /end COMPU_METHOD
/begin COMPU_METHOD m_q1p5259Em8_kg "" RAT_FUNC "%10.9" "kg" COEFFS 0 65536000 0 0 0 1 /end COMPU_METHOD
/begin COMPU_METHOD m_q1_mg "" RAT_FUNC "%6.2" "mg" COEFFS 0 1 0 0 0 1 /end COMPU_METHOD
/begin COMPU_METHOD OneToOne "" RAT_FUNC "%6.2" "-" COEFFS 0 1 0 0 0 1 /end COMPU_METHOD
/begin COMPU_METHOD Pos_Prc_float "" RAT_FUNC "%6.2" "%" COEFFS 0 1 0 0 0 1 /end COMPU_METHOD
/begin COMPU_METHOD Prc "" RAT_FUNC "%6.4" "%" COEFFS 0 81.92 0 0 0 1 /end COMPU_METHOD
/begin COMPU_METHOD PrcSec "" RAT_FUNC "%6.4" "%/s" COEFFS 0 81.92 0 0 0 1 /end COMPU_METHOD
/begin COMPU_METHOD Pres_hPa "" RAT_FUNC "%6.2" "hPa" COEFFS 0 1 0 0 0 1 /end COMPU_METHOD
/begin COMPU_METHOD Pwr_q0p01_COMPU "" RAT_FUNC "%6.4" "W" COEFFS 0 100 0 0 0 1 /end COMPU_METHOD
/begin COMPU_METHOD q100_ms "" RAT_FUNC "%6.0" "ms" COEFFS 0 1 0 0 0 100 /end COMPU_METHOD
/begin COMPU_METHOD q10_mV_DIV_s "" RAT_FUNC "%6.1" "mV/s" COEFFS 0 1 0 0 0 10 /end COMPU_METHOD
/begin COMPU_METHOD q1Em4_s "" RAT_FUNC "%7.6" "s" COEFFS 0 10000 0 0 0 1 /end COMPU_METHOD
/begin COMPU_METHOD q1_Ncm "" RAT_FUNC "%6.2" "Ncm" COEFFS 0 1 0 0 0 1 /end COMPU_METHOD
/begin COMPU_METHOD q9p313226Em10_Perc_DIV_mV "" RAT_FUNC "%12.11" "%/mV" COEFFS 0 1073741824 0 0 0 1 /end COMPU_METHOD
/begin COMPU_METHOD RmpPrc "" RAT_FUNC "%6.5" "%/s" COEFFS 0 5368.70912 0 0 0 1 /end COMPU_METHOD
/begin COMPU_METHOD RmpPrc16 "" RAT_FUNC "%6.4" "%/s" COEFFS 0 41.94304 0 0 0 1 /end COMPU_METHOD
/begin COMPU_METHOD SigQly_COMPU_VERB "" TAB_VERB "%6.3" "" COMPU_TAB_REF SigQly_COMPU_VERB /end COMPU_METHOD
/begin COMPU_VTAB SigQly_COMPU_VERB "" TAB_VERB 16 0 "SIGQLY_NOTCALC" 1 "SIGQLY_INIT" 2 "SIGQLY_OK" 3 "SIGQLY_MODEL" 4 "SIGQLY_REPLACEMENT" 5 "SIGQLY_FROZEN" 6 "SIGQLY_INVALID" 7 "SIGQLY_RESERVED_7" 8 "SIGQLY_RESERVED_8" 9 "SIGQLY_RESERVED_9" 10 "SIGQLY_RESERVED_10" 11 "SIGQLY_RESERVED_11" 12 "SIGQLY_RESERVED_12" 13 "SIGQLY_RESERVED_13" 14 "SIGQLY_RESERVED_14" 15 "SIGQLY_RESERVED_15" /end COMPU_VTAB
/begin COMPU_METHOD spg_q0p01_V "" RAT_FUNC "%6.4" "V" COEFFS 0 100 0 0 0 1 /end COMPU_METHOD
/begin COMPU_METHOD spg_q1p221Em3_V "" RAT_FUNC "%6.4" "V" COEFFS 0 65536 0 0 0 80 /end COMPU_METHOD
/begin COMPU_METHOD spg_q1p8626Em8_V "" RAT_FUNC "%10.9" "V" COEFFS 0 268435456 0 0 0 5 /end COMPU_METHOD
/begin COMPU_METHOD Temp_Cels "" RAT_FUNC "%6.1" "deg C" COEFFS 0 10 2731.4 0 0 1 /end COMPU_METHOD
/begin COMPU_METHOD TimeDelay_s "" RAT_FUNC "%6.1" "s" COEFFS 0 0 1 0 0.00023283064365387 0 /end COMPU_METHOD
/begin COMPU_METHOD Time_ms "" RAT_FUNC "%6.1" "ms" COEFFS 0 0.1 0 0 0 1 /end COMPU_METHOD
/begin COMPU_METHOD Time_s "" RAT_FUNC "%6.4" "s" COEFFS 0 100 0 0 0 1 /end COMPU_METHOD
/begin COMPU_METHOD Time_usec_q1_COMPU "" RAT_FUNC "%6.2" "us" COEFFS 0 1 0 0 0 1 /end COMPU_METHOD
/begin COMPU_METHOD t_q0p002 "" RAT_FUNC "%6.4" "s" COEFFS 0 1000 0 0 0 2 /end COMPU_METHOD
/begin COMPU_METHOD t_q0p01 "" RAT_FUNC "%6.4" "s" COEFFS 0 100 0 0 0 1 /end COMPU_METHOD
/begin COMPU_METHOD t_q0p1 "" RAT_FUNC "%6.3" "s" COEFFS 0 10 0 0 0 1 /end COMPU_METHOD
/begin COMPU_METHOD VlvVel "" RAT_FUNC "%6.3" "%/s" COEFFS 0 8.192 0 0 0 1 /end COMPU_METHOD
/begin COMPU_METHOD Volt "" RAT_FUNC "%6.3" "mV" COEFFS 0 5 0 0 0 1 /end COMPU_METHOD
/begin COMPU_METHOD Volt_Batt "" RAT_FUNC "%6.1" "mV" COEFFS 0 0.05 0 0 0 1 /end COMPU_METHOD
/begin RECORD_LAYOUT Cur_Xs16Ws16 NO_AXIS_PTS_X 1 SWORD AXIS_PTS_X 2 SWORD INDEX_INCR DIRECT FNC_VALUES 3 SWORD COLUMN_DIR DIRECT /end RECORD_LAYOUT
/begin RECORD_LAYOUT Kw_Ws16 FNC_VALUES 1 SWORD COLUMN_DIR DIRECT /end RECORD_LAYOUT
/begin RECORD_LAYOUT Kw_Ws32 FNC_VALUES 1 SLONG COLUMN_DIR DIRECT /end RECORD_LAYOUT
/begin RECORD_LAYOUT Kw_Wu8 FNC_VALUES 1 UBYTE COLUMN_DIR DIRECT /end RECORD_LAYOUT
/begin RECORD_LAYOUT Map_Xs16Ys16Ws16 NO_AXIS_PTS_X 1 SWORD NO_AXIS_PTS_Y 2 SWORD AXIS_PTS_X 3 SWORD INDEX_INCR DIRECT AXIS_PTS_Y 4 SWORD INDEX_INCR DIRECT FNC_VALUES 5 SWORD COLUMN_DIR DIRECT /end RECORD_LAYOUT
/begin RECORD_LAYOUT RB_Curve_S16_S16 NO_AXIS_PTS_X 1 SWORD AXIS_PTS_X 2 SWORD INDEX_INCR DIRECT FNC_VALUES 3 SWORD COLUMN_DIR DIRECT /end RECORD_LAYOUT
/begin RECORD_LAYOUT RB_Curve_S16_S32_Static NO_AXIS_PTS_X 1 SWORD AXIS_PTS_X 2 SWORD INDEX_INCR DIRECT FNC_VALUES 3 SLONG COLUMN_DIR DIRECT STATIC_RECORD_LAYOUT /end RECORD_LAYOUT
/begin RECORD_LAYOUT RB_Curve_S16_U16_Static NO_AXIS_PTS_X 1 SWORD AXIS_PTS_X 2 SWORD INDEX_INCR DIRECT FNC_VALUES 3 UWORD COLUMN_DIR DIRECT STATIC_RECORD_LAYOUT /end RECORD_LAYOUT
/begin RECORD_LAYOUT RB_Map_S16S16_S16 NO_AXIS_PTS_X 1 SWORD NO_AXIS_PTS_Y 2 SWORD AXIS_PTS_X 3 SWORD INDEX_INCR DIRECT AXIS_PTS_Y 4 SWORD INDEX_INCR DIRECT FNC_VALUES 5 SWORD COLUMN_DIR DIRECT /end RECORD_LAYOUT
/begin RECORD_LAYOUT RB_Map_S16S16_U16 NO_AXIS_PTS_X 1 SWORD NO_AXIS_PTS_Y 2 SWORD AXIS_PTS_X 3 SWORD INDEX_INCR DIRECT AXIS_PTS_Y 4 SWORD INDEX_INCR DIRECT FNC_VALUES 5 UWORD COLUMN_DIR DIRECT /end RECORD_LAYOUT
/begin RECORD_LAYOUT RB_Val_Ws16 FNC_VALUES 1 SWORD COLUMN_DIR DIRECT /end RECORD_LAYOUT
/begin RECORD_LAYOUT RB_Val_Ws32 FNC_VALUES 1 SLONG COLUMN_DIR DIRECT /end RECORD_LAYOUT
/begin RECORD_LAYOUT RB_Val_Wu16 FNC_VALUES 1 UWORD COLUMN_DIR DIRECT /end RECORD_LAYOUT
/begin RECORD_LAYOUT RB_Val_Wu8 FNC_VALUES 1 UBYTE COLUMN_DIR DIRECT /end RECORD_LAYOUT
/begin RECORD_LAYOUT Val_Ws16 FNC_VALUES 1 SWORD COLUMN_DIR DIRECT /end RECORD_LAYOUT
/begin RECORD_LAYOUT Val_Ws32 FNC_VALUES 1 SLONG COLUMN_DIR DIRECT /end RECORD_LAYOUT
/begin RECORD_LAYOUT Val_Wu16 FNC_VALUES 1 UWORD COLUMN_DIR DIRECT /end RECORD_LAYOUT
/begin RECORD_LAYOUT Val_Wu8 FNC_VALUES 1 UBYTE COLUMN_DIR DIRECT /end RECORD_LAYOUT
/end MODULE
/end PROJECT
