ASAP2_VERSION 1 60
/begin PROJECT MG1CS022 "MG1CS022"
/begin HEADER "" VERSION "MG1CS022_62XSC_V036_TPROT" PROJECT_NO MG1CS022 /end HEADER
/begin MODULE DIM ""
/begin MOD_COMMON "" BYTE_ORDER MSB_LAST ALIGNMENT_BYTE 1 ALIGNMENT_WORD 2 ALIGNMENT_LONG 4 ALIGNMENT_INT64 4 ALIGNMENT_FLOAT32_IEEE 4 ALIGNMENT_FLOAT64_IEEE 4 DATA_SIZE 32 /end MOD_COMMON
/begin CHARACTERISTIC UEGO_deltaUHeatrRamp_C "increment of heater voltage during ramp phase (per second)" VALUE 0x80581640 RB_Val_Wu16 327.6700 spg_q0p005 0.0050 327.6750 FORMAT "%8.4" EXTENDED_LIMITS 0.00 327.6750 /end CHARACTERISTIC
/begin CHARACTERISTIC UEGO_facErrTiHeatrCrv_C "correction factor maximum time of curve phase at open load errors" VALUE 0x80581642 RB_Val_Wu16 65.53500 Fact1000 0.00 65.53500 FORMAT "%8.5" /end CHARACTERISTIC
/begin CHARACTERISTIC UEGO_facErrUHeatrCrv_C "correction factor maximum voltage of curve phase at open load errors" VALUE 0x80581644 RB_Val_Wu16 65.53500 Fact1000 0.00 65.53500 FORMAT "%8.5" /end CHARACTERISTIC
/begin CHARACTERISTIC UEGO_facHeatrGovrKD_C "D-part of PID controller for sensor heater" VALUE 0x80581646 RB_Val_Wu16 54.61250 fak_uw_q0p00083 0.00 54.61250 FORMAT "%8.5" /end CHARACTERISTIC
/begin CHARACTERISTIC UEGO_facHeatrGovrKI_C "I-part of PID controller for sensor heater" VALUE 0x80581648 RB_Val_Wu16 54.61250 fak_uw_q0p00083 0.00 54.61250 FORMAT "%8.5" /end CHARACTERISTIC
/begin CHARACTERISTIC UEGO_facHeatrGovrKP_C "P-part of PID controller for sensor heater" VALUE 0x8058164A RB_Val_Wu16 54.61250 fak_uw_q0p00083 0.00 54.61250 FORMAT "%8.5" /end CHARACTERISTIC
/begin CHARACTERISTIC UEGO_flgOperPlausFastTestResEna_C "flag to switch fast test result of operplaus." VALUE 0x80581550 RB_Val_Wu8 1.00000000000 B_TRUE 0.00 1.00000000000 FORMAT "%13.11" /end CHARACTERISTIC
/begin CHARACTERISTIC UEGO_flgOperPlausPreEngStrtRels_C "Flag to activate operplaus diagnosis in case of O2 sensor pre-heating before the engine start" VALUE 0x80581551 RB_Val_Wu8 1.00000000000 B_TRUE 0.00 1.00000000000 FORMAT "%13.11" /end CHARACTERISTIC
/begin CHARACTERISTIC UEGO_flgOvrHeatgPrevn_C "calibration to enable or disable overheating prevention" VALUE 0x8058164C RB_Val_Wboolean 1.00000000000 B_TRUE 0.00 1.00000000000 FORMAT "%13.11" /end CHARACTERISTIC
/begin CHARACTERISTIC UEGO_HeatrCtrlS1B1_I.stHeatgUpStgy_C "Instance S1B1 of heater control class / status word for configuration of the heating up phase - codes which phases are active" VALUE 0x80581670 RB_Val_Wu8 255.0 dez 0.00 255.0 FORMAT "%5.1" /end CHARACTERISTIC
/begin CHARACTERISTIC UEGO_HeatrCtrlS1B1_I.stHeatrCtrl_C "Instance S1B1 of heater control class / status word heater control" VALUE 0x80581671 RB_Val_Wu8 255.0 dez 0.00 255.0 FORMAT "%5.1" /end CHARACTERISTIC
/begin CHARACTERISTIC UEGO_HeatrCtrlS1B1_I.uCrv_T "Instance S1B1 of heater control class / Map for time dependent heater voltage during open loop curve phase" CURVE 0x80581672 RB_Curve_U16_U16 327.6750 spg_q0p005 0.00 327.6750 FORMAT "%8.4"
 /begin AXIS_DESCR STD_AXIS NO_INPUT_QUANTITY t_q0p02 10 0.00 1310.700 FORMAT "%8.3" DEPOSIT ABSOLUTE /end AXIS_DESCR
/end CHARACTERISTIC
/begin CHARACTERISTIC UEGO_HeatrCtrlS1B1_I.uHldRampStrt_T "Instance S1B1 of heater control class / Map deciding on hold phase and initial ramp phase voltage based on environment temperature" CURVE 0x8058169C RB_Curve_S16_U16_Static 327.6750 spg_q0p005 0.00 327.6750 FORMAT "%8.4"
 /begin AXIS_DESCR STD_AXIS NO_INPUT_QUANTITY temp_q0p1_o273 5 -3549.940 3003.560 FORMAT "%8.3" DEPOSIT ABSOLUTE /end AXIS_DESCR
/end CHARACTERISTIC
/begin CHARACTERISTIC UEGO_iDeltaPmpDiagScHi_C "higher threshold value of change in pump current during short circuit diagnosis" VALUE 0x805815A8 RB_Val_Ws16 0.04369000 i_q6p6667Em7_A -0.02184533 0.02184467 FORMAT "%10.8" /end CHARACTERISTIC
/begin CHARACTERISTIC UEGO_iDeltaPmpDiagScLo_C "lower threshold value of change in pump current during short circuit diagnosis" VALUE 0x805815AA RB_Val_Ws16 0.04369000 i_q6p6667Em7_A -0.02184533 0.02184467 FORMAT "%10.8" /end CHARACTERISTIC
/begin CHARACTERISTIC UEGO_iDeltaPmpHi_C "Maximum tolerated positive absolute deviation of the pump current measurement from the aim set value" VALUE 0x80581560 RB_Val_Ws16 0.04369000 i_q6p6667Em7_A -0.02184533 0.02184467 FORMAT "%10.8" /end CHARACTERISTIC
/begin CHARACTERISTIC UEGO_iDeltaPmpLo_C "Minimum tolerated negative absolute deviation of the pump current measurement from the aim set value" VALUE 0x80581562 RB_Val_Ws16 0.04369000 i_q6p6667Em7_A -0.02184533 0.02184467 FORMAT "%10.8" /end CHARACTERISTIC
/begin CHARACTERISTIC UEGO_iIsoHi_C "Maximum tolerable shunt current through sensor line" VALUE 0x805815AC RB_Val_Ws16 0.04369000 i_q6p6667Em7_A -0.02184533 0.02184467 FORMAT "%10.8" /end CHARACTERISTIC
/begin CHARACTERISTIC UEGO_iIsoLo_C "Minimum tolerable shunt current through sensor line in case of shunt to ground" VALUE 0x805815AE RB_Val_Ws16 0.04369000 i_q6p6667Em7_A -0.02184533 0.02184467 FORMAT "%10.8" /end CHARACTERISTIC
/begin CHARACTERISTIC UEGO_iIsqDesWireScHiIsqEvln_C "Desired Amplitude current required evlauting short circut in HiIsq swton submode" VALUE 0x8058154A RB_Val_Wu16 0.02000000 i_q6p6667Em7_A 0.00 0.02000000 FORMAT "%10.8" EXTENDED_LIMITS 0.00 0.04369000 /end CHARACTERISTIC
/begin CHARACTERISTIC UEGO_iIsqDesWireScLoIsqEvln_C "Desired Amplitude current required evlauting short circut in LoIsq swton submode" VALUE 0x8058154C RB_Val_Wu16 0.02000000 i_q6p6667Em7_A 0.00 0.02000000 FORMAT "%10.8" EXTENDED_LIMITS 0.00 0.04369000 /end CHARACTERISTIC
/begin CHARACTERISTIC UEGO_iSwtIPin_C "Parameter for the leakage current on the Pin" VALUE 0x805816D2 RB_Val_Ws16 0.04369000 i_q6p6667Em7_A -0.02184533 0.02184467 FORMAT "%10.8" /end CHARACTERISTIC
/begin CHARACTERISTIC UEGO_nrDiagSigIdleDchaTi_C "The discharge time of the capacitors in ASIC mode Idle" VALUE 0x80581570 RB_Val_Wu8 255.0 dez 0.00 255.0 FORMAT "%5.1" /end CHARACTERISTIC
/begin CHARACTERISTIC UEGO_nrHeatgOff_C "Internal heater mode where the heater is considered OFF" VALUE 0x8058164D RB_Val_Wu8 2.000 dez 0.00 2.000 FORMAT "%5.3" EXTENDED_LIMITS 0.00 255.0 /end CHARACTERISTIC
/begin CHARACTERISTIC UEGO_nrRamFailPosnMax_C "" VALUE 0x80581571 RB_Val_Wu8 255.0 dez 0.00 255.0 FORMAT "%5.1" /end CHARACTERISTIC
/begin CHARACTERISTIC UEGO_nrRamFailPosnMin_C "" VALUE 0x80581572 RB_Val_Wu8 255.0 dez 0.00 255.0 FORMAT "%5.1" /end CHARACTERISTIC
/begin CHARACTERISTIC UEGO_nrTstPlsHeatrRly_C "Maximum number of allowed test pulses in one driving cycle." VALUE 0x805816C0 RB_Val_Wu32 4294967295.00 OneToOne 0.00 4294967295.00 FORMAT "%13.2" /end CHARACTERISTIC
/begin CHARACTERISTIC UEGO_ratHeatrPwrStgMax_C "Maximum allowed duty cycle" VALUE 0x805816B4 RB_Val_Wu16 199.9969 rel_q0p003052 0.00 199.9969 FORMAT "%8.4" /end CHARACTERISTIC
/begin CHARACTERISTIC UEGO_ratIFltHi_C "Maximum tolerable falure current through sensor line related to ISQ amplitude" VALUE 0x805815B0 RB_Val_Ws16 7.872072 fak_q1p201Em4 -3.936096 3.935976 FORMAT "%8.6" /end CHARACTERISTIC
/begin CHARACTERISTIC UEGO_ratIFltLo_C "Miimum tolerable falure current through sensor line related to ISQ amplitude" VALUE 0x805815B2 RB_Val_Ws16 7.872072 fak_q1p201Em4 -3.936096 3.935976 FORMAT "%8.6" /end CHARACTERISTIC
/begin CHARACTERISTIC UEGO_ratIPmpExctDiagScHi_C "higher threshold value of rate of pump current excitation during short circuit diagnosis" VALUE 0x805815B4 RB_Val_Ws16 7.872072 fak_q1p201Em4 -3.936096 3.935976 FORMAT "%8.6" /end CHARACTERISTIC
/begin CHARACTERISTIC UEGO_ratIPmpExctDiagScLoTempLo_C "" VALUE 0x805815B6 RB_Val_Ws16 7.872072 fak_q1p201Em4 -3.936096 3.935976 FORMAT "%8.6" /end CHARACTERISTIC
/begin CHARACTERISTIC UEGO_ratIPmpExctDiagScLo_C "lower threshold value of rate of pump current excitation during short circuit diagnosis" VALUE 0x805815B8 RB_Val_Ws16 7.872072 fak_q1p201Em4 -3.936096 3.935976 FORMAT "%8.6" /end CHARACTERISTIC
/begin CHARACTERISTIC UEGO_ratIPmpExctDiagWireOlElectLo_C "calibration for determining open load due to low back-measured current at pump cell with current injection at pump cell" VALUE 0x80581574 RB_Val_Ws16 7.872072 fak_q1p201Em4 -3.936096 3.935976 FORMAT "%8.6" /end CHARACTERISTIC
/begin CHARACTERISTIC UEGO_ratIPmpExctDiagWireRCmpLo_C "" VALUE 0x80581576 RB_Val_Ws16 7.872072 fak_q1p201Em4 -3.936096 3.935976 FORMAT "%8.6" /end CHARACTERISTIC
/begin CHARACTERISTIC UEGO_ratIPmpExctHi_C "Maximum tolerated positive relative deviation of the pump current measurement with additional excitation at the pump cell from the aim set value" VALUE 0x80581564 RB_Val_Ws16 7.872072 fak_q1p201Em4 -3.936096 3.935976 FORMAT "%8.6" /end CHARACTERISTIC
/begin CHARACTERISTIC UEGO_ratIPmpExctLo_C "Minimum tolerated positive relative deviation of the pump current measurement with additional excitation at the pump cell from the aim set value" VALUE 0x80581566 RB_Val_Ws16 7.872072 fak_q1p201Em4 -3.936096 3.935976 FORMAT "%8.6" /end CHARACTERISTIC
/begin CHARACTERISTIC UEGO_rCircHi_C "Maximum allowed resistance between APE-IPE pins respectively RE-IPE" VALUE 0x80581578 RB_Val_Wu16 6553.500 r_q0p1_Ohm 0.00 6553.500 FORMAT "%8.3" /end CHARACTERISTIC
/begin CHARACTERISTIC UEGO_rCmpHi_C "" VALUE 0x8058157A RB_Val_Wu16 6553.500 r_q0p1_Ohm 0.00 6553.500 FORMAT "%8.3" /end CHARACTERISTIC
/begin CHARACTERISTIC UEGO_rRipHi_C "Maximum tolerated pump resistance of UEGO" VALUE 0x80581568 RB_Val_Wu16 6553.500 r_q0p1_Ohm 0.00 6553.500 FORMAT "%8.3" /end CHARACTERISTIC
/begin CHARACTERISTIC UEGO_rRPmpDiagHi_C "" VALUE 0x8058157C RB_Val_Wu16 6553.500 r_q0p1_Ohm 0.00 6553.500 FORMAT "%8.3" /end CHARACTERISTIC
/begin CHARACTERISTIC UEGO_rRPmpDiagIni_C "" VALUE 0x8058157E RB_Val_Wu16 6553.500 r_q0p1_Ohm 0.00 6553.500 FORMAT "%8.3" /end CHARACTERISTIC
/begin CHARACTERISTIC UEGO_rRPmpStep_C "" VALUE 0x80581580 RB_Val_Wu16 6553.500 r_q0p1_Ohm 0.00 6553.500 FORMAT "%8.3" /end CHARACTERISTIC
/begin CHARACTERISTIC UEGO_rSc_C "Assumed shunt resistor between sensor wiring and battery or ground" VALUE 0x80581548 RB_Val_Wu16 6553.500 r_q0p1_Ohm 0.00 6553.500 FORMAT "%8.3" /end CHARACTERISTIC
/begin CHARACTERISTIC UEGO_rWireApeDiagWireOlHi_T "Threshold for Ape wire resistance diagnosis" CURVE 0x80581582 RB_Curve_U16_U16 6553.500 r_q0p1_Ohm 0.00 6553.500 FORMAT "%8.3"
 /begin AXIS_DESCR STD_AXIS NO_INPUT_QUANTITY r_q0p1_Ohm 4 0.00 6553.500 FORMAT "%8.3" DEPOSIT ABSOLUTE /end AXIS_DESCR
/end CHARACTERISTIC
/begin CHARACTERISTIC UEGO_stDiagSigOperPlausReactnEna_C "Bitwise activation of subsitute reaction of Ip plausibility error paths" VALUE 0x80581552 RB_Val_Wu8 255.0 OneToOne 0.00 255.0 FORMAT "%5.1" /end CHARACTERISTIC
/begin CHARACTERISTIC UEGO_stDiagSigOperPlausRelsDly_C "Code word for conditions for release of operation plausibility diagnosis with delay" VALUE 0x80581553 RB_Val_Wu8 255.0 dez 0.00 255.0 FORMAT "%5.1" /end CHARACTERISTIC
/begin CHARACTERISTIC UEGO_stDiagSigOperPlausRelsNoDly_C "Code word for conditions for release of operation plausibility diagnosis without delay resp. for inhibition of operation plausibility diagnosis" VALUE 0x80581554 RB_Val_Wu8 255.0 dez 0.00 255.0 FORMAT "%5.1" /end CHARACTERISTIC
/begin CHARACTERISTIC UEGO_stDiagSigSnsrReactnEna_C "Bit-by-bit activation of the fault reaction of the critical sensor fault path" VALUE 0x8058156A RB_Val_Wu8 255.0 OneToOne 0.00 255.0 FORMAT "%5.1" /end CHARACTERISTIC
/begin CHARACTERISTIC UEGO_stDiagSigSnsrRprtEna_C "Bit-by-bit activation of the fault report of the sensor fault path" VALUE 0x8058156B RB_Val_Wu8 255.0 OneToOne 0.00 255.0 FORMAT "%5.1" /end CHARACTERISTIC
/begin CHARACTERISTIC UEGO_stDiagSigWireOlApesRprtEna_C "" VALUE 0x80581594 RB_Val_Wu16 65535.00 OneToOne 0.00 65535.00 FORMAT "%8.2" /end CHARACTERISTIC
/begin CHARACTERISTIC UEGO_stDiagSigWireOlElectCircReactnEna_C "Calibration for enabling wire electrode circuit continuity diagnosis reaction" VALUE 0x80581596 RB_Val_Wu16 65535.00 OneToOne 0.00 65535.00 FORMAT "%8.2" /end CHARACTERISTIC
/begin CHARACTERISTIC UEGO_stDiagSigWireOlIpeRprtEna_C "Bit-by-bit activation of the fault report at IPE-pin of the circuit continuity fault path" VALUE 0x80581598 RB_Val_Wu16 65535.00 OneToOne 0.00 65535.00 FORMAT "%8.2" /end CHARACTERISTIC
/begin CHARACTERISTIC UEGO_stDiagSigWireOlReRprtEna_C "" VALUE 0x8058159A RB_Val_Wu16 65535.00 OneToOne 0.00 65535.00 FORMAT "%8.2" /end CHARACTERISTIC
/begin CHARACTERISTIC UEGO_stDiagSigWireRCmpCircReactnEna_C "" VALUE 0x8058159C RB_Val_Wu16 65535.00 OneToOne 0.00 65535.00 FORMAT "%8.2" /end CHARACTERISTIC
/begin CHARACTERISTIC UEGO_stDiagSigWireRCmpRprtEna_C "" VALUE 0x8058159E RB_Val_Wu16 65535.00 dez 0.00 65535.00 FORMAT "%8.2" /end CHARACTERISTIC
/begin CHARACTERISTIC UEGO_stDiagSigWireScbReactnEna_C "Bitwise acitvation of failure trigger paths of short circuit to battery diagnosis" VALUE 0x805815BA RB_Val_Wu16 65535.00 OneToOne 0.00 65535.00 FORMAT "%8.2" /end CHARACTERISTIC
/begin CHARACTERISTIC UEGO_stDiagSigWireScbRprtEna_C "Bitwise acitvation of failure detection paths of short circuit to battery diagnosis" VALUE 0x805815BC RB_Val_Wu16 65535.00 OneToOne 0.00 65535.00 FORMAT "%8.2" /end CHARACTERISTIC
/begin CHARACTERISTIC UEGO_stDiagSigWireScgReactnEna_C "Bitwise acitvation of failure trigger paths of short circuit to ground diagnosis" VALUE 0x805815BE RB_Val_Wu16 65535.00 OneToOne 0.00 65535.00 FORMAT "%8.2" /end CHARACTERISTIC
/begin CHARACTERISTIC UEGO_stDiagSigWireScgRprtEna_C "Bitwise acitvation of failure detection paths of short circuit to ground diagnosis" VALUE 0x805815C0 RB_Val_Wu16 65535.00 OneToOne 0.00 65535.00 FORMAT "%8.2" /end CHARACTERISTIC
/begin CHARACTERISTIC UEGO_stDiagSigWireSc_C "Code word for function feature" VALUE 0x805815C2 RB_Val_Wu16 65535.00 OneToOne 0.00 65535.00 FORMAT "%8.2" /end CHARACTERISTIC
/begin CHARACTERISTIC UEGO_stHeatrPwrStgCtrl_C "Code word for heater power stage control" VALUE 0x805816B6 RB_Val_Wu8 255.0 dez 0.00 255.0 FORMAT "%5.1" /end CHARACTERISTIC
/begin CHARACTERISTIC UEGO_stHeatrRlyDeactvn_C "Deactivation control of relay for heater of lambda sensor" VALUE 0x805816BC RB_Val_Wu16 65535.00 OneToOne 0.00 65535.00 FORMAT "%8.2" /end CHARACTERISTIC
/begin CHARACTERISTIC UEGO_stHeatrRlyPsDiagDeactvn_C "Deaktivation of diagnosis of power stage of relay of heater from lambda sensor depending on system contdition" VALUE 0x805816C4 RB_Val_Wu16 65535.00 OneToOne 0.00 65535.00 FORMAT "%8.2" /end CHARACTERISTIC
/begin CHARACTERISTIC UEGO_stIPin_C "Codeword for function UEGO_IPin" VALUE 0x805816D0 RB_Val_Wu16 65535.00 dez 0.00 65535.00 FORMAT "%8.2" /end CHARACTERISTIC
/begin CHARACTERISTIC UEGO_swtClcTranStgy_C "selection switch for closed loop control heating mode transition strategy" VALUE 0x8058164E RB_Val_Wboolean 1.00000000000 B_TRUE 0.00 1.00000000000 FORMAT "%13.11" /end CHARACTERISTIC
/begin CHARACTERISTIC UEGO_swtEngStrtNotRunng_C "Switch to remove Engine starting (CRANKING) from engine running state." VALUE 0x8058163C RB_Val_Wboolean 1.00000000000 B_TRUE 0.00 1.00000000000 FORMAT "%13.11" /end CHARACTERISTIC
/begin CHARACTERISTIC UEGO_swtHeatrRlyOffT15Off_C "Switch off relay for heater lambda sensor at T15 off" VALUE 0x805816BE RB_Val_Wu8 1.00000000000 B_TRUE 0.00 1.00000000000 FORMAT "%13.11" /end CHARACTERISTIC
/begin CHARACTERISTIC UEGO_swtHeatrRlyPsTestPlsMod_C "Switch to select the test puls mode" VALUE 0x805816C6 RB_Val_Wu8 255.0 OneToOne 0.00 255.0 FORMAT "%5.1" /end CHARACTERISTIC
/begin CHARACTERISTIC UEGO_swtIsoHi_C "Option to select either shunt voltage and resistance or shunt current for monitoring a shunt at any sensor line to battery." VALUE 0x805815C4 RB_Val_Wu8 127.0 OneToOne 0.00 127.0 FORMAT "%5.1" EXTENDED_LIMITS 0.00 255.0 /end CHARACTERISTIC
/begin CHARACTERISTIC UEGO_swtIsoLo_C "Option to select either shunt voltage and resistance or shunt current for monitoring a shunt at any sensor line to ground." VALUE 0x805815C5 RB_Val_Wu8 127.0 OneToOne 0.00 127.0 FORMAT "%5.1" EXTENDED_LIMITS 0.00 255.0 /end CHARACTERISTIC
/begin CHARACTERISTIC UEGO_swtOverHeatgProtn_C "switch to enable or disable overheating protection" VALUE 0x8058164F RB_Val_Wboolean 1.00000000000 B_TRUE 0.00 1.00000000000 FORMAT "%13.11" /end CHARACTERISTIC
/begin CHARACTERISTIC UEGO_tCeramicHeatrClcEna_C "Temperature of the heater for enabling closed loop heater control" VALUE 0x80581650 RB_Val_Wu16 1535.977 temp_q0p0234_o273 -273.150 1262.827 FORMAT "%8.3" /end CHARACTERISTIC
/begin CHARACTERISTIC UEGO_tCeramicHeatrCrvMax_C "temperature of the heater to close the curve phase" VALUE 0x80581652 RB_Val_Wu16 1535.977 temp_q0p0234_o273 -273.150 1262.827 FORMAT "%8.3" /end CHARACTERISTIC
/begin CHARACTERISTIC UEGO_tCeramicHeatrSp_C "Temperature setpoint for lambda sensor ceramic" VALUE 0x80581668 RB_Val_Wu16 1535.977 temp_q0p0234_o273 -273.150 1262.827 FORMAT "%8.3" /end CHARACTERISTIC
/begin CHARACTERISTIC UEGO_tCerRatIPmpExctScLoSwt_C "" VALUE 0x805815C6 RB_Val_Wu16 1535.977 temp_q0p0234_o273 -273.150 1262.827 FORMAT "%8.3" /end CHARACTERISTIC
/begin CHARACTERISTIC UEGO_tDiagSigSnsr_C "Release temperature of the UEGO sensor diagnosis" VALUE 0x8058156C RB_Val_Wu16 1535.977 temp_q0p0234_o273 -273.150 1262.827 FORMAT "%8.3" /end CHARACTERISTIC
/begin CHARACTERISTIC UEGO_tiBtwElecFltHeatrRly_C "Time between two test pulses during validated permanent electric fault" VALUE 0x805816C8 RB_Val_Ws16 655350.0 Time_ms -327680.0 327670.0 FORMAT "%8.1" /end CHARACTERISTIC
/begin CHARACTERISTIC UEGO_tiBtwOTFltHeatrRly_C "Time between two test pulses during a permanent over temperature fault" VALUE 0x805816CA RB_Val_Ws16 655.3500 Time_s -327.6800 327.6700 FORMAT "%8.4" /end CHARACTERISTIC
/begin CHARACTERISTIC UEGO_tiDiagSigStrtDi_C "Period duration of diagnosis pulses for performing short circuit diagnosis" VALUE 0x805815C8 RB_Val_Wu8 2.550 t_q0p01 0.00 2.550 FORMAT "%5.3" /end CHARACTERISTIC
/begin CHARACTERISTIC UEGO_tiDlyDiagSigOperPlausOvrRunOff_C "delay time for no overrun present" VALUE 0x80581556 RB_Val_Wu16 655.3500 t_q0p01 0.00 655.3500 FORMAT "%8.4" /end CHARACTERISTIC
/begin CHARACTERISTIC UEGO_tiDlyDiagSigOperPlausOvrRunOn_C "delay time for active overrun" VALUE 0x80581558 RB_Val_Wu16 655.3500 t_q0p01 0.00 655.3500 FORMAT "%8.4" /end CHARACTERISTIC
/begin CHARACTERISTIC UEGO_tiDlyDiagSigOperPlausRels_C "Delay for release of operation plausibility diagnosis" VALUE 0x8058155A RB_Val_Wu16 655.3500 t_q0p01 0.00 655.3500 FORMAT "%8.4" /end CHARACTERISTIC
/begin CHARACTERISTIC UEGO_tiDlyHeatrOlcFinshd_C "Delay time after finish of the heater ramp until release of the closed loop control, delay time until heating up is respected as sufficient" VALUE 0x80581654 RB_Val_Wu16 1310.700 t_q0p02 0.00 1310.700 FORMAT "%8.3" /end CHARACTERISTIC
/begin CHARACTERISTIC UEGO_tiDlyHeatrPwrStgOff_C "Delay time for protected heating if power stage control is off" VALUE 0x80581656 RB_Val_Wu8 5.100 t_q0p02 0.00 5.100 FORMAT "%5.3" /end CHARACTERISTIC
/begin CHARACTERISTIC UEGO_tiDlyHeatrRlyOn_C "Timedelay to switch on the relay for heater of lambda sensor" VALUE 0x805816BF RB_Val_Wu8 2.550 t_q0p01 0.00 2.550 FORMAT "%5.3" /end CHARACTERISTIC
/begin CHARACTERISTIC UEGO_tiDlyRipHi_C "" VALUE 0x8058156E RB_Val_Wu8 2.550 t_q0p01 0.00 2.550 FORMAT "%5.3" /end CHARACTERISTIC
/begin CHARACTERISTIC UEGO_tiHeatrCrvMax_C "maximum duration for curve phase of open-loop heater control" VALUE 0x80581658 RB_Val_Wu16 1310.700 t_q0p02 0.00 1310.700 FORMAT "%8.3" /end CHARACTERISTIC
/begin CHARACTERISTIC UEGO_tiHeatrHld_C "maximum duration for hold phase of open-loop heater control" VALUE 0x8058165A RB_Val_Wu16 1310.700 t_q0p02 0.00 1310.700 FORMAT "%8.3" /end CHARACTERISTIC
/begin CHARACTERISTIC UEGO_tiRPmpDiagSwtDly_C "" VALUE 0x805815A0 RB_Val_Wu16 655.3500 t_q0p01 0.00 655.3500 FORMAT "%8.4" /end CHARACTERISTIC
/begin CHARACTERISTIC UEGO_tRPmpDiagSwt_C "" VALUE 0x805815A2 RB_Val_Wu16 1535.977 temp_q0p0234_o273 -273.150 1262.827 FORMAT "%8.3" /end CHARACTERISTIC
/begin CHARACTERISTIC UEGO_uBattUHiOperPlaus_C "Higher supply voltage level to disable the diagnosis release." VALUE 0x8058155C RB_Val_Ws16 1310700. Volt_Batt -655360.0 655340.0 FORMAT "%8.1" /end CHARACTERISTIC
/begin CHARACTERISTIC UEGO_uBattULoOperPlaus_C "Lower supply voltage level to disable the diagnosis release." VALUE 0x8058155E RB_Val_Ws16 1310700. Volt_Batt -655360.0 655340.0 FORMAT "%8.1" /end CHARACTERISTIC
/begin CHARACTERISTIC UEGO_uHeatrClcMax_C "maximum allowed effective heater voltage for closed loop control of sensor heater" VALUE 0x8058166A RB_Val_Wu16 327.6750 spg_q0p005 0.00 327.6750 FORMAT "%8.4" /end CHARACTERISTIC
/begin CHARACTERISTIC UEGO_uHeatrEfcDft_C "Default voltage when no other condition for heater controller mode applies" VALUE 0x8058165C RB_Val_Wu16 327.6750 spg_q0p005 0.00 327.6750 FORMAT "%8.4" /end CHARACTERISTIC
/begin CHARACTERISTIC UEGO_uHeatrEfcMin_C "Effective heater voltage output during protection mode" VALUE 0x8058165E RB_Val_Wu16 327.6750 spg_q0p005 0.00 327.6750 FORMAT "%8.4" /end CHARACTERISTIC
/begin CHARACTERISTIC UEGO_uHeatrEfcReduced_C "Reduced effective heater voltage (Temperature not measurable)" VALUE 0x80581660 RB_Val_Wu16 327.6750 spg_q0p005 0.00 327.6750 FORMAT "%8.4" /end CHARACTERISTIC
/begin CHARACTERISTIC UEGO_uHeatrPidSp_C "Voltage setpoint of PID controller" VALUE 0x80581662 RB_Val_Wu16 327.6750 spg_q0p005 0.00 327.6750 FORMAT "%8.4" /end CHARACTERISTIC
/begin CHARACTERISTIC UEGO_uHeatrPwrSplyMax_C "Maximum allowed heater voltage (sensor dpendent)" VALUE 0x805816B8 RB_Val_Wu16 327.6750 spg_q0p005 0.00 327.6750 FORMAT "%8.4" /end CHARACTERISTIC
/begin CHARACTERISTIC UEGO_uHeatrPwrStgExtPwrSply_C "Voltage level of an external power supply for calibration purpose" VALUE 0x805816BA RB_Val_Wu16 327.6750 spg_q0p005 0.00 327.6750 FORMAT "%8.4" /end CHARACTERISTIC
/begin CHARACTERISTIC UEGO_uHeatrRampMax_C "maximum effective heater voltage leading to termination of ramp phase of open loop heater control" VALUE 0x80581664 RB_Val_Wu16 327.6750 spg_q0p005 0.00 327.6750 FORMAT "%8.4" /end CHARACTERISTIC
/begin CHARACTERISTIC UEGO_uHeatrRlyPsTestPlsRels_C "Threshold for Battery Voltage for Release of Test Puls for Diagnosis of Heater Relay Powerstage" VALUE 0x805816CC RB_Val_Ws16 1310700. Volt_Batt -655360.0 655340.0 FORMAT "%8.1" /end CHARACTERISTIC
/begin CHARACTERISTIC UEGO_uNernstDiagScHi_C "higher threshold value of nernst voltage during short circuit diagnosis" VALUE 0x805815CA RB_Val_Ws16 20.97120 spg_q3p2Em4_V -10.48576 10.48544 FORMAT "%8.5" /end CHARACTERISTIC
/begin CHARACTERISTIC UEGO_uNernstDiagScLo_C "lower threshold value of nernst voltage during short circuit diagnosis" VALUE 0x805815CC RB_Val_Ws16 20.97120 spg_q3p2Em4_V -10.48576 10.48544 FORMAT "%8.5" /end CHARACTERISTIC
/begin CHARACTERISTIC UEGO_uNernstDiagWireOlHi_C "" VALUE 0x805815A4 RB_Val_Ws16 20.97120 spg_q3p2Em4_V -10.48576 10.48544 FORMAT "%8.5" /end CHARACTERISTIC
/begin CHARACTERISTIC UEGO_uOverHeatgProtn_C "effective heater voltage in PROTECTION_OVERHEATG heater mode" VALUE 0x80581666 RB_Val_Wu16 327.6750 spg_q0p005 0.00 327.6750 FORMAT "%8.4" /end CHARACTERISTIC
/begin CHARACTERISTIC UEGO_urIsoHi_M "Minimum tolerable shunt resistance to any sensor line dependent on the shunt voltage applied in case of shunt to voltage higher of equal 5V." MAP 0x805815CE RB_Map_S16U16_U8 255.0 dez 0.00 255.0 FORMAT "%5.1"
 /begin AXIS_DESCR STD_AXIS NO_INPUT_QUANTITY spg_q3p2Em4_V 5 -10.48576 10.48544 FORMAT "%8.5" DEPOSIT ABSOLUTE /end AXIS_DESCR
 /begin AXIS_DESCR STD_AXIS NO_INPUT_QUANTITY r_q0p1_Ohm 5 0.100 6553.500 FORMAT "%8.3" EXTENDED_LIMITS 0.00 6553.500 DEPOSIT ABSOLUTE /end AXIS_DESCR
/end CHARACTERISTIC
/begin CHARACTERISTIC UEGO_urIsoLo_M "Minimum tolerable shunt resistance to any sensor line dependent on the shunt voltage applied in case of shunt to ground (voltage lower or equal 1V) )" MAP 0x80581600 RB_Map_S16U16_U8 255.0 dez 0.00 255.0 FORMAT "%5.1"
 /begin AXIS_DESCR STD_AXIS NO_INPUT_QUANTITY spg_q3p2Em4_V 5 -10.48576 10.48544 FORMAT "%8.5" DEPOSIT ABSOLUTE /end AXIS_DESCR
 /begin AXIS_DESCR STD_AXIS NO_INPUT_QUANTITY r_q0p1_Ohm 5 0.100 6553.500 FORMAT "%8.3" EXTENDED_LIMITS 0.00 6553.500 DEPOSIT ABSOLUTE /end AXIS_DESCR
/end CHARACTERISTIC
/begin CHARACTERISTIC UEGO_uScSwtOnHi_C "higher threshold value of short circuit voltage during switchon mode" VALUE 0x80581634 RB_Val_Ws32 65.5340800000 spg_q3p2Em4_V -32.7670400000 32.7670400000 FORMAT "%13.10" EXTENDED_LIMITS -687194.767360 687194.767040 /end CHARACTERISTIC
/begin CHARACTERISTIC UEGO_uScSwtOnLo_C "lower threshold value of short circuit voltage during switchon mode" VALUE 0x80581638 RB_Val_Ws16 20.97120 spg_q3p2Em4_V -10.48576 10.48544 FORMAT "%8.5" /end CHARACTERISTIC
/begin CHARACTERISTIC UEGO_uUamDiagHi_C "Max. allowed Uam signal (voltage between Ape and Mes)" VALUE 0x8058163A RB_Val_Ws16 20.97120 spg_q3p2Em4_V -10.48576 10.48544 FORMAT "%8.5" /end CHARACTERISTIC
/begin CHARACTERISTIC UEGO_uUgxxDeltaMaxIni_C "Initial allowed deviation for Ugxx peak filter" VALUE 0x8058154E RB_Val_Wu16 10.48544 spg_q3p2Em4_V 0.00 10.48544 FORMAT "%8.5" EXTENDED_LIMITS 0.00 20.97120 /end CHARACTERISTIC
/begin MEASUREMENT UEGO_cntrDiagSigGetReIniProc10msec "counter for postdrive leave" UBYTE OneToOne 1 100 0.00 255.0 FORMAT "%5.1" ECU_ADDRESS 0x6000AD5F /end MEASUREMENT
/begin MEASUREMENT UEGO_cntrDiagSigOperPlausReiniProc10msec "Counter for Post-Drive exits" UBYTE OneToOne 1 100 0.00 255.0 FORMAT "%5.1" ECU_ADDRESS 0x6000AD5E /end MEASUREMENT
/begin MEASUREMENT UEGO_cntrDiagSigRamBnkSpiS1B1 "counter for rambank transfer spi error s1b1" SWORD OneToOne 1 100 -255.0000 255.0000 FORMAT "%8.4" ECU_ADDRESS 0x60008EE6 /end MEASUREMENT
/begin MEASUREMENT UEGO_cntrDiagSigRegBnkSpiS1B1 "counter for registerbank transfer spi error s1b1" SWORD OneToOne 1 100 -255.0000 255.0000 FORMAT "%8.4" ECU_ADDRESS 0x60008EE4 /end MEASUREMENT
/begin MEASUREMENT UEGO_cntrDiagSigRegDiagSpiS1B1 "counter for Diagnosysregister transfer spi error s1b1" SWORD OneToOne 1 100 -255.0000 255.0000 FORMAT "%8.4" ECU_ADDRESS 0x60008EE2 /end MEASUREMENT
/begin MEASUREMENT UEGO_cntrDiagSigSnsrReiniProc10msec "Counter of Post-Drive exits for sensor diagnosis" UBYTE OneToOne 1 100 0.00 255.0 FORMAT "%5.1" ECU_ADDRESS 0x6000AD5D /end MEASUREMENT
/begin MEASUREMENT UEGO_cntrDiagSigWireOlReIniProc10ms "Counter of Post-Drive exits for open load wire diagnosis" UBYTE OneToOne 1 100 0.00 255.0 FORMAT "%5.1" ECU_ADDRESS 0x6000AD5C /end MEASUREMENT
/begin MEASUREMENT UEGO_cntrDiagSigWireScReiniProc10msec "short circuit wire diagnosis Proc 10ms Reni counter" UBYTE OneToOne 1 100 0.00 255.0 FORMAT "%5.1" ECU_ADDRESS 0x6000AD5B /end MEASUREMENT
/begin MEASUREMENT UEGO_cntrHeatrRlyPsCtrlReiniProc10msec "ECU post drive leave counter" UBYTE OneToOne 1 100 0.00 255.0 FORMAT "%5.1" ECU_ADDRESS 0x6000AD58 /end MEASUREMENT
/begin MEASUREMENT UEGO_cntrHeatrRlyPsDiagReiniProc100msec "post drive leave counter for heater relay power stage diagnosis" UBYTE OneToOne 1 100 0.00 255.0 FORMAT "%5.1" ECU_ADDRESS 0x6000AD56 /end MEASUREMENT
/begin MEASUREMENT UEGO_DiagSigEvlnS1B1_I.flgDeltaUg0aHiIsqVld "Class for Evaluation of voltages at the sensor lines for sensor 1 Bank 1 / Validity of Delta Ug0a measurement when HiIsq is applied in Swton submode" UBYTE B_TRUE 1 100 0.00 1.00000000000 BIT_MASK 0x1 FORMAT "%13.11" ECU_ADDRESS 0x60002304 /end MEASUREMENT
/begin MEASUREMENT UEGO_DiagSigEvlnS1B1_I.flgDeltaUg0aLoIsqVld "Class for Evaluation of voltages at the sensor lines for sensor 1 Bank 1 / Validity of Delta Ug0a measurement when LoIsq is applied in Swton submode" UBYTE B_TRUE 1 100 0.00 1.00000000000 BIT_MASK 0x1 FORMAT "%13.11" ECU_ADDRESS 0x60002305 /end MEASUREMENT
/begin MEASUREMENT UEGO_DiagSigEvlnS1B1_I.flgDeltaUg0aVld "Class for Evaluation of voltages at the sensor lines for sensor 1 Bank 1 / Validity of Delta Ug0a measurement" UBYTE B_TRUE 1 100 0.00 1.00000000000 BIT_MASK 0x1 FORMAT "%13.11" ECU_ADDRESS 0x60002306 /end MEASUREMENT
/begin MEASUREMENT UEGO_DiagSigEvlnS1B1_I.flgDeltaUg0eHiIsqVld "Class for Evaluation of voltages at the sensor lines for sensor 1 Bank 1 / Validity of Delta Ug0e surement when HiIsq is applied in Swton submode" UBYTE B_TRUE 1 100 0.00 1.00000000000 BIT_MASK 0x1 FORMAT "%13.11" ECU_ADDRESS 0x60002307 /end MEASUREMENT
/begin MEASUREMENT UEGO_DiagSigEvlnS1B1_I.flgDeltaUg0eLoIsqVld "Class for Evaluation of voltages at the sensor lines for sensor 1 Bank 1 / Validity of Delta Ug0e measurement when LoIsq is applied in Swton submode" UBYTE B_TRUE 1 100 0.00 1.00000000000 BIT_MASK 0x1 FORMAT "%13.11" ECU_ADDRESS 0x60002308 /end MEASUREMENT
/begin MEASUREMENT UEGO_DiagSigEvlnS1B1_I.flgDeltaUg0eVld "Class for Evaluation of voltages at the sensor lines for sensor 1 Bank 1 / Validity of Delta Ug0e measurement" UBYTE B_TRUE 1 100 0.00 1.00000000000 BIT_MASK 0x1 FORMAT "%13.11" ECU_ADDRESS 0x60002309 /end MEASUREMENT
/begin MEASUREMENT UEGO_DiagSigEvlnS1B1_I.flgDeltaUg0iHiIsqVld "Class for Evaluation of voltages at the sensor lines for sensor 1 Bank 1 / Validity of Delta Ug0i measurement when HiIsq is applied in Swton submode" UBYTE B_TRUE 1 100 0.00 1.00000000000 BIT_MASK 0x1 FORMAT "%13.11" ECU_ADDRESS 0x6000230A /end MEASUREMENT
/begin MEASUREMENT UEGO_DiagSigEvlnS1B1_I.flgDeltaUg0iLoIsqVld "Class for Evaluation of voltages at the sensor lines for sensor 1 Bank 1 / Validity of Delta Ug0i measurement when LoIsq is applied in Swton submode" UBYTE B_TRUE 1 100 0.00 1.00000000000 BIT_MASK 0x1 FORMAT "%13.11" ECU_ADDRESS 0x6000230B /end MEASUREMENT
/begin MEASUREMENT UEGO_DiagSigEvlnS1B1_I.flgDeltaUg0iVld "Class for Evaluation of voltages at the sensor lines for sensor 1 Bank 1 / Validity of Delta Ug0i measurement" UBYTE B_TRUE 1 100 0.00 1.00000000000 BIT_MASK 0x1 FORMAT "%13.11" ECU_ADDRESS 0x6000230C /end MEASUREMENT
/begin MEASUREMENT UEGO_DiagSigEvlnS1B1_I.flgHiIsqCalcnCmpl "Class for Evaluation of voltages at the sensor lines for sensor 1 Bank 1 / Status of HiIsq current is applied to the senor and finsihed its first calculation" UBYTE B_TRUE 1 100 0.00 1.00000000000 BIT_MASK 0x1 FORMAT "%13.11" ECU_ADDRESS 0x6000230D /end MEASUREMENT
/begin MEASUREMENT UEGO_DiagSigEvlnS1B1_I.flgIIsoApeVld "Class for Evaluation of voltages at the sensor lines for sensor 1 Bank 1 / Status of shunt current at APE when both Hi and Lo Isq signals are valid" UBYTE B_TRUE 1 100 0.00 1.00000000000 BIT_MASK 0x1 FORMAT "%13.11" ECU_ADDRESS 0x6000230E /end MEASUREMENT
/begin MEASUREMENT UEGO_DiagSigEvlnS1B1_I.flgIIsoIpeVld "Class for Evaluation of voltages at the sensor lines for sensor 1 Bank 1 / Status of shunt current at IPE when both Hi and Lo Isq signals are valid" UBYTE B_TRUE 1 100 0.00 1.00000000000 BIT_MASK 0x1 FORMAT "%13.11" ECU_ADDRESS 0x6000230F /end MEASUREMENT
/begin MEASUREMENT UEGO_DiagSigEvlnS1B1_I.flgIIsoReVld "Class for Evaluation of voltages at the sensor lines for sensor 1 Bank 1 / Status of shunt current at RE when both Hi and Lo Isq signals are valid" UBYTE B_TRUE 1 100 0.00 1.00000000000 BIT_MASK 0x1 FORMAT "%13.11" ECU_ADDRESS 0x60002310 /end MEASUREMENT
/begin MEASUREMENT UEGO_DiagSigEvlnS1B1_I.flgIsoApeVld "Class for Evaluation of voltages at the sensor lines for sensor 1 Bank 1 / Status of Shunt Resistance, Voltages, and current are calculated at sensor line APE" UBYTE B_TRUE 1 100 0.00 1.00000000000 BIT_MASK 0x1 FORMAT "%13.11" ECU_ADDRESS 0x60002311 /end MEASUREMENT
/begin MEASUREMENT UEGO_DiagSigEvlnS1B1_I.flgIsoIpeVld "Class for Evaluation of voltages at the sensor lines for sensor 1 Bank 1 / Status of Shunt Resistance, Voltages, and current are calculated at sensor line IPE" UBYTE B_TRUE 1 100 0.00 1.00000000000 BIT_MASK 0x1 FORMAT "%13.11" ECU_ADDRESS 0x60002312 /end MEASUREMENT
/begin MEASUREMENT UEGO_DiagSigEvlnS1B1_I.flgIsoReVld "Class for Evaluation of voltages at the sensor lines for sensor 1 Bank 1 / Status of Shunt Resistance, Voltages, and current are calculated at sensor line RE" UBYTE B_TRUE 1 100 0.00 1.00000000000 BIT_MASK 0x1 FORMAT "%13.11" ECU_ADDRESS 0x60002313 /end MEASUREMENT
/begin MEASUREMENT UEGO_DiagSigEvlnS1B1_I.flgRatIFltApeScVld "Class for Evaluation of voltages at the sensor lines for sensor 1 Bank 1 / Status of ratio Failure current at sensor line APE" UBYTE B_TRUE 1 100 0.00 1.00000000000 BIT_MASK 0x1 FORMAT "%13.11" ECU_ADDRESS 0x60002314 /end MEASUREMENT
/begin MEASUREMENT UEGO_DiagSigEvlnS1B1_I.flgRatIFltScIpeVld "Class for Evaluation of voltages at the sensor lines for sensor 1 Bank 1 / Status of ratio Failure current at sensor line IPE" UBYTE B_TRUE 1 100 0.00 1.00000000000 BIT_MASK 0x1 FORMAT "%13.11" ECU_ADDRESS 0x60002315 /end MEASUREMENT
/begin MEASUREMENT UEGO_DiagSigEvlnS1B1_I.flgRatIFltScReVld "Class for Evaluation of voltages at the sensor lines for sensor 1 Bank 1 / Status of ratio Failure current at sensor line RE" UBYTE B_TRUE 1 100 0.00 1.00000000000 BIT_MASK 0x1 FORMAT "%13.11" ECU_ADDRESS 0x60002316 /end MEASUREMENT
/begin MEASUREMENT UEGO_DiagSigEvlnS1B1_I.flgRisoApeVld "Class for Evaluation of voltages at the sensor lines for sensor 1 Bank 1 / Status of Shunt Resistance is calculated at sensor line APE" UBYTE B_TRUE 1 100 0.00 1.00000000000 BIT_MASK 0x1 FORMAT "%13.11" ECU_ADDRESS 0x60002317 /end MEASUREMENT
/begin MEASUREMENT UEGO_DiagSigEvlnS1B1_I.flgRisoIpeVld "Class for Evaluation of voltages at the sensor lines for sensor 1 Bank 1 / Status of Shunt Resistance is calculated at sensor line IPE" UBYTE B_TRUE 1 100 0.00 1.00000000000 BIT_MASK 0x1 FORMAT "%13.11" ECU_ADDRESS 0x60002318 /end MEASUREMENT
/begin MEASUREMENT UEGO_DiagSigEvlnS1B1_I.flgRisoReVld "Class for Evaluation of voltages at the sensor lines for sensor 1 Bank 1 / Status of Shunt Resistance is calculated at sensor line RE" UBYTE B_TRUE 1 100 0.00 1.00000000000 BIT_MASK 0x1 FORMAT "%13.11" ECU_ADDRESS 0x60002319 /end MEASUREMENT
/begin MEASUREMENT UEGO_DiagSigEvlnS1B1_I.flgRstReqModChng "Class for Evaluation of voltages at the sensor lines for sensor 1 Bank 1 / Status for requesting reset data when there is a mode change request" UBYTE B_TRUE 1 100 0.00 1.00000000000 BIT_MASK 0x1 FORMAT "%13.11" ECU_ADDRESS 0x6000231A /end MEASUREMENT
/begin MEASUREMENT UEGO_DiagSigEvlnS1B1_I.flgUScApeVld "Class for Evaluation of voltages at the sensor lines for sensor 1 Bank 1 / Validity flag for voltage at Ape" UBYTE B_TRUE 1 100 0.00 1.00000000000 BIT_MASK 0x1 FORMAT "%13.11" ECU_ADDRESS 0x6000231B /end MEASUREMENT
/begin MEASUREMENT UEGO_DiagSigEvlnS1B1_I.flgUScIpeVld "Class for Evaluation of voltages at the sensor lines for sensor 1 Bank 1 / Validity flag for voltage at Ipe" UBYTE B_TRUE 1 100 0.00 1.00000000000 BIT_MASK 0x1 FORMAT "%13.11" ECU_ADDRESS 0x6000231C /end MEASUREMENT
/begin MEASUREMENT UEGO_DiagSigEvlnS1B1_I.flgUScReVld "Class for Evaluation of voltages at the sensor lines for sensor 1 Bank 1 / Validity flag for voltage at Re" UBYTE B_TRUE 1 100 0.00 1.00000000000 BIT_MASK 0x1 FORMAT "%13.11" ECU_ADDRESS 0x6000231D /end MEASUREMENT
/begin MEASUREMENT UEGO_DiagSigEvlnS1B1_I.flgUg0HiIsqVld "Class for Evaluation of voltages at the sensor lines for sensor 1 Bank 1 / Validity of Ug0 when Hi Isq is apllied" UBYTE B_TRUE 1 100 0.00 1.00000000000 BIT_MASK 0x1 FORMAT "%13.11" ECU_ADDRESS 0x6000231E /end MEASUREMENT
/begin MEASUREMENT UEGO_DiagSigEvlnS1B1_I.flgUg0LoIsqVld "Class for Evaluation of voltages at the sensor lines for sensor 1 Bank 1 / Validity of Ug0 when Lo Isq is apllied" UBYTE B_TRUE 1 100 0.00 1.00000000000 BIT_MASK 0x1 FORMAT "%13.11" ECU_ADDRESS 0x6000231F /end MEASUREMENT
/begin MEASUREMENT UEGO_DiagSigEvlnS1B1_I.flgUg0PckPeakVld "Class for Evaluation of voltages at the sensor lines for sensor 1 Bank 1 / Validity of Ug0 with filtered peak value" UBYTE B_TRUE 1 100 0.00 1.00000000000 BIT_MASK 0x1 FORMAT "%13.11" ECU_ADDRESS 0x60002320 /end MEASUREMENT
/begin MEASUREMENT UEGO_DiagSigEvlnS1B1_I.flgUg0PckVld "Class for Evaluation of voltages at the sensor lines for sensor 1 Bank 1 / Validity of Voltage Ug0Pck" UBYTE B_TRUE 1 100 0.00 1.00000000000 BIT_MASK 0x1 FORMAT "%13.11" ECU_ADDRESS 0x60002321 /end MEASUREMENT
/begin MEASUREMENT UEGO_DiagSigEvlnS1B1_I.flgUisoApeVld "Class for Evaluation of voltages at the sensor lines for sensor 1 Bank 1 / Validity flag for shunt voltage at Ape" UBYTE B_TRUE 1 100 0.00 1.00000000000 BIT_MASK 0x1 FORMAT "%13.11" ECU_ADDRESS 0x60002322 /end MEASUREMENT
/begin MEASUREMENT UEGO_DiagSigEvlnS1B1_I.flgUisoIpeVld "Class for Evaluation of voltages at the sensor lines for sensor 1 Bank 1 / Validity flag for shunt voltage at Ipe" UBYTE B_TRUE 1 100 0.00 1.00000000000 BIT_MASK 0x1 FORMAT "%13.11" ECU_ADDRESS 0x60002323 /end MEASUREMENT
/begin MEASUREMENT UEGO_DiagSigEvlnS1B1_I.flgUisoReVld "Class for Evaluation of voltages at the sensor lines for sensor 1 Bank 1 / Validity flag for shunt voltage at Re" UBYTE B_TRUE 1 100 0.00 1.00000000000 BIT_MASK 0x1 FORMAT "%13.11" ECU_ADDRESS 0x60002324 /end MEASUREMENT
/begin MEASUREMENT UEGO_DiagSigEvlnS1B1_I.iIsoApe "Class for Evaluation of voltages at the sensor lines for sensor 1 Bank 1 / shunt current at Ape" SWORD i_q6p6667Em7_A 1 100 -0.02184533 0.02184467 FORMAT "%10.8" ECU_ADDRESS 0x60002326 /end MEASUREMENT
/begin MEASUREMENT UEGO_DiagSigEvlnS1B1_I.iIsoIpe "Class for Evaluation of voltages at the sensor lines for sensor 1 Bank 1 / shunt current at Ipe" SWORD i_q6p6667Em7_A 1 100 -0.02184533 0.02184467 FORMAT "%10.8" ECU_ADDRESS 0x60002328 /end MEASUREMENT
/begin MEASUREMENT UEGO_DiagSigEvlnS1B1_I.iIsoRe "Class for Evaluation of voltages at the sensor lines for sensor 1 Bank 1 / shunt current at Re" SWORD i_q6p6667Em7_A 1 100 -0.02184533 0.02184467 FORMAT "%10.8" ECU_ADDRESS 0x6000232A /end MEASUREMENT
/begin MEASUREMENT UEGO_DiagSigEvlnS1B1_I.nrModMeasOld "Class for Evaluation of voltages at the sensor lines for sensor 1 Bank 1 / Status of old mode meas" UBYTE dez 1 100 0.00 255.0 FORMAT "%5.1" ECU_ADDRESS 0x6000232C /end MEASUREMENT
/begin MEASUREMENT UEGO_DiagSigEvlnS1B1_I.nrSubModMeasOld "Class for Evaluation of voltages at the sensor lines for sensor 1 Bank 1 / Status of old submode meas" UBYTE dez 1 100 0.00 255.0 FORMAT "%5.1" ECU_ADDRESS 0x6000232D /end MEASUREMENT
/begin MEASUREMENT UEGO_DiagSigEvlnS1B1_I.rIsoApe "Class for Evaluation of voltages at the sensor lines for sensor 1 Bank 1 / shunt resistance at pin Ape" ULONG r_q0p1_Ohm 1 100 0.1000000 65535.0000000 FORMAT "%13.7" ECU_ADDRESS 0x60002330 /end MEASUREMENT
/begin MEASUREMENT UEGO_DiagSigEvlnS1B1_I.rIsoIpe "Class for Evaluation of voltages at the sensor lines for sensor 1 Bank 1 / shunt resistance at pin Ipe" ULONG r_q0p1_Ohm 1 100 0.1000000 65535.0000000 FORMAT "%13.7" ECU_ADDRESS 0x60002334 /end MEASUREMENT
/begin MEASUREMENT UEGO_DiagSigEvlnS1B1_I.rIsoRe "Class for Evaluation of voltages at the sensor lines for sensor 1 Bank 1 / shunt resistance at pin Re" ULONG r_q0p1_Ohm 1 100 0.1000000 65535.0000000 FORMAT "%13.7" ECU_ADDRESS 0x60002338 /end MEASUREMENT
/begin MEASUREMENT UEGO_DiagSigEvlnS1B1_I.ratIFltApeSc "Class for Evaluation of voltages at the sensor lines for sensor 1 Bank 1 / Status of ratio Failure current at sensor line APE" SWORD fak_q1p201Em4 1 100 -3.936096 3.935976 FORMAT "%8.6" ECU_ADDRESS 0x6000233C /end MEASUREMENT
/begin MEASUREMENT UEGO_DiagSigEvlnS1B1_I.ratIFltIpeSc "Class for Evaluation of voltages at the sensor lines for sensor 1 Bank 1 / Status of ratio Failure current at sensor line IPE" SWORD fak_q1p201Em4 1 100 -3.936096 3.935976 FORMAT "%8.6" ECU_ADDRESS 0x6000233E /end MEASUREMENT
/begin MEASUREMENT UEGO_DiagSigEvlnS1B1_I.ratIFltReSc "Class for Evaluation of voltages at the sensor lines for sensor 1 Bank 1 / Status of ratio Failure current at sensor line RE" SWORD fak_q1p201Em4 1 100 -3.936096 3.935976 FORMAT "%8.6" ECU_ADDRESS 0x60002340 /end MEASUREMENT
/begin MEASUREMENT UEGO_DiagSigEvlnS1B1_I.uDeltaUg0a "Class for Evaluation of voltages at the sensor lines for sensor 1 Bank 1 / Voltage Ug0a with reference to Ug0" SWORD spg_q3p2Em4_V 1 100 -10.48576 10.48544 FORMAT "%8.5" ECU_ADDRESS 0x60002342 /end MEASUREMENT
/begin MEASUREMENT UEGO_DiagSigEvlnS1B1_I.uDeltaUg0aHiIsq "Class for Evaluation of voltages at the sensor lines for sensor 1 Bank 1 / Delta voltage at sensor line APE when High Isq is applied to the sensor" SWORD spg_q3p2Em4_V 1 100 -10.48576 10.48544 FORMAT "%8.5" ECU_ADDRESS 0x60002344 /end MEASUREMENT
/begin MEASUREMENT UEGO_DiagSigEvlnS1B1_I.uDeltaUg0aLoIsq "Class for Evaluation of voltages at the sensor lines for sensor 1 Bank 1 / Delta voltage at sensor line APE when Low Isq is applied to the sensor" SWORD spg_q3p2Em4_V 1 100 -10.48576 10.48544 FORMAT "%8.5" ECU_ADDRESS 0x60002346 /end MEASUREMENT
/begin MEASUREMENT UEGO_DiagSigEvlnS1B1_I.uDeltaUg0e "Class for Evaluation of voltages at the sensor lines for sensor 1 Bank 1 / Voltage Ug0e with reference to Ug0" SWORD spg_q3p2Em4_V 1 100 -10.48576 10.48544 FORMAT "%8.5" ECU_ADDRESS 0x60002348 /end MEASUREMENT
/begin MEASUREMENT UEGO_DiagSigEvlnS1B1_I.uDeltaUg0eHiIsq "Class for Evaluation of voltages at the sensor lines for sensor 1 Bank 1 / Delta voltage at sensor line IPE when High Isq is applied to the sensor" SWORD spg_q3p2Em4_V 1 100 -10.48576 10.48544 FORMAT "%8.5" ECU_ADDRESS 0x6000234A /end MEASUREMENT
/begin MEASUREMENT UEGO_DiagSigEvlnS1B1_I.uDeltaUg0eLoIsq "Class for Evaluation of voltages at the sensor lines for sensor 1 Bank 1 / Delta voltage at sensor line IPE when Low Isq is applied to the sensor" SWORD spg_q3p2Em4_V 1 100 -10.48576 10.48544 FORMAT "%8.5" ECU_ADDRESS 0x6000234C /end MEASUREMENT
/begin MEASUREMENT UEGO_DiagSigEvlnS1B1_I.uDeltaUg0i "Class for Evaluation of voltages at the sensor lines for sensor 1 Bank 1 / Voltage Ug0i with reference to Ug0" SWORD spg_q3p2Em4_V 1 100 -10.48576 10.48544 FORMAT "%8.5" ECU_ADDRESS 0x6000234E /end MEASUREMENT
/begin MEASUREMENT UEGO_DiagSigEvlnS1B1_I.uDeltaUg0iHiIsq "Class for Evaluation of voltages at the sensor lines for sensor 1 Bank 1 / Delta voltage at sensor line RE when High Isq is applied to the sensor" SWORD spg_q3p2Em4_V 1 100 -10.48576 10.48544 FORMAT "%8.5" ECU_ADDRESS 0x60002350 /end MEASUREMENT
/begin MEASUREMENT UEGO_DiagSigEvlnS1B1_I.uDeltaUg0iLoIsq "Class for Evaluation of voltages at the sensor lines for sensor 1 Bank 1 / Delta voltage at sensor line IPE when Low Isq is applied to the sensor" SWORD spg_q3p2Em4_V 1 100 -10.48576 10.48544 FORMAT "%8.5" ECU_ADDRESS 0x60002352 /end MEASUREMENT
/begin MEASUREMENT UEGO_DiagSigEvlnS1B1_I.uIsoApe "Class for Evaluation of voltages at the sensor lines for sensor 1 Bank 1 / Shunt voltage across Ape" SLONG spg_q3p2Em4_V 1 100 -32.7670400000 32.7670400000 FORMAT "%13.10" ECU_ADDRESS 0x60002354 /end MEASUREMENT
/begin MEASUREMENT UEGO_DiagSigEvlnS1B1_I.uIsoIpe "Class for Evaluation of voltages at the sensor lines for sensor 1 Bank 1 / Shunt voltage across Ipe" SLONG spg_q3p2Em4_V 1 100 -32.7670400000 32.7670400000 FORMAT "%13.10" ECU_ADDRESS 0x60002358 /end MEASUREMENT
/begin MEASUREMENT UEGO_DiagSigEvlnS1B1_I.uIsoRe "Class for Evaluation of voltages at the sensor lines for sensor 1 Bank 1 / Shunt voltage across Re" SLONG spg_q3p2Em4_V 1 100 -32.7670400000 32.7670400000 FORMAT "%13.10" ECU_ADDRESS 0x6000235C /end MEASUREMENT
/begin MEASUREMENT UEGO_DiagSigEvlnS1B1_I.uScApe "Class for Evaluation of voltages at the sensor lines for sensor 1 Bank 1 / Calculated short circuit voltage at the pin Ape" SLONG spg_q3p2Em4_V 1 100 -32.7670400000 32.7670400000 FORMAT "%13.10" ECU_ADDRESS 0x60002360 /end MEASUREMENT
/begin MEASUREMENT UEGO_DiagSigEvlnS1B1_I.uScIpe "Class for Evaluation of voltages at the sensor lines for sensor 1 Bank 1 / Calculated short circuit voltage at the pin Ipe" SLONG spg_q3p2Em4_V 1 100 -32.7670400000 32.7670400000 FORMAT "%13.10" ECU_ADDRESS 0x60002364 /end MEASUREMENT
/begin MEASUREMENT UEGO_DiagSigEvlnS1B1_I.uScRe "Class for Evaluation of voltages at the sensor lines for sensor 1 Bank 1 / Calculated short circuit voltage at the pin Re" SLONG spg_q3p2Em4_V 1 100 -32.7670400000 32.7670400000 FORMAT "%13.10" ECU_ADDRESS 0x60002368 /end MEASUREMENT
/begin MEASUREMENT UEGO_DiagSigEvlnS1B1_I.uUg0HiIsq "Class for Evaluation of voltages at the sensor lines for sensor 1 Bank 1 / Voltage across Ug0 when Hi Isq is applied" SWORD spg_q3p2Em4_V 1 100 -10.48576 10.48544 FORMAT "%8.5" ECU_ADDRESS 0x6000236C /end MEASUREMENT
/begin MEASUREMENT UEGO_DiagSigEvlnS1B1_I.uUg0LoIsq "Class for Evaluation of voltages at the sensor lines for sensor 1 Bank 1 / Voltage across Ug0 when Lo Isq is applied" SWORD spg_q3p2Em4_V 1 100 -10.48576 10.48544 FORMAT "%8.5" ECU_ADDRESS 0x6000236E /end MEASUREMENT
/begin MEASUREMENT UEGO_DiagSigEvlnS1B1_I.uUg0Pck "Class for Evaluation of voltages at the sensor lines for sensor 1 Bank 1 / Voltage across Ug0" SWORD spg_q3p2Em4_V 1 100 -10.48576 10.48544 FORMAT "%8.5" ECU_ADDRESS 0x60002370 /end MEASUREMENT
/begin MEASUREMENT UEGO_DiagSigEvlnS1B1_I.uUg0PckPeak "Class for Evaluation of voltages at the sensor lines for sensor 1 Bank 1 / Filtered voltage across Ug0" SWORD spg_q3p2Em4_V 1 100 -10.48576 10.48544 FORMAT "%8.5" ECU_ADDRESS 0x60002372 /end MEASUREMENT
/begin MEASUREMENT UEGO_DiagSigEvlnS1B1_I.uUg0PeakFil_I.flgFilStrtd "Class for Evaluation of voltages at the sensor lines for sensor 1 Bank 1 / Class instance for Peak filter of Delta Ug0 / Flag status to start filtring" UBYTE B_TRUE 1 100 0.00 1.00000000000 BIT_MASK 0x1 FORMAT "%13.11" ECU_ADDRESS 0x60002374 /end MEASUREMENT
/begin MEASUREMENT UEGO_DiagSigEvlnS1B1_I.uUg0PeakFil_I.uDeltaInOutpMax "Class for Evaluation of voltages at the sensor lines for sensor 1 Bank 1 / Class instance for Peak filter of Delta Ug0 / maximum value of input to optput delta voltage" SWORD spg_q3p2Em4_V 1 100 -10.48576 10.48544 FORMAT "%8.5" ECU_ADDRESS 0x60002376 /end MEASUREMENT
/begin MEASUREMENT UEGO_DiagSigEvlnS1B1_I.uUg0aDeltaPeakFil_I.flgFilStrtd "Class for Evaluation of voltages at the sensor lines for sensor 1 Bank 1 / Class instance for Peak filter of Delta Ug0a / Flag status to start filtring" UBYTE B_TRUE 1 100 0.00 1.00000000000 BIT_MASK 0x1 FORMAT "%13.11" ECU_ADDRESS 0x60002378 /end MEASUREMENT
/begin MEASUREMENT UEGO_DiagSigEvlnS1B1_I.uUg0aDeltaPeakFil_I.uDeltaInOutpMax "Class for Evaluation of voltages at the sensor lines for sensor 1 Bank 1 / Class instance for Peak filter of Delta Ug0a / maximum value of input to optput delta voltage" SWORD spg_q3p2Em4_V 1 100 -10.48576 10.48544 FORMAT "%8.5" ECU_ADDRESS 0x6000237A /end MEASUREMENT
/begin MEASUREMENT UEGO_DiagSigEvlnS1B1_I.uUg0eDeltaPeakFil_I.flgFilStrtd "Class for Evaluation of voltages at the sensor lines for sensor 1 Bank 1 / Class instance for Peak filter of Delta Ug0e / Flag status to start filtring" UBYTE B_TRUE 1 100 0.00 1.00000000000 BIT_MASK 0x1 FORMAT "%13.11" ECU_ADDRESS 0x6000237C /end MEASUREMENT
/begin MEASUREMENT UEGO_DiagSigEvlnS1B1_I.uUg0eDeltaPeakFil_I.uDeltaInOutpMax "Class for Evaluation of voltages at the sensor lines for sensor 1 Bank 1 / Class instance for Peak filter of Delta Ug0e / maximum value of input to optput delta voltage" SWORD spg_q3p2Em4_V 1 100 -10.48576 10.48544 FORMAT "%8.5" ECU_ADDRESS 0x6000237E /end MEASUREMENT
/begin MEASUREMENT UEGO_DiagSigEvlnS1B1_I.uUg0iDeltaPeakFil_I.flgFilStrtd "Class for Evaluation of voltages at the sensor lines for sensor 1 Bank 1 / Class instance for Peak filter of Delta Ug0i / Flag status to start filtring" UBYTE B_TRUE 1 100 0.00 1.00000000000 BIT_MASK 0x1 FORMAT "%13.11" ECU_ADDRESS 0x60002380 /end MEASUREMENT
/begin MEASUREMENT UEGO_DiagSigEvlnS1B1_I.uUg0iDeltaPeakFil_I.uDeltaInOutpMax "Class for Evaluation of voltages at the sensor lines for sensor 1 Bank 1 / Class instance for Peak filter of Delta Ug0i / maximum value of input to optput delta voltage" SWORD spg_q3p2Em4_V 1 100 -10.48576 10.48544 FORMAT "%8.5" ECU_ADDRESS 0x60002382 /end MEASUREMENT
/begin MEASUREMENT UEGO_DiagSigGetS1B1_I.ErrAry "Class instance of UEGO_DiagSigGet / Static array for accessing the Diag register , Chip error and IRQ error information from the BSW software" UBYTE OneToOne 1 100 0.00 255.0 FORMAT "%5.1" ARRAY_SIZE 7 ECU_ADDRESS 0x60006768 /end MEASUREMENT
/begin MEASUREMENT UEGO_DiagSigGetS1B1_I.ErrAry_5ms "Class instance of UEGO_DiagSigGet / Diagnostic error array in 5ms" UBYTE OneToOne 1 100 0.00 255.0 FORMAT "%5.1" ARRAY_SIZE 7 ECU_ADDRESS 0x6000676F /end MEASUREMENT
/begin MEASUREMENT UEGO_DiagSigGetS1B1_I.TmpArr10ms "Class instance of UEGO_DiagSigGet / Temporary array used to store the ACTMODE register information in the UEGO software" UWORD dez 1 100 0.00 65535.00 FORMAT "%8.2" ARRAY_SIZE 16 ECU_ADDRESS 0x60006776 /end MEASUREMENT
/begin MEASUREMENT UEGO_DiagSigGetS1B1_I.cntrDiagSigRamBnkSpi "Class instance of UEGO_DiagSigGet / counter for rambank transfer spi error" SWORD OneToOne 1 100 -255.0000 255.0000 FORMAT "%8.4" ECU_ADDRESS 0x60006796 /end MEASUREMENT
/begin MEASUREMENT UEGO_DiagSigGetS1B1_I.cntrDiagSigRegBnkSpi "Class instance of UEGO_DiagSigGet / counter for registerbank transfer spi error" SWORD OneToOne 1 100 -255.0000 255.0000 FORMAT "%8.4" ECU_ADDRESS 0x60006798 /end MEASUREMENT
/begin MEASUREMENT UEGO_DiagSigGetS1B1_I.cntrDiagSigRegDiagSpi "Class instance of UEGO_DiagSigGet / counter for diagregister transfer spi error" SWORD OneToOne 1 100 -255.0000 255.0000 FORMAT "%8.4" ECU_ADDRESS 0x6000679A /end MEASUREMENT
/begin MEASUREMENT UEGO_DiagSigGetS1B1_I.flgDiagSigCmnIrqVld "Class instance of UEGO_DiagSigGet / validity of the common IRQ information." UBYTE B_TRUE 1 100 0.00 1.00000000000 BIT_MASK 0x1 FORMAT "%13.11" ECU_ADDRESS 0x6000679C /end MEASUREMENT
/begin MEASUREMENT UEGO_DiagSigGetS1B1_I.flgDiagSigNewDat "Class instance of UEGO_DiagSigGet / new information available from the Diag registers of CJ135 ASIC" UBYTE B_TRUE 1 100 0.00 1.00000000000 BIT_MASK 0x1 FORMAT "%13.11" ECU_ADDRESS 0x6000679D /end MEASUREMENT
/begin MEASUREMENT UEGO_DiagSigGetS1B1_I.flgDiagSigNewDat_5ms "Class instance of UEGO_DiagSigGet / new diagnostic data in 5ms" UBYTE B_TRUE 1 100 0.00 1.00000000000 BIT_MASK 0x1 FORMAT "%13.11" ECU_ADDRESS 0x6000679E /end MEASUREMENT
/begin MEASUREMENT UEGO_DiagSigGetS1B1_I.flgDiagSigNewDat_New "Class instance of UEGO_DiagSigGet / new diagnostic data in 5ms" UBYTE B_TRUE 1 100 0.00 1.00000000000 BIT_MASK 0x1 FORMAT "%13.11" ECU_ADDRESS 0x6000679F /end MEASUREMENT
/begin MEASUREMENT UEGO_DiagSigGetS1B1_I.flgDiagSigRamBnkSpiVld "Class instance of UEGO_DiagSigGet / counter for rambank transfer spi error is valid" UBYTE B_TRUE 1 100 0.00 1.00000000000 BIT_MASK 0x1 FORMAT "%13.11" ECU_ADDRESS 0x600067A0 /end MEASUREMENT
/begin MEASUREMENT UEGO_DiagSigGetS1B1_I.flgDiagSigRegBnkSpi "Class instance of UEGO_DiagSigGet / flag representing the SPI error of the register bank transfer" UBYTE B_TRUE 1 100 0.00 1.00000000000 BIT_MASK 0x1 FORMAT "%13.11" ECU_ADDRESS 0x600067A1 /end MEASUREMENT
/begin MEASUREMENT UEGO_DiagSigGetS1B1_I.flgDiagSigRegBnkSpiPrv "Class instance of UEGO_DiagSigGet / SPI error previous" UBYTE B_TRUE 1 100 0.00 1.00000000000 BIT_MASK 0x1 FORMAT "%13.11" ECU_ADDRESS 0x600067A2 /end MEASUREMENT
/begin MEASUREMENT UEGO_DiagSigGetS1B1_I.flgDiagSigRegBnkSpiVld "Class instance of UEGO_DiagSigGet / counter for diagregister transfer spi error is valid" UBYTE B_TRUE 1 100 0.00 1.00000000000 BIT_MASK 0x1 FORMAT "%13.11" ECU_ADDRESS 0x600067A3 /end MEASUREMENT
/begin MEASUREMENT UEGO_DiagSigGetS1B1_I.flgDiagSigRegDiagSpi "Class instance of UEGO_DiagSigGet / flag representing the SPI error while transferring the DIAG register information" UBYTE B_TRUE 1 100 0.00 1.00000000000 BIT_MASK 0x1 FORMAT "%13.11" ECU_ADDRESS 0x600067A4 /end MEASUREMENT
/begin MEASUREMENT UEGO_DiagSigGetS1B1_I.flgDiagSigRegDiagSpiVld "Class instance of UEGO_DiagSigGet / counter for diagregister transfer spi error is valid" UBYTE B_TRUE 1 100 0.00 1.00000000000 BIT_MASK 0x1 FORMAT "%13.11" ECU_ADDRESS 0x600067A5 /end MEASUREMENT
/begin MEASUREMENT UEGO_DiagSigGetS1B1_I.flgDiagSigRegDiagSpi_5ms "Class instance of UEGO_DiagSigGet / spi error during diagnostic register transfer in 5ms" UBYTE B_TRUE 1 100 0.00 1.00000000000 BIT_MASK 0x1 FORMAT "%13.11" ECU_ADDRESS 0x600067A6 /end MEASUREMENT
/begin MEASUREMENT UEGO_DiagSigGetS1B1_I.flgDiagSigRegDiagVld "Class instance of UEGO_DiagSigGet / validity of the DIAG register information" UBYTE B_TRUE 1 100 0.00 1.00000000000 BIT_MASK 0x1 FORMAT "%13.11" ECU_ADDRESS 0x600067A7 /end MEASUREMENT
/begin MEASUREMENT UEGO_DiagSigGetS1B1_I.flgDiagSigRegDiagVld_5ms "Class instance of UEGO_DiagSigGet / validity of diagnostic registers in 5ms" UBYTE B_TRUE 1 100 0.00 1.00000000000 BIT_MASK 0x1 FORMAT "%13.11" ECU_ADDRESS 0x600067A8 /end MEASUREMENT
/begin MEASUREMENT UEGO_DiagSigGetS1B1_I.flgDiagSigRegDiagVld_New "Class instance of UEGO_DiagSigGet / validity of diagnostic registers in 5ms" UBYTE B_TRUE 1 100 0.00 1.00000000000 BIT_MASK 0x1 FORMAT "%13.11" ECU_ADDRESS 0x600067A9 /end MEASUREMENT
/begin MEASUREMENT UEGO_DiagSigGetS1B1_I.flgDiagSigSpiErr "Class instance of UEGO_DiagSigGet / flag representing the SPI error while transferring the DIAG register information" UBYTE B_TRUE 1 100 0.00 1.00000000000 BIT_MASK 0x1 FORMAT "%13.11" ECU_ADDRESS 0x600067AA /end MEASUREMENT
/begin MEASUREMENT UEGO_DiagSigGetS1B1_I.flgDiagSigSpiErrPrv "Class instance of UEGO_DiagSigGet / spi error previous" UBYTE B_TRUE 1 100 0.00 1.00000000000 BIT_MASK 0x1 FORMAT "%13.11" ECU_ADDRESS 0x600067AB /end MEASUREMENT
/begin MEASUREMENT UEGO_DiagSigGetS1B1_I.flgDiagSigSpiErr_5ms "Class instance of UEGO_DiagSigGet / validity of spi error during diagnostic register transmission in 5ms" UBYTE B_TRUE 1 100 0.00 1.00000000000 BIT_MASK 0x1 FORMAT "%13.11" ECU_ADDRESS 0x600067AC /end MEASUREMENT
/begin MEASUREMENT UEGO_DiagSigGetS1B1_I.flgErrSpiRamBnk10ms "Class instance of UEGO_DiagSigGet / spi error in 10ms" UBYTE B_TRUE 1 100 0.00 1.00000000000 BIT_MASK 0x1 FORMAT "%13.11" ECU_ADDRESS 0x600067AD /end MEASUREMENT
/begin MEASUREMENT UEGO_DiagSigGetS1B1_I.flgErrSpiRamBnk10msPrv "Class instance of UEGO_DiagSigGet / spi error in 10ms previous" UBYTE B_TRUE 1 100 0.00 1.00000000000 BIT_MASK 0x1 FORMAT "%13.11" ECU_ADDRESS 0x600067AE /end MEASUREMENT
/begin MEASUREMENT UEGO_DiagSigGetS1B1_I.flgErrSpiRamBnk5ms "Class instance of UEGO_DiagSigGet / spi error in 5ms" UBYTE B_TRUE 1 100 0.00 1.00000000000 BIT_MASK 0x1 FORMAT "%13.11" ECU_ADDRESS 0x600067AF /end MEASUREMENT
/begin MEASUREMENT UEGO_DiagSigGetS1B1_I.flgRegBnkDatVld "Class instance of UEGO_DiagSigGet / register bank data valid." UBYTE B_TRUE 1 100 0.00 1.00000000000 BIT_MASK 0x1 FORMAT "%13.11" ECU_ADDRESS 0x600067B0 /end MEASUREMENT
/begin MEASUREMENT UEGO_DiagSigGetS1B1_I.flgRegBnkSpiErr "Class instance of UEGO_DiagSigGet / register bank spi error" UBYTE B_TRUE 1 100 0.00 1.00000000000 BIT_MASK 0x1 FORMAT "%13.11" ECU_ADDRESS 0x600067B1 /end MEASUREMENT
/begin MEASUREMENT UEGO_DiagSigGetS1B1_I.flgRstExtReq "Class instance of UEGO_DiagSigGet / external reset request" UBYTE B_TRUE 1 100 0.00 1.00000000000 BIT_MASK 0x1 FORMAT "%13.11" ECU_ADDRESS 0x600067B2 /end MEASUREMENT
/begin MEASUREMENT UEGO_DiagSigGetS1B1_I.numModCurr "Class instance of UEGO_DiagSigGet / current mode of the ASIC" UBYTE dez 1 100 0.00 255.0 FORMAT "%5.1" ECU_ADDRESS 0x600067B3 /end MEASUREMENT
/begin MEASUREMENT UEGO_DiagSigGetS1B1_I.stDiagSigChp "Class instance of UEGO_DiagSigGet / Status of the Chip error information of the ASIC" UBYTE dez 1 100 0.00 255.0 FORMAT "%5.1" ECU_ADDRESS 0x600067B4 /end MEASUREMENT
/begin MEASUREMENT UEGO_DiagSigGetS1B1_I.stDiagSigChp_5ms "Class instance of UEGO_DiagSigGet / Chip error in 5ms" UBYTE dez 1 100 0.00 255.0 FORMAT "%5.1" ECU_ADDRESS 0x600067B5 /end MEASUREMENT
/begin MEASUREMENT UEGO_DiagSigGetS1B1_I.stDiagSigChp_New "Class instance of UEGO_DiagSigGet / Chip error in 5ms" UBYTE dez 1 100 0.00 255.0 FORMAT "%5.1" ECU_ADDRESS 0x600067B6 /end MEASUREMENT
/begin MEASUREMENT UEGO_DiagSigGetS1B1_I.stDiagSigCmnIrq "Class instance of UEGO_DiagSigGet / status of the IRQ error information of the ASICs present in the ECU" UBYTE dez 1 100 0.00 255.0 FORMAT "%5.1" ECU_ADDRESS 0x600067B7 /end MEASUREMENT
/begin MEASUREMENT UEGO_DiagSigGetS1B1_I.stDiagSigRegChpSt "Class instance of UEGO_DiagSigGet / Status of the CHIPSTAT register" UBYTE dez 1 100 0.00 255.0 FORMAT "%5.1" ECU_ADDRESS 0x600067B8 /end MEASUREMENT
/begin MEASUREMENT UEGO_DiagSigGetS1B1_I.stDiagSigRegChpSt_5ms "Class instance of UEGO_DiagSigGet / CHIPSTAT register information in 5ms" UBYTE dez 1 100 0.00 255.0 FORMAT "%5.1" ECU_ADDRESS 0x600067B9 /end MEASUREMENT
/begin MEASUREMENT UEGO_DiagSigGetS1B1_I.stDiagSigRegChpSt_New "Class instance of UEGO_DiagSigGet / CHIPSTAT register information in 5ms" UBYTE dez 1 100 0.00 255.0 FORMAT "%5.1" ECU_ADDRESS 0x600067BA /end MEASUREMENT
/begin MEASUREMENT UEGO_DiagSigGetS1B1_I.stDiagSigRegDiag0 "Class instance of UEGO_DiagSigGet / Status of the DIAG0 register" UBYTE dez 1 100 0.00 255.0 FORMAT "%5.1" ECU_ADDRESS 0x600067BB /end MEASUREMENT
/begin MEASUREMENT UEGO_DiagSigGetS1B1_I.stDiagSigRegDiag0_5ms "Class instance of UEGO_DiagSigGet / DIAG0 register information in 5ms" UBYTE dez 1 100 0.00 255.0 FORMAT "%5.1" ECU_ADDRESS 0x600067BC /end MEASUREMENT
/begin MEASUREMENT UEGO_DiagSigGetS1B1_I.stDiagSigRegDiag0_New "Class instance of UEGO_DiagSigGet / DIAG0 register information in 5ms" UBYTE dez 1 100 0.00 255.0 FORMAT "%5.1" ECU_ADDRESS 0x600067BD /end MEASUREMENT
/begin MEASUREMENT UEGO_DiagSigGetS1B1_I.stDiagSigRegDiag1 "Class instance of UEGO_DiagSigGet / Status of the DIAG1 register" UBYTE dez 1 100 0.00 255.0 FORMAT "%5.1" ECU_ADDRESS 0x600067BE /end MEASUREMENT
/begin MEASUREMENT UEGO_DiagSigGetS1B1_I.stDiagSigRegDiag1_5ms "Class instance of UEGO_DiagSigGet / DIAG1 register information in 5ms" UBYTE dez 1 100 0.00 255.0 FORMAT "%5.1" ECU_ADDRESS 0x600067BF /end MEASUREMENT
/begin MEASUREMENT UEGO_DiagSigGetS1B1_I.stDiagSigRegDiag1_New "Class instance of UEGO_DiagSigGet / DIAG1 register information in 5ms" UBYTE dez 1 100 0.00 255.0 FORMAT "%5.1" ECU_ADDRESS 0x600067C0 /end MEASUREMENT
/begin MEASUREMENT UEGO_DiagSigGetS1B1_I.stDiagSigRegDspSt "Class instance of UEGO_DiagSigGet / Status of the DSPSTAT register" UBYTE dez 1 100 0.00 255.0 FORMAT "%5.1" ECU_ADDRESS 0x600067C1 /end MEASUREMENT
/begin MEASUREMENT UEGO_DiagSigGetS1B1_I.stDiagSigRegDspSt_5ms "Class instance of UEGO_DiagSigGet / DSPSTAT register information in 5ms" UBYTE dez 1 100 0.00 255.0 FORMAT "%5.1" ECU_ADDRESS 0x600067C2 /end MEASUREMENT
/begin MEASUREMENT UEGO_DiagSigGetS1B1_I.stDiagSigRegDspSt_New "Class instance of UEGO_DiagSigGet / DSPSTAT register information in 5ms" UBYTE dez 1 100 0.00 255.0 FORMAT "%5.1" ECU_ADDRESS 0x600067C3 /end MEASUREMENT
/begin MEASUREMENT UEGO_DiagSigOperPlausS1B1_I.flgEngRunngOnceCyc "Class instance of UEGO_DiagSigOperPlaus for sensor 1 bank 1 / Engine has run once in driving cycle" UBYTE B_TRUE 1 100 0.00 1.00000000000 BIT_MASK 0x1 FORMAT "%13.11" ECU_ADDRESS 0x60006754 /end MEASUREMENT
/begin MEASUREMENT UEGO_DiagSigOperPlausS1B1_I.flgRstDsmClr "Class instance of UEGO_DiagSigOperPlaus for sensor 1 bank 1 / flag for Reseting status report variable when dsm xclear is being requested" UBYTE B_TRUE 1 100 0.00 1.00000000000 BIT_MASK 0x1 FORMAT "%13.11" ECU_ADDRESS 0x60006755 /end MEASUREMENT
/begin MEASUREMENT UEGO_DiagSigOperPlausS1B1_I.flgRstExtReq "Class instance of UEGO_DiagSigOperPlaus for sensor 1 bank 1 / External request for reevaluation of diagnostics" UBYTE B_TRUE 1 100 0.00 1.00000000000 BIT_MASK 0x1 FORMAT "%13.11" ECU_ADDRESS 0x60006756 /end MEASUREMENT
/begin MEASUREMENT UEGO_DiagSigOperPlausS1B1_I.stDiagSigOperPlausRels "Class instance of UEGO_DiagSigOperPlaus for sensor 1 bank 1 / Status of the relelase conditions for diagnosis" UBYTE OneToOne 1 100 0.00 255.0 FORMAT "%5.1" ECU_ADDRESS 0x60006757 /end MEASUREMENT
/begin MEASUREMENT UEGO_DiagSigOperPlausS1B1_I.stDiagSigOperPlausRprt "Class instance of UEGO_DiagSigOperPlaus for sensor 1 bank 1 / Local variable about Detailed fault status of UEGO ASIC diagnosis for sensor x on bank y in DFC_UegoSigOperPlausSxBy" UBYTE OneToOne 1 100 0.00 255.0 FORMAT "%5.1" ECU_ADDRESS 0x60038A9A /end MEASUREMENT
/begin MEASUREMENT UEGO_DiagSigOperPlausS1B1_I.OperPlausFastTestRelsFF_I.status "Class instance of UEGO_DiagSigOperPlaus for sensor 1 bank 1 / flipflop for fast operplaus test result. / current value of RS-FF" UBYTE B_TRUE 1 100 0.00 1.00000000000 BIT_MASK 0x1 FORMAT "%13.11" ECU_ADDRESS 0x60006758 /end MEASUREMENT
/begin MEASUREMENT UEGO_DiagSigOperPlausS1B1_I.UEGO_flgDsmErrDebERNM_I.oldSignal "Class instance of UEGO_DiagSigOperPlaus for sensor 1 bank 1 / DSM OperPlaus error debounce flag / value of input signal last calculation" UBYTE B_TRUE 1 100 0.00 1.00000000000 BIT_MASK 0x1 FORMAT "%13.11" ECU_ADDRESS 0x60006759 /end MEASUREMENT
/begin MEASUREMENT UEGO_DiagSigOperPlausS1B1_I.UEGO_flgDsmTstERNM_I.oldSignal "Class instance of UEGO_DiagSigOperPlaus for sensor 1 bank 1 / DSM OperPlaus test flag / value of input signal last calculation" UBYTE B_TRUE 1 100 0.00 1.00000000000 BIT_MASK 0x1 FORMAT "%13.11" ECU_ADDRESS 0x6000675A /end MEASUREMENT
/begin MEASUREMENT UEGO_DiagSigOperPlausS1B1_I.tiDlyDiagSigOperPlausOvrRunTOFFV_I.outbit "Class instance of UEGO_DiagSigOperPlaus for sensor 1 bank 1 / turn off delay for overrun / Output Bit" UBYTE B_TRUE 1 100 0.00 1.00000000000 BIT_MASK 0x1 FORMAT "%13.11" ECU_ADDRESS 0x6000675C /end MEASUREMENT
/begin MEASUREMENT UEGO_DiagSigOperPlausS1B1_I.tiDlyDiagSigOperPlausOvrRunTOFFV_I.time "Class instance of UEGO_DiagSigOperPlaus for sensor 1 bank 1 / turn off delay for overrun / Occured Time" UWORD t_q0p01 1 100 0.00 655.3500 FORMAT "%8.4" ECU_ADDRESS 0x6000675E /end MEASUREMENT
/begin MEASUREMENT UEGO_DiagSigOperPlausS1B1_I.tiDlyDiagSigOperPlausOvrRunTONV_I.outbit "Class instance of UEGO_DiagSigOperPlaus for sensor 1 bank 1 / turn on delay for overrun / return value" UBYTE B_TRUE 1 100 0.00 1.00000000000 BIT_MASK 0x1 FORMAT "%13.11" ECU_ADDRESS 0x60006760 /end MEASUREMENT
/begin MEASUREMENT UEGO_DiagSigOperPlausS1B1_I.tiDlyDiagSigOperPlausOvrRunTONV_I.time "Class instance of UEGO_DiagSigOperPlaus for sensor 1 bank 1 / turn on delay for overrun / expired delay time" UWORD t_q0p01 1 100 0.00 655.3500 FORMAT "%8.4" ECU_ADDRESS 0x60006762 /end MEASUREMENT
/begin MEASUREMENT UEGO_DiagSigOperPlausS1B1_I.tiDlyDiagSigOperPlausRelsTONVNM_I.time "Class instance of UEGO_DiagSigOperPlaus for sensor 1 bank 1 / Turn on delay for release of operation plausibility diagnosis / Delay Time" UWORD t_q0p01 1 100 0.00 655.3500 FORMAT "%8.4" ECU_ADDRESS 0x60006764 /end MEASUREMENT
/begin MEASUREMENT UEGO_DiagSigSnsrS1B1_I.flgDiagSigSnsrRst "Instance of the UEGO sensor signal diagnostics for sensor position 1 bank 1 / reset of signals contributing to the UEGO sensor diagnosis" UBYTE B_TRUE 1 100 0.00 1.00000000000 BIT_MASK 0x1 FORMAT "%13.11" ECU_ADDRESS 0x60006746 /end MEASUREMENT
/begin MEASUREMENT UEGO_DiagSigSnsrS1B1_I.flgDiagSigSnsrTstdOk "Instance of the UEGO sensor signal diagnostics for sensor position 1 bank 1 / UEGO sensor diagnostic tested without fault results" UBYTE B_TRUE 1 100 0.00 1.00000000000 BIT_MASK 0x1 FORMAT "%13.11" ECU_ADDRESS 0x60006747 /end MEASUREMENT
/begin MEASUREMENT UEGO_DiagSigSnsrS1B1_I.flgRstDsmClr "Instance of the UEGO sensor signal diagnostics for sensor position 1 bank 1 / flag for Reseting status report variable when dsm xclear is being requested" UBYTE B_TRUE 1 100 0.00 1.00000000000 BIT_MASK 0x1 FORMAT "%13.11" ECU_ADDRESS 0x60006748 /end MEASUREMENT
/begin MEASUREMENT UEGO_DiagSigSnsrS1B1_I.flgRstExtReq "Instance of the UEGO sensor signal diagnostics for sensor position 1 bank 1 / External request for reevaluation" UBYTE B_TRUE 1 100 0.00 1.00000000000 BIT_MASK 0x1 FORMAT "%13.11" ECU_ADDRESS 0x60006749 /end MEASUREMENT
/begin MEASUREMENT UEGO_DiagSigSnsrS1B1_I.stDiagSigSnsrCyc "Instance of the UEGO sensor signal diagnostics for sensor position 1 bank 1 / UEGO detailed status on sensor diagnosis" UBYTE dez 1 100 0.00 255.0 FORMAT "%5.1" ECU_ADDRESS 0x6000674A /end MEASUREMENT
/begin MEASUREMENT UEGO_DiagSigSnsrS1B1_I.stDiagSigSnsrRprt "Instance of the UEGO sensor signal diagnostics for sensor position 1 bank 1 / Local variable about Detailed fault status of UEGO ASIC diagnosis for sensor x on bank y in DFC_UegoDiagSigSnsrSxBy" UBYTE dez 1 100 0.00 255.0 FORMAT "%5.1" ECU_ADDRESS 0x60038A98 /end MEASUREMENT
/begin MEASUREMENT UEGO_DiagSigSnsrS1B1_I.UEGO_DiagSigSnsrResClass_I.stErr "Instance of the UEGO sensor signal diagnostics for sensor position 1 bank 1 / Put-Bit string class instance / error detection status of individual fault path." UBYTE dez 1 100 0.00 255.0 FORMAT "%5.1" ECU_ADDRESS 0x6000674C /end MEASUREMENT
/begin MEASUREMENT UEGO_DiagSigSnsrS1B1_I.UEGO_DiagSigSnsrResClass_I.stTstdCyc "Instance of the UEGO sensor signal diagnostics for sensor position 1 bank 1 / Put-Bit string class instance / Bitwise status of fault path tested result." UBYTE dez 1 100 0.00 255.0 FORMAT "%5.1" ECU_ADDRESS 0x6000674D /end MEASUREMENT
/begin MEASUREMENT UEGO_DiagSigSnsrS1B1_I.UEGO_DiagSigSnsrResClass_I.stTstdCycRprt "Instance of the UEGO sensor signal diagnostics for sensor position 1 bank 1 / Put-Bit string class instance / Bitwise status of fault path tested result when report is released." UBYTE dez 1 100 0.00 255.0 FORMAT "%5.1" ECU_ADDRESS 0x6000674E /end MEASUREMENT
/begin MEASUREMENT UEGO_DiagSigSnsrS1B1_I.UEGO_RipHiErrTONVNM_I.time "Instance of the UEGO sensor signal diagnostics for sensor position 1 bank 1 / Time delay for erronous pump resistance / Delay Time" UBYTE t_q0p01 1 100 0.00 2.550 FORMAT "%5.3" ECU_ADDRESS 0x60006750 /end MEASUREMENT
/begin MEASUREMENT UEGO_DiagSigSnsrS1B1_I.UEGO_RipHiRelsTONVNM_I.time "Instance of the UEGO sensor signal diagnostics for sensor position 1 bank 1 / Time delay for pump resistance evaluation / Delay Time" UBYTE t_q0p01 1 100 0.00 2.550 FORMAT "%5.3" ECU_ADDRESS 0x60006751 /end MEASUREMENT
/begin MEASUREMENT UEGO_DiagSigSnsrS1B1_I.UEGO_flgDsmErrDebERNM_I.oldSignal "Instance of the UEGO sensor signal diagnostics for sensor position 1 bank 1 / DSM DiagSigSnsr Error Debounce flag / value of input signal last calculation" UBYTE B_TRUE 1 100 0.00 1.00000000000 BIT_MASK 0x1 FORMAT "%13.11" ECU_ADDRESS 0x60006752 /end MEASUREMENT
/begin MEASUREMENT UEGO_DiagSigSnsrS1B1_I.UEGO_flgDsmTstERNM_I.oldSignal "Instance of the UEGO sensor signal diagnostics for sensor position 1 bank 1 / DSm DiagSigSnsr Test Flag / value of input signal last calculation" UBYTE B_TRUE 1 100 0.00 1.00000000000 BIT_MASK 0x1 FORMAT "%13.11" ECU_ADDRESS 0x60006753 /end MEASUREMENT
/begin MEASUREMENT UEGO_DiagSigWireOlS1B1_I.cntrRPmpStep "Class instance of UEGO_DiagSigWireOl for sensor 1 bank 1 / Pump cell resistance step for multi step diagnosis" UBYTE dez 1 100 0.00 255.0 FORMAT "%5.1" ECU_ADDRESS 0x60006728 /end MEASUREMENT
/begin MEASUREMENT UEGO_DiagSigWireOlS1B1_I.flgDiagSigWireOlElectrodeCircRst "Class instance of UEGO_DiagSigWireOl for sensor 1 bank 1 / reset of signals contributing to the UEGO wire circuit continuity diagnosis" UBYTE B_TRUE 1 100 0.00 1.00000000000 BIT_MASK 0x1 FORMAT "%13.11" ECU_ADDRESS 0x60006729 /end MEASUREMENT
/begin MEASUREMENT UEGO_DiagSigWireOlS1B1_I.flgDiagSigWireOlRst "Class instance of UEGO_DiagSigWireOl for sensor 1 bank 1 / reset of signals contributing to the UEGO wire circuit continuity diagnosis" UBYTE B_TRUE 1 100 0.00 1.00000000000 BIT_MASK 0x1 FORMAT "%13.11" ECU_ADDRESS 0x6000672A /end MEASUREMENT
/begin MEASUREMENT UEGO_DiagSigWireOlS1B1_I.flgDiagSigWireOlTstdOk "Class instance of UEGO_DiagSigWireOl for sensor 1 bank 1 / UEGO wire circuit continuity diagnostic tested without fault" UBYTE B_TRUE 1 100 0.00 1.00000000000 BIT_MASK 0x1 FORMAT "%13.11" ECU_ADDRESS 0x6000672B /end MEASUREMENT
/begin MEASUREMENT UEGO_DiagSigWireOlS1B1_I.flgDiagSigWireRCmpCircRst "Class instance of UEGO_DiagSigWireOl for sensor 1 bank 1 / reset of signals contributing to UEGO wire compensation resistor circuit continuity diagnosis" UBYTE B_TRUE 1 100 0.00 1.00000000000 BIT_MASK 0x1 FORMAT "%13.11" ECU_ADDRESS 0x6000672C /end MEASUREMENT
/begin MEASUREMENT UEGO_DiagSigWireOlS1B1_I.flgRCmpErr "Class instance of UEGO_DiagSigWireOl for sensor 1 bank 1 / Flag of error at compensator resistance" UBYTE B_TRUE 1 100 0.00 1.00000000000 BIT_MASK 0x1 FORMAT "%13.11" ECU_ADDRESS 0x6000672D /end MEASUREMENT
/begin MEASUREMENT UEGO_DiagSigWireOlS1B1_I.flgRstExtReq "Class instance of UEGO_DiagSigWireOl for sensor 1 bank 1 / External request for reevaluation" UBYTE B_TRUE 1 100 0.00 1.00000000000 BIT_MASK 0x1 FORMAT "%13.11" ECU_ADDRESS 0x6000672E /end MEASUREMENT
/begin MEASUREMENT UEGO_DiagSigWireOlS1B1_I.rWireApeDiagWireOlHi "Class instance of UEGO_DiagSigWireOl for sensor 1 bank 1 / Output of curve used as threhold for Ape wire resistance diagnosis" UWORD r_q0p1_Ohm 1 100 0.00 6553.500 FORMAT "%8.3" ECU_ADDRESS 0x60006730 /end MEASUREMENT
/begin MEASUREMENT UEGO_DiagSigWireOlS1B1_I.stDiagSigWireOlElectCircCyc "Class instance of UEGO_DiagSigWireOl for sensor 1 bank 1 / UEGO detailed status on wire electrode circuit continuity diagnosis" UWORD dez 1 100 0.00 65535.00 FORMAT "%8.2" ECU_ADDRESS 0x60006732 /end MEASUREMENT
/begin MEASUREMENT UEGO_DiagSigWireOlS1B1_I.stDiagSigWireRCmpCircCyc "Class instance of UEGO_DiagSigWireOl for sensor 1 bank 1 / UEGO detailed status on wire compensation resistor circuit continuity diagnosis" UWORD dez 1 100 0.00 65535.00 FORMAT "%8.2" ECU_ADDRESS 0x60006734 /end MEASUREMENT
/begin MEASUREMENT UEGO_DiagSigWireOlS1B1_I.UEGO_DiagSigRCmpCircResClass_I.stErr "Class instance of UEGO_DiagSigWireOl for sensor 1 bank 1 / Class instance of the functional class of FC UEGO_DiagSigWireOl / error detection status of individual fault path." UWORD dez 1 100 0.00 65535.00 FORMAT "%8.2" ECU_ADDRESS 0x60006736 /end MEASUREMENT
/begin MEASUREMENT UEGO_DiagSigWireOlS1B1_I.UEGO_DiagSigRCmpCircResClass_I.stTstdCyc "Class instance of UEGO_DiagSigWireOl for sensor 1 bank 1 / Class instance of the functional class of FC UEGO_DiagSigWireOl / bitwise status of fault path tested result." UWORD dez 1 100 0.00 65535.00 FORMAT "%8.2" ECU_ADDRESS 0x60006738 /end MEASUREMENT
/begin MEASUREMENT UEGO_DiagSigWireOlS1B1_I.UEGO_DiagSigRCmpCircResClass_I.stTstdCycRprt "Class instance of UEGO_DiagSigWireOl for sensor 1 bank 1 / Class instance of the functional class of FC UEGO_DiagSigWireOl / bitwise status of fault path tested result with report released." UWORD dez 1 100 0.00 65535.00 FORMAT "%8.2" ECU_ADDRESS 0x6000673A /end MEASUREMENT
/begin MEASUREMENT UEGO_DiagSigWireOlS1B1_I.UEGO_DiagSigWireElectrodeCircResClass_I.stErr "Class instance of UEGO_DiagSigWireOl for sensor 1 bank 1 / Class instance of the functional class of FC UEGO_DiagSigWireOl / error detection status of individual fault path." UWORD dez 1 100 0.00 65535.00 FORMAT "%8.2" ECU_ADDRESS 0x6000673C /end MEASUREMENT
/begin MEASUREMENT UEGO_DiagSigWireOlS1B1_I.UEGO_DiagSigWireElectrodeCircResClass_I.stTstdCyc "Class instance of UEGO_DiagSigWireOl for sensor 1 bank 1 / Class instance of the functional class of FC UEGO_DiagSigWireOl / bitwise status of fault path tested result." UWORD dez 1 100 0.00 65535.00 FORMAT "%8.2" ECU_ADDRESS 0x6000673E /end MEASUREMENT
/begin MEASUREMENT UEGO_DiagSigWireOlS1B1_I.UEGO_DiagSigWireElectrodeCircResClass_I.stTstdCycRprt "Class instance of UEGO_DiagSigWireOl for sensor 1 bank 1 / Class instance of the functional class of FC UEGO_DiagSigWireOl / bitwise status of fault path tested result with report released." UWORD dez 1 100 0.00 65535.00 FORMAT "%8.2" ECU_ADDRESS 0x60006740 /end MEASUREMENT
/begin MEASUREMENT UEGO_DiagSigWireOlS1B1_I.UEGO_DiagSigWireOlStabIdleReqFF_I.status "Class instance of UEGO_DiagSigWireOl for sensor 1 bank 1 / FlipFlop / current value of RS-FF" UBYTE B_TRUE 1 100 0.00 1.00000000000 BIT_MASK 0x1 FORMAT "%13.11" ECU_ADDRESS 0x60006742 /end MEASUREMENT
/begin MEASUREMENT UEGO_DiagSigWireOlS1B1_I.UEGO_DiagSigWireOlSwtDlyTONVNM_I.time "Class instance of UEGO_DiagSigWireOl for sensor 1 bank 1 / turn on delay for multi stage OL diagnosis threshold selection. / Delay Time" UWORD t_q0p01 1 100 0.00 655.3500 FORMAT "%8.4" ECU_ADDRESS 0x60006744 /end MEASUREMENT
/begin MEASUREMENT UEGO_DiagSigWireScS1B1_I.flgDiagSigWireScRst "instance of the UEGO diagnostics of short circuits in the wires of the signal path / Request for reset of signals contributing to short circuit diagnosis" UBYTE B_TRUE 1 100 0.00 1.00000000000 BIT_MASK 0x1 FORMAT "%13.11" ECU_ADDRESS 0x6000670C /end MEASUREMENT
/begin MEASUREMENT UEGO_DiagSigWireScS1B1_I.flgDiagSigWireScTstdOk "instance of the UEGO diagnostics of short circuits in the wires of the signal path / Status of short circuit diagnosis test result in current sub-mode" UBYTE B_TRUE 1 100 0.00 1.00000000000 BIT_MASK 0x1 FORMAT "%13.11" ECU_ADDRESS 0x6000670D /end MEASUREMENT
/begin MEASUREMENT UEGO_DiagSigWireScS1B1_I.flgDiagSigWireScbRst "instance of the UEGO diagnostics of short circuits in the wires of the signal path / Request for reset of signals contributing to short circuit to battery diagnosis" UBYTE B_TRUE 1 100 0.00 1.00000000000 BIT_MASK 0x1 FORMAT "%13.11" ECU_ADDRESS 0x6000670E /end MEASUREMENT
/begin MEASUREMENT UEGO_DiagSigWireScS1B1_I.flgDiagSigWireScgRst "instance of the UEGO diagnostics of short circuits in the wires of the signal path / Request for reset of signals contributing to short circuit to ground diagnosis" UBYTE B_TRUE 1 100 0.00 1.00000000000 BIT_MASK 0x1 FORMAT "%13.11" ECU_ADDRESS 0x6000670F /end MEASUREMENT
/begin MEASUREMENT UEGO_DiagSigWireScS1B1_I.flgPerdDiag "instance of the UEGO diagnostics of short circuits in the wires of the signal path / Reset request for performing periodic diagnosis" UBYTE B_TRUE 1 100 0.00 1.00000000000 BIT_MASK 0x1 FORMAT "%13.11" ECU_ADDRESS 0x60006710 /end MEASUREMENT
/begin MEASUREMENT UEGO_DiagSigWireScS1B1_I.flgRstExtReq "instance of the UEGO diagnostics of short circuits in the wires of the signal path / Internal variable for interprocess communication" UBYTE B_TRUE 1 100 0.00 1.00000000000 BIT_MASK 0x1 FORMAT "%13.11" ECU_ADDRESS 0x60006711 /end MEASUREMENT
/begin MEASUREMENT UEGO_DiagSigWireScS1B1_I.flgSnglShtDiag "instance of the UEGO diagnostics of short circuits in the wires of the signal path / Reset request for performing single shot diagnosis" UBYTE B_TRUE 1 100 0.00 1.00000000000 BIT_MASK 0x1 FORMAT "%13.11" ECU_ADDRESS 0x60006712 /end MEASUREMENT
/begin MEASUREMENT UEGO_DiagSigWireScS1B1_I.stDiagSigWireScbCyc "instance of the UEGO diagnostics of short circuits in the wires of the signal path / UEGO detailed status on short circuit to battery diagnosis" UWORD dez 1 100 0.00 65535.00 FORMAT "%8.2" ECU_ADDRESS 0x60006714 /end MEASUREMENT
/begin MEASUREMENT UEGO_DiagSigWireScS1B1_I.stDiagSigWireScgCyc "instance of the UEGO diagnostics of short circuits in the wires of the signal path / UEGO detailed status on short circuit to ground diagnosis" UWORD dez 1 100 0.00 65535.00 FORMAT "%8.2" ECU_ADDRESS 0x60006716 /end MEASUREMENT
/begin MEASUREMENT UEGO_DiagSigWireScS1B1_I.IPmpLimSevErrTONVNM_I.time "instance of the UEGO diagnostics of short circuits in the wires of the signal path / Delay pump current limited / Delay Time" UBYTE t_q0p01 1 100 0.00 2.550 FORMAT "%5.3" ECU_ADDRESS 0x60006718 /end MEASUREMENT
/begin MEASUREMENT UEGO_DiagSigWireScS1B1_I.IPmpLimSevTstdTONVNM_I.time "instance of the UEGO diagnostics of short circuits in the wires of the signal path / Delay pump current limitation tested / Delay Time" UBYTE t_q0p01 1 100 0.00 2.550 FORMAT "%5.3" ECU_ADDRESS 0x60006719 /end MEASUREMENT
/begin MEASUREMENT UEGO_DiagSigWireScS1B1_I.PerdDiagOperTR_I.timeCounter "instance of the UEGO diagnostics of short circuits in the wires of the signal path / Timer value for periodic diagnosis / Remaining time of the timer" UBYTE t_q0p01 1 100 0.00 2.550 FORMAT "%5.3" ECU_ADDRESS 0x6000671A /end MEASUREMENT
/begin MEASUREMENT UEGO_DiagSigWireScS1B1_I.UEGO_DiagSigScb16FltPahResClass_I.stErr "instance of the UEGO diagnostics of short circuits in the wires of the signal path / Class for short circuit diagnosis to Ub / error detection status of individual fault path." UWORD dez 1 100 0.00 65535.00 FORMAT "%8.2" ECU_ADDRESS 0x6000671C /end MEASUREMENT
/begin MEASUREMENT UEGO_DiagSigWireScS1B1_I.UEGO_DiagSigScb16FltPahResClass_I.stTstdCyc "instance of the UEGO diagnostics of short circuits in the wires of the signal path / Class for short circuit diagnosis to Ub / bitwise status of fault path tested result." UWORD dez 1 100 0.00 65535.00 FORMAT "%8.2" ECU_ADDRESS 0x6000671E /end MEASUREMENT
/begin MEASUREMENT UEGO_DiagSigWireScS1B1_I.UEGO_DiagSigScb16FltPahResClass_I.stTstdCycRprt "instance of the UEGO diagnostics of short circuits in the wires of the signal path / Class for short circuit diagnosis to Ub / bitwise status of fault path tested result with report released." UWORD dez 1 100 0.00 65535.00 FORMAT "%8.2" ECU_ADDRESS 0x60006720 /end MEASUREMENT
/begin MEASUREMENT UEGO_DiagSigWireScS1B1_I.UEGO_DiagSigScg16FltPahResClass_I.stErr "instance of the UEGO diagnostics of short circuits in the wires of the signal path / Class for short circuit diagnosis to Gnd / error detection status of individual fault path." UWORD dez 1 100 0.00 65535.00 FORMAT "%8.2" ECU_ADDRESS 0x60006722 /end MEASUREMENT
/begin MEASUREMENT UEGO_DiagSigWireScS1B1_I.UEGO_DiagSigScg16FltPahResClass_I.stTstdCyc "instance of the UEGO diagnostics of short circuits in the wires of the signal path / Class for short circuit diagnosis to Gnd / bitwise status of fault path tested result." UWORD dez 1 100 0.00 65535.00 FORMAT "%8.2" ECU_ADDRESS 0x60006724 /end MEASUREMENT
/begin MEASUREMENT UEGO_DiagSigWireScS1B1_I.UEGO_DiagSigScg16FltPahResClass_I.stTstdCycRprt "instance of the UEGO diagnostics of short circuits in the wires of the signal path / Class for short circuit diagnosis to Gnd / bitwise status of fault path tested result with report released." UWORD dez 1 100 0.00 65535.00 FORMAT "%8.2" ECU_ADDRESS 0x60006726 /end MEASUREMENT
/begin MEASUREMENT UEGO_flgCmbEngStopDcycEnd "Combustion engine stopped at the end of the driving cycle" UBYTE B_TRUE 1 100 0.00 1.00000000000 BIT_MASK 0x1 FORMAT "%13.11" ECU_ADDRESS 0x6000F07C /end MEASUREMENT
/begin MEASUREMENT UEGO_flgCmbEngTmpStop "Combustion engine temporarliy stopped" UBYTE B_TRUE 1 100 0.00 1.00000000000 BIT_MASK 0x1 FORMAT "%13.11" ECU_ADDRESS 0x6000F07B /end MEASUREMENT
/begin MEASUREMENT UEGO_flgDiagSigCmnIrqVld "Validity of the common IRQ signal" UBYTE B_TRUE 1 100 0.00 1.00000000000 BIT_MASK 0x1 FORMAT "%13.11" ECU_ADDRESS 0x7000073E /end MEASUREMENT
/begin MEASUREMENT UEGO_flgDiagSigGetExtRstReq "External reset request" UBYTE B_TRUE 1 100 0.00 1.00000000000 BIT_MASK 0x1 FORMAT "%13.11" ECU_ADDRESS 0x700000D1 /end MEASUREMENT
/begin MEASUREMENT UEGO_flgDiagSigNewDatS1B1 "New Diagnostics data available" UBYTE B_TRUE 1 100 0.00 1.00000000000 BIT_MASK 0x1 FORMAT "%13.11" ECU_ADDRESS 0x70000739 /end MEASUREMENT
/begin MEASUREMENT UEGO_flgDiagSigOperPlausExtRstReq "External reset request of internal variables" UBYTE B_TRUE 1 100 0.00 1.00000000000 BIT_MASK 0x1 FORMAT "%13.11" ECU_ADDRESS 0x700000CF /end MEASUREMENT
/begin MEASUREMENT UEGO_flgDiagSigRamBnkSpiVldS1B1 "rambank spi error counter is valid s1b1" UBYTE B_TRUE 1 100 0.00 1.00000000000 BIT_MASK 0x1 FORMAT "%13.11" ECU_ADDRESS 0x70000738 /end MEASUREMENT
/begin MEASUREMENT UEGO_flgDiagSigRegBnkSpiS1B1 "spi communcation validity of all the bank register transformations of sensor 1 bank 1." UBYTE B_TRUE 1 100 0.00 1.00000000000 BIT_MASK 0x1 FORMAT "%13.11" ECU_ADDRESS 0x70000737 /end MEASUREMENT
/begin MEASUREMENT UEGO_flgDiagSigRegBnkSpiVldS1B1 "register bank spi erro counter is valid s1b1" UBYTE B_TRUE 1 100 0.00 1.00000000000 BIT_MASK 0x1 FORMAT "%13.11" ECU_ADDRESS 0x70000736 /end MEASUREMENT
/begin MEASUREMENT UEGO_flgDiagSigRegDiagSpiS1B1 "flag for the spi communication of the Diag registers of sensor 1 bank 1" UBYTE B_TRUE 1 100 0.00 1.00000000000 BIT_MASK 0x1 FORMAT "%13.11" ECU_ADDRESS 0x70000735 /end MEASUREMENT
/begin MEASUREMENT UEGO_flgDiagSigRegDiagSpiVldS1B1 "diagregister spi error counter is valid s1b1" UBYTE B_TRUE 1 100 0.00 1.00000000000 BIT_MASK 0x1 FORMAT "%13.11" ECU_ADDRESS 0x70000734 /end MEASUREMENT
/begin MEASUREMENT UEGO_flgDiagSigRegDiagVldS1B1 "UEGO diagnostics of short circuits in the wires of the signal path" UBYTE B_TRUE 1 100 0.00 1.00000000000 BIT_MASK 0x1 FORMAT "%13.11" ECU_ADDRESS 0x70000733 /end MEASUREMENT
/begin MEASUREMENT UEGO_flgDiagSigSnsrExtRstReq "external reset request flag for sensor diagnosis" UBYTE B_TRUE 1 100 0.00 1.00000000000 BIT_MASK 0x1 FORMAT "%13.11" ECU_ADDRESS 0x700000CE /end MEASUREMENT
/begin MEASUREMENT UEGO_flgDiagSigSnsrRstS1B1 "reset of signals contributing to the UEGO sensor diagnosis S1B1" UBYTE B_TRUE 1 100 0.00 1.00000000000 BIT_MASK 0x1 FORMAT "%13.11" ECU_ADDRESS 0x70000732 /end MEASUREMENT
/begin MEASUREMENT UEGO_flgDiagSigSnsrTstdOkS1B1 "UEGO sensor diagnostic tested without fault results S1B1" UBYTE B_TRUE 1 100 0.00 1.00000000000 BIT_MASK 0x1 FORMAT "%13.11" ECU_ADDRESS 0x70000731 /end MEASUREMENT
/begin MEASUREMENT UEGO_flgDiagSigWireOlExtRstReq "External reset request flag of internal variables for open load wire diagnosis" UBYTE B_TRUE 1 100 0.00 1.00000000000 BIT_MASK 0x1 FORMAT "%13.11" ECU_ADDRESS 0x700000CD /end MEASUREMENT
/begin MEASUREMENT UEGO_flgDiagSigWireOlRstS1B1 "reset of signals contributing to the UEGO wire circuit continuity diagnosis sensor 1 bank 1" UBYTE B_TRUE 1 100 0.00 1.00000000000 BIT_MASK 0x1 FORMAT "%13.11" ECU_ADDRESS 0x70000730 /end MEASUREMENT
/begin MEASUREMENT UEGO_flgDiagSigWireOlTstdOkS1B1 "UEGO wire circuit continuity diagnostic tested without fault sensor 1 bank 1" UBYTE B_TRUE 1 100 0.00 1.00000000000 BIT_MASK 0x1 FORMAT "%13.11" ECU_ADDRESS 0x7000072F /end MEASUREMENT
/begin MEASUREMENT UEGO_flgDiagSigWireScExtRstReq "external reset request flag for short circuit wire diagnosis" UBYTE B_TRUE 1 100 0.00 1.00000000000 BIT_MASK 0x1 FORMAT "%13.11" ECU_ADDRESS 0x700000CC /end MEASUREMENT
/begin MEASUREMENT UEGO_flgDiagSigWireScRstS1B1 "The request for reset of signals contributing to short circuit diagnosis sensor 1 bank1." UBYTE B_TRUE 1 100 0.00 1.00000000000 BIT_MASK 0x1 FORMAT "%13.11" ECU_ADDRESS 0x7000072E /end MEASUREMENT
/begin MEASUREMENT UEGO_flgDiagSigWireScTstdOkS1B1 "The status of short circuit diagnosis test result in current sub-mode sensor 1 bank 1" UBYTE B_TRUE 1 100 0.00 1.00000000000 BIT_MASK 0x1 FORMAT "%13.11" ECU_ADDRESS 0x7000072D /end MEASUREMENT
/begin MEASUREMENT UEGO_flgEngRunng "engine running" UBYTE B_TRUE 1 100 0.00 1.00000000000 BIT_MASK 0x1 FORMAT "%13.11" ECU_ADDRESS 0x6000F078 /end MEASUREMENT
/begin MEASUREMENT UEGO_flgEngRunngIdleInt "Engine is running with idle mode" UBYTE B_TRUE 1 100 0.00 1.00000000000 BIT_MASK 0x1 FORMAT "%13.11" ECU_ADDRESS 0x6000AD5A /end MEASUREMENT
/begin MEASUREMENT UEGO_flgEomIdle "engine idle phase" UBYTE B_TRUE 1 100 0.00 1.00000000000 BIT_MASK 0x1 FORMAT "%13.11" ECU_ADDRESS 0x6000F076 /end MEASUREMENT
/begin MEASUREMENT UEGO_flgErrSpiRamBnk10msS1B1 "SPI error of the RAM bank (detected in 10ms raster) of the ASIC of sensor 1 bank 1" UBYTE B_TRUE 1 100 0.00 1.00000000000 BIT_MASK 0x1 FORMAT "%13.11" ECU_ADDRESS 0x7000072B /end MEASUREMENT
/begin MEASUREMENT UEGO_flgErrSpiRamBnk5msS1B1 "SPI error of the RAM bank (detected in 5ms raster) of the ASIC of sensor 1 bank 1" UBYTE B_TRUE 1 100 0.00 1.00000000000 BIT_MASK 0x1 FORMAT "%13.11" ECU_ADDRESS 0x700000D0 /end MEASUREMENT
/begin MEASUREMENT UEGO_flgHeatgOffS1B1 "The lambda sensor heater is considered OFF, Sensor 1 Bank 1" UBYTE B_TRUE 1 100 0.00 1.00000000000 BIT_MASK 0x1 FORMAT "%13.11" ECU_ADDRESS 0x7000072A /end MEASUREMENT
/begin MEASUREMENT UEGO_flgHeatrClcActvS1B1 "Heater closed loop control is active" UBYTE B_TRUE 1 100 0.00 1.00000000000 BIT_MASK 0x1 FORMAT "%13.11" ECU_ADDRESS 0x70000729 /end MEASUREMENT
/begin MEASUREMENT UEGO_flgHeatrCtrldModActvS1B1 "Indicates that the controlled heater mode is active, that is heating up has begun or is already finished for sensor S1B1" UBYTE B_TRUE 1 100 0.00 1.00000000000 BIT_MASK 0x1 FORMAT "%13.11" ECU_ADDRESS 0x70000728 /end MEASUREMENT
/begin MEASUREMENT UEGO_flgHeatrPwrStgCtrlMaxS1B1 "Demanded heater voltage exceeds maximum possible by power stage -- voltage limitation" UBYTE B_TRUE 1 100 0.00 1.00000000000 BIT_MASK 0x1 FORMAT "%13.11" ECU_ADDRESS 0x70000727 /end MEASUREMENT
/begin MEASUREMENT UEGO_flgHeatrPwrStgOffS1B1 "Heater power stage switched off sensor 1 bank 1" UBYTE B_TRUE 1 100 0.00 1.00000000000 BIT_MASK 0x1 FORMAT "%13.11" ECU_ADDRESS 0x70000726 /end MEASUREMENT
/begin MEASUREMENT UEGO_flgHeatrRlyActvS1B1 "Relay for heater of lambda sensor switched on; sensor 1, bank 1" UBYTE B_TRUE 1 100 0.00 1.00000000000 BIT_MASK 0x1 FORMAT "%13.11" ECU_ADDRESS 0x6000F070 /end MEASUREMENT
/begin MEASUREMENT UEGO_flgHeatrRlyPsCtrlExtRstReq "external reset request for Heater relay power stage control" UBYTE B_TRUE 1 100 0.00 1.00000000000 BIT_MASK 0x1 FORMAT "%13.11" ECU_ADDRESS 0x6000AD57 /end MEASUREMENT
/begin MEASUREMENT UEGO_flgHeatrRlyPsDiagExtRstReq "external reset request for Heater relay power stage diagnosis" UBYTE B_TRUE 1 100 0.00 1.00000000000 BIT_MASK 0x1 FORMAT "%13.11" ECU_ADDRESS 0x6000AD55 /end MEASUREMENT
/begin MEASUREMENT UEGO_flgHiIsqCalcnCmplS1B1 "Status of HiIsq current is applied to the senor and finsihed its first calculation for sensor 1 Bank 1" UBYTE B_TRUE 1 100 0.00 1.00000000000 BIT_MASK 0x1 FORMAT "%13.11" ECU_ADDRESS 0x70000725 /end MEASUREMENT
/begin MEASUREMENT UEGO_flgINernstPinVldS1B1 "validity flag for effective nernst-cell-currents by clamping and switching effects sensor 1 bank 1" UBYTE B_TRUE 1 100 0.00 1.00000000000 BIT_MASK 0x1 FORMAT "%13.11" ECU_ADDRESS 0x70000724 /end MEASUREMENT
/begin MEASUREMENT UEGO_flgIPmpPinVldS1B1 "validity flag for effective pump-cell-currents by clamping and switching effects sensor 1 bank 1" UBYTE B_TRUE 1 100 0.00 1.00000000000 BIT_MASK 0x1 FORMAT "%13.11" ECU_ADDRESS 0x7000071A /end MEASUREMENT
/begin MEASUREMENT UEGO_flgIsoApeVldS1B1 "Status of Shunt Resistance, Voltages, and current are calculated at sensor line APE for Sensor 1 Bank 1" UBYTE B_TRUE 1 100 0.00 1.00000000000 BIT_MASK 0x1 FORMAT "%13.11" ECU_ADDRESS 0x70000714 /end MEASUREMENT
/begin MEASUREMENT UEGO_flgIsoIpeVldS1B1 "Status of Shunt Resistance, Voltages, and current are calculated at sensor line IPE for Sensor 1 Bank 1" UBYTE B_TRUE 1 100 0.00 1.00000000000 BIT_MASK 0x1 FORMAT "%13.11" ECU_ADDRESS 0x70000713 /end MEASUREMENT
/begin MEASUREMENT UEGO_flgIsoReVldS1B1 "Status of Shunt Resistance, Voltages, and current are calculated at sensor line RE for Sensor 1 Bank 1" UBYTE B_TRUE 1 100 0.00 1.00000000000 BIT_MASK 0x1 FORMAT "%13.11" ECU_ADDRESS 0x70000712 /end MEASUREMENT
/begin MEASUREMENT UEGO_flgNSyncn "Condition pump current sync filter is active" UBYTE B_TRUE 1 100 0.00 1.00000000000 BIT_MASK 0x1 FORMAT "%13.11" ECU_ADDRESS 0x6000F06D /end MEASUREMENT
/begin MEASUREMENT UEGO_flgRatIFltApeScVldS1B1 "Status of ratio Failure current at sensor line APE for Sensor 1 Bank 1" UBYTE B_TRUE 1 100 0.00 1.00000000000 BIT_MASK 0x1 FORMAT "%13.11" ECU_ADDRESS 0x700006F1 /end MEASUREMENT
/begin MEASUREMENT UEGO_flgRatIFltIpeScVldS1B1 "Status of ratio Failure current at sensor line IPE for Sensor 1 Bank 1" UBYTE B_TRUE 1 100 0.00 1.00000000000 BIT_MASK 0x1 FORMAT "%13.11" ECU_ADDRESS 0x700006F0 /end MEASUREMENT
/begin MEASUREMENT UEGO_flgRatIFltReScVldS1B1 "Status of ratio Failure current at sensor line RE due to short circuit at Sensor 1 Bank 1" UBYTE B_TRUE 1 100 0.00 1.00000000000 BIT_MASK 0x1 FORMAT "%13.11" ECU_ADDRESS 0x700006EF /end MEASUREMENT
/begin MEASUREMENT UEGO_flgScavActv "Engine is running with scavenging" UBYTE B_TRUE 1 100 0.00 1.00000000000 BIT_MASK 0x1 FORMAT "%13.11" ECU_ADDRESS 0x6000AD59 /end MEASUREMENT
/begin MEASUREMENT UEGO_flgUScApeVldS1B1 "Validity flag for calculated short circuit voltage at Ape" UBYTE B_TRUE 1 100 0.00 1.00000000000 BIT_MASK 0x1 FORMAT "%13.11" ECU_ADDRESS 0x700006D9 /end MEASUREMENT
/begin MEASUREMENT UEGO_flgUScIpeVldS1B1 "Validity flag for calculated short circuit voltage at Ipe" UBYTE B_TRUE 1 100 0.00 1.00000000000 BIT_MASK 0x1 FORMAT "%13.11" ECU_ADDRESS 0x700006D8 /end MEASUREMENT
/begin MEASUREMENT UEGO_flgUScReVldS1B1 "Validity flag for calculated short circuit voltage at Re" UBYTE B_TRUE 1 100 0.00 1.00000000000 BIT_MASK 0x1 FORMAT "%13.11" ECU_ADDRESS 0x700006D7 /end MEASUREMENT
/begin MEASUREMENT UEGO_HeatrCtrlS1B1_I.cntrReiniCalc20ms "Instance S1B1 of heater control class / Counter of interrupted postdrives per driving cycle" UBYTE OneToOne 1 100 0.00 255.0 FORMAT "%5.1" ECU_ADDRESS 0x600022D6 /end MEASUREMENT
/begin MEASUREMENT UEGO_HeatrCtrlS1B1_I.flgClcLimd "Instance S1B1 of heater control class / Heater controller is in limitation because demanded heater voltage exceeds maximum voltage allowed for the sensor type" UBYTE B_TRUE 1 100 0.00 1.00000000000 BIT_MASK 0x4 FORMAT "%13.11" ECU_ADDRESS 0x600022D4 /end MEASUREMENT
/begin MEASUREMENT UEGO_HeatrCtrlS1B1_I.flgCrvPhaFinshd "Instance S1B1 of heater control class / Open loop curve phase has finished" UBYTE B_TRUE 1 100 0.00 1.00000000000 BIT_MASK 0x8 FORMAT "%13.11" ECU_ADDRESS 0x600022D4 /end MEASUREMENT
/begin MEASUREMENT UEGO_HeatrCtrlS1B1_I.flgHeatgOff "Instance S1B1 of heater control class / Flag shows if the heater is considered as OFF" UBYTE B_TRUE 1 100 0.00 1.00000000000 BIT_MASK 0x1 FORMAT "%13.11" ECU_ADDRESS 0x600022D7 /end MEASUREMENT
/begin MEASUREMENT UEGO_HeatrCtrlS1B1_I.flgHeatgUpFinshd "Instance S1B1 of heater control class / the open loop heating up phase has finished" UBYTE B_TRUE 1 100 0.00 1.00000000000 BIT_MASK 0x8 FORMAT "%13.11" ECU_ADDRESS 0x600022D5 /end MEASUREMENT
/begin MEASUREMENT UEGO_HeatrCtrlS1B1_I.flgHeatgUpRgl "Instance S1B1 of heater control class / Regular heating up is released" UBYTE B_TRUE 1 100 0.00 1.00000000000 BIT_MASK 0x2 FORMAT "%13.11" ECU_ADDRESS 0x600022D4 /end MEASUREMENT
/begin MEASUREMENT UEGO_HeatrCtrlS1B1_I.flgHeatrClcActv "Instance S1B1 of heater control class / Heater closed loop control is active" UBYTE B_TRUE 1 100 0.00 1.00000000000 BIT_MASK 0x1 FORMAT "%13.11" ECU_ADDRESS 0x600022D8 /end MEASUREMENT
/begin MEASUREMENT UEGO_HeatrCtrlS1B1_I.flgHeatrCtrlReduced "Instance S1B1 of heater control class / reduced mode is active because of wire errors at nernst cell" UBYTE B_TRUE 1 100 0.00 1.00000000000 BIT_MASK 0x40 FORMAT "%13.11" ECU_ADDRESS 0x600022D4 /end MEASUREMENT
/begin MEASUREMENT UEGO_HeatrCtrlS1B1_I.flgHeatrCtrldModActv "Instance S1B1 of heater control class / The heater controller is in regular mode" UBYTE B_TRUE 1 100 0.00 1.00000000000 BIT_MASK 0x1 FORMAT "%13.11" ECU_ADDRESS 0x600022D9 /end MEASUREMENT
/begin MEASUREMENT UEGO_HeatrCtrlS1B1_I.flgHeatrPwrStgOffLong "Instance S1B1 of heater control class / powerstage off for a while" UBYTE B_TRUE 1 100 0.00 1.00000000000 BIT_MASK 0x80 FORMAT "%13.11" ECU_ADDRESS 0x600022D4 /end MEASUREMENT
/begin MEASUREMENT UEGO_HeatrCtrlS1B1_I.flgHldPhaFinshd "Instance S1B1 of heater control class / open loop hold phase has finished" UBYTE B_TRUE 1 100 0.00 1.00000000000 BIT_MASK 0x1 FORMAT "%13.11" ECU_ADDRESS 0x600022D5 /end MEASUREMENT
/begin MEASUREMENT UEGO_HeatrCtrlS1B1_I.flgPrePostHeatgDisad "Instance S1B1 of heater control class / protection heating in the current driving mode (postdrive or before engine start) is disabled" UBYTE B_TRUE 1 100 0.00 1.00000000000 BIT_MASK 0x2 FORMAT "%13.11" ECU_ADDRESS 0x600022D5 /end MEASUREMENT
/begin MEASUREMENT UEGO_HeatrCtrlS1B1_I.flgRampPhaFinshd "Instance S1B1 of heater control class / open loop ramp phase has finished" UBYTE B_TRUE 1 100 0.00 1.00000000000 BIT_MASK 0x4 FORMAT "%13.11" ECU_ADDRESS 0x600022D5 /end MEASUREMENT
/begin MEASUREMENT UEGO_HeatrCtrlS1B1_I.flgSysDsbc "Instance S1B1 of heater control class / anti windup measure have to be performed because demanded heater voltage exceeds possible heater voltage" UBYTE B_TRUE 1 100 0.00 1.00000000000 BIT_MASK 0x10 FORMAT "%13.11" ECU_ADDRESS 0x600022D5 /end MEASUREMENT
/begin MEASUREMENT UEGO_HeatrCtrlS1B1_I.nrModInt "Instance S1B1 of heater control class / internal mode of heater controller" UBYTE UEGO_HeatrCtrlModInt_COMPU_VERB 1 100 0.00 10.0000000000 FORMAT "%13.10" ECU_ADDRESS 0x600022DA /end MEASUREMENT
/begin MEASUREMENT UEGO_HeatrCtrlS1B1_I.nrModIntOld "Instance S1B1 of heater control class / internal mode of heater controller from last computation raster" UBYTE UEGO_HeatrCtrlModInt_COMPU_VERB 1 100 0.00 10.0000000000 FORMAT "%13.10" ECU_ADDRESS 0x600022DB /end MEASUREMENT
/begin MEASUREMENT UEGO_HeatrCtrlS1B1_I.tDe "Instance S1B1 of heater control class / current sensor temperature deviation from setpoint" SWORD temp_q0p0234 1 100 -768.0000 767.9766 FORMAT "%8.4" ECU_ADDRESS 0x600022DC /end MEASUREMENT
/begin MEASUREMENT UEGO_HeatrCtrlS1B1_I.tDeOld "Instance S1B1 of heater control class / sensor temperature deviation from last driving cycle" SWORD temp_q0p0234 1 100 -768.0000 767.9766 FORMAT "%8.4" ECU_ADDRESS 0x600022DE /end MEASUREMENT
/begin MEASUREMENT UEGO_HeatrCtrlS1B1_I.uClcKd "Instance S1B1 of heater control class / demanded effective heater voltage - differential part" SWORD spg_q0p005 1 100 -163.8400 163.8350 FORMAT "%8.4" ECU_ADDRESS 0x600022E0 /end MEASUREMENT
/begin MEASUREMENT UEGO_HeatrCtrlS1B1_I.uClcKi "Instance S1B1 of heater control class / demanded effective heater voltage - integral part" UWORD spg_q0p005 1 100 0.00 327.6750 FORMAT "%8.4" ECU_ADDRESS 0x600022E2 /end MEASUREMENT
/begin MEASUREMENT UEGO_HeatrCtrlS1B1_I.uClcKp "Instance S1B1 of heater control class / demanded effective heater voltage - proportional part" SWORD spg_q0p005 1 100 -163.8400 163.8350 FORMAT "%8.4" ECU_ADDRESS 0x600022E4 /end MEASUREMENT
/begin MEASUREMENT UEGO_HeatrCtrlS1B1_I.uClcTot "Instance S1B1 of heater control class / Voltage computed by PID - controller before limitation" UWORD spg_q0p005 1 100 0.00 327.6750 FORMAT "%8.4" ECU_ADDRESS 0x600022E6 /end MEASUREMENT
/begin MEASUREMENT UEGO_HeatrCtrlS1B1_I.uHeatrCtrlEfc "Instance S1B1 of heater control class / demanded effective heater voltage" UWORD spg_q0p005 1 100 0.00 327.6750 FORMAT "%8.4" ECU_ADDRESS 0x600022E8 /end MEASUREMENT
/begin MEASUREMENT UEGO_HeatrCtrlS1B1_I.uHldPhaEfc "Instance S1B1 of heater control class / Demanded effective heater voltage during hold phase" UWORD spg_q0p005 1 100 0.00 327.6750 FORMAT "%8.4" ECU_ADDRESS 0x600022EA /end MEASUREMENT
/begin MEASUREMENT UEGO_HeatrCtrlS1B1_I.ClcIntglITL_I.memory "Instance S1B1 of heater control class / Integrator for I - part of PID controller / current integrator value" ULONG fak_uw_b0p005 1 100 0.00 327.679999924 FORMAT "%13.9" ECU_ADDRESS 0x600022EC /end MEASUREMENT
/begin MEASUREMENT UEGO_HeatrCtrlS1B1_I.flgPwrStgOffTONV_I.outbit "Instance S1B1 of heater control class / TONV_I powerstage off for a while / return value" UBYTE B_TRUE 1 100 0.00 1.00000000000 BIT_MASK 0x1 FORMAT "%13.11" ECU_ADDRESS 0x600022F0 /end MEASUREMENT
/begin MEASUREMENT UEGO_HeatrCtrlS1B1_I.flgPwrStgOffTONV_I.time "Instance S1B1 of heater control class / TONV_I powerstage off for a while / expired delay time" UBYTE t_q0p02 1 100 0.00 5.100 FORMAT "%5.3" ECU_ADDRESS 0x600022F1 /end MEASUREMENT
/begin MEASUREMENT UEGO_HeatrCtrlS1B1_I.ratSqUBattSqUEfcA_I.memory "Instance S1B1 of heater control class / accumulated ratio of squared battery voltage to squared demanded effective heater voltage / Accumulator" SLONG spg_q0p005 1 100 -10737418.2400 10737418.2350 FORMAT "%13.4" ECU_ADDRESS 0x600022F4 /end MEASUREMENT
/begin MEASUREMENT UEGO_HeatrCtrlS1B1_I.tiCrvPhaSW_I.timeCounter "Instance S1B1 of heater control class / Timer for duration of open loop curve phase / expired time since start" UWORD t_q0p02 1 100 0.00 1310.700 FORMAT "%8.3" ECU_ADDRESS 0x600022F8 /end MEASUREMENT
/begin MEASUREMENT UEGO_HeatrCtrlS1B1_I.tiExtdPhaSW_I.timeCounter "Instance S1B1 of heater control class / Timer for open loop extended phase / expired time since start" UWORD t_q0p02 1 100 0.00 1310.700 FORMAT "%8.3" ECU_ADDRESS 0x600022FA /end MEASUREMENT
/begin MEASUREMENT UEGO_HeatrCtrlS1B1_I.tiHldPhaSW_I.timeCounter "Instance S1B1 of heater control class / Timer for open loop hold phase / expired time since start" UWORD t_q0p02 1 100 0.00 1310.700 FORMAT "%8.3" ECU_ADDRESS 0x600022FC /end MEASUREMENT
/begin MEASUREMENT UEGO_HeatrCtrlS1B1_I.uRampITL_I.memory "Instance S1B1 of heater control class / Integrator for voltage output during open loop ramp phase / current integrator value" ULONG fak_uw_b0p005 1 100 0.00 327.679999924 FORMAT "%13.9" ECU_ADDRESS 0x60002300 /end MEASUREMENT
/begin MEASUREMENT UEGO_HeatrPwrStgCtrlS1B1_I.flgHeatrPwrStgCtrlMax "Heater power stage control sensor 1 bank 1 / Power stage is in limitation" UBYTE B_TRUE 1 100 0.00 1.00000000000 BIT_MASK 0x1 FORMAT "%13.11" ECU_ADDRESS 0x60006704 /end MEASUREMENT
/begin MEASUREMENT UEGO_HeatrPwrStgCtrlS1B1_I.flgHeatrPwrStgOff "Heater power stage control sensor 1 bank 1 / Power stage is turned off" UBYTE B_TRUE 1 100 0.00 1.00000000000 BIT_MASK 0x1 FORMAT "%13.11" ECU_ADDRESS 0x60006705 /end MEASUREMENT
/begin MEASUREMENT UEGO_HeatrPwrStgCtrlS1B1_I.ratHeatrPwrStgCtrl "Heater power stage control sensor 1 bank 1 / demanded duty cycle" UWORD rel_q0p003052 1 100 0.00 199.9969 FORMAT "%8.4" ECU_ADDRESS 0x60006706 /end MEASUREMENT
/begin MEASUREMENT UEGO_HeatrPwrStgCtrlS1B1_I.ratHeatrSnsrAct "Heater power stage control sensor 1 bank 1 / actual duty cycle" UWORD rel_q0p003052 1 100 0.00 199.9969 FORMAT "%8.4" ECU_ADDRESS 0x60006708 /end MEASUREMENT
/begin MEASUREMENT UEGO_HeatrPwrStgCtrlS1B1_I.ratReqd "Heater power stage control sensor 1 bank 1 / duty cycle computed for demanded heater voltage" UWORD rel_q0p003052 1 100 0.00 199.9969 FORMAT "%8.4" ECU_ADDRESS 0x6000670A /end MEASUREMENT
/begin MEASUREMENT UEGO_HeatrRlyPSCtrlS1B1_I.flgHeatrRlyActv "Instance of class UEGO_HeatrRlyPSCtrl / Relay for heater of lambda sensor active" UBYTE B_TRUE 1 100 0.00 1.00000000000 BIT_MASK 0x1 FORMAT "%13.11" ECU_ADDRESS 0x60006702 /end MEASUREMENT
/begin MEASUREMENT UEGO_HeatrRlyPSCtrlS1B1_I.stHeatrRlyTONVNM_I.time "Instance of class UEGO_HeatrRlyPSCtrl / Status TurnOn Delay / Delay Time" UBYTE t_q0p01 1 100 0.00 2.550 FORMAT "%5.3" ECU_ADDRESS 0x60006703 /end MEASUREMENT
/begin MEASUREMENT UEGO_HeatrRlyPsDiagS1B1_I.cntrTestPls "Instance of UEGO_HeatrRlyPsDiag Class / Counter for test pulses" UBYTE OneToOne 1 100 0.00 255.0 FORMAT "%5.1" ECU_ADDRESS 0x600066FA /end MEASUREMENT
/begin MEASUREMENT UEGO_HeatrRlyPsDiagS1B1_I.flgDSMClrReq "Instance of UEGO_HeatrRlyPsDiag Class / Clear of Faul Memory activ" UBYTE B_TRUE 1 100 0.00 1.00000000000 BIT_MASK 0x1 FORMAT "%13.11" ECU_ADDRESS 0x600066FB /end MEASUREMENT
/begin MEASUREMENT UEGO_HeatrRlyPsDiagS1B1_I.flgDiagEna "Instance of UEGO_HeatrRlyPsDiag Class / diagnosis enable" UBYTE B_TRUE 1 100 0.00 1.00000000000 BIT_MASK 0x1 FORMAT "%13.11" ECU_ADDRESS 0x600066FC /end MEASUREMENT
/begin MEASUREMENT UEGO_HeatrRlyPsDiagS1B1_I.flgRlyDiagRels "Instance of UEGO_HeatrRlyPsDiag Class / Diagnosis powerstage relay heater lambda sensor released" UBYTE B_TRUE 1 100 0.00 1.00000000000 BIT_MASK 0x1 FORMAT "%13.11" ECU_ADDRESS 0x600066FD /end MEASUREMENT
/begin MEASUREMENT UEGO_HeatrRlyPsDiagS1B1_I.flgRlyErrOL "Instance of UEGO_HeatrRlyPsDiag Class / Fault open line (OL) powerstage relay heater lambda sensor" UBYTE B_TRUE 1 100 0.00 1.00000000000 BIT_MASK 0x1 FORMAT "%13.11" ECU_ADDRESS 0x600066FE /end MEASUREMENT
/begin MEASUREMENT UEGO_HeatrRlyPsDiagS1B1_I.flgRlyErrSCB "Instance of UEGO_HeatrRlyPsDiag Class / Fault short circuit to battery (SCB) powerstage relay heater lambda sensor" UBYTE B_TRUE 1 100 0.00 1.00000000000 BIT_MASK 0x1 FORMAT "%13.11" ECU_ADDRESS 0x600066FF /end MEASUREMENT
/begin MEASUREMENT UEGO_HeatrRlyPsDiagS1B1_I.flgRlyErrSCG "Instance of UEGO_HeatrRlyPsDiag Class / Fault short circuit to ground (SCG) powerstage relay heater lambda sensor" UBYTE B_TRUE 1 100 0.00 1.00000000000 BIT_MASK 0x1 FORMAT "%13.11" ECU_ADDRESS 0x60006700 /end MEASUREMENT
/begin MEASUREMENT UEGO_HeatrRlyPsDiagS1B1_I.flgRlyIniEnd "Instance of UEGO_HeatrRlyPsDiag Class / Initialisation diagnosis powerstage relay heater lambda sensor successful" UBYTE B_TRUE 1 100 0.00 1.00000000000 BIT_MASK 0x1 FORMAT "%13.11" ECU_ADDRESS 0x60006701 /end MEASUREMENT
/begin MEASUREMENT UEGO_iIsoApeS1B1 "Shunt current on wire Ape, sensor 1 bank 1" SWORD i_q6p6667Em7_A 1 100 -0.02184533 0.02184467 FORMAT "%10.8" ECU_ADDRESS 0x60008E96 /end MEASUREMENT
/begin MEASUREMENT UEGO_iIsoIpeS1B1 "Shunt current on wire Ipe, sensor 1 bank 1" SWORD i_q6p6667Em7_A 1 100 -0.02184533 0.02184467 FORMAT "%10.8" ECU_ADDRESS 0x60008E94 /end MEASUREMENT
/begin MEASUREMENT UEGO_iIsoReS1B1 "Shunt current on wire Re, sensor 1 bank 1" SWORD i_q6p6667Em7_A 1 100 -0.02184533 0.02184467 FORMAT "%10.8" ECU_ADDRESS 0x60008E92 /end MEASUREMENT
/begin MEASUREMENT UEGO_iNernstPinS1B1 "effective nernst-cell-currents by clamping and switching effects sensor 1 bank 1" SWORD i_q6p6667Em7_A 1 100 -0.02184533 0.02184467 FORMAT "%10.8" ECU_ADDRESS 0x60008E80 /end MEASUREMENT
/begin MEASUREMENT UEGO_IPinCtrlS1B1_I.flgMkSetVld "Class instance of the functional class of FC UEGO_IPin for the control-part for Bank 1 Sensor 1 / indicator for successful setting of the MK-register" UBYTE B_TRUE 1 100 0.00 1.00000000000 BIT_MASK 0x4 FORMAT "%13.11" ECU_ADDRESS 0x600066F6 /end MEASUREMENT
/begin MEASUREMENT UEGO_IPinCtrlS1B1_I.nrModIntMK "Class instance of the functional class of FC UEGO_IPin for the control-part for Bank 1 Sensor 1 / numerical indication for the currently active control state (MK)" UBYTE UEGO_MKRegIPin_COMPU_VERB 1 100 0.00 3.00000000000 FORMAT "%13.11" ECU_ADDRESS 0x600066F7 /end MEASUREMENT
/begin MEASUREMENT UEGO_IPinCtrlS1B1_I.nrModIntMKOld "Class instance of the functional class of FC UEGO_IPin for the control-part for Bank 1 Sensor 1 / numerical indication for the previously active control state (MK)" UBYTE UEGO_MKRegIPin_COMPU_VERB 1 100 0.00 3.00000000000 FORMAT "%13.11" ECU_ADDRESS 0x600066F8 /end MEASUREMENT
/begin MEASUREMENT UEGO_IPinEvlnS1B1_I.flgINernstPinVld "Class instance of the functional class of FC UEGO_IPin for the evaluation-part for Bank 1 Sensor 1 / validity for effective nernst-cell-currents by clamping and switching effects" UBYTE B_TRUE 1 100 0.00 1.00000000000 BIT_MASK 0x1 FORMAT "%13.11" ECU_ADDRESS 0x600022B8 /end MEASUREMENT
/begin MEASUREMENT UEGO_IPinEvlnS1B1_I.flgIPmpPinVld "Class instance of the functional class of FC UEGO_IPin for the evaluation-part for Bank 1 Sensor 1 / validity for effective Pump-cell-currents by clamping and switching effects" UBYTE B_TRUE 1 100 0.00 1.00000000000 BIT_MASK 0x1 FORMAT "%13.11" ECU_ADDRESS 0x600022B9 /end MEASUREMENT
/begin MEASUREMENT UEGO_IPinEvlnS1B1_I.flgSwtNernstVld "Class instance of the functional class of FC UEGO_IPin for the evaluation-part for Bank 1 Sensor 1 / validity for effective Nernst-cell-currents by switching effects" UBYTE B_TRUE 1 100 0.00 1.00000000000 BIT_MASK 0x1 FORMAT "%13.11" ECU_ADDRESS 0x600022BA /end MEASUREMENT
/begin MEASUREMENT UEGO_IPinEvlnS1B1_I.flgSwtPmpVld "Class instance of the functional class of FC UEGO_IPin for the evaluation-part for Bank 1 Sensor 1 / validity for effective Pump-cell-currents by switching effects" UBYTE B_TRUE 1 100 0.00 1.00000000000 BIT_MASK 0x1 FORMAT "%13.11" ECU_ADDRESS 0x600022BB /end MEASUREMENT
/begin MEASUREMENT UEGO_IPinEvlnS1B1_I.iNernstPin "Class instance of the functional class of FC UEGO_IPin for the evaluation-part for Bank 1 Sensor 1 / intern value effective nernst-cell-currents by clamping and switching effects" SWORD i_q6p6667Em7_A 1 100 -0.02184533 0.02184467 FORMAT "%10.8" ECU_ADDRESS 0x600022BC /end MEASUREMENT
/begin MEASUREMENT UEGO_IPinEvlnS1B1_I.iPmpPin "Class instance of the functional class of FC UEGO_IPin for the evaluation-part for Bank 1 Sensor 1 / intern value effective pump-cell-currents by clamping and switching effects" SWORD i_q6p6667Em7_A 1 100 -0.02184533 0.02184467 FORMAT "%10.8" ECU_ADDRESS 0x600022BE /end MEASUREMENT
/begin MEASUREMENT UEGO_IPinEvlnS1B1_I.iSwtNernst "Class instance of the functional class of FC UEGO_IPin for the evaluation-part for Bank 1 Sensor 1 / intern single value effective nernst-cell-currents by switching effects" SWORD i_q6p6667Em7_A 1 100 -0.02184533 0.02184467 FORMAT "%10.8" ECU_ADDRESS 0x600022C0 /end MEASUREMENT
/begin MEASUREMENT UEGO_IPinEvlnS1B1_I.iSwtNernstEfc "Class instance of the functional class of FC UEGO_IPin for the evaluation-part for Bank 1 Sensor 1 / intern value effective nernst-cell-currents by switching effects" SWORD i_q6p6667Em7_A 1 100 -0.02184533 0.02184467 FORMAT "%10.8" ECU_ADDRESS 0x600022C2 /end MEASUREMENT
/begin MEASUREMENT UEGO_IPinEvlnS1B1_I.iSwtNernstEfcSum "Class instance of the functional class of FC UEGO_IPin for the evaluation-part for Bank 1 Sensor 1 / intern sum-value effective nernst-cell-currents by switching effects" SLONG i_q6p6667Em7_A 1 100 -1431.65576533 1431.65576467 FORMAT "%13.8" ECU_ADDRESS 0x600022C4 /end MEASUREMENT
/begin MEASUREMENT UEGO_IPinEvlnS1B1_I.iSwtPmp "Class instance of the functional class of FC UEGO_IPin for the evaluation-part for Bank 1 Sensor 1 / intern single value effective pump-cell-currents by switching effects" SWORD i_q6p6667Em7_A 1 100 -0.02184533 0.02184467 FORMAT "%10.8" ECU_ADDRESS 0x600022C8 /end MEASUREMENT
/begin MEASUREMENT UEGO_IPinEvlnS1B1_I.iSwtPmpEfc "Class instance of the functional class of FC UEGO_IPin for the evaluation-part for Bank 1 Sensor 1 / intern value effective pump-cell-currents by switching effects" SWORD i_q6p6667Em7_A 1 100 -0.02184533 0.02184467 FORMAT "%10.8" ECU_ADDRESS 0x600022CA /end MEASUREMENT
/begin MEASUREMENT UEGO_IPinEvlnS1B1_I.iSwtPmpEfcSum "Class instance of the functional class of FC UEGO_IPin for the evaluation-part for Bank 1 Sensor 1 / intern sum-value effective pump-cell-currents by switching effects" SLONG i_q6p6667Em7_A 1 100 -1431.65576533 1431.65576467 FORMAT "%13.8" ECU_ADDRESS 0x600022CC /end MEASUREMENT
/begin MEASUREMENT UEGO_IPinEvlnS1B1_I.nrModIntEvalSwt "Class instance of the functional class of FC UEGO_IPin for the evaluation-part for Bank 1 Sensor 1 / numerical indication for the currently active evaluation switching-state" UBYTE UEGO_ModIPinEvalSwt_COMPU_VERB 1 100 1.0000000000 13.0000000000 FORMAT "%13.10" ECU_ADDRESS 0x600022D0 /end MEASUREMENT
/begin MEASUREMENT UEGO_IPinEvlnS1B1_I.nrModIntEvalSwtOld "Class instance of the functional class of FC UEGO_IPin for the evaluation-part for Bank 1 Sensor 1 / numerical indication for the previously active evaluation switching-state" UBYTE UEGO_ModIPinEvalSwt_COMPU_VERB 1 100 1.0000000000 13.0000000000 FORMAT "%13.10" ECU_ADDRESS 0x600022D1 /end MEASUREMENT
/begin MEASUREMENT UEGO_IPinEvlnS1B1_I.stTM "Class instance of the functional class of FC UEGO_IPin for the evaluation-part for Bank 1 Sensor 1 / Timing mode of CJ135" UBYTE OneToOne 1 100 0.00 255.0 FORMAT "%5.1" ECU_ADDRESS 0x600022D2 /end MEASUREMENT
/begin MEASUREMENT UEGO_iPmpPinS1B1 "effective pump-cell-currents by clamping and switching effects" SWORD i_q6p6667Em7_A 1 100 -0.02184533 0.02184467 FORMAT "%10.8" ECU_ADDRESS 0x60008E78 /end MEASUREMENT
/begin MEASUREMENT UEGO_nrModCurrS1B1 "Current mode of the ASIC of sensor 1 bank 1" UBYTE dez 1 100 0.00 255.0 FORMAT "%5.1" ECU_ADDRESS 0x6000F324 /end MEASUREMENT
/begin MEASUREMENT UEGO_numModCurrS1B1 "Current mode of the ASIC of sensor 1 bank 1" UBYTE dez 1 100 0.00 255.0 FORMAT "%5.1" ECU_ADDRESS 0x6000F31E /end MEASUREMENT
/begin MEASUREMENT UEGO_ratHeatrPwrStgCtrlS1B1 "Duty cycle control powerstage heater sensor 1 bank 1" UWORD rel_q0p003052 1 100 0.00 199.9969 FORMAT "%8.4" ECU_ADDRESS 0x60008B52 /end MEASUREMENT
/begin MEASUREMENT UEGO_ratHeatrSnsrActS1B1 "Actual duty cycle at sensor 1 bank 1" UWORD rel_q0p003052 1 100 0.00 199.9969 FORMAT "%8.4" ECU_ADDRESS 0x60008B50 /end MEASUREMENT
/begin MEASUREMENT UEGO_ratIFltApeScS1B1 "Fault current through Ape line related to ISQ current amplitude sensor 1, bank 1" SWORD fak_q1p201Em4 1 100 -3.936096 3.935976 FORMAT "%8.6" ECU_ADDRESS 0x60008E44 /end MEASUREMENT
/begin MEASUREMENT UEGO_ratIFltIpeScS1B1 "Fault current through Ipe line related to ISQ current amplitude sensor 1, bank 1" SWORD fak_q1p201Em4 1 100 -3.936096 3.935976 FORMAT "%8.6" ECU_ADDRESS 0x60008E42 /end MEASUREMENT
/begin MEASUREMENT UEGO_ratIFltReScS1B1 "Fault current through Re line related to ISQ current amplitude sensor 1, bank 1" SWORD fak_q1p201Em4 1 100 -3.936096 3.935976 FORMAT "%8.6" ECU_ADDRESS 0x60008E40 /end MEASUREMENT
/begin MEASUREMENT UEGO_rIsoApeS1B1 "Calculated shunt resistance at pin Ape, sensor1, bank1" ULONG r_q0p1_Ohm 1 100 0.1000000 65535.0000000 FORMAT "%13.7" ECU_ADDRESS 0x6000388C /end MEASUREMENT
/begin MEASUREMENT UEGO_rIsoIpeS1B1 "Calculated shunt resistance at pin Ipe, sensor1, bank1" ULONG r_q0p1_Ohm 1 100 0.1000000 65535.0000000 FORMAT "%13.7" ECU_ADDRESS 0x60003888 /end MEASUREMENT
/begin MEASUREMENT UEGO_rIsoReS1B1 "Calculated shunt resistance at pin Re, sensor1, bank1" ULONG r_q0p1_Ohm 1 100 0.1000000 65535.0000000 FORMAT "%13.7" ECU_ADDRESS 0x60003884 /end MEASUREMENT
/begin MEASUREMENT UEGO_stDiagSigChpS1B1 "Status of Chip error information of the ASIC sensor 1 bank 1" UBYTE dez 1 100 0.00 255.0 FORMAT "%5.1" ECU_ADDRESS 0x6000F31D /end MEASUREMENT
/begin MEASUREMENT UEGO_stDiagSigCmnIrq "Status of the common IRQ error of the ASICs in ECU" UBYTE dez 1 100 0.00 255.0 FORMAT "%5.1" ECU_ADDRESS 0x6000F31C /end MEASUREMENT
/begin MEASUREMENT UEGO_stDiagSigOperPlausRprtS1B1 "Detailed fault status of UEGO operation plausibility diagnosis for sensor 1 on bank 1 in DFC_UegoSigOperPlausS1B1" UBYTE OneToOne 1 100 0.00 255.0 FORMAT "%5.1" ECU_ADDRESS 0x60038A9B /end MEASUREMENT
/begin MEASUREMENT UEGO_stDiagSigRegChpStS1B1 "Status of CHIPSTAT register information of sensor 1 bank 1" UBYTE dez 1 100 0.00 255.0 FORMAT "%5.1" ECU_ADDRESS 0x6000F31B /end MEASUREMENT
/begin MEASUREMENT UEGO_stDiagSigRegDiag0S1B1 "Status of DIAG0 register information of sensor 1 bank 1." UBYTE dez 1 100 0.00 255.0 FORMAT "%5.1" ECU_ADDRESS 0x6000F31A /end MEASUREMENT
/begin MEASUREMENT UEGO_stDiagSigRegDiag1S1B1 "Status of DIAG1 register information of the senosr 1 bank 1" UBYTE dez 1 100 0.00 255.0 FORMAT "%5.1" ECU_ADDRESS 0x6000F319 /end MEASUREMENT
/begin MEASUREMENT UEGO_stDiagSigRegDspStS1B1 "Status of DSPSTAT register information of the senosr 1 bank 1" UBYTE dez 1 100 0.00 255.0 FORMAT "%5.1" ECU_ADDRESS 0x6000F318 /end MEASUREMENT
/begin MEASUREMENT UEGO_stDiagSigSnsrCycS1B1 "UEGO detailed status on sensor diagnosis S1B1" UBYTE dez 1 100 0.00 255.0 FORMAT "%5.1" ECU_ADDRESS 0x6000F317 /end MEASUREMENT
/begin MEASUREMENT UEGO_stDiagSigSnsrRprtS1B1 "Detailed fault status of UEGO sensor diagnosis for sensor 1 on bank 1 in DFC_UegoDiagSigSnsrS1B1" UBYTE dez 1 100 0.00 255.0 FORMAT "%5.1" ECU_ADDRESS 0x60038A99 /end MEASUREMENT
/begin MEASUREMENT UEGO_stDiagSigWireOlElectrCircCycS1B1 "UEGO detailed status on wire electrode circuit continuity diagnosis sensor 1 bank 1" UWORD dez 1 100 0.00 65535.00 FORMAT "%8.2" ECU_ADDRESS 0x60008B4A /end MEASUREMENT
/begin MEASUREMENT UEGO_stDiagSigWireRCmpCircCycS1B1 "UEGO detailed status on wire compensation resistor circuit continuity diagnosis sensor 1 bank 1" UWORD dez 1 100 0.00 65535.00 FORMAT "%8.2" ECU_ADDRESS 0x60008B48 /end MEASUREMENT
/begin MEASUREMENT UEGO_stDiagSigWireScbCycS1B1 "UEGO detailed status on short circuit to battery diagnosis for sensor 1 at bank 1" UWORD dez 1 100 0.00 65535.00 FORMAT "%8.2" ECU_ADDRESS 0x60008B46 /end MEASUREMENT
/begin MEASUREMENT UEGO_stDiagSigWireScgCycS1B1 "UEGO detailed status on short circuit to ground diagnosis for sensor 1 at bank 1" UWORD dez 1 100 0.00 65535.00 FORMAT "%8.2" ECU_ADDRESS 0x60008B44 /end MEASUREMENT
/begin MEASUREMENT UEGO_stEng "Engine status" UBYTE UEGO_EngModSt_COMPU_VERB 1 100 0.00 6.00000000000 FORMAT "%13.11" ECU_ADDRESS 0x6000F316 /end MEASUREMENT
/begin MEASUREMENT UEGO_tEgMdlS1B1 "modelled exhaust gas temperature at sensor 1 bank 1" SWORD Temp_Cels 1 100 -3549.940 3003.560 FORMAT "%8.3" ECU_ADDRESS 0x60008E38 /end MEASUREMENT
/begin MEASUREMENT UEGO_tWallMdlS1B1 "Temperature wall modelled, sensor 1, bank 1" SWORD Temp_Cels 1 100 -3549.940 3003.560 FORMAT "%8.3" ECU_ADDRESS 0x60008E36 /end MEASUREMENT
/begin MEASUREMENT UEGO_uHeatrCtrlEfcS1B1 "effective heater voltage (reqested by heater control from heater power stage control) sensor 1 bank 1" UWORD spg_q0p005 1 100 0.00 327.6750 FORMAT "%8.4" ECU_ADDRESS 0x60008B40 /end MEASUREMENT
/begin MEASUREMENT UEGO_uIsoApeS1B1 "Calculated shunt voltage at pin Ape, sensor1, bank1" SLONG spg_q3p2Em4_V 1 100 -32.7670400000 32.7670400000 FORMAT "%13.10" ECU_ADDRESS 0x60003930 /end MEASUREMENT
/begin MEASUREMENT UEGO_uIsoIpeS1B1 "Calculated shunt voltage at pin Ipe, sensor1, bank1" SLONG spg_q3p2Em4_V 1 100 -32.7670400000 32.7670400000 FORMAT "%13.10" ECU_ADDRESS 0x6000392C /end MEASUREMENT
/begin MEASUREMENT UEGO_uIsoReS1B1 "Calculated shunt voltage at pin Re, sensor1, bank1" SLONG spg_q3p2Em4_V 1 100 -32.7670400000 32.7670400000 FORMAT "%13.10" ECU_ADDRESS 0x60003928 /end MEASUREMENT
/begin MEASUREMENT UEGO_uPwrSply "UEGO power supply for operational release" SWORD Volt_Batt 1 100 -655360.0 655340.0 FORMAT "%8.1" ECU_ADDRESS 0x60006766 /end MEASUREMENT
/begin MEASUREMENT UEGO_uScApeS1B1 "Calculated short circuit voltage at the pin Ape" SLONG spg_q3p2Em4_V 1 100 -32.7670400000 32.7670400000 FORMAT "%13.10" ECU_ADDRESS 0x60003924 /end MEASUREMENT
/begin MEASUREMENT UEGO_uScIpeS1B1 "Calculated short circuit voltage at the pin Ipe" SLONG spg_q3p2Em4_V 1 100 -32.7670400000 32.7670400000 FORMAT "%13.10" ECU_ADDRESS 0x60003920 /end MEASUREMENT
/begin MEASUREMENT UEGO_uScReS1B1 "Calculated short circuit voltage at the pin Re" SLONG spg_q3p2Em4_V 1 100 -32.7670400000 32.7670400000 FORMAT "%13.10" ECU_ADDRESS 0x6000391C /end MEASUREMENT
/begin FUNCTION UEGO_DiagSigEvlnCntct "1.16.0    UEGO diagnostics evaluation of contact measurements of the signal path"
 /begin DEF_CHARACTERISTIC UEGO_rSc_C UEGO_iIsqDesWireScHiIsqEvln_C UEGO_iIsqDesWireScLoIsqEvln_C UEGO_uUgxxDeltaMaxIni_C /end DEF_CHARACTERISTIC
 /begin REF_CHARACTERISTIC UEGO_resRGnd_C /end REF_CHARACTERISTIC
 /begin IN_MEASUREMENT UEGO_DataSplyClsS1B1_I.flgCj135An UEGO_DataSplyClsS1B1_I.flgDACOff UEGO_DataSplyClsS1B1_I.flgErrSpiRamRet UEGO_DataSplyClsS1B1_I.flgFKal1Vld UEGO_DataSplyClsS1B1_I.flgFKal2Vld UEGO_DataSplyClsS1B1_I.flgFKal3Vld UEGO_DataSplyClsS1B1_I.flgIPmpActvd UEGO_DataSplyClsS1B1_I.flgISQrA UEGO_DataSplyClsS1B1_I.flgISQrE UEGO_DataSplyClsS1B1_I.flgLCURR UEGO_DataSplyClsS1B1_I.flgLNMeas UEGO_DataSplyClsS1B1_I.flgLPMeas UEGO_DataSplyClsS1B1_I.flgLoupeCAL UEGO_DataSplyClsS1B1_I.flgLoupeG0 UEGO_DataSplyClsS1B1_I.flgLstPckAbort UEGO_DataSplyClsS1B1_I.flgMKA UEGO_DataSplyClsS1B1_I.flgMKE UEGO_DataSplyClsS1B1_I.flgNewIPmpDacPckAry UEGO_DataSplyClsS1B1_I.flgNewIPmpOK UEGO_DataSplyClsS1B1_I.flgNewIPmpPckAry UEGO_DataSplyClsS1B1_I.flgNewIPmpTM UEGO_DataSplyClsS1B1_I.flgNewPck UEGO_DataSplyClsS1B1_I.flgNewPckCstnc UEGO_DataSplyClsS1B1_I.flgNewPckMiss UEGO_DataSplyClsS1B1_I.flgNewPckVld UEGO_DataSplyClsS1B1_I.flgNewTiPck UEGO_DataSplyClsS1B1_I.flgNewURmVG4MeasAryVld UEGO_DataSplyClsS1B1_I.flgNewUa2Pck UEGO_DataSplyClsS1B1_I.flgNewUa31Pck UEGO_DataSplyClsS1B1_I.flgNewUa32Pck UEGO_DataSplyClsS1B1_I.flgNewUa33Pck UEGO_DataSplyClsS1B1_I.flgNewUamPck UEGO_DataSplyClsS1B1_I.flgNewUapePck UEGO_DataSplyClsS1B1_I.flgNewUcalMaxPck UEGO_DataSplyClsS1B1_I.flgNewUcalPck UEGO_DataSplyClsS1B1_I.flgNewUg0Pck UEGO_DataSplyClsS1B1_I.flgNewUg0PckAry UEGO_DataSplyClsS1B1_I.flgNewUg0aPck UEGO_DataSplyClsS1B1_I.flgNewUg0ePck UEGO_DataSplyClsS1B1_I.flgNewUg0iPck UEGO_DataSplyClsS1B1_I.flgNewUg0iPckAry UEGO_DataSplyClsS1B1_I.flgNewUg0iaiPck UEGO_DataSplyClsS1B1_I.flgNewUg0ieiPck UEGO_DataSplyClsS1B1_I.flgNewUg0ix7PckAry UEGO_DataSplyClsS1B1_I.flgNewUg0ix9PckAry UEGO_DataSplyClsS1B1_I.flgNewUg0ixPckAry UEGO_DataSplyClsS1B1_I.flgNewUg0mPck UEGO_DataSplyClsS1B1_I.flgNewUgaPck UEGO_DataSplyClsS1B1_I.flgNewUgiPckAry UEGO_DataSplyClsS1B1_I.flgNewUgkAvrgPck UEGO_DataSplyClsS1B1_I.flgNewUguaPck UEGO_DataSplyClsS1B1_I.flgNewUguaZ2Pck UEGO_DataSplyClsS1B1_I.flgNewUguiPck UEGO_DataSplyClsS1B1_I.flgNewUguiZ1Pck UEGO_DataSplyClsS1B1_I.flgNewUi21PckAry UEGO_DataSplyClsS1B1_I.flgNewUi22Pck UEGO_DataSplyClsS1B1_I.flgNewUi23Pck UEGO_DataSplyClsS1B1_I.flgNewUi24Pck UEGO_DataSplyClsS1B1_I.flgNewUi4Pck UEGO_DataSplyClsS1B1_I.flgNewUi4Z2Pck UEGO_DataSplyClsS1B1_I.flgNewUigPckAry UEGO_DataSplyClsS1B1_I.flgNewUigmkPckAry UEGO_DataSplyClsS1B1_I.flgNewUipcalAvrgPck UEGO_DataSplyClsS1B1_I.flgNewUn0Pck UEGO_DataSplyClsS1B1_I.flgNewUn0Pck4Ary UEGO_DataSplyClsS1B1_I.flgNewUn0Pck5Ary UEGO_DataSplyClsS1B1_I.flgNewUn0PckAry UEGO_DataSplyClsS1B1_I.flgNewUnPckAry UEGO_DataSplyClsS1B1_I.flgNewUnSetPck UEGO_DataSplyClsS1B1_I.flgNewUnx3PckAry UEGO_DataSplyClsS1B1_I.flgNewUnx4PckAry UEGO_DataSplyClsS1B1_I.flgNewUp0Pck UEGO_DataSplyClsS1B1_I.flgNewUp0Pck4 UEGO_DataSplyClsS1B1_I.flgNewUp0Pck5Ary UEGO_DataSplyClsS1B1_I.flgNewUp0PckAry UEGO_DataSplyClsS1B1_I.flgNewUpPckAry UEGO_DataSplyClsS1B1_I.flgNewUpx3PckAry UEGO_DataSplyClsS1B1_I.flgNewUpx4PckAry UEGO_DataSplyClsS1B1_I.flgNewUriaPckVld UEGO_DataSplyClsS1B1_I.flgNewUriePckAry UEGO_DataSplyClsS1B1_I.flgNewUx6PckAry UEGO_DataSplyClsS1B1_I.flgNewUx7PckAry UEGO_DataSplyClsS1B1_I.flgNewUx8PckAry UEGO_DataSplyClsS1B1_I.flgNewUx9PckAry UEGO_DataSplyClsS1B1_I.flgNewUxPckAry UEGO_DataSplyClsS1B1_I.flgReStable UEGO_DataSplyClsS1B1_I.flgSngCell UEGO_DataSplyClsS1B1_I.flgUical0Vld UEGO_DataSplyClsS1B1_I.flgUicalVld UEGO_DataSplyClsS1B1_I.flgUoffipe1Vld UEGO_DataSplyClsS1B1_I.flgUoffipe2Vld UEGO_DataSplyClsS1B1_I.flgUoffipe3Vld UEGO_DataSplyClsS1B1_I.flgUoffvcc1Vld UEGO_DataSplyClsS1B1_I.flgUoffvcc2Vld UEGO_DataSplyClsS1B1_I.flgUoffvcc3Vld UEGO_DataSplyClsS1B1_I.flgUriaMeas UEGO_DataSplyClsS1B1_I.nrIPmpDacPckAry UEGO_DataSplyClsS1B1_I.nrIpPckAry UEGO_DataSplyClsS1B1_I.nrModeMeas UEGO_DataSplyClsS1B1_I.nrRamFailPosn UEGO_DataSplyClsS1B1_I.nrRamMod UEGO_DataSplyClsS1B1_I.nrRamRegMod UEGO_DataSplyClsS1B1_I.nrRamSts1 UEGO_DataSplyClsS1B1_I.nrRamSts2 UEGO_DataSplyClsS1B1_I.nrRamSts3 UEGO_DataSplyClsS1B1_I.nrURmVG4PckAry UEGO_DataSplyClsS1B1_I.nrUa2PckAry UEGO_DataSplyClsS1B1_I.nrUcalMaxCorrd UEGO_DataSplyClsS1B1_I.nrUg0PckAry UEGO_DataSplyClsS1B1_I.nrUg0iPckAry UEGO_DataSplyClsS1B1_I.nrUg0ix7PckAry UEGO_DataSplyClsS1B1_I.nrUg0ix9PckAry UEGO_DataSplyClsS1B1_I.nrUg0ixPckAry UEGO_DataSplyClsS1B1_I.nrUgaPckAry UEGO_DataSplyClsS1B1_I.nrUgiPckAry UEGO_DataSplyClsS1B1_I.nrUi21PckAry UEGO_DataSplyClsS1B1_I.nrUical0PckCorrd UEGO_DataSplyClsS1B1_I.nrUicalPckCorrd UEGO_DataSplyClsS1B1_I.nrUigPckAry UEGO_DataSplyClsS1B1_I.nrUigmkPckAry UEGO_DataSplyClsS1B1_I.nrUn0Pck4Ary UEGO_DataSplyClsS1B1_I.nrUn0Pck5Ary UEGO_DataSplyClsS1B1_I.nrUn0PckAry UEGO_DataSplyClsS1B1_I.nrUnPckAry UEGO_DataSplyClsS1B1_I.nrUnx3PckAry UEGO_DataSplyClsS1B1_I.nrUnx4PckAry UEGO_DataSplyClsS1B1_I.nrUoffipe1 UEGO_DataSplyClsS1B1_I.nrUoffipe2 UEGO_DataSplyClsS1B1_I.nrUoffipe3 UEGO_DataSplyClsS1B1_I.nrUoffvcc1 UEGO_DataSplyClsS1B1_I.nrUoffvcc2 UEGO_DataSplyClsS1B1_I.nrUoffvcc3 UEGO_DataSplyClsS1B1_I.nrUp0Pck5Ary UEGO_DataSplyClsS1B1_I.nrUp0PckAry UEGO_DataSplyClsS1B1_I.nrUpPckAry UEGO_DataSplyClsS1B1_I.nrUpx3PckAry UEGO_DataSplyClsS1B1_I.nrUpx4PckAry UEGO_DataSplyClsS1B1_I.nrUriePckAry UEGO_DataSplyClsS1B1_I.nrUx6PckAry UEGO_DataSplyClsS1B1_I.nrUx7PckAry UEGO_DataSplyClsS1B1_I.nrUx8PckAry UEGO_DataSplyClsS1B1_I.nrUx9PckAry UEGO_DataSplyClsS1B1_I.nrUxPckAry UEGO_DataSplyClsS1B1_I.stIPmpOK UEGO_DataSplyClsS1B1_I.stIPmpTM UEGO_DataSplyClsS1B1_I.stIPmpTM2L UEGO_DataSplyClsS1B1_I.stIPmpTM2R UEGO_DataSplyClsS1B1_I.stLsmRetValMod UEGO_DataSplyClsS1B1_I.stMKMeas UEGO_DataSplyClsS1B1_I.stOFFMeas UEGO_DataSplyClsS1B1_I.stOPTMeas UEGO_DataSplyClsS1B1_I.stREFMeas UEGO_DataSplyClsS1B1_I.stUa2PckAry UEGO_DataSplyClsS1B1_I.stUa2Z1PckAry UEGO_DataSplyClsS1B1_I.stUg0iPckAry UEGO_DataSplyClsS1B1_I.stUg0ix7IActvPckAry UEGO_DataSplyClsS1B1_I.stUg0ix7PmpIActvPckAry UEGO_DataSplyClsS1B1_I.stUg0ix9IActvPckAry UEGO_DataSplyClsS1B1_I.stUg0ix9PmpIActvPckAry UEGO_DataSplyClsS1B1_I.stUg0ixIActvPckAry UEGO_DataSplyClsS1B1_I.stUg0ixPmpIActvPckAry UEGO_DataSplyClsS1B1_I.stUi21PckAry UEGO_DataSplyClsS1B1_I.stUi21Z1PckAry UEGO_DataSplyClsS1B1_I.stUigmkNernstIActvPckAry UEGO_DataSplyClsS1B1_I.stUigmkPmpIActvPckAry UEGO_DataSplyClsS1B1_I.stUn0PckAry UEGO_DataSplyClsS1B1_I.stUn0Z2PckAry UEGO_DataSplyClsS1B1_I.stUnPckAry UEGO_DataSplyClsS1B1_I.stUnx3IActvAcrsNernstCellPckAry UEGO_DataSplyClsS1B1_I.stUnx3IActvAcrsPmpCellPckAry UEGO_DataSplyClsS1B1_I.stUnx4IActvAcrsNernstCellPckAry UEGO_DataSplyClsS1B1_I.stUnx4IActvAcrsPmpCellPckAry UEGO_DataSplyClsS1B1_I.stUp0PckAry UEGO_DataSplyClsS1B1_I.stUp0Z2PckAry UEGO_DataSplyClsS1B1_I.stUpPckAry UEGO_DataSplyClsS1B1_I.stUpZ2PckAry UEGO_DataSplyClsS1B1_I.stUpx3IActvAcrsNernstCellPckAry UEGO_DataSplyClsS1B1_I.stUpx3IActvAcrsPmpCellPckAry UEGO_DataSplyClsS1B1_I.stUpx4IActvAcrsNernstCellPckAry UEGO_DataSplyClsS1B1_I.stUpx4IActvAcrsPmpCellPckAry UEGO_DataSplyClsS1B1_I.stUriePckAry UEGO_DataSplyClsS1B1_I.stUx6IActvPckAry UEGO_DataSplyClsS1B1_I.stUx6MeasAcrsPmpCellPckAry UEGO_DataSplyClsS1B1_I.stUx7IActvPckAry UEGO_DataSplyClsS1B1_I.stUx7MeasAcrsPmpCellPckAry UEGO_DataSplyClsS1B1_I.stUx8IActvPckAry UEGO_DataSplyClsS1B1_I.stUx8MeasAcrsPmpCellPckAry UEGO_DataSplyClsS1B1_I.stUx9IActvPckAry UEGO_DataSplyClsS1B1_I.stUx9MeasAcrsPmpCellPckAry UEGO_DataSplyClsS1B1_I.stUxIActvPckAry UEGO_DataSplyClsS1B1_I.stUxMeasAcrsPmpCell UEGO_DataSplyClsS1B1_I.tiUEGOPck UEGO_DataSplyClsS1B1_I.uFkal1 UEGO_DataSplyClsS1B1_I.uFkal2 UEGO_DataSplyClsS1B1_I.uFkal3 UEGO_DataSplyClsS1B1_I.uUCalPck UEGO_DataSplyClsS1B1_I.uUa31Pck UEGO_DataSplyClsS1B1_I.uUa32Pck UEGO_DataSplyClsS1B1_I.uUa33Pck UEGO_DataSplyClsS1B1_I.uUamPck UEGO_DataSplyClsS1B1_I.uUapePck UEGO_DataSplyClsS1B1_I.uUcalMaxPck UEGO_DataSplyClsS1B1_I.uUg0Pck UEGO_DataSplyClsS1B1_I.uUg0aPck UEGO_DataSplyClsS1B1_I.uUg0ePck UEGO_DataSplyClsS1B1_I.uUg0iPck UEGO_DataSplyClsS1B1_I.uUg0iaiPck UEGO_DataSplyClsS1B1_I.uUg0ieiPck UEGO_DataSplyClsS1B1_I.uUg0mPck UEGO_DataSplyClsS1B1_I.uUgkAvrgPck UEGO_DataSplyClsS1B1_I.uUguaPck UEGO_DataSplyClsS1B1_I.uUguaZ2Pck UEGO_DataSplyClsS1B1_I.uUguiPck UEGO_DataSplyClsS1B1_I.uUguiZ1Pck UEGO_DataSplyClsS1B1_I.uUi22Pck UEGO_DataSplyClsS1B1_I.uUi23Pck UEGO_DataSplyClsS1B1_I.uUi24Pck UEGO_DataSplyClsS1B1_I.uUi4Pck UEGO_DataSplyClsS1B1_I.uUi4Z2Pck UEGO_DataSplyClsS1B1_I.uUipcalAvrgPck UEGO_DataSplyClsS1B1_I.uUn0Pck UEGO_DataSplyClsS1B1_I.uUnSet UEGO_DataSplyClsS1B1_I.uUp0Pck UEGO_DataSplyClsS1B1_I.uUp0Pck4 UEGO_DataSplyClsS1B1_I.uUriaPck UEGO_DataSplyClsS1B1_I.uVCC1Corrd UEGO_DataSplyClsS1B1_I.uVCC3Ref UEGO_flgCJ135AnS1B1 UEGO_flgDiagSigWireScRstS1B1 UEGO_flgSysSuprtdS1B1 UEGO_RegGetPrmS1B1_I.flgDlyBlcknNxtPckVld UEGO_RegGetPrmS1B1_I.flgDlyBlcknVld UEGO_RegGetPrmS1B1_I.flgDspDiagDis UEGO_RegGetPrmS1B1_I.flgDspDiagDisNxtPck UEGO_RegGetPrmS1B1_I.flgDspDiagDisNxtPckVld UEGO_RegGetPrmS1B1_I.flgDspDiagDisVld UEGO_RegGetPrmS1B1_I.flgEnSpA UEGO_RegGetPrmS1B1_I.flgEnSpAVld UEGO_RegGetPrmS1B1_I.flgEnSpE UEGO_RegGetPrmS1B1_I.flgEnSpEVld UEGO_RegGetPrmS1B1_I.flgEnSpNxtPckVld UEGO_RegGetPrmS1B1_I.flgEnSpVld UEGO_RegGetPrmS1B1_I.flgIPmpBlcknNxtPckVld UEGO_RegGetPrmS1B1_I.flgIPmpBlcknVld UEGO_RegGetPrmS1B1_I.flgIPmpLimnHiVld UEGO_RegGetPrmS1B1_I.flgIPmpLimnLoVld UEGO_RegGetPrmS1B1_I.flgIPmpRst UEGO_RegGetPrmS1B1_I.flgIPmpRstNxtPck UEGO_RegGetPrmS1B1_I.flgIPmpRstNxtPckVld UEGO_RegGetPrmS1B1_I.flgIPmpRstVld UEGO_RegGetPrmS1B1_I.flgIPmpSm UEGO_RegGetPrmS1B1_I.flgIPmpSmNxtPck UEGO_RegGetPrmS1B1_I.flgIPmpSmNxtPckVld UEGO_RegGetPrmS1B1_I.flgIPmpSmVld UEGO_RegGetPrmS1B1_I.flgLCal UEGO_RegGetPrmS1B1_I.flgLCalVld UEGO_RegGetPrmS1B1_I.flgLCurr UEGO_RegGetPrmS1B1_I.flgLCurrVld UEGO_RegGetPrmS1B1_I.flgLDAC UEGO_RegGetPrmS1B1_I.flgLDACConf UEGO_RegGetPrmS1B1_I.flgLDACConfVld UEGO_RegGetPrmS1B1_I.flgLDACVld UEGO_RegGetPrmS1B1_I.flgLG0 UEGO_RegGetPrmS1B1_I.flgLG0Vld UEGO_RegGetPrmS1B1_I.flgLN UEGO_RegGetPrmS1B1_I.flgLNNxtPck UEGO_RegGetPrmS1B1_I.flgLNNxtPckVld UEGO_RegGetPrmS1B1_I.flgLNVld UEGO_RegGetPrmS1B1_I.flgLP UEGO_RegGetPrmS1B1_I.flgLPNxtPck UEGO_RegGetPrmS1B1_I.flgLPNxtPckVld UEGO_RegGetPrmS1B1_I.flgLPVld UEGO_RegGetPrmS1B1_I.flgMKA UEGO_RegGetPrmS1B1_I.flgMKAVld UEGO_RegGetPrmS1B1_I.flgMKE UEGO_RegGetPrmS1B1_I.flgMKEVld UEGO_RegGetPrmS1B1_I.flgMKNxtPckVld UEGO_RegGetPrmS1B1_I.flgMKVld UEGO_RegGetPrmS1B1_I.flgN3MeasActvNxtPck UEGO_RegGetPrmS1B1_I.flgN3MeasActvNxtPckVld UEGO_RegGetPrmS1B1_I.flgOFFNxtPckVld UEGO_RegGetPrmS1B1_I.flgOFFVld UEGO_RegGetPrmS1B1_I.flgOPTNxtPckVld UEGO_RegGetPrmS1B1_I.flgOPTVld UEGO_RegGetPrmS1B1_I.flgPatNxtPckVld UEGO_RegGetPrmS1B1_I.flgPatVld UEGO_RegGetPrmS1B1_I.flgRCmpHeatrEdgeShiftAllwd UEGO_RegGetPrmS1B1_I.flgRCmpHeatrEdgeShiftAllwdNxtPck UEGO_RegGetPrmS1B1_I.flgRCmpHeatrEdgeShiftAllwdNxtPckVld UEGO_RegGetPrmS1B1_I.flgRCmpHeatrEdgeShiftAllwdVld UEGO_RegGetPrmS1B1_I.flgReStab UEGO_RegGetPrmS1B1_I.flgReStabVld UEGO_RegGetPrmS1B1_I.flgRefNxtPckVld UEGO_RegGetPrmS1B1_I.flgRefPatChng UEGO_RegGetPrmS1B1_I.flgRefPatNxtPckVld UEGO_RegGetPrmS1B1_I.flgRefPatVld UEGO_RegGetPrmS1B1_I.flgRefVld UEGO_RegGetPrmS1B1_I.flgRegIPmpSetNxtPckVld UEGO_RegGetPrmS1B1_I.flgRegIPmpSetVld UEGO_RegGetPrmS1B1_I.flgRegIpoffChng UEGO_RegGetPrmS1B1_I.flgRegIpoffNxtPckVld UEGO_RegGetPrmS1B1_I.flgRegIpoffVld UEGO_RegGetPrmS1B1_I.flgRegModNxtPckVld UEGO_RegGetPrmS1B1_I.flgRegModVld UEGO_RegGetPrmS1B1_I.flgRegPartModNxtPckVld UEGO_RegGetPrmS1B1_I.flgRegPartModVld UEGO_RegGetPrmS1B1_I.flgRegUnsetNxtPckVld UEGO_RegGetPrmS1B1_I.flgRiaPatChng UEGO_RegGetPrmS1B1_I.flgRiaPatVld UEGO_RegGetPrmS1B1_I.flgRipVld UEGO_RegGetPrmS1B1_I.flgSngCell UEGO_RegGetPrmS1B1_I.flgSngCellVld UEGO_RegGetPrmS1B1_I.flgSteerPatChng UEGO_RegGetPrmS1B1_I.flgSteerPatNxtPckVld UEGO_RegGetPrmS1B1_I.flgSteerPatVld UEGO_RegGetPrmS1B1_I.flgSubModMeasNxtPckVld UEGO_RegGetPrmS1B1_I.flgSubModMeasVld UEGO_RegGetPrmS1B1_I.flgSwVirtGnd UEGO_RegGetPrmS1B1_I.flgSwVirtGndVld UEGO_RegGetPrmS1B1_I.flgTrimSqChng UEGO_RegGetPrmS1B1_I.flgTrimSqrCalChng UEGO_RegGetPrmS1B1_I.flgTrimSqrChng UEGO_RegGetPrmS1B1_I.flgTrmNxtPckVld UEGO_RegGetPrmS1B1_I.flgTrmSqCalOffSet UEGO_RegGetPrmS1B1_I.flgTrmSqCalVld UEGO_RegGetPrmS1B1_I.flgTrmSqOffSet UEGO_RegGetPrmS1B1_I.flgTrmSqOffSetVld UEGO_RegGetPrmS1B1_I.flgTrmSqVld UEGO_RegGetPrmS1B1_I.flgTrmSqrCalOffSet UEGO_RegGetPrmS1B1_I.flgTrmSqrCalVld UEGO_RegGetPrmS1B1_I.flgTrmSqrOffSet UEGO_RegGetPrmS1B1_I.flgTrmSqrOffSetVld UEGO_RegGetPrmS1B1_I.flgTrmSqrVld UEGO_RegGetPrmS1B1_I.flgUnsetVld UEGO_RegGetPrmS1B1_I.flgUp0LeanNxtPckVld UEGO_RegGetPrmS1B1_I.flgUp0LeanVld UEGO_RegGetPrmS1B1_I.flgUp0RichNxtPckVld UEGO_RegGetPrmS1B1_I.flgUp0RichVld UEGO_RegGetPrmS1B1_I.flgUria UEGO_RegGetPrmS1B1_I.flgUriaNxtPck UEGO_RegGetPrmS1B1_I.flgUriaNxtPckVld UEGO_RegGetPrmS1B1_I.flgUriaVld UEGO_RegGetPrmS1B1_I.flgV1BF2NxtPckVld UEGO_RegGetPrmS1B1_I.flgV1BF2Vld UEGO_RegGetPrmS1B1_I.flgV1BF3NxtPckVld UEGO_RegGetPrmS1B1_I.flgV1BIT1 UEGO_RegGetPrmS1B1_I.flgV1BIT1NxtPck UEGO_RegGetPrmS1B1_I.flgV1BIT1NxtPckVld UEGO_RegGetPrmS1B1_I.flgV1BIT1Vld UEGO_RegGetPrmS1B1_I.flgV1BIT2 UEGO_RegGetPrmS1B1_I.flgV1BIT2NxtPck UEGO_RegGetPrmS1B1_I.flgV1BIT2NxtPckVld UEGO_RegGetPrmS1B1_I.flgV1BIT2Vld UEGO_RegGetPrmS1B1_I.flgV1BIT5 UEGO_RegGetPrmS1B1_I.flgV1BIT5NxtPck UEGO_RegGetPrmS1B1_I.flgV1BIT5NxtPckVld UEGO_RegGetPrmS1B1_I.flgV1BIT5Vld UEGO_RegGetPrmS1B1_I.flgWtrEleclyActv UEGO_RegGetPrmS1B1_I.flgWtrEleclyActvNxtPck UEGO_RegGetPrmS1B1_I.flgWtrEleclyActvNxtPckVld UEGO_RegGetPrmS1B1_I.flgWtrEleclyActvVld UEGO_RegGetPrmS1B1_I.flgZIsqrA UEGO_RegGetPrmS1B1_I.flgZIsqrAVld UEGO_RegGetPrmS1B1_I.flgZIsqrE UEGO_RegGetPrmS1B1_I.flgZIsqrEVld UEGO_RegGetPrmS1B1_I.nrIPmpBlcknNxtPck UEGO_RegGetPrmS1B1_I.nrIPmpLimnHi UEGO_RegGetPrmS1B1_I.nrIPmpLimnLo UEGO_RegGetPrmS1B1_I.nrPmpBlckn UEGO_RegGetPrmS1B1_I.nrRefPatNxtPck UEGO_RegGetPrmS1B1_I.nrRegIPmpSet UEGO_RegGetPrmS1B1_I.nrRegIPmpSetNxtPck UEGO_RegGetPrmS1B1_I.nrRegIpoff UEGO_RegGetPrmS1B1_I.nrRegMod UEGO_RegGetPrmS1B1_I.nrRegModNxtPck UEGO_RegGetPrmS1B1_I.nrRegPartMod UEGO_RegGetPrmS1B1_I.nrRegPartModNxtPck UEGO_RegGetPrmS1B1_I.nrRegTrmNxtPck UEGO_RegGetPrmS1B1_I.nrRegTrmSqNxtPck UEGO_RegGetPrmS1B1_I.nrRegTrmSqrNxtPck UEGO_RegGetPrmS1B1_I.nrRip UEGO_RegGetPrmS1B1_I.nrSteerPatNxtPck UEGO_RegGetPrmS1B1_I.nrSubModMeas UEGO_RegGetPrmS1B1_I.nrSubModMeasNxtPck UEGO_RegGetPrmS1B1_I.nrTrmSq UEGO_RegGetPrmS1B1_I.nrTrmSqCal UEGO_RegGetPrmS1B1_I.nrTrmSqr UEGO_RegGetPrmS1B1_I.nrTrmSqrCal UEGO_RegGetPrmS1B1_I.nrUnset UEGO_RegGetPrmS1B1_I.nrUnsetNxtPck UEGO_RegGetPrmS1B1_I.nrUp0Lean UEGO_RegGetPrmS1B1_I.nrUp0LeanNxtPck UEGO_RegGetPrmS1B1_I.nrUp0Rich UEGO_RegGetPrmS1B1_I.nrUp0RichNxtPck UEGO_RegGetPrmS1B1_I.stDlyBlckn UEGO_RegGetPrmS1B1_I.stDlyBlcknNxtPck UEGO_RegGetPrmS1B1_I.stEnSp UEGO_RegGetPrmS1B1_I.stEnSpNxtPck UEGO_RegGetPrmS1B1_I.stMK UEGO_RegGetPrmS1B1_I.stMKNxtPck UEGO_RegGetPrmS1B1_I.stOFF UEGO_RegGetPrmS1B1_I.stOFFNxtPck UEGO_RegGetPrmS1B1_I.stOPT UEGO_RegGetPrmS1B1_I.stOPTNxtPck UEGO_RegGetPrmS1B1_I.stPat UEGO_RegGetPrmS1B1_I.stPatNxtPck UEGO_RegGetPrmS1B1_I.stRef UEGO_RegGetPrmS1B1_I.stRefNxtPck UEGO_RegGetPrmS1B1_I.stRefPat UEGO_RegGetPrmS1B1_I.stRegIpoffNxtPck UEGO_RegGetPrmS1B1_I.stRiaPat UEGO_RegGetPrmS1B1_I.stSteerPat UEGO_RegGetPrmS1B1_I.stV1BF2 UEGO_RegGetPrmS1B1_I.stV1BF2NxtPck UEGO_RegGetPrmS1B1_I.stV1BF3NxtPck /end IN_MEASUREMENT
 /begin OUT_MEASUREMENT UEGO_flgHiIsqCalcnCmplS1B1 UEGO_flgIsoApeVldS1B1 UEGO_flgIsoIpeVldS1B1 UEGO_flgIsoReVldS1B1 UEGO_flgRatIFltApeScVldS1B1 UEGO_flgRatIFltIpeScVldS1B1 UEGO_flgRatIFltReScVldS1B1 UEGO_flgUScApeVldS1B1 UEGO_flgUScIpeVldS1B1 UEGO_flgUScReVldS1B1 UEGO_iIsoApeS1B1 UEGO_iIsoIpeS1B1 UEGO_iIsoReS1B1 UEGO_ratIFltApeScS1B1 UEGO_ratIFltIpeScS1B1 UEGO_ratIFltReScS1B1 UEGO_rIsoApeS1B1 UEGO_rIsoIpeS1B1 UEGO_rIsoReS1B1 UEGO_uIsoApeS1B1 UEGO_uIsoIpeS1B1 UEGO_uIsoReS1B1 UEGO_uScApeS1B1 UEGO_uScIpeS1B1 UEGO_uScReS1B1 /end OUT_MEASUREMENT
 /begin LOC_MEASUREMENT UEGO_DiagSigEvlnS1B1_I.flgDeltaUg0aHiIsqVld UEGO_DiagSigEvlnS1B1_I.flgDeltaUg0aLoIsqVld UEGO_DiagSigEvlnS1B1_I.flgDeltaUg0aVld UEGO_DiagSigEvlnS1B1_I.flgDeltaUg0eHiIsqVld UEGO_DiagSigEvlnS1B1_I.flgDeltaUg0eLoIsqVld UEGO_DiagSigEvlnS1B1_I.flgDeltaUg0eVld UEGO_DiagSigEvlnS1B1_I.flgDeltaUg0iHiIsqVld UEGO_DiagSigEvlnS1B1_I.flgDeltaUg0iLoIsqVld UEGO_DiagSigEvlnS1B1_I.flgDeltaUg0iVld UEGO_DiagSigEvlnS1B1_I.flgHiIsqCalcnCmpl UEGO_DiagSigEvlnS1B1_I.flgIIsoApeVld UEGO_DiagSigEvlnS1B1_I.flgIIsoIpeVld UEGO_DiagSigEvlnS1B1_I.flgIIsoReVld UEGO_DiagSigEvlnS1B1_I.flgIsoApeVld UEGO_DiagSigEvlnS1B1_I.flgIsoIpeVld UEGO_DiagSigEvlnS1B1_I.flgIsoReVld UEGO_DiagSigEvlnS1B1_I.flgRatIFltApeScVld UEGO_DiagSigEvlnS1B1_I.flgRatIFltScIpeVld UEGO_DiagSigEvlnS1B1_I.flgRatIFltScReVld UEGO_DiagSigEvlnS1B1_I.flgRisoApeVld UEGO_DiagSigEvlnS1B1_I.flgRisoIpeVld UEGO_DiagSigEvlnS1B1_I.flgRisoReVld UEGO_DiagSigEvlnS1B1_I.flgRstReqModChng UEGO_DiagSigEvlnS1B1_I.flgUScApeVld UEGO_DiagSigEvlnS1B1_I.flgUScIpeVld UEGO_DiagSigEvlnS1B1_I.flgUScReVld UEGO_DiagSigEvlnS1B1_I.flgUg0HiIsqVld UEGO_DiagSigEvlnS1B1_I.flgUg0LoIsqVld UEGO_DiagSigEvlnS1B1_I.flgUg0PckPeakVld UEGO_DiagSigEvlnS1B1_I.flgUg0PckVld UEGO_DiagSigEvlnS1B1_I.flgUisoApeVld UEGO_DiagSigEvlnS1B1_I.flgUisoIpeVld UEGO_DiagSigEvlnS1B1_I.flgUisoReVld UEGO_DiagSigEvlnS1B1_I.iIsoApe UEGO_DiagSigEvlnS1B1_I.iIsoIpe UEGO_DiagSigEvlnS1B1_I.iIsoRe UEGO_DiagSigEvlnS1B1_I.nrModMeasOld UEGO_DiagSigEvlnS1B1_I.nrSubModMeasOld UEGO_DiagSigEvlnS1B1_I.rIsoApe UEGO_DiagSigEvlnS1B1_I.rIsoIpe UEGO_DiagSigEvlnS1B1_I.rIsoRe UEGO_DiagSigEvlnS1B1_I.ratIFltApeSc UEGO_DiagSigEvlnS1B1_I.ratIFltIpeSc UEGO_DiagSigEvlnS1B1_I.ratIFltReSc UEGO_DiagSigEvlnS1B1_I.uDeltaUg0a UEGO_DiagSigEvlnS1B1_I.uDeltaUg0aHiIsq UEGO_DiagSigEvlnS1B1_I.uDeltaUg0aLoIsq UEGO_DiagSigEvlnS1B1_I.uDeltaUg0e UEGO_DiagSigEvlnS1B1_I.uDeltaUg0eHiIsq UEGO_DiagSigEvlnS1B1_I.uDeltaUg0eLoIsq UEGO_DiagSigEvlnS1B1_I.uDeltaUg0i UEGO_DiagSigEvlnS1B1_I.uDeltaUg0iHiIsq UEGO_DiagSigEvlnS1B1_I.uDeltaUg0iLoIsq UEGO_DiagSigEvlnS1B1_I.uIsoApe UEGO_DiagSigEvlnS1B1_I.uIsoIpe UEGO_DiagSigEvlnS1B1_I.uIsoRe UEGO_DiagSigEvlnS1B1_I.uScApe UEGO_DiagSigEvlnS1B1_I.uScIpe UEGO_DiagSigEvlnS1B1_I.uScRe UEGO_DiagSigEvlnS1B1_I.uUg0HiIsq UEGO_DiagSigEvlnS1B1_I.uUg0LoIsq UEGO_DiagSigEvlnS1B1_I.uUg0Pck UEGO_DiagSigEvlnS1B1_I.uUg0PckPeak UEGO_DiagSigEvlnS1B1_I.uUg0PeakFil_I.flgFilStrtd UEGO_DiagSigEvlnS1B1_I.uUg0PeakFil_I.uDeltaInOutpMax UEGO_DiagSigEvlnS1B1_I.uUg0aDeltaPeakFil_I.flgFilStrtd UEGO_DiagSigEvlnS1B1_I.uUg0aDeltaPeakFil_I.uDeltaInOutpMax UEGO_DiagSigEvlnS1B1_I.uUg0eDeltaPeakFil_I.flgFilStrtd UEGO_DiagSigEvlnS1B1_I.uUg0eDeltaPeakFil_I.uDeltaInOutpMax UEGO_DiagSigEvlnS1B1_I.uUg0iDeltaPeakFil_I.flgFilStrtd UEGO_DiagSigEvlnS1B1_I.uUg0iDeltaPeakFil_I.uDeltaInOutpMax /end LOC_MEASUREMENT
 FUNCTION_VERSION "1.16.0" /end FUNCTION
/begin FUNCTION UEGO_DiagSigGet "1.10.0    UEGO diagnostics data acquisition of the signal path" /begin REF_CHARACTERISTIC UEGO_idxHWES1B1_C /end REF_CHARACTERISTIC
 /begin IN_MEASUREMENT SyC_ctPostDrvLeave UEGO_DataSplyClsS1B1_I.flgCj135An UEGO_DataSplyClsS1B1_I.flgDACOff UEGO_DataSplyClsS1B1_I.flgErrSpiRamRet UEGO_DataSplyClsS1B1_I.flgFKal1Vld UEGO_DataSplyClsS1B1_I.flgFKal2Vld UEGO_DataSplyClsS1B1_I.flgFKal3Vld UEGO_DataSplyClsS1B1_I.flgIPmpActvd UEGO_DataSplyClsS1B1_I.flgISQrA UEGO_DataSplyClsS1B1_I.flgISQrE UEGO_DataSplyClsS1B1_I.flgLCURR UEGO_DataSplyClsS1B1_I.flgLNMeas UEGO_DataSplyClsS1B1_I.flgLPMeas UEGO_DataSplyClsS1B1_I.flgLoupeCAL UEGO_DataSplyClsS1B1_I.flgLoupeG0 UEGO_DataSplyClsS1B1_I.flgLstPckAbort UEGO_DataSplyClsS1B1_I.flgMKA UEGO_DataSplyClsS1B1_I.flgMKE UEGO_DataSplyClsS1B1_I.flgNewIPmpDacPckAry UEGO_DataSplyClsS1B1_I.flgNewIPmpOK UEGO_DataSplyClsS1B1_I.flgNewIPmpPckAry UEGO_DataSplyClsS1B1_I.flgNewIPmpTM UEGO_DataSplyClsS1B1_I.flgNewPck UEGO_DataSplyClsS1B1_I.flgNewPckCstnc UEGO_DataSplyClsS1B1_I.flgNewPckMiss UEGO_DataSplyClsS1B1_I.flgNewPckVld UEGO_DataSplyClsS1B1_I.flgNewTiPck UEGO_DataSplyClsS1B1_I.flgNewURmVG4MeasAryVld UEGO_DataSplyClsS1B1_I.flgNewUa2Pck UEGO_DataSplyClsS1B1_I.flgNewUa31Pck UEGO_DataSplyClsS1B1_I.flgNewUa32Pck UEGO_DataSplyClsS1B1_I.flgNewUa33Pck UEGO_DataSplyClsS1B1_I.flgNewUamPck UEGO_DataSplyClsS1B1_I.flgNewUapePck UEGO_DataSplyClsS1B1_I.flgNewUcalMaxPck UEGO_DataSplyClsS1B1_I.flgNewUcalPck UEGO_DataSplyClsS1B1_I.flgNewUg0Pck UEGO_DataSplyClsS1B1_I.flgNewUg0PckAry UEGO_DataSplyClsS1B1_I.flgNewUg0aPck UEGO_DataSplyClsS1B1_I.flgNewUg0ePck UEGO_DataSplyClsS1B1_I.flgNewUg0iPck UEGO_DataSplyClsS1B1_I.flgNewUg0iPckAry UEGO_DataSplyClsS1B1_I.flgNewUg0iaiPck UEGO_DataSplyClsS1B1_I.flgNewUg0ieiPck UEGO_DataSplyClsS1B1_I.flgNewUg0ix7PckAry UEGO_DataSplyClsS1B1_I.flgNewUg0ix9PckAry UEGO_DataSplyClsS1B1_I.flgNewUg0ixPckAry UEGO_DataSplyClsS1B1_I.flgNewUg0mPck UEGO_DataSplyClsS1B1_I.flgNewUgaPck UEGO_DataSplyClsS1B1_I.flgNewUgiPckAry UEGO_DataSplyClsS1B1_I.flgNewUgkAvrgPck UEGO_DataSplyClsS1B1_I.flgNewUguaPck UEGO_DataSplyClsS1B1_I.flgNewUguaZ2Pck UEGO_DataSplyClsS1B1_I.flgNewUguiPck UEGO_DataSplyClsS1B1_I.flgNewUguiZ1Pck UEGO_DataSplyClsS1B1_I.flgNewUi21PckAry UEGO_DataSplyClsS1B1_I.flgNewUi22Pck UEGO_DataSplyClsS1B1_I.flgNewUi23Pck UEGO_DataSplyClsS1B1_I.flgNewUi24Pck UEGO_DataSplyClsS1B1_I.flgNewUi4Pck UEGO_DataSplyClsS1B1_I.flgNewUi4Z2Pck UEGO_DataSplyClsS1B1_I.flgNewUigPckAry UEGO_DataSplyClsS1B1_I.flgNewUigmkPckAry UEGO_DataSplyClsS1B1_I.flgNewUipcalAvrgPck UEGO_DataSplyClsS1B1_I.flgNewUn0Pck UEGO_DataSplyClsS1B1_I.flgNewUn0Pck4Ary UEGO_DataSplyClsS1B1_I.flgNewUn0Pck5Ary UEGO_DataSplyClsS1B1_I.flgNewUn0PckAry UEGO_DataSplyClsS1B1_I.flgNewUnPckAry UEGO_DataSplyClsS1B1_I.flgNewUnSetPck UEGO_DataSplyClsS1B1_I.flgNewUnx3PckAry UEGO_DataSplyClsS1B1_I.flgNewUnx4PckAry UEGO_DataSplyClsS1B1_I.flgNewUp0Pck UEGO_DataSplyClsS1B1_I.flgNewUp0Pck4 UEGO_DataSplyClsS1B1_I.flgNewUp0Pck5Ary UEGO_DataSplyClsS1B1_I.flgNewUp0PckAry UEGO_DataSplyClsS1B1_I.flgNewUpPckAry UEGO_DataSplyClsS1B1_I.flgNewUpx3PckAry UEGO_DataSplyClsS1B1_I.flgNewUpx4PckAry UEGO_DataSplyClsS1B1_I.flgNewUriaPckVld UEGO_DataSplyClsS1B1_I.flgNewUriePckAry UEGO_DataSplyClsS1B1_I.flgNewUx6PckAry UEGO_DataSplyClsS1B1_I.flgNewUx7PckAry UEGO_DataSplyClsS1B1_I.flgNewUx8PckAry UEGO_DataSplyClsS1B1_I.flgNewUx9PckAry UEGO_DataSplyClsS1B1_I.flgNewUxPckAry UEGO_DataSplyClsS1B1_I.flgReStable UEGO_DataSplyClsS1B1_I.flgSngCell UEGO_DataSplyClsS1B1_I.flgUical0Vld UEGO_DataSplyClsS1B1_I.flgUicalVld UEGO_DataSplyClsS1B1_I.flgUoffipe1Vld UEGO_DataSplyClsS1B1_I.flgUoffipe2Vld UEGO_DataSplyClsS1B1_I.flgUoffipe3Vld UEGO_DataSplyClsS1B1_I.flgUoffvcc1Vld UEGO_DataSplyClsS1B1_I.flgUoffvcc2Vld UEGO_DataSplyClsS1B1_I.flgUoffvcc3Vld UEGO_DataSplyClsS1B1_I.flgUriaMeas UEGO_DataSplyClsS1B1_I.nrIPmpDacPckAry UEGO_DataSplyClsS1B1_I.nrIpPckAry UEGO_DataSplyClsS1B1_I.nrModeMeas UEGO_DataSplyClsS1B1_I.nrRamFailPosn UEGO_DataSplyClsS1B1_I.nrRamMod UEGO_DataSplyClsS1B1_I.nrRamRegMod UEGO_DataSplyClsS1B1_I.nrRamSts1 UEGO_DataSplyClsS1B1_I.nrRamSts2 UEGO_DataSplyClsS1B1_I.nrRamSts3 UEGO_DataSplyClsS1B1_I.nrURmVG4PckAry UEGO_DataSplyClsS1B1_I.nrUa2PckAry UEGO_DataSplyClsS1B1_I.nrUcalMaxCorrd UEGO_DataSplyClsS1B1_I.nrUg0PckAry UEGO_DataSplyClsS1B1_I.nrUg0iPckAry UEGO_DataSplyClsS1B1_I.nrUg0ix7PckAry UEGO_DataSplyClsS1B1_I.nrUg0ix9PckAry UEGO_DataSplyClsS1B1_I.nrUg0ixPckAry UEGO_DataSplyClsS1B1_I.nrUgaPckAry UEGO_DataSplyClsS1B1_I.nrUgiPckAry UEGO_DataSplyClsS1B1_I.nrUi21PckAry UEGO_DataSplyClsS1B1_I.nrUical0PckCorrd UEGO_DataSplyClsS1B1_I.nrUicalPckCorrd UEGO_DataSplyClsS1B1_I.nrUigPckAry UEGO_DataSplyClsS1B1_I.nrUigmkPckAry UEGO_DataSplyClsS1B1_I.nrUn0Pck4Ary UEGO_DataSplyClsS1B1_I.nrUn0Pck5Ary UEGO_DataSplyClsS1B1_I.nrUn0PckAry UEGO_DataSplyClsS1B1_I.nrUnPckAry UEGO_DataSplyClsS1B1_I.nrUnx3PckAry UEGO_DataSplyClsS1B1_I.nrUnx4PckAry UEGO_DataSplyClsS1B1_I.nrUoffipe1 UEGO_DataSplyClsS1B1_I.nrUoffipe2 UEGO_DataSplyClsS1B1_I.nrUoffipe3 UEGO_DataSplyClsS1B1_I.nrUoffvcc1 UEGO_DataSplyClsS1B1_I.nrUoffvcc2 UEGO_DataSplyClsS1B1_I.nrUoffvcc3 UEGO_DataSplyClsS1B1_I.nrUp0Pck5Ary UEGO_DataSplyClsS1B1_I.nrUp0PckAry UEGO_DataSplyClsS1B1_I.nrUpPckAry UEGO_DataSplyClsS1B1_I.nrUpx3PckAry UEGO_DataSplyClsS1B1_I.nrUpx4PckAry UEGO_DataSplyClsS1B1_I.nrUriePckAry UEGO_DataSplyClsS1B1_I.nrUx6PckAry UEGO_DataSplyClsS1B1_I.nrUx7PckAry UEGO_DataSplyClsS1B1_I.nrUx8PckAry UEGO_DataSplyClsS1B1_I.nrUx9PckAry UEGO_DataSplyClsS1B1_I.nrUxPckAry UEGO_DataSplyClsS1B1_I.stIPmpOK UEGO_DataSplyClsS1B1_I.stIPmpTM UEGO_DataSplyClsS1B1_I.stIPmpTM2L UEGO_DataSplyClsS1B1_I.stIPmpTM2R UEGO_DataSplyClsS1B1_I.stLsmRetValMod UEGO_DataSplyClsS1B1_I.stMKMeas UEGO_DataSplyClsS1B1_I.stOFFMeas UEGO_DataSplyClsS1B1_I.stOPTMeas UEGO_DataSplyClsS1B1_I.stREFMeas UEGO_DataSplyClsS1B1_I.stUa2PckAry UEGO_DataSplyClsS1B1_I.stUa2Z1PckAry UEGO_DataSplyClsS1B1_I.stUg0iPckAry UEGO_DataSplyClsS1B1_I.stUg0ix7IActvPckAry UEGO_DataSplyClsS1B1_I.stUg0ix7PmpIActvPckAry UEGO_DataSplyClsS1B1_I.stUg0ix9IActvPckAry UEGO_DataSplyClsS1B1_I.stUg0ix9PmpIActvPckAry UEGO_DataSplyClsS1B1_I.stUg0ixIActvPckAry UEGO_DataSplyClsS1B1_I.stUg0ixPmpIActvPckAry UEGO_DataSplyClsS1B1_I.stUi21PckAry UEGO_DataSplyClsS1B1_I.stUi21Z1PckAry UEGO_DataSplyClsS1B1_I.stUigmkNernstIActvPckAry UEGO_DataSplyClsS1B1_I.stUigmkPmpIActvPckAry UEGO_DataSplyClsS1B1_I.stUn0PckAry UEGO_DataSplyClsS1B1_I.stUn0Z2PckAry UEGO_DataSplyClsS1B1_I.stUnPckAry UEGO_DataSplyClsS1B1_I.stUnx3IActvAcrsNernstCellPckAry UEGO_DataSplyClsS1B1_I.stUnx3IActvAcrsPmpCellPckAry UEGO_DataSplyClsS1B1_I.stUnx4IActvAcrsNernstCellPckAry UEGO_DataSplyClsS1B1_I.stUnx4IActvAcrsPmpCellPckAry UEGO_DataSplyClsS1B1_I.stUp0PckAry UEGO_DataSplyClsS1B1_I.stUp0Z2PckAry UEGO_DataSplyClsS1B1_I.stUpPckAry UEGO_DataSplyClsS1B1_I.stUpZ2PckAry UEGO_DataSplyClsS1B1_I.stUpx3IActvAcrsNernstCellPckAry UEGO_DataSplyClsS1B1_I.stUpx3IActvAcrsPmpCellPckAry UEGO_DataSplyClsS1B1_I.stUpx4IActvAcrsNernstCellPckAry UEGO_DataSplyClsS1B1_I.stUpx4IActvAcrsPmpCellPckAry UEGO_DataSplyClsS1B1_I.stUriePckAry UEGO_DataSplyClsS1B1_I.stUx6IActvPckAry UEGO_DataSplyClsS1B1_I.stUx6MeasAcrsPmpCellPckAry UEGO_DataSplyClsS1B1_I.stUx7IActvPckAry UEGO_DataSplyClsS1B1_I.stUx7MeasAcrsPmpCellPckAry UEGO_DataSplyClsS1B1_I.stUx8IActvPckAry UEGO_DataSplyClsS1B1_I.stUx8MeasAcrsPmpCellPckAry UEGO_DataSplyClsS1B1_I.stUx9IActvPckAry UEGO_DataSplyClsS1B1_I.stUx9MeasAcrsPmpCellPckAry UEGO_DataSplyClsS1B1_I.stUxIActvPckAry UEGO_DataSplyClsS1B1_I.stUxMeasAcrsPmpCell UEGO_DataSplyClsS1B1_I.tiUEGOPck UEGO_DataSplyClsS1B1_I.uFkal1 UEGO_DataSplyClsS1B1_I.uFkal2 UEGO_DataSplyClsS1B1_I.uFkal3 UEGO_DataSplyClsS1B1_I.uUCalPck UEGO_DataSplyClsS1B1_I.uUa31Pck UEGO_DataSplyClsS1B1_I.uUa32Pck UEGO_DataSplyClsS1B1_I.uUa33Pck UEGO_DataSplyClsS1B1_I.uUamPck UEGO_DataSplyClsS1B1_I.uUapePck UEGO_DataSplyClsS1B1_I.uUcalMaxPck UEGO_DataSplyClsS1B1_I.uUg0Pck UEGO_DataSplyClsS1B1_I.uUg0aPck UEGO_DataSplyClsS1B1_I.uUg0ePck UEGO_DataSplyClsS1B1_I.uUg0iPck UEGO_DataSplyClsS1B1_I.uUg0iaiPck UEGO_DataSplyClsS1B1_I.uUg0ieiPck UEGO_DataSplyClsS1B1_I.uUg0mPck UEGO_DataSplyClsS1B1_I.uUgkAvrgPck UEGO_DataSplyClsS1B1_I.uUguaPck UEGO_DataSplyClsS1B1_I.uUguaZ2Pck UEGO_DataSplyClsS1B1_I.uUguiPck UEGO_DataSplyClsS1B1_I.uUguiZ1Pck UEGO_DataSplyClsS1B1_I.uUi22Pck UEGO_DataSplyClsS1B1_I.uUi23Pck UEGO_DataSplyClsS1B1_I.uUi24Pck UEGO_DataSplyClsS1B1_I.uUi4Pck UEGO_DataSplyClsS1B1_I.uUi4Z2Pck UEGO_DataSplyClsS1B1_I.uUipcalAvrgPck UEGO_DataSplyClsS1B1_I.uUn0Pck UEGO_DataSplyClsS1B1_I.uUnSet UEGO_DataSplyClsS1B1_I.uUp0Pck UEGO_DataSplyClsS1B1_I.uUp0Pck4 UEGO_DataSplyClsS1B1_I.uUriaPck UEGO_DataSplyClsS1B1_I.uVCC1Corrd UEGO_DataSplyClsS1B1_I.uVCC3Ref UEGO_flgSysSuprtdS1B1 /end IN_MEASUREMENT
 /begin OUT_MEASUREMENT UEGO_cntrDiagSigRamBnkSpiS1B1 UEGO_cntrDiagSigRegBnkSpiS1B1 UEGO_cntrDiagSigRegDiagSpiS1B1 UEGO_flgDiagSigCmnIrqVld UEGO_flgDiagSigNewDatS1B1 UEGO_flgDiagSigRamBnkSpiVldS1B1 UEGO_flgDiagSigRegBnkSpiS1B1 UEGO_flgDiagSigRegBnkSpiVldS1B1 UEGO_flgDiagSigRegDiagSpiS1B1 UEGO_flgDiagSigRegDiagSpiVldS1B1 UEGO_flgDiagSigRegDiagVldS1B1 UEGO_flgErrSpiRamBnk10msS1B1 UEGO_flgErrSpiRamBnk5msS1B1 UEGO_nrModCurrS1B1 UEGO_numModCurrS1B1 UEGO_stDiagSigChpS1B1 UEGO_stDiagSigCmnIrq UEGO_stDiagSigRegChpStS1B1 UEGO_stDiagSigRegDiag0S1B1 UEGO_stDiagSigRegDiag1S1B1 UEGO_stDiagSigRegDspStS1B1 /end OUT_MEASUREMENT
 /begin LOC_MEASUREMENT UEGO_cntrDiagSigGetReIniProc10msec UEGO_DiagSigGetS1B1_I.ErrAry UEGO_DiagSigGetS1B1_I.ErrAry_5ms UEGO_DiagSigGetS1B1_I.TmpArr10ms UEGO_DiagSigGetS1B1_I.cntrDiagSigRamBnkSpi UEGO_DiagSigGetS1B1_I.cntrDiagSigRegBnkSpi UEGO_DiagSigGetS1B1_I.cntrDiagSigRegDiagSpi UEGO_DiagSigGetS1B1_I.flgDiagSigCmnIrqVld UEGO_DiagSigGetS1B1_I.flgDiagSigNewDat UEGO_DiagSigGetS1B1_I.flgDiagSigNewDat_5ms UEGO_DiagSigGetS1B1_I.flgDiagSigNewDat_New UEGO_DiagSigGetS1B1_I.flgDiagSigRamBnkSpiVld UEGO_DiagSigGetS1B1_I.flgDiagSigRegBnkSpi UEGO_DiagSigGetS1B1_I.flgDiagSigRegBnkSpiPrv UEGO_DiagSigGetS1B1_I.flgDiagSigRegBnkSpiVld UEGO_DiagSigGetS1B1_I.flgDiagSigRegDiagSpi UEGO_DiagSigGetS1B1_I.flgDiagSigRegDiagSpiVld UEGO_DiagSigGetS1B1_I.flgDiagSigRegDiagSpi_5ms UEGO_DiagSigGetS1B1_I.flgDiagSigRegDiagVld UEGO_DiagSigGetS1B1_I.flgDiagSigRegDiagVld_5ms UEGO_DiagSigGetS1B1_I.flgDiagSigRegDiagVld_New UEGO_DiagSigGetS1B1_I.flgDiagSigSpiErr UEGO_DiagSigGetS1B1_I.flgDiagSigSpiErrPrv UEGO_DiagSigGetS1B1_I.flgDiagSigSpiErr_5ms UEGO_DiagSigGetS1B1_I.flgErrSpiRamBnk10ms UEGO_DiagSigGetS1B1_I.flgErrSpiRamBnk10msPrv UEGO_DiagSigGetS1B1_I.flgErrSpiRamBnk5ms UEGO_DiagSigGetS1B1_I.flgRegBnkDatVld UEGO_DiagSigGetS1B1_I.flgRegBnkSpiErr UEGO_DiagSigGetS1B1_I.flgRstExtReq UEGO_DiagSigGetS1B1_I.numModCurr UEGO_DiagSigGetS1B1_I.stDiagSigChp UEGO_DiagSigGetS1B1_I.stDiagSigChp_5ms UEGO_DiagSigGetS1B1_I.stDiagSigChp_New UEGO_DiagSigGetS1B1_I.stDiagSigCmnIrq UEGO_DiagSigGetS1B1_I.stDiagSigRegChpSt UEGO_DiagSigGetS1B1_I.stDiagSigRegChpSt_5ms UEGO_DiagSigGetS1B1_I.stDiagSigRegChpSt_New UEGO_DiagSigGetS1B1_I.stDiagSigRegDiag0 UEGO_DiagSigGetS1B1_I.stDiagSigRegDiag0_5ms UEGO_DiagSigGetS1B1_I.stDiagSigRegDiag0_New UEGO_DiagSigGetS1B1_I.stDiagSigRegDiag1 UEGO_DiagSigGetS1B1_I.stDiagSigRegDiag1_5ms UEGO_DiagSigGetS1B1_I.stDiagSigRegDiag1_New UEGO_DiagSigGetS1B1_I.stDiagSigRegDspSt UEGO_DiagSigGetS1B1_I.stDiagSigRegDspSt_5ms UEGO_DiagSigGetS1B1_I.stDiagSigRegDspSt_New UEGO_flgDiagSigGetExtRstReq /end LOC_MEASUREMENT
 FUNCTION_VERSION "1.10.0" /end FUNCTION
/begin FUNCTION UEGO_DiagSigOperPlaus "1.24.0    UEGO diagnostics of plausibility of the operation of the signal path"
 /begin DEF_CHARACTERISTIC UEGO_flgOperPlausFastTestResEna_C UEGO_flgOperPlausPreEngStrtRels_C UEGO_stDiagSigOperPlausReactnEna_C UEGO_stDiagSigOperPlausRelsDly_C UEGO_stDiagSigOperPlausRelsNoDly_C UEGO_tiDlyDiagSigOperPlausOvrRunOff_C UEGO_tiDlyDiagSigOperPlausOvrRunOn_C UEGO_tiDlyDiagSigOperPlausRels_C UEGO_uBattUHiOperPlaus_C UEGO_uBattULoOperPlaus_C /end DEF_CHARACTERISTIC
 /begin REF_CHARACTERISTIC UEGO_stO2VldBitMask_C /end REF_CHARACTERISTIC
 /begin IN_MEASUREMENT BattU_u B_sa_msg SyC_ctPostDrvLeave UEGO_cntrModEvlnS1B1 UEGO_cntrSubModEvlnS1B1 UEGO_flgCmbEngStopDcycEnd UEGO_flgDewPntRelsS1B1 UEGO_flgDsmVld UEGO_flgEngRunng UEGO_flgO2EquivVldS1B1 UEGO_idxTypS1B1 UEGO_nrModVrfdS1B1 UEGO_nrSubModVrfdS1B1 UEGO_RegSetS1B1_I.cntrRegSet UEGO_RegSetS1B1_I.flgCJ135An UEGO_RegSetS1B1_I.flgConvVld UEGO_RegSetS1B1_I.flgIPmpDes UEGO_RegSetS1B1_I.flgIPmpPhyRels UEGO_RegSetS1B1_I.flgIniFinshd UEGO_RegSetS1B1_I.flgLoupeCURRDes UEGO_RegSetS1B1_I.flgLoupeDACDes UEGO_RegSetS1B1_I.flgLoupeNDes UEGO_RegSetS1B1_I.flgLoupePDes UEGO_RegSetS1B1_I.flgNewReq UEGO_RegSetS1B1_I.flgRegSetSt UEGO_RegSetS1B1_I.flgRegSetStVld UEGO_RegSetS1B1_I.flgReqAcptd UEGO_RegSetS1B1_I.flgSetRegOk UEGO_RegSetS1B1_I.flgTakeDataOk UEGO_RegSetS1B1_I.idxChp UEGO_RegSetS1B1_I.nrIdleSubMode UEGO_RegSetS1B1_I.nrModDes UEGO_RegSetS1B1_I.nrNormSubMode UEGO_RegSetS1B1_I.nrRegSet UEGO_RegSetS1B1_I.nrSubModDes UEGO_RegSetS1B1_I.nrSwtOnSubMode UEGO_RegSetS1B1_I.nrTrmSq UEGO_RegSetS1B1_I.nrWrmUpSubMode UEGO_RegSetS1B1_I.stRegSet UEGO_RegSetS1B1_I.stRegSetVld UEGO_RegSetS1B1_I.tmpVar UEGO_stO2VldS1B1 /end IN_MEASUREMENT
 /begin OUT_MEASUREMENT UEGO_stDiagSigOperPlausRprtS1B1 /end OUT_MEASUREMENT
 /begin LOC_MEASUREMENT UEGO_cntrDiagSigOperPlausReiniProc10msec UEGO_DiagSigOperPlausS1B1_I.flgEngRunngOnceCyc UEGO_DiagSigOperPlausS1B1_I.flgRstDsmClr UEGO_DiagSigOperPlausS1B1_I.flgRstExtReq UEGO_DiagSigOperPlausS1B1_I.stDiagSigOperPlausRels UEGO_DiagSigOperPlausS1B1_I.stDiagSigOperPlausRprt UEGO_DiagSigOperPlausS1B1_I.OperPlausFastTestRelsFF_I.status UEGO_DiagSigOperPlausS1B1_I.UEGO_flgDsmErrDebERNM_I.oldSignal UEGO_DiagSigOperPlausS1B1_I.UEGO_flgDsmTstERNM_I.oldSignal UEGO_DiagSigOperPlausS1B1_I.tiDlyDiagSigOperPlausOvrRunTOFFV_I.outbit UEGO_DiagSigOperPlausS1B1_I.tiDlyDiagSigOperPlausOvrRunTOFFV_I.time UEGO_DiagSigOperPlausS1B1_I.tiDlyDiagSigOperPlausOvrRunTONV_I.outbit UEGO_DiagSigOperPlausS1B1_I.tiDlyDiagSigOperPlausOvrRunTONV_I.time UEGO_DiagSigOperPlausS1B1_I.tiDlyDiagSigOperPlausRelsTONVNM_I.time UEGO_flgDiagSigOperPlausExtRstReq UEGO_uPwrSply /end LOC_MEASUREMENT
 FUNCTION_VERSION "1.24.0" /end FUNCTION
/begin FUNCTION UEGO_DiagSigSnsr "1.16.0    UEGO diagnostics of the sensor part of the signal path"
 /begin DEF_CHARACTERISTIC UEGO_iDeltaPmpHi_C UEGO_iDeltaPmpLo_C UEGO_ratIPmpExctHi_C UEGO_ratIPmpExctLo_C UEGO_rRipHi_C UEGO_stDiagSigSnsrReactnEna_C UEGO_stDiagSigSnsrRprtEna_C UEGO_tDiagSigSnsr_C UEGO_tiDlyRipHi_C /end DEF_CHARACTERISTIC
 /begin IN_MEASUREMENT SyC_ctPostDrvLeave UEGO_cntrModEvlnS1B1 UEGO_cntrSubModEvlnS1B1 UEGO_flgDiagRprtRelsS1B1 UEGO_flgDiagSigEcuAsicTstdOkS1B1 UEGO_flgDiagSigEcuComTstdOkS1B1 UEGO_flgDiagSigWireOlTstdOkS1B1 UEGO_flgDiagSigWireScTstdOkS1B1 UEGO_flgDsmVld UEGO_flgIPmpDeltaVldS1B1 UEGO_flgRatIPmpExctVldS1B1 UEGO_flgRPmpPlsOperDiagVldS1B1 UEGO_flgSysSuprtdS1B1 UEGO_flgTCeramicVldS1B1 UEGO_iIPmpDeltaS1B1 UEGO_nrModVrfdS1B1 UEGO_nrSubModVrfdS1B1 UEGO_ratIPmpExctS1B1 UEGO_rRPmpPlsOperDiagS1B1 UEGO_tCeramicS1B1 /end IN_MEASUREMENT
 /begin OUT_MEASUREMENT UEGO_flgDiagSigSnsrRstS1B1 UEGO_flgDiagSigSnsrTstdOkS1B1 UEGO_stDiagSigSnsrCycS1B1 UEGO_stDiagSigSnsrRprtS1B1 /end OUT_MEASUREMENT
 /begin LOC_MEASUREMENT UEGO_cntrDiagSigSnsrReiniProc10msec UEGO_DiagSigSnsrS1B1_I.flgDiagSigSnsrRst UEGO_DiagSigSnsrS1B1_I.flgDiagSigSnsrTstdOk UEGO_DiagSigSnsrS1B1_I.flgRstDsmClr UEGO_DiagSigSnsrS1B1_I.flgRstExtReq UEGO_DiagSigSnsrS1B1_I.stDiagSigSnsrCyc UEGO_DiagSigSnsrS1B1_I.stDiagSigSnsrRprt UEGO_DiagSigSnsrS1B1_I.UEGO_DiagSigSnsrResClass_I.stErr UEGO_DiagSigSnsrS1B1_I.UEGO_DiagSigSnsrResClass_I.stTstdCyc UEGO_DiagSigSnsrS1B1_I.UEGO_DiagSigSnsrResClass_I.stTstdCycRprt UEGO_DiagSigSnsrS1B1_I.UEGO_RipHiErrTONVNM_I.time UEGO_DiagSigSnsrS1B1_I.UEGO_RipHiRelsTONVNM_I.time UEGO_DiagSigSnsrS1B1_I.UEGO_flgDsmErrDebERNM_I.oldSignal UEGO_DiagSigSnsrS1B1_I.UEGO_flgDsmTstERNM_I.oldSignal UEGO_flgDiagSigSnsrExtRstReq /end LOC_MEASUREMENT
 FUNCTION_VERSION "1.16.0" /end FUNCTION
/begin FUNCTION UEGO_DiagSigWireOl "1.32.0    UEGO diagnostics of open-loads in the wires of the signal path"
 /begin DEF_CHARACTERISTIC UEGO_nrDiagSigIdleDchaTi_C UEGO_nrRamFailPosnMax_C UEGO_nrRamFailPosnMin_C UEGO_ratIPmpExctDiagWireOlElectLo_C UEGO_ratIPmpExctDiagWireRCmpLo_C UEGO_rCircHi_C UEGO_rCmpHi_C UEGO_rRPmpDiagHi_C UEGO_rRPmpDiagIni_C UEGO_rRPmpStep_C UEGO_rWireApeDiagWireOlHi_T UEGO_stDiagSigWireOlApesRprtEna_C UEGO_stDiagSigWireOlElectCircReactnEna_C UEGO_stDiagSigWireOlIpeRprtEna_C UEGO_stDiagSigWireOlReRprtEna_C UEGO_stDiagSigWireRCmpCircReactnEna_C UEGO_stDiagSigWireRCmpRprtEna_C UEGO_tiRPmpDiagSwtDly_C UEGO_tRPmpDiagSwt_C UEGO_uNernstDiagWireOlHi_C /end DEF_CHARACTERISTIC
 /begin IN_MEASUREMENT SyC_ctPostDrvLeave UEGO_cntrModEvlnS1B1 UEGO_cntrSubModEvlnS1B1 UEGO_flgDiagRprtRelsS1B1 UEGO_flgDiagSigEcuAsicTstdOkS1B1 UEGO_flgDiagSigEcuComTstdOkS1B1 UEGO_flgDiagSigWireScTstdOkS1B1 UEGO_flgDsmVld UEGO_flgRamFailVldS1B1 UEGO_flgRatINernstExctVldS1B1 UEGO_flgRatIPmpExctVldS1B1 UEGO_flgRCmpUseS1B1 UEGO_flgRCmpVldS1B1 UEGO_flgRNernstDiagVldS1B1 UEGO_flgRPmpDiagVldS1B1 UEGO_flgRPmpPlsOperDiagVldS1B1 UEGO_flgSnsrMdlHotS1B1 UEGO_flgSysSuprtdS1B1 UEGO_flgTCeramicVldS1B1 UEGO_flgUNernstDiagVldS1B1 UEGO_nrModVrfdS1B1 UEGO_nrRamFailPosnS1B1 UEGO_nrRamFailSts2S1B1 UEGO_nrRamFailSts3S1B1 UEGO_nrSubModVrfdS1B1 UEGO_ratINernstExctS1B1 UEGO_ratIPmpExctS1B1 UEGO_RegSetS1B1_I.cntrRegSet UEGO_RegSetS1B1_I.flgCJ135An UEGO_RegSetS1B1_I.flgConvVld UEGO_RegSetS1B1_I.flgIPmpDes UEGO_RegSetS1B1_I.flgIPmpPhyRels UEGO_RegSetS1B1_I.flgIniFinshd UEGO_RegSetS1B1_I.flgLoupeCURRDes UEGO_RegSetS1B1_I.flgLoupeDACDes UEGO_RegSetS1B1_I.flgLoupeNDes UEGO_RegSetS1B1_I.flgLoupePDes UEGO_RegSetS1B1_I.flgNewReq UEGO_RegSetS1B1_I.flgRegSetSt UEGO_RegSetS1B1_I.flgRegSetStVld UEGO_RegSetS1B1_I.flgReqAcptd UEGO_RegSetS1B1_I.flgSetRegOk UEGO_RegSetS1B1_I.flgTakeDataOk UEGO_RegSetS1B1_I.idxChp UEGO_RegSetS1B1_I.nrIdleSubMode UEGO_RegSetS1B1_I.nrModDes UEGO_RegSetS1B1_I.nrNormSubMode UEGO_RegSetS1B1_I.nrRegSet UEGO_RegSetS1B1_I.nrSubModDes UEGO_RegSetS1B1_I.nrSwtOnSubMode UEGO_RegSetS1B1_I.nrTrmSq UEGO_RegSetS1B1_I.nrWrmUpSubMode UEGO_RegSetS1B1_I.stRegSet UEGO_RegSetS1B1_I.stRegSetVld UEGO_RegSetS1B1_I.tmpVar UEGO_rRCmpS1B1 UEGO_rRNernstDiagS1B1 UEGO_rRPmpDiagS1B1 UEGO_rRPmpPlsOperDiagS1B1 UEGO_tCeramicS1B1 UEGO_uUNernstDiagS1B1 /end IN_MEASUREMENT
 /begin OUT_MEASUREMENT UEGO_flgDiagSigWireOlRstS1B1 UEGO_flgDiagSigWireOlTstdOkS1B1 UEGO_stDiagSigWireOlElectrCircCycS1B1 UEGO_stDiagSigWireRCmpCircCycS1B1 /end OUT_MEASUREMENT
 /begin LOC_MEASUREMENT UEGO_cntrDiagSigWireOlReIniProc10ms UEGO_DiagSigWireOlS1B1_I.cntrRPmpStep UEGO_DiagSigWireOlS1B1_I.flgDiagSigWireOlElectrodeCircRst UEGO_DiagSigWireOlS1B1_I.flgDiagSigWireOlRst UEGO_DiagSigWireOlS1B1_I.flgDiagSigWireOlTstdOk UEGO_DiagSigWireOlS1B1_I.flgDiagSigWireRCmpCircRst UEGO_DiagSigWireOlS1B1_I.flgRCmpErr UEGO_DiagSigWireOlS1B1_I.flgRstExtReq UEGO_DiagSigWireOlS1B1_I.rWireApeDiagWireOlHi UEGO_DiagSigWireOlS1B1_I.stDiagSigWireOlElectCircCyc UEGO_DiagSigWireOlS1B1_I.stDiagSigWireRCmpCircCyc UEGO_DiagSigWireOlS1B1_I.UEGO_DiagSigRCmpCircResClass_I.stErr UEGO_DiagSigWireOlS1B1_I.UEGO_DiagSigRCmpCircResClass_I.stTstdCyc UEGO_DiagSigWireOlS1B1_I.UEGO_DiagSigRCmpCircResClass_I.stTstdCycRprt UEGO_DiagSigWireOlS1B1_I.UEGO_DiagSigWireElectrodeCircResClass_I.stErr UEGO_DiagSigWireOlS1B1_I.UEGO_DiagSigWireElectrodeCircResClass_I.stTstdCyc UEGO_DiagSigWireOlS1B1_I.UEGO_DiagSigWireElectrodeCircResClass_I.stTstdCycRprt UEGO_DiagSigWireOlS1B1_I.UEGO_DiagSigWireOlStabIdleReqFF_I.status UEGO_DiagSigWireOlS1B1_I.UEGO_DiagSigWireOlSwtDlyTONVNM_I.time UEGO_flgDiagSigWireOlExtRstReq /end LOC_MEASUREMENT
 FUNCTION_VERSION "1.32.0" /end FUNCTION
/begin FUNCTION UEGO_DiagSigWireSc "1.23.0    UEGO diagnostics of short circuits in the wires of the signal path"
 /begin DEF_CHARACTERISTIC UEGO_iDeltaPmpDiagScHi_C UEGO_iDeltaPmpDiagScLo_C UEGO_iIsoHi_C UEGO_iIsoLo_C UEGO_ratIFltHi_C UEGO_ratIFltLo_C UEGO_ratIPmpExctDiagScHi_C UEGO_ratIPmpExctDiagScLoTempLo_C UEGO_ratIPmpExctDiagScLo_C UEGO_stDiagSigWireScbReactnEna_C UEGO_stDiagSigWireScbRprtEna_C UEGO_stDiagSigWireScgReactnEna_C UEGO_stDiagSigWireScgRprtEna_C UEGO_stDiagSigWireSc_C UEGO_swtIsoHi_C UEGO_swtIsoLo_C UEGO_tCerRatIPmpExctScLoSwt_C UEGO_tiDiagSigStrtDi_C UEGO_uNernstDiagScHi_C UEGO_uNernstDiagScLo_C UEGO_urIsoHi_M UEGO_urIsoLo_M UEGO_uScSwtOnHi_C UEGO_uScSwtOnLo_C UEGO_uUamDiagHi_C /end DEF_CHARACTERISTIC
 /begin IN_MEASUREMENT SyC_ctPostDrvLeave T15_st UEGO_cntrModEvlnS1B1 UEGO_cntrSubModEvlnS1B1 UEGO_flgCJ135AnS1B1 UEGO_flgDiagRprtRelsS1B1 UEGO_flgDiagSigEcuAsicTstdOkS1B1 UEGO_flgDiagSigEcuComTstdOkS1B1 UEGO_flgDiagSigRegDiagVldS1B1 UEGO_flgDsmVld UEGO_flgHiIsqCalcnCmplS1B1 UEGO_flgIPmpDeltaVldS1B1 UEGO_flgIsoApeVldS1B1 UEGO_flgIsoIpeVldS1B1 UEGO_flgIsoReVldS1B1 UEGO_flgRamFailVldS1B1 UEGO_flgRatIFltApeScVldS1B1 UEGO_flgRatIFltIpeScVldS1B1 UEGO_flgRatIFltReScVldS1B1 UEGO_flgRatINernstExctVldS1B1 UEGO_flgRatIPmpExctVldS1B1 UEGO_flgSnsrMdlHotS1B1 UEGO_flgSysSuprtdS1B1 UEGO_flgTCeramicVldS1B1 UEGO_flgTiEngOffVld UEGO_flgUNernstDiagVldS1B1 UEGO_flgUScApeVldS1B1 UEGO_flgUScIpeVldS1B1 UEGO_flgUScReVldS1B1 UEGO_iIPmpDeltaS1B1 UEGO_iIsoApeS1B1 UEGO_iIsoIpeS1B1 UEGO_iIsoReS1B1 UEGO_nrModVrfdS1B1 UEGO_nrRamFailSts1S1B1 UEGO_nrRamFailSts2S1B1 UEGO_nrRamFailSts3S1B1 UEGO_nrSubModVrfdS1B1 UEGO_ratIFltApeScS1B1 UEGO_ratIFltIpeScS1B1 UEGO_ratIFltReScS1B1 UEGO_ratINernstExctS1B1 UEGO_ratIPmpExctS1B1 UEGO_RegSetS1B1_I.cntrRegSet UEGO_RegSetS1B1_I.flgCJ135An UEGO_RegSetS1B1_I.flgConvVld UEGO_RegSetS1B1_I.flgIPmpDes UEGO_RegSetS1B1_I.flgIPmpPhyRels UEGO_RegSetS1B1_I.flgIniFinshd UEGO_RegSetS1B1_I.flgLoupeCURRDes UEGO_RegSetS1B1_I.flgLoupeDACDes UEGO_RegSetS1B1_I.flgLoupeNDes UEGO_RegSetS1B1_I.flgLoupePDes UEGO_RegSetS1B1_I.flgNewReq UEGO_RegSetS1B1_I.flgRegSetSt UEGO_RegSetS1B1_I.flgRegSetStVld UEGO_RegSetS1B1_I.flgReqAcptd UEGO_RegSetS1B1_I.flgSetRegOk UEGO_RegSetS1B1_I.flgTakeDataOk UEGO_RegSetS1B1_I.idxChp UEGO_RegSetS1B1_I.nrIdleSubMode UEGO_RegSetS1B1_I.nrModDes UEGO_RegSetS1B1_I.nrNormSubMode UEGO_RegSetS1B1_I.nrRegSet UEGO_RegSetS1B1_I.nrSubModDes UEGO_RegSetS1B1_I.nrSwtOnSubMode UEGO_RegSetS1B1_I.nrTrmSq UEGO_RegSetS1B1_I.nrWrmUpSubMode UEGO_RegSetS1B1_I.stRegSet UEGO_RegSetS1B1_I.stRegSetVld UEGO_RegSetS1B1_I.tmpVar UEGO_rIsoApeS1B1 UEGO_rIsoIpeS1B1 UEGO_rIsoReS1B1 UEGO_stDiagSigRegDiag0S1B1 UEGO_tCeramicS1B1 UEGO_tEgMdlS1B1 UEGO_tiEngOff UEGO_uIsoApeS1B1 UEGO_uIsoIpeS1B1 UEGO_uIsoReS1B1 UEGO_uScApeS1B1 UEGO_uScIpeS1B1 UEGO_uScReS1B1 UEGO_uUNernstDiagS1B1 /end IN_MEASUREMENT
 /begin OUT_MEASUREMENT UEGO_flgDiagSigWireScRstS1B1 UEGO_flgDiagSigWireScTstdOkS1B1 UEGO_stDiagSigWireScbCycS1B1 UEGO_stDiagSigWireScgCycS1B1 /end OUT_MEASUREMENT
 /begin LOC_MEASUREMENT UEGO_cntrDiagSigWireScReiniProc10msec UEGO_DiagSigWireScS1B1_I.flgDiagSigWireScRst UEGO_DiagSigWireScS1B1_I.flgDiagSigWireScTstdOk UEGO_DiagSigWireScS1B1_I.flgDiagSigWireScbRst UEGO_DiagSigWireScS1B1_I.flgDiagSigWireScgRst UEGO_DiagSigWireScS1B1_I.flgPerdDiag UEGO_DiagSigWireScS1B1_I.flgRstExtReq UEGO_DiagSigWireScS1B1_I.flgSnglShtDiag UEGO_DiagSigWireScS1B1_I.stDiagSigWireScbCyc UEGO_DiagSigWireScS1B1_I.stDiagSigWireScgCyc UEGO_DiagSigWireScS1B1_I.IPmpLimSevErrTONVNM_I.time UEGO_DiagSigWireScS1B1_I.IPmpLimSevTstdTONVNM_I.time UEGO_DiagSigWireScS1B1_I.PerdDiagOperTR_I.timeCounter UEGO_DiagSigWireScS1B1_I.UEGO_DiagSigScb16FltPahResClass_I.stErr UEGO_DiagSigWireScS1B1_I.UEGO_DiagSigScb16FltPahResClass_I.stTstdCyc UEGO_DiagSigWireScS1B1_I.UEGO_DiagSigScb16FltPahResClass_I.stTstdCycRprt UEGO_DiagSigWireScS1B1_I.UEGO_DiagSigScg16FltPahResClass_I.stErr UEGO_DiagSigWireScS1B1_I.UEGO_DiagSigScg16FltPahResClass_I.stTstdCyc UEGO_DiagSigWireScS1B1_I.UEGO_DiagSigScg16FltPahResClass_I.stTstdCycRprt UEGO_flgDiagSigWireScExtRstReq /end LOC_MEASUREMENT
 FUNCTION_VERSION "1.23.0" /end FUNCTION
/begin FUNCTION UEGO_Eng "1.15.1    Status of the Engine and the ECU" /begin DEF_CHARACTERISTIC UEGO_swtEngStrtNotRunng_C /end DEF_CHARACTERISTIC /begin IN_MEASUREMENT CoEng_stMai CoEng_stMaiOld /end IN_MEASUREMENT
 /begin OUT_MEASUREMENT UEGO_flgCmbEngStopDcycEnd UEGO_flgCmbEngTmpStop UEGO_flgEngRunng UEGO_flgEomIdle UEGO_flgNSyncn UEGO_stEng /end OUT_MEASUREMENT
 /begin LOC_MEASUREMENT UEGO_flgEngRunngIdleInt UEGO_flgScavActv /end LOC_MEASUREMENT
 FUNCTION_VERSION "1.15.1" /end FUNCTION
/begin FUNCTION UEGO_Exh "1.8.0     Properties of exhaust gas" /begin IN_MEASUREMENT ExhMod_tExhS1B1 ExhMod_tWallS1B1 UEGO_flgSysSuprtdS1B1 /end IN_MEASUREMENT /begin OUT_MEASUREMENT UEGO_tEgMdlS1B1 UEGO_tWallMdlS1B1 /end OUT_MEASUREMENT FUNCTION_VERSION "1.8.0" /end FUNCTION
/begin FUNCTION UEGO_HeatrCtrl "1.21.0    UEGO Heater Control"
 /begin DEF_CHARACTERISTIC UEGO_deltaUHeatrRamp_C UEGO_facErrTiHeatrCrv_C UEGO_facErrUHeatrCrv_C UEGO_facHeatrGovrKD_C UEGO_facHeatrGovrKI_C UEGO_facHeatrGovrKP_C UEGO_flgOvrHeatgPrevn_C UEGO_nrHeatgOff_C UEGO_swtClcTranStgy_C UEGO_swtOverHeatgProtn_C UEGO_tCeramicHeatrClcEna_C UEGO_tCeramicHeatrCrvMax_C UEGO_tiDlyHeatrOlcFinshd_C UEGO_tiDlyHeatrPwrStgOff_C UEGO_tiHeatrCrvMax_C UEGO_tiHeatrHld_C UEGO_uHeatrEfcDft_C UEGO_uHeatrEfcMin_C UEGO_uHeatrEfcReduced_C UEGO_uHeatrPidSp_C UEGO_uHeatrRampMax_C UEGO_uOverHeatgProtn_C UEGO_HeatrCtrlS1B1_I.stHeatgUpStgy_C UEGO_HeatrCtrlS1B1_I.stHeatrCtrl_C UEGO_HeatrCtrlS1B1_I.uCrv_T UEGO_HeatrCtrlS1B1_I.uHldRampStrt_T UEGO_tCeramicHeatrSp_C UEGO_uHeatrClcMax_C /end DEF_CHARACTERISTIC
 /begin IN_MEASUREMENT EnvT_t SyC_ctPostDrvLeave SyC_stSub UEGO_flgDsmVld UEGO_flgEngStHeatgStgyS1B1 UEGO_flgHeatrPsErrS1B1 UEGO_flgHeatrPwrStgCtrlMaxS1B1 UEGO_flgHeatrPwrStgOffS1B1 UEGO_flgOperRelsS1B1 UEGO_flgSnsrMdlHeatgUpFinshdS1B1 UEGO_flgSnsrMdlOverHeatgProtnS1B1 UEGO_flgSysSuprtdS1B1 UEGO_flgTCeramicVldS1B1 UEGO_tCeramicS1B1 UEGO_uHeatrS1B1 /end IN_MEASUREMENT
 /begin OUT_MEASUREMENT UEGO_flgHeatgOffS1B1 UEGO_flgHeatrClcActvS1B1 UEGO_flgHeatrCtrldModActvS1B1 UEGO_uHeatrCtrlEfcS1B1 /end OUT_MEASUREMENT
 /begin LOC_MEASUREMENT UEGO_HeatrCtrlS1B1_I.cntrReiniCalc20ms UEGO_HeatrCtrlS1B1_I.flgClcLimd UEGO_HeatrCtrlS1B1_I.flgCrvPhaFinshd UEGO_HeatrCtrlS1B1_I.flgHeatgOff UEGO_HeatrCtrlS1B1_I.flgHeatgUpFinshd UEGO_HeatrCtrlS1B1_I.flgHeatgUpRgl UEGO_HeatrCtrlS1B1_I.flgHeatrClcActv UEGO_HeatrCtrlS1B1_I.flgHeatrCtrlReduced UEGO_HeatrCtrlS1B1_I.flgHeatrCtrldModActv UEGO_HeatrCtrlS1B1_I.flgHeatrPwrStgOffLong UEGO_HeatrCtrlS1B1_I.flgHldPhaFinshd UEGO_HeatrCtrlS1B1_I.flgPrePostHeatgDisad UEGO_HeatrCtrlS1B1_I.flgRampPhaFinshd UEGO_HeatrCtrlS1B1_I.flgSysDsbc UEGO_HeatrCtrlS1B1_I.nrModInt UEGO_HeatrCtrlS1B1_I.nrModIntOld UEGO_HeatrCtrlS1B1_I.tDe UEGO_HeatrCtrlS1B1_I.tDeOld UEGO_HeatrCtrlS1B1_I.uClcKd UEGO_HeatrCtrlS1B1_I.uClcKi UEGO_HeatrCtrlS1B1_I.uClcKp UEGO_HeatrCtrlS1B1_I.uClcTot UEGO_HeatrCtrlS1B1_I.uHeatrCtrlEfc UEGO_HeatrCtrlS1B1_I.uHldPhaEfc UEGO_HeatrCtrlS1B1_I.ClcIntglITL_I.memory UEGO_HeatrCtrlS1B1_I.flgPwrStgOffTONV_I.outbit UEGO_HeatrCtrlS1B1_I.flgPwrStgOffTONV_I.time UEGO_HeatrCtrlS1B1_I.ratSqUBattSqUEfcA_I.memory UEGO_HeatrCtrlS1B1_I.tiCrvPhaSW_I.timeCounter UEGO_HeatrCtrlS1B1_I.tiExtdPhaSW_I.timeCounter UEGO_HeatrCtrlS1B1_I.tiHldPhaSW_I.timeCounter UEGO_HeatrCtrlS1B1_I.uRampITL_I.memory /end LOC_MEASUREMENT
 FUNCTION_VERSION "1.21.0" /end FUNCTION
/begin FUNCTION UEGO_HeatrPwrStgCtrl "1.7.0     UEGO Heater Power Stage Control"
 /begin DEF_CHARACTERISTIC UEGO_ratHeatrPwrStgMax_C UEGO_stHeatrPwrStgCtrl_C UEGO_uHeatrPwrSplyMax_C UEGO_uHeatrPwrStgExtPwrSply_C /end DEF_CHARACTERISTIC
 /begin REF_CHARACTERISTIC UEGO_idxHWES1B1_C /end REF_CHARACTERISTIC
 /begin IN_MEASUREMENT UEGO_flgHeatrErrOLRawS1B1 UEGO_flgHeatrErrSCBRawS1B1 UEGO_flgHeatrErrSCGRawS1B1 UEGO_flgSysSuprtdS1B1 UEGO_flgUHeatrVld UEGO_uHeatrCtrlEfcS1B1 UEGO_uHeatrS1B1 /end IN_MEASUREMENT
 /begin OUT_MEASUREMENT UEGO_flgHeatrPwrStgCtrlMaxS1B1 UEGO_flgHeatrPwrStgOffS1B1 UEGO_ratHeatrPwrStgCtrlS1B1 UEGO_ratHeatrSnsrActS1B1 /end OUT_MEASUREMENT
 /begin LOC_MEASUREMENT UEGO_HeatrPwrStgCtrlS1B1_I.flgHeatrPwrStgCtrlMax UEGO_HeatrPwrStgCtrlS1B1_I.flgHeatrPwrStgOff UEGO_HeatrPwrStgCtrlS1B1_I.ratHeatrPwrStgCtrl UEGO_HeatrPwrStgCtrlS1B1_I.ratHeatrSnsrAct UEGO_HeatrPwrStgCtrlS1B1_I.ratReqd /end LOC_MEASUREMENT
 FUNCTION_VERSION "1.7.0" /end FUNCTION
/begin FUNCTION UEGO_HeatrRlyPsCtrl "56.0.0    UEGO Control Relay for Heater of Lambda Sensor"
 /begin DEF_CHARACTERISTIC UEGO_stHeatrRlyDeactvn_C UEGO_swtHeatrRlyOffT15Off_C UEGO_tiDlyHeatrRlyOn_C /end DEF_CHARACTERISTIC
 /begin IN_MEASUREMENT DevLib_stPwrStgEnaCond MRly_st SyC_ctPostDrvLeave SyC_stPreDrv T15_st UEGO_flgSysSuprtdS1B1 /end IN_MEASUREMENT
 /begin OUT_MEASUREMENT UEGO_flgHeatrRlyActvS1B1 /end OUT_MEASUREMENT
 /begin LOC_MEASUREMENT UEGO_cntrHeatrRlyPsCtrlReiniProc10msec UEGO_flgHeatrRlyPsCtrlExtRstReq UEGO_HeatrRlyPSCtrlS1B1_I.flgHeatrRlyActv UEGO_HeatrRlyPSCtrlS1B1_I.stHeatrRlyTONVNM_I.time /end LOC_MEASUREMENT
 FUNCTION_VERSION "56.0.0" /end FUNCTION
/begin FUNCTION UEGO_HeatrRlyPsDiag "56.1.0    UEGO Diagnosis Relay for Heater of Lambda Sensor"
 /begin DEF_CHARACTERISTIC UEGO_nrTstPlsHeatrRly_C UEGO_stHeatrRlyPsDiagDeactvn_C UEGO_swtHeatrRlyPsTestPlsMod_C UEGO_tiBtwElecFltHeatrRly_C UEGO_tiBtwOTFltHeatrRly_C UEGO_uHeatrRlyPsTestPlsRels_C /end DEF_CHARACTERISTIC
 /begin IN_MEASUREMENT BattU_u DevLib_stPwrStgEnaCond SyC_ctPostDrvLeave UEGO_flgSysSuprtdS1B1 /end IN_MEASUREMENT
 /begin LOC_MEASUREMENT UEGO_cntrHeatrRlyPsDiagReiniProc100msec UEGO_flgHeatrRlyPsDiagExtRstReq UEGO_HeatrRlyPsDiagS1B1_I.cntrTestPls UEGO_HeatrRlyPsDiagS1B1_I.flgDSMClrReq UEGO_HeatrRlyPsDiagS1B1_I.flgDiagEna UEGO_HeatrRlyPsDiagS1B1_I.flgRlyDiagRels UEGO_HeatrRlyPsDiagS1B1_I.flgRlyErrOL UEGO_HeatrRlyPsDiagS1B1_I.flgRlyErrSCB UEGO_HeatrRlyPsDiagS1B1_I.flgRlyErrSCG UEGO_HeatrRlyPsDiagS1B1_I.flgRlyIniEnd /end LOC_MEASUREMENT
 FUNCTION_VERSION "56.1.0" /end FUNCTION
/begin FUNCTION UEGO_IPin "1.3.0     UEGO signal pin currents" /begin DEF_CHARACTERISTIC UEGO_stIPin_C UEGO_iSwtIPin_C /end DEF_CHARACTERISTIC
 /begin IN_MEASUREMENT UEGO_DataSplyClsS1B1_I.flgCj135An UEGO_DataSplyClsS1B1_I.flgDACOff UEGO_DataSplyClsS1B1_I.flgErrSpiRamRet UEGO_DataSplyClsS1B1_I.flgFKal1Vld UEGO_DataSplyClsS1B1_I.flgFKal2Vld UEGO_DataSplyClsS1B1_I.flgFKal3Vld UEGO_DataSplyClsS1B1_I.flgIPmpActvd UEGO_DataSplyClsS1B1_I.flgISQrA UEGO_DataSplyClsS1B1_I.flgISQrE UEGO_DataSplyClsS1B1_I.flgLCURR UEGO_DataSplyClsS1B1_I.flgLNMeas UEGO_DataSplyClsS1B1_I.flgLPMeas UEGO_DataSplyClsS1B1_I.flgLoupeCAL UEGO_DataSplyClsS1B1_I.flgLoupeG0 UEGO_DataSplyClsS1B1_I.flgLstPckAbort UEGO_DataSplyClsS1B1_I.flgMKA UEGO_DataSplyClsS1B1_I.flgMKE UEGO_DataSplyClsS1B1_I.flgNewIPmpDacPckAry UEGO_DataSplyClsS1B1_I.flgNewIPmpOK UEGO_DataSplyClsS1B1_I.flgNewIPmpPckAry UEGO_DataSplyClsS1B1_I.flgNewIPmpTM UEGO_DataSplyClsS1B1_I.flgNewPck UEGO_DataSplyClsS1B1_I.flgNewPckCstnc UEGO_DataSplyClsS1B1_I.flgNewPckMiss UEGO_DataSplyClsS1B1_I.flgNewPckVld UEGO_DataSplyClsS1B1_I.flgNewTiPck UEGO_DataSplyClsS1B1_I.flgNewURmVG4MeasAryVld UEGO_DataSplyClsS1B1_I.flgNewUa2Pck UEGO_DataSplyClsS1B1_I.flgNewUa31Pck UEGO_DataSplyClsS1B1_I.flgNewUa32Pck UEGO_DataSplyClsS1B1_I.flgNewUa33Pck UEGO_DataSplyClsS1B1_I.flgNewUamPck UEGO_DataSplyClsS1B1_I.flgNewUapePck UEGO_DataSplyClsS1B1_I.flgNewUcalMaxPck UEGO_DataSplyClsS1B1_I.flgNewUcalPck UEGO_DataSplyClsS1B1_I.flgNewUg0Pck UEGO_DataSplyClsS1B1_I.flgNewUg0PckAry UEGO_DataSplyClsS1B1_I.flgNewUg0aPck UEGO_DataSplyClsS1B1_I.flgNewUg0ePck UEGO_DataSplyClsS1B1_I.flgNewUg0iPck UEGO_DataSplyClsS1B1_I.flgNewUg0iPckAry UEGO_DataSplyClsS1B1_I.flgNewUg0iaiPck UEGO_DataSplyClsS1B1_I.flgNewUg0ieiPck UEGO_DataSplyClsS1B1_I.flgNewUg0ix7PckAry UEGO_DataSplyClsS1B1_I.flgNewUg0ix9PckAry UEGO_DataSplyClsS1B1_I.flgNewUg0ixPckAry UEGO_DataSplyClsS1B1_I.flgNewUg0mPck UEGO_DataSplyClsS1B1_I.flgNewUgaPck UEGO_DataSplyClsS1B1_I.flgNewUgiPckAry UEGO_DataSplyClsS1B1_I.flgNewUgkAvrgPck UEGO_DataSplyClsS1B1_I.flgNewUguaPck UEGO_DataSplyClsS1B1_I.flgNewUguaZ2Pck UEGO_DataSplyClsS1B1_I.flgNewUguiPck UEGO_DataSplyClsS1B1_I.flgNewUguiZ1Pck UEGO_DataSplyClsS1B1_I.flgNewUi21PckAry UEGO_DataSplyClsS1B1_I.flgNewUi22Pck UEGO_DataSplyClsS1B1_I.flgNewUi23Pck UEGO_DataSplyClsS1B1_I.flgNewUi24Pck UEGO_DataSplyClsS1B1_I.flgNewUi4Pck UEGO_DataSplyClsS1B1_I.flgNewUi4Z2Pck UEGO_DataSplyClsS1B1_I.flgNewUigPckAry UEGO_DataSplyClsS1B1_I.flgNewUigmkPckAry UEGO_DataSplyClsS1B1_I.flgNewUipcalAvrgPck UEGO_DataSplyClsS1B1_I.flgNewUn0Pck UEGO_DataSplyClsS1B1_I.flgNewUn0Pck4Ary UEGO_DataSplyClsS1B1_I.flgNewUn0Pck5Ary UEGO_DataSplyClsS1B1_I.flgNewUn0PckAry UEGO_DataSplyClsS1B1_I.flgNewUnPckAry UEGO_DataSplyClsS1B1_I.flgNewUnSetPck UEGO_DataSplyClsS1B1_I.flgNewUnx3PckAry UEGO_DataSplyClsS1B1_I.flgNewUnx4PckAry UEGO_DataSplyClsS1B1_I.flgNewUp0Pck UEGO_DataSplyClsS1B1_I.flgNewUp0Pck4 UEGO_DataSplyClsS1B1_I.flgNewUp0Pck5Ary UEGO_DataSplyClsS1B1_I.flgNewUp0PckAry UEGO_DataSplyClsS1B1_I.flgNewUpPckAry UEGO_DataSplyClsS1B1_I.flgNewUpx3PckAry UEGO_DataSplyClsS1B1_I.flgNewUpx4PckAry UEGO_DataSplyClsS1B1_I.flgNewUriaPckVld UEGO_DataSplyClsS1B1_I.flgNewUriePckAry UEGO_DataSplyClsS1B1_I.flgNewUx6PckAry UEGO_DataSplyClsS1B1_I.flgNewUx7PckAry UEGO_DataSplyClsS1B1_I.flgNewUx8PckAry UEGO_DataSplyClsS1B1_I.flgNewUx9PckAry UEGO_DataSplyClsS1B1_I.flgNewUxPckAry UEGO_DataSplyClsS1B1_I.flgReStable UEGO_DataSplyClsS1B1_I.flgSngCell UEGO_DataSplyClsS1B1_I.flgUical0Vld UEGO_DataSplyClsS1B1_I.flgUicalVld UEGO_DataSplyClsS1B1_I.flgUoffipe1Vld UEGO_DataSplyClsS1B1_I.flgUoffipe2Vld UEGO_DataSplyClsS1B1_I.flgUoffipe3Vld UEGO_DataSplyClsS1B1_I.flgUoffvcc1Vld UEGO_DataSplyClsS1B1_I.flgUoffvcc2Vld UEGO_DataSplyClsS1B1_I.flgUoffvcc3Vld UEGO_DataSplyClsS1B1_I.flgUriaMeas UEGO_DataSplyClsS1B1_I.nrIPmpDacPckAry UEGO_DataSplyClsS1B1_I.nrIpPckAry UEGO_DataSplyClsS1B1_I.nrModeMeas UEGO_DataSplyClsS1B1_I.nrRamFailPosn UEGO_DataSplyClsS1B1_I.nrRamMod UEGO_DataSplyClsS1B1_I.nrRamRegMod UEGO_DataSplyClsS1B1_I.nrRamSts1 UEGO_DataSplyClsS1B1_I.nrRamSts2 UEGO_DataSplyClsS1B1_I.nrRamSts3 UEGO_DataSplyClsS1B1_I.nrURmVG4PckAry UEGO_DataSplyClsS1B1_I.nrUa2PckAry UEGO_DataSplyClsS1B1_I.nrUcalMaxCorrd UEGO_DataSplyClsS1B1_I.nrUg0PckAry UEGO_DataSplyClsS1B1_I.nrUg0iPckAry UEGO_DataSplyClsS1B1_I.nrUg0ix7PckAry UEGO_DataSplyClsS1B1_I.nrUg0ix9PckAry UEGO_DataSplyClsS1B1_I.nrUg0ixPckAry UEGO_DataSplyClsS1B1_I.nrUgaPckAry UEGO_DataSplyClsS1B1_I.nrUgiPckAry UEGO_DataSplyClsS1B1_I.nrUi21PckAry UEGO_DataSplyClsS1B1_I.nrUical0PckCorrd UEGO_DataSplyClsS1B1_I.nrUicalPckCorrd UEGO_DataSplyClsS1B1_I.nrUigPckAry UEGO_DataSplyClsS1B1_I.nrUigmkPckAry UEGO_DataSplyClsS1B1_I.nrUn0Pck4Ary UEGO_DataSplyClsS1B1_I.nrUn0Pck5Ary UEGO_DataSplyClsS1B1_I.nrUn0PckAry UEGO_DataSplyClsS1B1_I.nrUnPckAry UEGO_DataSplyClsS1B1_I.nrUnx3PckAry UEGO_DataSplyClsS1B1_I.nrUnx4PckAry UEGO_DataSplyClsS1B1_I.nrUoffipe1 UEGO_DataSplyClsS1B1_I.nrUoffipe2 UEGO_DataSplyClsS1B1_I.nrUoffipe3 UEGO_DataSplyClsS1B1_I.nrUoffvcc1 UEGO_DataSplyClsS1B1_I.nrUoffvcc2 UEGO_DataSplyClsS1B1_I.nrUoffvcc3 UEGO_DataSplyClsS1B1_I.nrUp0Pck5Ary UEGO_DataSplyClsS1B1_I.nrUp0PckAry UEGO_DataSplyClsS1B1_I.nrUpPckAry UEGO_DataSplyClsS1B1_I.nrUpx3PckAry UEGO_DataSplyClsS1B1_I.nrUpx4PckAry UEGO_DataSplyClsS1B1_I.nrUriePckAry UEGO_DataSplyClsS1B1_I.nrUx6PckAry UEGO_DataSplyClsS1B1_I.nrUx7PckAry UEGO_DataSplyClsS1B1_I.nrUx8PckAry UEGO_DataSplyClsS1B1_I.nrUx9PckAry UEGO_DataSplyClsS1B1_I.nrUxPckAry UEGO_DataSplyClsS1B1_I.stIPmpOK UEGO_DataSplyClsS1B1_I.stIPmpTM UEGO_DataSplyClsS1B1_I.stIPmpTM2L UEGO_DataSplyClsS1B1_I.stIPmpTM2R UEGO_DataSplyClsS1B1_I.stLsmRetValMod UEGO_DataSplyClsS1B1_I.stMKMeas UEGO_DataSplyClsS1B1_I.stOFFMeas UEGO_DataSplyClsS1B1_I.stOPTMeas UEGO_DataSplyClsS1B1_I.stREFMeas UEGO_DataSplyClsS1B1_I.stUa2PckAry UEGO_DataSplyClsS1B1_I.stUa2Z1PckAry UEGO_DataSplyClsS1B1_I.stUg0iPckAry UEGO_DataSplyClsS1B1_I.stUg0ix7IActvPckAry UEGO_DataSplyClsS1B1_I.stUg0ix7PmpIActvPckAry UEGO_DataSplyClsS1B1_I.stUg0ix9IActvPckAry UEGO_DataSplyClsS1B1_I.stUg0ix9PmpIActvPckAry UEGO_DataSplyClsS1B1_I.stUg0ixIActvPckAry UEGO_DataSplyClsS1B1_I.stUg0ixPmpIActvPckAry UEGO_DataSplyClsS1B1_I.stUi21PckAry UEGO_DataSplyClsS1B1_I.stUi21Z1PckAry UEGO_DataSplyClsS1B1_I.stUigmkNernstIActvPckAry UEGO_DataSplyClsS1B1_I.stUigmkPmpIActvPckAry UEGO_DataSplyClsS1B1_I.stUn0PckAry UEGO_DataSplyClsS1B1_I.stUn0Z2PckAry UEGO_DataSplyClsS1B1_I.stUnPckAry UEGO_DataSplyClsS1B1_I.stUnx3IActvAcrsNernstCellPckAry UEGO_DataSplyClsS1B1_I.stUnx3IActvAcrsPmpCellPckAry UEGO_DataSplyClsS1B1_I.stUnx4IActvAcrsNernstCellPckAry UEGO_DataSplyClsS1B1_I.stUnx4IActvAcrsPmpCellPckAry UEGO_DataSplyClsS1B1_I.stUp0PckAry UEGO_DataSplyClsS1B1_I.stUp0Z2PckAry UEGO_DataSplyClsS1B1_I.stUpPckAry UEGO_DataSplyClsS1B1_I.stUpZ2PckAry UEGO_DataSplyClsS1B1_I.stUpx3IActvAcrsNernstCellPckAry UEGO_DataSplyClsS1B1_I.stUpx3IActvAcrsPmpCellPckAry UEGO_DataSplyClsS1B1_I.stUpx4IActvAcrsNernstCellPckAry UEGO_DataSplyClsS1B1_I.stUpx4IActvAcrsPmpCellPckAry UEGO_DataSplyClsS1B1_I.stUriePckAry UEGO_DataSplyClsS1B1_I.stUx6IActvPckAry UEGO_DataSplyClsS1B1_I.stUx6MeasAcrsPmpCellPckAry UEGO_DataSplyClsS1B1_I.stUx7IActvPckAry UEGO_DataSplyClsS1B1_I.stUx7MeasAcrsPmpCellPckAry UEGO_DataSplyClsS1B1_I.stUx8IActvPckAry UEGO_DataSplyClsS1B1_I.stUx8MeasAcrsPmpCellPckAry UEGO_DataSplyClsS1B1_I.stUx9IActvPckAry UEGO_DataSplyClsS1B1_I.stUx9MeasAcrsPmpCellPckAry UEGO_DataSplyClsS1B1_I.stUxIActvPckAry UEGO_DataSplyClsS1B1_I.stUxMeasAcrsPmpCell UEGO_DataSplyClsS1B1_I.tiUEGOPck UEGO_DataSplyClsS1B1_I.uFkal1 UEGO_DataSplyClsS1B1_I.uFkal2 UEGO_DataSplyClsS1B1_I.uFkal3 UEGO_DataSplyClsS1B1_I.uUCalPck UEGO_DataSplyClsS1B1_I.uUa31Pck UEGO_DataSplyClsS1B1_I.uUa32Pck UEGO_DataSplyClsS1B1_I.uUa33Pck UEGO_DataSplyClsS1B1_I.uUamPck UEGO_DataSplyClsS1B1_I.uUapePck UEGO_DataSplyClsS1B1_I.uUcalMaxPck UEGO_DataSplyClsS1B1_I.uUg0Pck UEGO_DataSplyClsS1B1_I.uUg0aPck UEGO_DataSplyClsS1B1_I.uUg0ePck UEGO_DataSplyClsS1B1_I.uUg0iPck UEGO_DataSplyClsS1B1_I.uUg0iaiPck UEGO_DataSplyClsS1B1_I.uUg0ieiPck UEGO_DataSplyClsS1B1_I.uUg0mPck UEGO_DataSplyClsS1B1_I.uUgkAvrgPck UEGO_DataSplyClsS1B1_I.uUguaPck UEGO_DataSplyClsS1B1_I.uUguaZ2Pck UEGO_DataSplyClsS1B1_I.uUguiPck UEGO_DataSplyClsS1B1_I.uUguiZ1Pck UEGO_DataSplyClsS1B1_I.uUi22Pck UEGO_DataSplyClsS1B1_I.uUi23Pck UEGO_DataSplyClsS1B1_I.uUi24Pck UEGO_DataSplyClsS1B1_I.uUi4Pck UEGO_DataSplyClsS1B1_I.uUi4Z2Pck UEGO_DataSplyClsS1B1_I.uUipcalAvrgPck UEGO_DataSplyClsS1B1_I.uUn0Pck UEGO_DataSplyClsS1B1_I.uUnSet UEGO_DataSplyClsS1B1_I.uUp0Pck UEGO_DataSplyClsS1B1_I.uUp0Pck4 UEGO_DataSplyClsS1B1_I.uUriaPck UEGO_DataSplyClsS1B1_I.uVCC1Corrd UEGO_DataSplyClsS1B1_I.uVCC3Ref UEGO_flgCJ135AnS1B1 UEGO_flgIsqrMeasVldS1B1 UEGO_flgSnglCellS1B1 UEGO_flgSysSuprtdS1B1 UEGO_ratIPmpRawS1B1 UEGO_RegSetS1B1_I.cntrRegSet UEGO_RegSetS1B1_I.flgCJ135An UEGO_RegSetS1B1_I.flgConvVld UEGO_RegSetS1B1_I.flgIPmpDes UEGO_RegSetS1B1_I.flgIPmpPhyRels UEGO_RegSetS1B1_I.flgIniFinshd UEGO_RegSetS1B1_I.flgLoupeCURRDes UEGO_RegSetS1B1_I.flgLoupeDACDes UEGO_RegSetS1B1_I.flgLoupeNDes UEGO_RegSetS1B1_I.flgLoupePDes UEGO_RegSetS1B1_I.flgNewReq UEGO_RegSetS1B1_I.flgRegSetSt UEGO_RegSetS1B1_I.flgRegSetStVld UEGO_RegSetS1B1_I.flgReqAcptd UEGO_RegSetS1B1_I.flgSetRegOk UEGO_RegSetS1B1_I.flgTakeDataOk UEGO_RegSetS1B1_I.idxChp UEGO_RegSetS1B1_I.nrIdleSubMode UEGO_RegSetS1B1_I.nrModDes UEGO_RegSetS1B1_I.nrNormSubMode UEGO_RegSetS1B1_I.nrRegSet UEGO_RegSetS1B1_I.nrSubModDes UEGO_RegSetS1B1_I.nrSwtOnSubMode UEGO_RegSetS1B1_I.nrTrmSq UEGO_RegSetS1B1_I.nrWrmUpSubMode UEGO_RegSetS1B1_I.stRegSet UEGO_RegSetS1B1_I.stRegSetVld UEGO_RegSetS1B1_I.tmpVar /end IN_MEASUREMENT
 /begin OUT_MEASUREMENT UEGO_flgINernstPinVldS1B1 UEGO_flgIPmpPinVldS1B1 UEGO_iNernstPinS1B1 UEGO_iPmpPinS1B1 /end OUT_MEASUREMENT
 /begin LOC_MEASUREMENT UEGO_IPinCtrlS1B1_I.flgMkSetVld UEGO_IPinCtrlS1B1_I.nrModIntMK UEGO_IPinCtrlS1B1_I.nrModIntMKOld UEGO_IPinEvlnS1B1_I.flgINernstPinVld UEGO_IPinEvlnS1B1_I.flgIPmpPinVld UEGO_IPinEvlnS1B1_I.flgSwtNernstVld UEGO_IPinEvlnS1B1_I.flgSwtPmpVld UEGO_IPinEvlnS1B1_I.iNernstPin UEGO_IPinEvlnS1B1_I.iPmpPin UEGO_IPinEvlnS1B1_I.iSwtNernst UEGO_IPinEvlnS1B1_I.iSwtNernstEfc UEGO_IPinEvlnS1B1_I.iSwtNernstEfcSum UEGO_IPinEvlnS1B1_I.iSwtPmp UEGO_IPinEvlnS1B1_I.iSwtPmpEfc UEGO_IPinEvlnS1B1_I.iSwtPmpEfcSum UEGO_IPinEvlnS1B1_I.nrModIntEvalSwt UEGO_IPinEvlnS1B1_I.nrModIntEvalSwtOld UEGO_IPinEvlnS1B1_I.stTM /end LOC_MEASUREMENT
 FUNCTION_VERSION "1.3.0" /end FUNCTION
/begin COMPU_METHOD B_TRUE "" TAB_VERB "%6.3" "" COMPU_TAB_REF B_TRUE /end COMPU_METHOD
/begin COMPU_VTAB B_TRUE "" TAB_VERB 2 0 "FALSE" 1 "TRUE" /end COMPU_VTAB
/begin COMPU_METHOD dez "" RAT_FUNC "%6.2" "" COEFFS 0 1 0 0 0 1 /end COMPU_METHOD
/begin COMPU_METHOD Fact1000 "" RAT_FUNC "%6.5" "-" COEFFS 0 1000 0 0 0 1 /end COMPU_METHOD
/begin COMPU_METHOD fak_q1p201Em4 "" RAT_FUNC "%6.5" "-" COEFFS 0 8325 0 0 0 1 /end COMPU_METHOD
/begin COMPU_METHOD fak_uw_b0p005 "" RAT_FUNC "%10.9" "" COEFFS 0 65536 0 0 0 0.005 /end COMPU_METHOD
/begin COMPU_METHOD fak_uw_q0p00083 "" RAT_FUNC "%6.5" "-" COEFFS 0 1200 0 0 0 1 /end COMPU_METHOD
/begin COMPU_METHOD i_q6p6667Em7_A "" RAT_FUNC "%9.8" "A" COEFFS 0 1500000 0 0 0 1 /end COMPU_METHOD
/begin COMPU_METHOD OneToOne "" RAT_FUNC "%6.2" "-" COEFFS 0 1 0 0 0 1 /end COMPU_METHOD
/begin COMPU_METHOD rel_q0p003052 "" RAT_FUNC "%6.4" "%" COEFFS 0 65536 0 0 0 200 /end COMPU_METHOD
/begin COMPU_METHOD r_q0p1_Ohm "" RAT_FUNC "%6.3" "Ohm" COEFFS 0 10 0 0 0 1 /end COMPU_METHOD
/begin COMPU_METHOD spg_q0p005 "" RAT_FUNC "%6.4" "V" COEFFS 0 1 0 0 0 0.005 /end COMPU_METHOD
/begin COMPU_METHOD spg_q3p2Em4_V "" RAT_FUNC "%6.5" "V" COEFFS 0 32768 0 0 0 10.48576 /end COMPU_METHOD
/begin COMPU_METHOD Temp_Cels "" RAT_FUNC "%6.1" "deg C" COEFFS 0 10 2731.4 0 0 1 /end COMPU_METHOD
/begin COMPU_METHOD temp_q0p0234 "" RAT_FUNC "%6.4" "K" COEFFS 0 256 0 0 0 6 /end COMPU_METHOD
/begin COMPU_METHOD temp_q0p0234_o273 "" RAT_FUNC "%6.1" "Grad C" COEFFS 0 1 273.15 0 0 0.0234375 /end COMPU_METHOD
/begin COMPU_METHOD temp_q0p1_o273 "" RAT_FUNC "%6.1" "Grad C" COEFFS 0 10 2731.4 0 0 1 /end COMPU_METHOD
/begin COMPU_METHOD Time_ms "" RAT_FUNC "%6.1" "ms" COEFFS 0 0.1 0 0 0 1 /end COMPU_METHOD
/begin COMPU_METHOD Time_s "" RAT_FUNC "%6.4" "s" COEFFS 0 100 0 0 0 1 /end COMPU_METHOD
/begin COMPU_METHOD t_q0p01 "" RAT_FUNC "%6.4" "s" COEFFS 0 100 0 0 0 1 /end COMPU_METHOD
/begin COMPU_METHOD t_q0p02 "" RAT_FUNC "%6.4" "s" COEFFS 0 100 0 0 0 2 /end COMPU_METHOD
/begin COMPU_METHOD UEGO_CJ135AN_SC_Compu "" TAB_VERB "%6.3" "" COMPU_TAB_REF UEGO_CJ135AN_SC_Compu /end COMPU_METHOD
/begin COMPU_VTAB UEGO_CJ135AN_SC_Compu "" TAB_VERB 2 0 "False" 1 "True" /end COMPU_VTAB
/begin COMPU_METHOD UEGO_CJ135IPMPOFFSIDN_SC_Compu "" TAB_VERB "%6.3" "" COMPU_TAB_REF UEGO_CJ135IPMPOFFSIDN_SC_Compu /end COMPU_METHOD
/begin COMPU_VTAB UEGO_CJ135IPMPOFFSIDN_SC_Compu "" TAB_VERB 2 0 "False" 1 "True" /end COMPU_VTAB
/begin COMPU_METHOD UEGO_CJ135_SC_Compu "" TAB_VERB "%6.3" "" COMPU_TAB_REF UEGO_CJ135_SC_Compu /end COMPU_METHOD
/begin COMPU_VTAB UEGO_CJ135_SC_Compu "" TAB_VERB 2 0 "False" 1 "True" /end COMPU_VTAB
/begin COMPU_METHOD UEGO_DATAVIS12VSUPRT_SC_Compu "" TAB_VERB "%6.3" "" COMPU_TAB_REF UEGO_DATAVIS12VSUPRT_SC_Compu /end COMPU_METHOD
/begin COMPU_VTAB UEGO_DATAVIS12VSUPRT_SC_Compu "" TAB_VERB 2 0 "0" 1 "1" /end COMPU_VTAB
/begin COMPU_METHOD UEGO_DATAVIS24VSUPRT_SC_Compu "" TAB_VERB "%6.3" "" COMPU_TAB_REF UEGO_DATAVIS24VSUPRT_SC_Compu /end COMPU_METHOD
/begin COMPU_VTAB UEGO_DATAVIS24VSUPRT_SC_Compu "" TAB_VERB 2 0 "0" 1 "1" /end COMPU_VTAB
/begin COMPU_METHOD UEGO_DATAVISCJ135CA_SC_Compu "" TAB_VERB "%6.3" "" COMPU_TAB_REF UEGO_DATAVISCJ135CA_SC_Compu /end COMPU_METHOD
/begin COMPU_VTAB UEGO_DATAVISCJ135CA_SC_Compu "" TAB_VERB 2 0 "invisible" 1 "visible" /end COMPU_VTAB
/begin COMPU_METHOD UEGO_DATAVISCJ135DA_SC_Compu "" TAB_VERB "%6.3" "" COMPU_TAB_REF UEGO_DATAVISCJ135DA_SC_Compu /end COMPU_METHOD
/begin COMPU_VTAB UEGO_DATAVISCJ135DA_SC_Compu "" TAB_VERB 2 0 "invisible" 1 "visible" /end COMPU_VTAB
/begin COMPU_METHOD UEGO_DATAVISCJ135EA_SC_Compu "" TAB_VERB "%6.3" "" COMPU_TAB_REF UEGO_DATAVISCJ135EA_SC_Compu /end COMPU_METHOD
/begin COMPU_VTAB UEGO_DATAVISCJ135EA_SC_Compu "" TAB_VERB 2 0 "invisible" 1 "visible" /end COMPU_VTAB
/begin COMPU_METHOD UEGO_DATAVISCJ135EB_SC_Compu "" TAB_VERB "%6.3" "" COMPU_TAB_REF UEGO_DATAVISCJ135EB_SC_Compu /end COMPU_METHOD
/begin COMPU_VTAB UEGO_DATAVISCJ135EB_SC_Compu "" TAB_VERB 2 0 "invisible" 1 "visible" /end COMPU_VTAB
/begin COMPU_METHOD UEGO_DATAVISCJ135FA_SC_Compu "" TAB_VERB "%6.3" "" COMPU_TAB_REF UEGO_DATAVISCJ135FA_SC_Compu /end COMPU_METHOD
/begin COMPU_VTAB UEGO_DATAVISCJ135FA_SC_Compu "" TAB_VERB 2 0 "invisible" 1 "visible" /end COMPU_VTAB
/begin COMPU_METHOD UEGO_DATAVISCJ135FB_SC_Compu "" TAB_VERB "%6.3" "" COMPU_TAB_REF UEGO_DATAVISCJ135FB_SC_Compu /end COMPU_METHOD
/begin COMPU_VTAB UEGO_DATAVISCJ135FB_SC_Compu "" TAB_VERB 2 0 "invisible" 1 "visible" /end COMPU_VTAB
/begin COMPU_METHOD UEGO_DATAVISCJ135FD_SC_Compu "" TAB_VERB "%6.3" "" COMPU_TAB_REF UEGO_DATAVISCJ135FD_SC_Compu /end COMPU_METHOD
/begin COMPU_VTAB UEGO_DATAVISCJ135FD_SC_Compu "" TAB_VERB 2 0 "invisible" 1 "visible" /end COMPU_VTAB
/begin COMPU_METHOD UEGO_DATAVISDENSOPLUS51_SC_Compu "" TAB_VERB "%6.3" "" COMPU_TAB_REF UEGO_DATAVISDENSOPLUS51_SC_Compu /end COMPU_METHOD
/begin COMPU_VTAB UEGO_DATAVISDENSOPLUS51_SC_Compu "" TAB_VERB 2 0 "Invisible" 1 "Visible" /end COMPU_VTAB
/begin COMPU_METHOD UEGO_DATAVISDENSOPLUS61_SC_Compu "" TAB_VERB "%6.3" "" COMPU_TAB_REF UEGO_DATAVISDENSOPLUS61_SC_Compu /end COMPU_METHOD
/begin COMPU_VTAB UEGO_DATAVISDENSOPLUS61_SC_Compu "" TAB_VERB 2 0 "Invisible" 1 "Visible" /end COMPU_VTAB
/begin COMPU_METHOD UEGO_DATAVISDENSOPLUS6F_SC_Compu "" TAB_VERB "%6.3" "" COMPU_TAB_REF UEGO_DATAVISDENSOPLUS6F_SC_Compu /end COMPU_METHOD
/begin COMPU_VTAB UEGO_DATAVISDENSOPLUS6F_SC_Compu "" TAB_VERB 2 0 "invisible" 1 "visible" /end COMPU_VTAB
/begin COMPU_METHOD UEGO_DATAVISLSU49TSP_SC_Compu "" TAB_VERB "%6.3" "" COMPU_TAB_REF UEGO_DATAVISLSU49TSP_SC_Compu /end COMPU_METHOD
/begin COMPU_VTAB UEGO_DATAVISLSU49TSP_SC_Compu "" TAB_VERB 2 0 "Invisible" 1 "Visible" /end COMPU_VTAB
/begin COMPU_METHOD UEGO_DATAVISLSU49_SC_Compu "" TAB_VERB "%6.3" "" COMPU_TAB_REF UEGO_DATAVISLSU49_SC_Compu /end COMPU_METHOD
/begin COMPU_VTAB UEGO_DATAVISLSU49_SC_Compu "" TAB_VERB 2 0 "Invisible" 1 "Visible" /end COMPU_VTAB
/begin COMPU_METHOD UEGO_DATAVISLSU51_SC_Compu "" TAB_VERB "%6.3" "" COMPU_TAB_REF UEGO_DATAVISLSU51_SC_Compu /end COMPU_METHOD
/begin COMPU_VTAB UEGO_DATAVISLSU51_SC_Compu "" TAB_VERB 2 0 "Invisible" 1 "Visible" /end COMPU_VTAB
/begin COMPU_METHOD UEGO_DATAVISLSU52_SC_Compu "" TAB_VERB "%6.3" "" COMPU_TAB_REF UEGO_DATAVISLSU52_SC_Compu /end COMPU_METHOD
/begin COMPU_VTAB UEGO_DATAVISLSU52_SC_Compu "" TAB_VERB 2 0 "Invisible" 1 "Visible" /end COMPU_VTAB
/begin COMPU_METHOD UEGO_DATAVISLSUADV_SC_Compu "" TAB_VERB "%6.3" "" COMPU_TAB_REF UEGO_DATAVISLSUADV_SC_Compu /end COMPU_METHOD
/begin COMPU_VTAB UEGO_DATAVISLSUADV_SC_Compu "" TAB_VERB 2 0 "Invisible" 1 "Visible" /end COMPU_VTAB
/begin COMPU_METHOD UEGO_DATAVISNORCMPPRSNT_SC_Compu "" TAB_VERB "%6.3" "" COMPU_TAB_REF UEGO_DATAVISNORCMPPRSNT_SC_Compu /end COMPU_METHOD
/begin COMPU_VTAB UEGO_DATAVISNORCMPPRSNT_SC_Compu "" TAB_VERB 2 0 "invisible" 1 "visible" /end COMPU_VTAB
/begin COMPU_METHOD UEGO_DATAVISNTKZFASU2_SC_Compu "" TAB_VERB "%6.3" "" COMPU_TAB_REF UEGO_DATAVISNTKZFASU2_SC_Compu /end COMPU_METHOD
/begin COMPU_VTAB UEGO_DATAVISNTKZFASU2_SC_Compu "" TAB_VERB 2 0 "Invisible" 1 "Visible" /end COMPU_VTAB
/begin COMPU_METHOD UEGO_DATAVISNTKZFASU3_SC_Compu "" TAB_VERB "%6.3" "" COMPU_TAB_REF UEGO_DATAVISNTKZFASU3_SC_Compu /end COMPU_METHOD
/begin COMPU_VTAB UEGO_DATAVISNTKZFASU3_SC_Compu "" TAB_VERB 2 0 "Invisible" 1 "Visible" /end COMPU_VTAB
/begin COMPU_METHOD UEGO_DATAVISRCMPPRSNT_SC_Compu "" TAB_VERB "%6.3" "" COMPU_TAB_REF UEGO_DATAVISRCMPPRSNT_SC_Compu /end COMPU_METHOD
/begin COMPU_VTAB UEGO_DATAVISRCMPPRSNT_SC_Compu "" TAB_VERB 2 0 "Invisible" 1 "visible" /end COMPU_VTAB
/begin COMPU_METHOD UEGO_DGSCMNDRVR_SC_Compu "" TAB_VERB "%6.3" "" COMPU_TAB_REF UEGO_DGSCMNDRVR_SC_Compu /end COMPU_METHOD
/begin COMPU_VTAB UEGO_DGSCMNDRVR_SC_Compu "" TAB_VERB 2 0 "False" 1 "True" /end COMPU_VTAB
/begin COMPU_METHOD UEGO_ENALAMPENVCORRD_SC_Compu "" TAB_VERB "%6.3" "" COMPU_TAB_REF UEGO_ENALAMPENVCORRD_SC_Compu /end COMPU_METHOD
/begin COMPU_VTAB UEGO_ENALAMPENVCORRD_SC_Compu "" TAB_VERB 2 0 "False" 1 "True" /end COMPU_VTAB
/begin COMPU_METHOD UEGO_EngModSt_COMPU_VERB "" TAB_VERB "%6.3" "" COMPU_TAB_REF UEGO_EngModSt_COMPU_VERB /end COMPU_METHOD
/begin COMPU_VTAB UEGO_EngModSt_COMPU_VERB "" TAB_VERB 7 0 "UEGOENG_ST_UNDEFD" 1 "UEGOENG_ST_RUNNGIDLE" 2 "UEGOENG _ST_RUNNGSTD" 3 "UEGOENG_ST_RUNNGWITHSCAV" 4 "UEGOENG_ST_TMPSTOP" 5 "UEGOENG_ST_ININOTRUNNG" 6 "UEGOENG_ST_STOPPHADCYCEND" /end COMPU_VTAB
/begin COMPU_METHOD UEGO_HEATGUPEXTD_SC_Compu "" TAB_VERB "%6.3" "" COMPU_TAB_REF UEGO_HEATGUPEXTD_SC_Compu /end COMPU_METHOD
/begin COMPU_VTAB UEGO_HEATGUPEXTD_SC_Compu "" TAB_VERB 2 0 "False" 1 "True" /end COMPU_VTAB
/begin COMPU_METHOD UEGO_HeatrCtrlModInt_COMPU_VERB "" TAB_VERB "%6.3" "" COMPU_TAB_REF UEGO_HeatrCtrlModInt_COMPU_VERB /end COMPU_METHOD
/begin COMPU_VTAB UEGO_HeatrCtrlModInt_COMPU_VERB "" TAB_VERB 11 0 "ZERO_VOLTAGE" 1 "PROTECTION_HEATING" 2 "REDUCED_HEATING" 3 "OPEN_LOOP_INI" 4 "OPEN_LOOP_CURVE_PHASE" 5 "OPEN_LOOP_HOLD_PHASE" 6 "OPEN_LOOP_RAMP_PHASE" 7 "OPEN_LOOP_EXTENDED" 8 "CLOSED_LOOP_CONTROL" 9 "DEFAULT_HEATING" 10 "PROTECTION_OVERHEATG" /end COMPU_VTAB
/begin COMPU_METHOD UEGO_HEATRFCTENA_SC_Compu "" TAB_VERB "%6.3" "" COMPU_TAB_REF UEGO_HEATRFCTENA_SC_Compu /end COMPU_METHOD
/begin COMPU_VTAB UEGO_HEATRFCTENA_SC_Compu "" TAB_VERB 2 0 "False" 1 "True" /end COMPU_VTAB
/begin COMPU_METHOD UEGO_HEATRRLY_SC_Compu "" TAB_VERB "%6.3" "" COMPU_TAB_REF UEGO_HEATRRLY_SC_Compu /end COMPU_METHOD
/begin COMPU_VTAB UEGO_HEATRRLY_SC_Compu "" TAB_VERB 2 0 "False" 1 "True" /end COMPU_VTAB
/begin COMPU_METHOD UEGO_HEATRSTGY_SC_Compu "" TAB_VERB "%6.3" "" COMPU_TAB_REF UEGO_HEATRSTGY_SC_Compu /end COMPU_METHOD
/begin COMPU_VTAB UEGO_HEATRSTGY_SC_Compu "" TAB_VERB 5 0 "0" 1 "1" 2 "2" 3 "3" 4 "4" /end COMPU_VTAB
/begin COMPU_METHOD UEGO_ICS1B1_SY_Compu "" TAB_VERB "%6.3" "" COMPU_TAB_REF UEGO_ICS1B1_SY_Compu /end COMPU_METHOD
/begin COMPU_VTAB UEGO_ICS1B1_SY_Compu "" TAB_VERB 3 0 "0" 1 "1" 2 "2" /end COMPU_VTAB
/begin COMPU_METHOD UEGO_ICS1B2_SY_Compu "" TAB_VERB "%6.3" "" COMPU_TAB_REF UEGO_ICS1B2_SY_Compu /end COMPU_METHOD
/begin COMPU_VTAB UEGO_ICS1B2_SY_Compu "" TAB_VERB 3 0 "0" 1 "1" 2 "2" /end COMPU_VTAB
/begin COMPU_METHOD UEGO_ICS2B1_SY_Compu "" TAB_VERB "%6.3" "" COMPU_TAB_REF UEGO_ICS2B1_SY_Compu /end COMPU_METHOD
/begin COMPU_VTAB UEGO_ICS2B1_SY_Compu "" TAB_VERB 3 0 "0" 1 "1" 2 "2" /end COMPU_VTAB
/begin COMPU_METHOD UEGO_MKRegIPin_COMPU_VERB "" TAB_VERB "%6.3" "" COMPU_TAB_REF UEGO_MKRegIPin_COMPU_VERB /end COMPU_METHOD
/begin COMPU_VTAB UEGO_MKRegIPin_COMPU_VERB "" TAB_VERB 4 0 "IPIN_MKEOFFMKAOFF" 1 "IPIN_MKEONMKAOFF" 2 "IPIN_MKEOFFMKAON" 3 "IPIN_MKEONMKAON" /end COMPU_VTAB
/begin COMPU_METHOD UEGO_ModIPinEvalSwt_COMPU_VERB "" TAB_VERB "%6.3" "" COMPU_TAB_REF UEGO_ModIPinEvalSwt_COMPU_VERB /end COMPU_METHOD
/begin COMPU_VTAB UEGO_ModIPinEvalSwt_COMPU_VERB "" TAB_VERB 5 1 "IPIN_CALC_SWT_CUR" 10 "IPIN_CALC_SWT_CUR_FA_IDLE_SWT_OPEN" 11 "IPIN_CALC_SWT_CUR_FA_NORMAL" 12 "IPIN_CALC_SWT_CUR_FA_SWITCHON" 13 "IPIN_CALC_SWT_CUR_FA_WARMUP" /end COMPU_VTAB
/begin COMPU_METHOD Volt_Batt "" RAT_FUNC "%6.1" "mV" COEFFS 0 0.05 0 0 0 1 /end COMPU_METHOD
/begin RECORD_LAYOUT RB_Curve_S16_U16_Static NO_AXIS_PTS_X 1 SWORD AXIS_PTS_X 2 SWORD INDEX_INCR DIRECT FNC_VALUES 3 UWORD COLUMN_DIR DIRECT STATIC_RECORD_LAYOUT /end RECORD_LAYOUT
/begin RECORD_LAYOUT RB_Curve_U16_U16 NO_AXIS_PTS_X 1 UWORD AXIS_PTS_X 2 UWORD INDEX_INCR DIRECT FNC_VALUES 3 UWORD COLUMN_DIR DIRECT /end RECORD_LAYOUT
/begin RECORD_LAYOUT RB_Map_S16U16_U8 NO_AXIS_PTS_X 1 SWORD NO_AXIS_PTS_Y 2 SWORD AXIS_PTS_X 3 SWORD INDEX_INCR DIRECT AXIS_PTS_Y 4 UWORD INDEX_INCR DIRECT FNC_VALUES 5 UBYTE ROW_DIR DIRECT /end RECORD_LAYOUT
/begin RECORD_LAYOUT RB_Val_Wboolean FNC_VALUES 1 UBYTE COLUMN_DIR DIRECT /end RECORD_LAYOUT
/begin RECORD_LAYOUT RB_Val_Ws16 FNC_VALUES 1 SWORD COLUMN_DIR DIRECT /end RECORD_LAYOUT
/begin RECORD_LAYOUT RB_Val_Ws32 FNC_VALUES 1 SLONG COLUMN_DIR DIRECT /end RECORD_LAYOUT
/begin RECORD_LAYOUT RB_Val_Wu16 FNC_VALUES 1 UWORD COLUMN_DIR DIRECT /end RECORD_LAYOUT
/begin RECORD_LAYOUT RB_Val_Wu32 FNC_VALUES 1 ULONG COLUMN_DIR DIRECT /end RECORD_LAYOUT
/begin RECORD_LAYOUT RB_Val_Wu8 FNC_VALUES 1 UBYTE COLUMN_DIR DIRECT /end RECORD_LAYOUT
/end MODULE
/end PROJECT
