ASAP2_VERSION 1 60
/begin PROJECT MG1CS022 "MG1CS022"
/begin HEADER "" VERSION "MG1CS022_62XSC_V036_TPROT" PROJECT_NO MG1CS022 /end HEADER
/begin MODULE DIM ""
/begin MOD_COMMON "" BYTE_ORDER MSB_LAST ALIGNMENT_BYTE 1 ALIGNMENT_WORD 2 ALIGNMENT_LONG 4 ALIGNMENT_INT64 4 ALIGNMENT_FLOAT32_IEEE 4 ALIGNMENT_FLOAT64_IEEE 4 DATA_SIZE 32 /end MOD_COMMON
/begin CHARACTERISTIC DFES_GrpRpr.DFC_GbxPNPosnDrvCdn_C "common MIL debouncing / group representative for common MIL debouncing of DFC_GbxPNPosnDrvCdn" VALUE 0x80504E08 Val_Wu16 906.000000000 DFC_Verb 0.00 906.000000000 FORMAT "%13.9" /end CHARACTERISTIC
/begin CHARACTERISTIC DFES_GrpRpr.DFC_GbxPNPosnPlausy_C "common MIL debouncing / group representative for common MIL debouncing of DFC_GbxPNPosnPlausy" VALUE 0x80504E0A Val_Wu16 906.000000000 DFC_Verb 0.00 906.000000000 FORMAT "%13.9" /end CHARACTERISTIC
/begin CHARACTERISTIC DFES_GrpRpr.DFC_AfsSigErrLineHiB1_C "common MIL debouncing / group representative for common MIL debouncing of DFC_AfsSigErrLineHiB1" VALUE 0x80504E0C Val_Wu16 906.000000000 DFC_Verb 0.00 906.000000000 FORMAT "%13.9" /end CHARACTERISTIC
/begin CHARACTERISTIC DFES_GrpRpr.DFC_AfsSigErrLineLoB1_C "common MIL debouncing / group representative for common MIL debouncing of DFC_AfsSigErrLineLoB1" VALUE 0x80504E0E Val_Wu16 906.000000000 DFC_Verb 0.00 906.000000000 FORMAT "%13.9" /end CHARACTERISTIC
/begin CHARACTERISTIC DFES_GrpRpr.DFC_PEnvCcMax_C "common MIL debouncing / group representative for common MIL debouncing of DFC_PEnvCcMax" VALUE 0x80504E10 Val_Wu16 906.000000000 DFC_Verb 0.00 906.000000000 FORMAT "%13.9" /end CHARACTERISTIC
/begin CHARACTERISTIC DFES_GrpRpr.DFC_PEnvCcMin_C "common MIL debouncing / group representative for common MIL debouncing of DFC_PEnvCcMin" VALUE 0x80504E12 Val_Wu16 906.000000000 DFC_Verb 0.00 906.000000000 FORMAT "%13.9" /end CHARACTERISTIC
/begin CHARACTERISTIC DFES_GrpRpr.DFC_PEnvRngChkMax_C "common MIL debouncing / group representative for common MIL debouncing of DFC_PEnvRngChkMax" VALUE 0x80504E14 Val_Wu16 906.000000000 DFC_Verb 0.00 906.000000000 FORMAT "%13.9" /end CHARACTERISTIC
/begin CHARACTERISTIC DFES_GrpRpr.DFC_PEnvRngChkMin_C "common MIL debouncing / group representative for common MIL debouncing of DFC_PEnvRngChkMin" VALUE 0x80504E16 Val_Wu16 906.000000000 DFC_Verb 0.00 906.000000000 FORMAT "%13.9" /end CHARACTERISTIC
/begin CHARACTERISTIC DFES_GrpRpr.DFC_PEnvSnsrPlaus_C "common MIL debouncing / group representative for common MIL debouncing of DFC_PEnvSnsrPlaus" VALUE 0x80504E18 Val_Wu16 906.000000000 DFC_Verb 0.00 906.000000000 FORMAT "%13.9" /end CHARACTERISTIC
/begin CHARACTERISTIC DFES_GrpRpr.DFC_UEGOHeatrRlyPsOLS1B1_C "common MIL debouncing / group representative for common MIL debouncing of DFC_UEGOHeatrRlyPsOLS1B1" VALUE 0x80504E1A Val_Wu16 906.000000000 DFC_Verb 0.00 906.000000000 FORMAT "%13.9" /end CHARACTERISTIC
/begin CHARACTERISTIC DFES_GrpRpr.DFC_UEGOHeatrRlyPsSCBS1B1_C "common MIL debouncing / group representative for common MIL debouncing of DFC_UEGOHeatrRlyPsSCBS1B1" VALUE 0x80504E1C Val_Wu16 906.000000000 DFC_Verb 0.00 906.000000000 FORMAT "%13.9" /end CHARACTERISTIC
/begin CHARACTERISTIC DFES_GrpRpr.DFC_UEGOHeatrRlyPsSCGS1B1_C "common MIL debouncing / group representative for common MIL debouncing of DFC_UEGOHeatrRlyPsSCGS1B1" VALUE 0x80504E1E Val_Wu16 906.000000000 DFC_Verb 0.00 906.000000000 FORMAT "%13.9" /end CHARACTERISTIC
/begin CHARACTERISTIC DFES_GrpRpr.DFC_UegoHeatrWireOlS1B1_C "common MIL debouncing / group representative for common MIL debouncing of DFC_UegoHeatrWireOlS1B1" VALUE 0x80504E20 Val_Wu16 906.000000000 DFC_Verb 0.00 906.000000000 FORMAT "%13.9" /end CHARACTERISTIC
/begin CHARACTERISTIC DFES_GrpRpr.DFC_UegoHeatrWireScbS1B1_C "common MIL debouncing / group representative for common MIL debouncing of DFC_UegoHeatrWireScbS1B1" VALUE 0x80504E22 Val_Wu16 906.000000000 DFC_Verb 0.00 906.000000000 FORMAT "%13.9" /end CHARACTERISTIC
/begin CHARACTERISTIC DFES_GrpRpr.DFC_UegoHeatrWireScgS1B1_C "common MIL debouncing / group representative for common MIL debouncing of DFC_UegoHeatrWireScgS1B1" VALUE 0x80504E24 Val_Wu16 906.000000000 DFC_Verb 0.00 906.000000000 FORMAT "%13.9" /end CHARACTERISTIC
/begin CHARACTERISTIC DFES_GrpRpr.DFC_KnDetSens1PortAMax_C "common MIL debouncing / group representative for common MIL debouncing of DFC_KnDetSens1PortAMax" VALUE 0x80504E26 Val_Wu16 906.000000000 DFC_Verb 0.00 906.000000000 FORMAT "%13.9" /end CHARACTERISTIC
/begin CHARACTERISTIC DFES_GrpRpr.DFC_KnDetSens1PortAMin_C "common MIL debouncing / group representative for common MIL debouncing of DFC_KnDetSens1PortAMin" VALUE 0x80504E28 Val_Wu16 906.000000000 DFC_Verb 0.00 906.000000000 FORMAT "%13.9" /end CHARACTERISTIC
/begin CHARACTERISTIC DFES_GrpRpr.DFC_KnDetSens1PortBMax_C "common MIL debouncing / group representative for common MIL debouncing of DFC_KnDetSens1PortBMax" VALUE 0x80504E2A Val_Wu16 906.000000000 DFC_Verb 0.00 906.000000000 FORMAT "%13.9" /end CHARACTERISTIC
/begin CHARACTERISTIC DFES_GrpRpr.DFC_KnDetSens1PortBMin_C "common MIL debouncing / group representative for common MIL debouncing of DFC_KnDetSens1PortBMin" VALUE 0x80504E2C Val_Wu16 906.000000000 DFC_Verb 0.00 906.000000000 FORMAT "%13.9" /end CHARACTERISTIC
/begin CHARACTERISTIC DFES_GrpRpr.DFC_Clth2ONStuck_C "common MIL debouncing / group representative for common MIL debouncing of DFC_Clth2ONStuck" VALUE 0x80504E2E Val_Wu16 906.000000000 DFC_Verb 0.00 906.000000000 FORMAT "%13.9" /end CHARACTERISTIC
/begin CHARACTERISTIC DFES_GrpRpr.DFC_Clth2ONStuckLdc_C "common MIL debouncing / group representative for common MIL debouncing of DFC_Clth2ONStuckLdc" VALUE 0x80504E30 Val_Wu16 906.000000000 DFC_Verb 0.00 906.000000000 FORMAT "%13.9" /end CHARACTERISTIC
/begin CHARACTERISTIC DFES_GrpRpr.DFC_Clth3ONStuckLdc_C "common MIL debouncing / group representative for common MIL debouncing of DFC_Clth3ONStuckLdc" VALUE 0x80504E32 Val_Wu16 906.000000000 DFC_Verb 0.00 906.000000000 FORMAT "%13.9" /end CHARACTERISTIC
/begin CHARACTERISTIC DFES_GrpRpr.DFC_Clth3ONStuckPostDrv_C "common MIL debouncing / group representative for common MIL debouncing of DFC_Clth3ONStuckPostDrv" VALUE 0x80504E34 Val_Wu16 906.000000000 DFC_Verb 0.00 906.000000000 FORMAT "%13.9" /end CHARACTERISTIC
/begin CHARACTERISTIC DFES_GrpRpr.DFC_Clth4ONStuck_C "common MIL debouncing / group representative for common MIL debouncing of DFC_Clth4ONStuck" VALUE 0x80504E36 Val_Wu16 906.000000000 DFC_Verb 0.00 906.000000000 FORMAT "%13.9" /end CHARACTERISTIC
/begin CHARACTERISTIC DFES_GrpRpr.DFC_Clth4ONStuckLdc_C "common MIL debouncing / group representative for common MIL debouncing of DFC_Clth4ONStuckLdc" VALUE 0x80504E38 Val_Wu16 906.000000000 DFC_Verb 0.00 906.000000000 FORMAT "%13.9" /end CHARACTERISTIC
/begin CHARACTERISTIC DFES_GrpRpr.DFC_ComBCMUnit_C "common MIL debouncing / group representative for common MIL debouncing of DFC_ComBCMUnit" VALUE 0x80504E3A Val_Wu16 906.000000000 DFC_Verb 0.00 906.000000000 FORMAT "%13.9" /end CHARACTERISTIC
/begin CHARACTERISTIC DFES_GrpRpr.DFC_ComDLCTCU01_C "common MIL debouncing / group representative for common MIL debouncing of DFC_ComDLCTCU01" VALUE 0x80504E3C Val_Wu16 906.000000000 DFC_Verb 0.00 906.000000000 FORMAT "%13.9" /end CHARACTERISTIC
/begin CHARACTERISTIC DFES_GrpRpr.DFC_ComDLCTCU02_C "common MIL debouncing / group representative for common MIL debouncing of DFC_ComDLCTCU02" VALUE 0x80504E3E Val_Wu16 906.000000000 DFC_Verb 0.00 906.000000000 FORMAT "%13.9" /end CHARACTERISTIC
/begin CHARACTERISTIC DFES_GrpRpr.DFC_ComDLCTCU1_C "common MIL debouncing / group representative for common MIL debouncing of DFC_ComDLCTCU1" VALUE 0x80504E40 Val_Wu16 906.000000000 DFC_Verb 0.00 906.000000000 FORMAT "%13.9" /end CHARACTERISTIC
/begin CHARACTERISTIC DFES_GrpRpr.DFC_ComDLCTCU11_C "common MIL debouncing / group representative for common MIL debouncing of DFC_ComDLCTCU11" VALUE 0x80504E42 Val_Wu16 906.000000000 DFC_Verb 0.00 906.000000000 FORMAT "%13.9" /end CHARACTERISTIC
/begin CHARACTERISTIC DFES_GrpRpr.DFC_ComDLCTCU12_C "common MIL debouncing / group representative for common MIL debouncing of DFC_ComDLCTCU12" VALUE 0x80504E44 Val_Wu16 906.000000000 DFC_Verb 0.00 906.000000000 FORMAT "%13.9" /end CHARACTERISTIC
/begin CHARACTERISTIC DFES_GrpRpr.DFC_ComDLCTCU13_C "common MIL debouncing / group representative for common MIL debouncing of DFC_ComDLCTCU13" VALUE 0x80504E46 Val_Wu16 906.000000000 DFC_Verb 0.00 906.000000000 FORMAT "%13.9" /end CHARACTERISTIC
/begin CHARACTERISTIC DFES_GrpRpr.DFC_ComDLCTCU14_C "common MIL debouncing / group representative for common MIL debouncing of DFC_ComDLCTCU14" VALUE 0x80504E48 Val_Wu16 906.000000000 DFC_Verb 0.00 906.000000000 FORMAT "%13.9" /end CHARACTERISTIC
/begin CHARACTERISTIC DFES_GrpRpr.DFC_ComDLCTCU2_C "common MIL debouncing / group representative for common MIL debouncing of DFC_ComDLCTCU2" VALUE 0x80504E4A Val_Wu16 906.000000000 DFC_Verb 0.00 906.000000000 FORMAT "%13.9" /end CHARACTERISTIC
/begin CHARACTERISTIC DFES_GrpRpr.DFC_ComDLCTCU3_C "common MIL debouncing / group representative for common MIL debouncing of DFC_ComDLCTCU3" VALUE 0x80504E4C Val_Wu16 906.000000000 DFC_Verb 0.00 906.000000000 FORMAT "%13.9" /end CHARACTERISTIC
/begin CHARACTERISTIC DFES_GrpRpr.DFC_ComDLCTCU4_C "common MIL debouncing / group representative for common MIL debouncing of DFC_ComDLCTCU4" VALUE 0x80504E4E Val_Wu16 906.000000000 DFC_Verb 0.00 906.000000000 FORMAT "%13.9" /end CHARACTERISTIC
/begin CHARACTERISTIC DFES_GrpRpr.DFC_ComEPSUnit_C "common MIL debouncing / group representative for common MIL debouncing of DFC_ComEPSUnit" VALUE 0x80504E50 Val_Wu16 906.000000000 DFC_Verb 0.00 906.000000000 FORMAT "%13.9" /end CHARACTERISTIC
/begin CHARACTERISTIC DFES_GrpRpr.DFC_ComIDASBUnit_C "common MIL debouncing / group representative for common MIL debouncing of DFC_ComIDASBUnit" VALUE 0x80504E52 Val_Wu16 906.000000000 DFC_Verb 0.00 906.000000000 FORMAT "%13.9" /end CHARACTERISTIC
/begin CHARACTERISTIC DFES_GrpRpr.DFC_ComIMGUnit_C "common MIL debouncing / group representative for common MIL debouncing of DFC_ComIMGUnit" VALUE 0x80504E54 Val_Wu16 906.000000000 DFC_Verb 0.00 906.000000000 FORMAT "%13.9" /end CHARACTERISTIC
/begin CHARACTERISTIC DFES_GrpRpr.DFC_ComMETUnit_C "common MIL debouncing / group representative for common MIL debouncing of DFC_ComMETUnit" VALUE 0x80504E56 Val_Wu16 906.000000000 DFC_Verb 0.00 906.000000000 FORMAT "%13.9" /end CHARACTERISTIC
/begin CHARACTERISTIC DFES_GrpRpr.DFC_ComSRSUnit_C "common MIL debouncing / group representative for common MIL debouncing of DFC_ComSRSUnit" VALUE 0x80504E58 Val_Wu16 906.000000000 DFC_Verb 0.00 906.000000000 FORMAT "%13.9" /end CHARACTERISTIC
/begin CHARACTERISTIC DFES_GrpRpr.DFC_ComVSAUnit_C "common MIL debouncing / group representative for common MIL debouncing of DFC_ComVSAUnit" VALUE 0x80504E5A Val_Wu16 906.000000000 DFC_Verb 0.00 906.000000000 FORMAT "%13.9" /end CHARACTERISTIC
/begin CHARACTERISTIC DFES_GrpRpr.DFC_EbsSocFlt_C "common MIL debouncing / group representative for common MIL debouncing of DFC_EbsSocFlt" VALUE 0x80504E5C Val_Wu16 906.000000000 DFC_Verb 0.00 906.000000000 FORMAT "%13.9" /end CHARACTERISTIC
/begin CHARACTERISTIC DFES_GrpRpr.DFC_I14229VINErr_C "common MIL debouncing / group representative for common MIL debouncing of DFC_I14229VINErr" VALUE 0x80504E5E Val_Wu16 906.000000000 DFC_Verb 0.00 906.000000000 FORMAT "%13.9" /end CHARACTERISTIC
/begin CHARACTERISTIC DFES_GrpRpr.DFC_InjCatHeatgErr_C "common MIL debouncing / group representative for common MIL debouncing of DFC_InjCatHeatgErr" VALUE 0x80504E60 Val_Wu16 906.000000000 DFC_Verb 0.00 906.000000000 FORMAT "%13.9" /end CHARACTERISTIC
/begin CHARACTERISTIC DFES_GrpRpr.DFC_InjSysMulInjDiagErr_C "common MIL debouncing / group representative for common MIL debouncing of DFC_InjSysMulInjDiagErr" VALUE 0x80504E62 Val_Wu16 906.000000000 DFC_Verb 0.00 906.000000000 FORMAT "%13.9" /end CHARACTERISTIC
/begin CHARACTERISTIC DFES_GrpRpr.DFC_LLRHmax_C "common MIL debouncing / group representative for common MIL debouncing of DFC_LLRHmax" VALUE 0x80504E64 Val_Wu16 906.000000000 DFC_Verb 0.00 906.000000000 FORMAT "%13.9" /end CHARACTERISTIC
/begin CHARACTERISTIC DFES_GrpRpr.DFC_LLRHmin_C "common MIL debouncing / group representative for common MIL debouncing of DFC_LLRHmin" VALUE 0x80504E66 Val_Wu16 906.000000000 DFC_Verb 0.00 906.000000000 FORMAT "%13.9" /end CHARACTERISTIC
/begin CHARACTERISTIC DFES_GrpRpr.DFC_LLRHnpl_C "common MIL debouncing / group representative for common MIL debouncing of DFC_LLRHnpl" VALUE 0x80504E68 Val_Wu16 906.000000000 DFC_Verb 0.00 906.000000000 FORMAT "%13.9" /end CHARACTERISTIC
/begin CHARACTERISTIC DFES_GrpRpr.DFC_LLRKHmax_C "common MIL debouncing / group representative for common MIL debouncing of DFC_LLRKHmax" VALUE 0x80504E6A Val_Wu16 906.000000000 DFC_Verb 0.00 906.000000000 FORMAT "%13.9" /end CHARACTERISTIC
/begin CHARACTERISTIC DFES_GrpRpr.DFC_LLRKHmin_C "common MIL debouncing / group representative for common MIL debouncing of DFC_LLRKHmin" VALUE 0x80504E6C Val_Wu16 906.000000000 DFC_Verb 0.00 906.000000000 FORMAT "%13.9" /end CHARACTERISTIC
/begin CHARACTERISTIC DFES_GrpRpr.DFC_LLRKHnpl_C "common MIL debouncing / group representative for common MIL debouncing of DFC_LLRKHnpl" VALUE 0x80504E6E Val_Wu16 906.000000000 DFC_Verb 0.00 906.000000000 FORMAT "%13.9" /end CHARACTERISTIC
/begin CHARACTERISTIC DFES_GrpRpr.DFC_LinACGUnit_C "common MIL debouncing / group representative for common MIL debouncing of DFC_LinACGUnit" VALUE 0x80504E70 Val_Wu16 906.000000000 DFC_Verb 0.00 906.000000000 FORMAT "%13.9" /end CHARACTERISTIC
/begin CHARACTERISTIC DFES_GrpRpr.DFC_LinAEVUnit_C "common MIL debouncing / group representative for common MIL debouncing of DFC_LinAEVUnit" VALUE 0x80504E72 Val_Wu16 906.000000000 DFC_Verb 0.00 906.000000000 FORMAT "%13.9" /end CHARACTERISTIC
/begin CHARACTERISTIC DFES_GrpRpr.DFC_LinEBSUnit_C "common MIL debouncing / group representative for common MIL debouncing of DFC_LinEBSUnit" VALUE 0x80504E74 Val_Wu16 906.000000000 DFC_Verb 0.00 906.000000000 FORMAT "%13.9" /end CHARACTERISTIC
/begin CHARACTERISTIC DFES_GrpRpr.DFC_RoughRoad_C "common MIL debouncing / group representative for common MIL debouncing of DFC_RoughRoad" VALUE 0x80504E76 Val_Wu16 906.000000000 DFC_Verb 0.00 906.000000000 FORMAT "%13.9" /end CHARACTERISTIC
/begin CHARACTERISTIC DFES_GrpRpr.DFC_SiaEEPRdErr_C "common MIL debouncing / group representative for common MIL debouncing of DFC_SiaEEPRdErr" VALUE 0x80504E78 Val_Wu16 906.000000000 DFC_Verb 0.00 906.000000000 FORMAT "%13.9" /end CHARACTERISTIC
/begin CHARACTERISTIC DFES_GrpRpr.DFC_SiaEEPWrngCod_C "common MIL debouncing / group representative for common MIL debouncing of DFC_SiaEEPWrngCod" VALUE 0x80504E7A Val_Wu16 906.000000000 DFC_Verb 0.00 906.000000000 FORMAT "%13.9" /end CHARACTERISTIC
/begin CHARACTERISTIC DFES_GrpRpr.DFC_UegoHeatrStrtS1B1_C "common MIL debouncing / group representative for common MIL debouncing of DFC_UegoHeatrStrtS1B1" VALUE 0x80504E7C Val_Wu16 906.000000000 DFC_Verb 0.00 906.000000000 FORMAT "%13.9" /end CHARACTERISTIC
/begin CHARACTERISTIC DFES_GrpRpr.DFC_BusDiagCANAPPLBusOff_C "common MIL debouncing / group representative for common MIL debouncing of DFC_BusDiagCANAPPLBusOff" VALUE 0x80504E7E Val_Wu16 906.000000000 DFC_Verb 0.00 906.000000000 FORMAT "%13.9" /end CHARACTERISTIC
/begin CHARACTERISTIC DFES_GrpRpr.DFC_BusDiagCANCANCBusOff_C "common MIL debouncing / group representative for common MIL debouncing of DFC_BusDiagCANCANCBusOff" VALUE 0x80504E80 Val_Wu16 906.000000000 DFC_Verb 0.00 906.000000000 FORMAT "%13.9" /end CHARACTERISTIC
/begin CHARACTERISTIC DFES_GrpRpr.DFC_BusDiagCANVEHICLEBusOff_C "common MIL debouncing / group representative for common MIL debouncing of DFC_BusDiagCANVEHICLEBusOff" VALUE 0x80504E82 Val_Wu16 906.000000000 DFC_Verb 0.00 906.000000000 FORMAT "%13.9" /end CHARACTERISTIC
/begin CHARACTERISTIC DFES_GrpRpr.DFC_RBA_IODIAGPWR_rba_IoExtCy329_SignalVltSply_0_C "common MIL debouncing / group representative for common MIL debouncing of DFC_RBA_IODIAGPWR_rba_IoExtCy329_SignalVltSply_0" VALUE 0x80504E84 Val_Wu16 906.000000000 DFC_Verb 0.00 906.000000000 FORMAT "%13.9" /end CHARACTERISTIC
/begin CHARACTERISTIC DFES_GrpRpr.DFC_RBA_IODIAGPWR_rba_IoExtCy329_SignalVltSply_0OT_C "common MIL debouncing / group representative for common MIL debouncing of DFC_RBA_IODIAGPWR_rba_IoExtCy329_SignalVltSply_0OT" VALUE 0x80504E86 Val_Wu16 906.000000000 DFC_Verb 0.00 906.000000000 FORMAT "%13.9" /end CHARACTERISTIC
/begin CHARACTERISTIC DFES_GrpRpr.DFC_RBA_IODIAGPWR_rba_IoExtCy329_SignalVltSply_0OV_C "common MIL debouncing / group representative for common MIL debouncing of DFC_RBA_IODIAGPWR_rba_IoExtCy329_SignalVltSply_0OV" VALUE 0x80504E88 Val_Wu16 906.000000000 DFC_Verb 0.00 906.000000000 FORMAT "%13.9" /end CHARACTERISTIC
/begin CHARACTERISTIC DFES_GrpRpr.DFC_RBA_IODIAGPWR_rba_IoExtCy329_SignalVltSply_0SCG_C "common MIL debouncing / group representative for common MIL debouncing of DFC_RBA_IODIAGPWR_rba_IoExtCy329_SignalVltSply_0SCG" VALUE 0x80504E8A Val_Wu16 906.000000000 DFC_Verb 0.00 906.000000000 FORMAT "%13.9" /end CHARACTERISTIC
/begin CHARACTERISTIC DFES_GrpRpr.DFC_RBA_IODIAGPWR_rba_IoExtCy329_SignalVltSply_0UV_C "common MIL debouncing / group representative for common MIL debouncing of DFC_RBA_IODIAGPWR_rba_IoExtCy329_SignalVltSply_0UV" VALUE 0x80504E8C Val_Wu16 906.000000000 DFC_Verb 0.00 906.000000000 FORMAT "%13.9" /end CHARACTERISTIC
/begin CHARACTERISTIC DFES_GrpRpr.DFC_RBA_IODIAGPWR_rba_IoExtCy329_SignalVltSply_1_C "common MIL debouncing / group representative for common MIL debouncing of DFC_RBA_IODIAGPWR_rba_IoExtCy329_SignalVltSply_1" VALUE 0x80504E8E Val_Wu16 906.000000000 DFC_Verb 0.00 906.000000000 FORMAT "%13.9" /end CHARACTERISTIC
/begin CHARACTERISTIC DFES_GrpRpr.DFC_RBA_IODIAGPWR_rba_IoExtCy329_SignalVltSply_1OT_C "common MIL debouncing / group representative for common MIL debouncing of DFC_RBA_IODIAGPWR_rba_IoExtCy329_SignalVltSply_1OT" VALUE 0x80504E90 Val_Wu16 906.000000000 DFC_Verb 0.00 906.000000000 FORMAT "%13.9" /end CHARACTERISTIC
/begin CHARACTERISTIC DFES_GrpRpr.DFC_RBA_IODIAGPWR_rba_IoExtCy329_SignalVltSply_1OV_C "common MIL debouncing / group representative for common MIL debouncing of DFC_RBA_IODIAGPWR_rba_IoExtCy329_SignalVltSply_1OV" VALUE 0x80504E92 Val_Wu16 906.000000000 DFC_Verb 0.00 906.000000000 FORMAT "%13.9" /end CHARACTERISTIC
/begin CHARACTERISTIC DFES_GrpRpr.DFC_RBA_IODIAGPWR_rba_IoExtCy329_SignalVltSply_1SCG_C "common MIL debouncing / group representative for common MIL debouncing of DFC_RBA_IODIAGPWR_rba_IoExtCy329_SignalVltSply_1SCG" VALUE 0x80504E94 Val_Wu16 906.000000000 DFC_Verb 0.00 906.000000000 FORMAT "%13.9" /end CHARACTERISTIC
/begin CHARACTERISTIC DFES_GrpRpr.DFC_RBA_IODIAGPWR_rba_IoExtCy329_SignalVltSply_1UV_C "common MIL debouncing / group representative for common MIL debouncing of DFC_RBA_IODIAGPWR_rba_IoExtCy329_SignalVltSply_1UV" VALUE 0x80504E96 Val_Wu16 906.000000000 DFC_Verb 0.00 906.000000000 FORMAT "%13.9" /end CHARACTERISTIC
/begin CHARACTERISTIC DFES_GrpRpr.DFC_RBA_IODIAGPWR_rba_IoExtCy329_SignalVltSply_2_C "common MIL debouncing / group representative for common MIL debouncing of DFC_RBA_IODIAGPWR_rba_IoExtCy329_SignalVltSply_2" VALUE 0x80504E98 Val_Wu16 906.000000000 DFC_Verb 0.00 906.000000000 FORMAT "%13.9" /end CHARACTERISTIC
/begin CHARACTERISTIC DFES_GrpRpr.DFC_RBA_IODIAGPWR_rba_IoExtCy329_SignalVltSply_2OT_C "common MIL debouncing / group representative for common MIL debouncing of DFC_RBA_IODIAGPWR_rba_IoExtCy329_SignalVltSply_2OT" VALUE 0x80504E9A Val_Wu16 906.000000000 DFC_Verb 0.00 906.000000000 FORMAT "%13.9" /end CHARACTERISTIC
/begin CHARACTERISTIC DFES_GrpRpr.DFC_RBA_IODIAGPWR_rba_IoExtCy329_SignalVltSply_2OV_C "common MIL debouncing / group representative for common MIL debouncing of DFC_RBA_IODIAGPWR_rba_IoExtCy329_SignalVltSply_2OV" VALUE 0x80504E9C Val_Wu16 906.000000000 DFC_Verb 0.00 906.000000000 FORMAT "%13.9" /end CHARACTERISTIC
/begin CHARACTERISTIC DFES_GrpRpr.DFC_RBA_IODIAGPWR_rba_IoExtCy329_SignalVltSply_2SCG_C "common MIL debouncing / group representative for common MIL debouncing of DFC_RBA_IODIAGPWR_rba_IoExtCy329_SignalVltSply_2SCG" VALUE 0x80504E9E Val_Wu16 906.000000000 DFC_Verb 0.00 906.000000000 FORMAT "%13.9" /end CHARACTERISTIC
/begin CHARACTERISTIC DFES_GrpRpr.DFC_RBA_IODIAGPWR_rba_IoExtCy329_SignalVltSply_2UV_C "common MIL debouncing / group representative for common MIL debouncing of DFC_RBA_IODIAGPWR_rba_IoExtCy329_SignalVltSply_2UV" VALUE 0x80504EA0 Val_Wu16 906.000000000 DFC_Verb 0.00 906.000000000 FORMAT "%13.9" /end CHARACTERISTIC
/begin CHARACTERISTIC DFES_GrpRpr.DFC_CAN_E_TIMEOUT_C "common MIL debouncing / group representative for common MIL debouncing of DFC_CAN_E_TIMEOUT" VALUE 0x80504EA2 Val_Wu16 906.000000000 DFC_Verb 0.00 906.000000000 FORMAT "%13.9" /end CHARACTERISTIC
/begin CHARACTERISTIC DFES_GrpRpr.DFC_LIN_E_TIMEOUT_C "common MIL debouncing / group representative for common MIL debouncing of DFC_LIN_E_TIMEOUT" VALUE 0x80504EA4 Val_Wu16 906.000000000 DFC_Verb 0.00 906.000000000 FORMAT "%13.9" /end CHARACTERISTIC
/begin CHARACTERISTIC DFES_GrpRpr.DFC_MRlyOL_C "common MIL debouncing / group representative for common MIL debouncing of DFC_MRlyOL" VALUE 0x80504EA6 Val_Wu16 906.000000000 DFC_Verb 0.00 906.000000000 FORMAT "%13.9" /end CHARACTERISTIC
/begin CHARACTERISTIC DFES_GrpRpr.DFC_MRlySCB_C "common MIL debouncing / group representative for common MIL debouncing of DFC_MRlySCB" VALUE 0x80504EA8 Val_Wu16 906.000000000 DFC_Verb 0.00 906.000000000 FORMAT "%13.9" /end CHARACTERISTIC
/begin CHARACTERISTIC DFES_GrpRpr.DFC_MRlySCG_C "common MIL debouncing / group representative for common MIL debouncing of DFC_MRlySCG" VALUE 0x80504EAA Val_Wu16 906.000000000 DFC_Verb 0.00 906.000000000 FORMAT "%13.9" /end CHARACTERISTIC
/begin CHARACTERISTIC DFES_GrpRpr.DFC_rba_MultiStackTrace_Threshold_C "common MIL debouncing / group representative for common MIL debouncing of DFC_rba_MultiStackTrace_Threshold" VALUE 0x80504EAC Val_Wu16 906.000000000 DFC_Verb 0.00 906.000000000 FORMAT "%13.9" /end CHARACTERISTIC
/begin CHARACTERISTIC DFES_GrpRpr.DFC_BSWM_E_ACTION_FAILED_C "common MIL debouncing / group representative for common MIL debouncing of DFC_BSWM_E_ACTION_FAILED" VALUE 0x80504EAE Val_Wu16 906.000000000 DFC_Verb 0.00 906.000000000 FORMAT "%13.9" /end CHARACTERISTIC
/begin CHARACTERISTIC DFES_GrpRpr.DFC_BSWM_E_INTRPTQUEUE_FULL_C "common MIL debouncing / group representative for common MIL debouncing of DFC_BSWM_E_INTRPTQUEUE_FULL" VALUE 0x80504EB0 Val_Wu16 906.000000000 DFC_Verb 0.00 906.000000000 FORMAT "%13.9" /end CHARACTERISTIC
/begin CHARACTERISTIC DFES_GrpRpr.DFC_RBA_IOEXTLIB_KEEPALIVE_DRV_C "common MIL debouncing / group representative for common MIL debouncing of DFC_RBA_IOEXTLIB_KEEPALIVE_DRV" VALUE 0x80504EB2 Val_Wu16 906.000000000 DFC_Verb 0.00 906.000000000 FORMAT "%13.9" /end CHARACTERISTIC
/begin CHARACTERISTIC DFES_GrpRpr.DFC_RBA_IOEXTLIB_KEEPALIVE_INI_C "common MIL debouncing / group representative for common MIL debouncing of DFC_RBA_IOEXTLIB_KEEPALIVE_INI" VALUE 0x80504EB4 Val_Wu16 906.000000000 DFC_Verb 0.00 906.000000000 FORMAT "%13.9" /end CHARACTERISTIC
/begin CHARACTERISTIC DFES_GrpRpr.DFC_rba_IoSigRtc_StopCounter_C "common MIL debouncing / group representative for common MIL debouncing of DFC_rba_IoSigRtc_StopCounter" VALUE 0x80504EB6 Val_Wu16 906.000000000 DFC_Verb 0.00 906.000000000 FORMAT "%13.9" /end CHARACTERISTIC
/begin CHARACTERISTIC DFES_GrpRpr.DFC_rba_MRly_Diag_Stk_Event_C "common MIL debouncing / group representative for common MIL debouncing of DFC_rba_MRly_Diag_Stk_Event" VALUE 0x80504EB8 Val_Wu16 906.000000000 DFC_Verb 0.00 906.000000000 FORMAT "%13.9" /end CHARACTERISTIC
/begin CHARACTERISTIC DFES_GrpRpr.DFC_rba_MemDiag_MemReadErr_C "common MIL debouncing / group representative for common MIL debouncing of DFC_rba_MemDiag_MemReadErr" VALUE 0x80504EBA Val_Wu16 906.000000000 DFC_Verb 0.00 906.000000000 FORMAT "%13.9" /end CHARACTERISTIC
/begin CHARACTERISTIC DFES_GrpRpr.DFC_rba_MemDiag_MemWrErr_C "common MIL debouncing / group representative for common MIL debouncing of DFC_rba_MemDiag_MemWrErr" VALUE 0x80504EBC Val_Wu16 906.000000000 DFC_Verb 0.00 906.000000000 FORMAT "%13.9" /end CHARACTERISTIC
/begin CHARACTERISTIC DFES_GrpRpr.DFC_rba_SyC_IrrSwOffTrigEngRun_Event_C "common MIL debouncing / group representative for common MIL debouncing of DFC_rba_SyC_IrrSwOffTrigEngRun_Event" VALUE 0x80504EBE Val_Wu16 906.000000000 DFC_Verb 0.00 906.000000000 FORMAT "%13.9" /end CHARACTERISTIC
/begin CHARACTERISTIC DFES_GrpRpr.DFC_rba_T15_Diag_ComInVld_Event_C "common MIL debouncing / group representative for common MIL debouncing of DFC_rba_T15_Diag_ComInVld_Event" VALUE 0x80504EC0 Val_Wu16 906.000000000 DFC_Verb 0.00 906.000000000 FORMAT "%13.9" /end CHARACTERISTIC
/begin CHARACTERISTIC DFES_GrpRpr.DFC_rba_T15_Diag_ComOff_HwOn_Event_C "common MIL debouncing / group representative for common MIL debouncing of DFC_rba_T15_Diag_ComOff_HwOn_Event" VALUE 0x80504EC2 Val_Wu16 906.000000000 DFC_Verb 0.00 906.000000000 FORMAT "%13.9" /end CHARACTERISTIC
/begin CHARACTERISTIC DFES_GrpRpr.DFC_rba_T15_Diag_ComOn_HwOff_Event_C "common MIL debouncing / group representative for common MIL debouncing of DFC_rba_T15_Diag_ComOn_HwOff_Event" VALUE 0x80504EC4 Val_Wu16 906.000000000 DFC_Verb 0.00 906.000000000 FORMAT "%13.9" /end CHARACTERISTIC
/begin CHARACTERISTIC DFES_GrpRpr.DFC_AAVmin_C "common MIL debouncing / group representative for common MIL debouncing of DFC_AAVmin" VALUE 0x80504EC6 Val_Wu16 906.000000000 DFC_Verb 0.00 906.000000000 FORMAT "%13.9" /end CHARACTERISTIC
/begin CHARACTERISTIC DFES_GrpRpr.DFC_AGRSUS_C "common MIL debouncing / group representative for common MIL debouncing of DFC_AGRSUS" VALUE 0x80504EC8 Val_Wu16 906.000000000 DFC_Verb 0.00 906.000000000 FORMAT "%13.9" /end CHARACTERISTIC
/begin CHARACTERISTIC DFES_GrpRpr.DFC_AfsPlausDiagHi_C "common MIL debouncing / group representative for common MIL debouncing of DFC_AfsPlausDiagHi" VALUE 0x80504ECA Val_Wu16 906.000000000 DFC_Verb 0.00 906.000000000 FORMAT "%13.9" /end CHARACTERISTIC
/begin CHARACTERISTIC DFES_GrpRpr.DFC_AfsPlausDiagLo_C "common MIL debouncing / group representative for common MIL debouncing of DFC_AfsPlausDiagLo" VALUE 0x80504ECC Val_Wu16 906.000000000 DFC_Verb 0.00 906.000000000 FORMAT "%13.9" /end CHARACTERISTIC
/begin CHARACTERISTIC DFES_GrpRpr.DFC_AfsVrntDiagErrB1_C "common MIL debouncing / group representative for common MIL debouncing of DFC_AfsVrntDiagErrB1" VALUE 0x80504ECE Val_Wu16 906.000000000 DFC_Verb 0.00 906.000000000 FORMAT "%13.9" /end CHARACTERISTIC
/begin CHARACTERISTIC DFES_GrpRpr.DFC_AppAllSnsrDfct_C "common MIL debouncing / group representative for common MIL debouncing of DFC_AppAllSnsrDfct" VALUE 0x80504ED0 Val_Wu16 906.000000000 DFC_Verb 0.00 906.000000000 FORMAT "%13.9" /end CHARACTERISTIC
/begin CHARACTERISTIC DFES_GrpRpr.DFC_BBKRnldg_C "common MIL debouncing / group representative for common MIL debouncing of DFC_BBKRnldg" VALUE 0x80504ED2 Val_Wu16 906.000000000 DFC_Verb 0.00 906.000000000 FORMAT "%13.9" /end CHARACTERISTIC
/begin CHARACTERISTIC DFES_GrpRpr.DFC_BBKRsyne_C "common MIL debouncing / group representative for common MIL debouncing of DFC_BBKRsyne" VALUE 0x80504ED4 Val_Wu16 906.000000000 DFC_Verb 0.00 906.000000000 FORMAT "%13.9" /end CHARACTERISTIC
/begin CHARACTERISTIC DFES_GrpRpr.DFC_BattUStdbyDiaOL_C "common MIL debouncing / group representative for common MIL debouncing of DFC_BattUStdbyDiaOL" VALUE 0x80504ED6 Val_Wu16 906.000000000 DFC_Verb 0.00 906.000000000 FORMAT "%13.9" /end CHARACTERISTIC
/begin CHARACTERISTIC DFES_GrpRpr.DFC_BigLeakIntkMnfldEmiInfl_C "common MIL debouncing / group representative for common MIL debouncing of DFC_BigLeakIntkMnfldEmiInfl" VALUE 0x80504ED8 Val_Wu16 906.000000000 DFC_Verb 0.00 906.000000000 FORMAT "%13.9" /end CHARACTERISTIC
/begin CHARACTERISTIC DFES_GrpRpr.DFC_BlkdLineTank_C "common MIL debouncing / group representative for common MIL debouncing of DFC_BlkdLineTank" VALUE 0x80504EDA Val_Wu16 906.000000000 DFC_Verb 0.00 906.000000000 FORMAT "%13.9" /end CHARACTERISTIC
/begin CHARACTERISTIC DFES_GrpRpr.DFC_BrkMnSwtContOnWarnLmp_C "common MIL debouncing / group representative for common MIL debouncing of DFC_BrkMnSwtContOnWarnLmp" VALUE 0x80504EDC Val_Wu16 906.000000000 DFC_Verb 0.00 906.000000000 FORMAT "%13.9" /end CHARACTERISTIC
/begin CHARACTERISTIC DFES_GrpRpr.DFC_BrkMnSwtNotStpWarnLmp_C "common MIL debouncing / group representative for common MIL debouncing of DFC_BrkMnSwtNotStpWarnLmp" VALUE 0x80504EDE Val_Wu16 906.000000000 DFC_Verb 0.00 906.000000000 FORMAT "%13.9" /end CHARACTERISTIC
/begin CHARACTERISTIC DFES_GrpRpr.DFC_BrkRdntSwtContOnWarnLmp_C "common MIL debouncing / group representative for common MIL debouncing of DFC_BrkRdntSwtContOnWarnLmp" VALUE 0x80504EE0 Val_Wu16 906.000000000 DFC_Verb 0.00 906.000000000 FORMAT "%13.9" /end CHARACTERISTIC
/begin CHARACTERISTIC DFES_GrpRpr.DFC_BrkRdntSwtNotStpWarnLmp_C "common MIL debouncing / group representative for common MIL debouncing of DFC_BrkRdntSwtNotStpWarnLmp" VALUE 0x80504EE2 Val_Wu16 906.000000000 DFC_Verb 0.00 906.000000000 FORMAT "%13.9" /end CHARACTERISTIC
/begin CHARACTERISTIC DFES_GrpRpr.DFC_CEngDsTColdStrtMax_C "common MIL debouncing / group representative for common MIL debouncing of DFC_CEngDsTColdStrtMax" VALUE 0x80504EE4 Val_Wu16 906.000000000 DFC_Verb 0.00 906.000000000 FORMAT "%13.9" /end CHARACTERISTIC
/begin CHARACTERISTIC DFES_GrpRpr.DFC_CEngDsTColdStrtMin_C "common MIL debouncing / group representative for common MIL debouncing of DFC_CEngDsTColdStrtMin" VALUE 0x80504EE6 Val_Wu16 906.000000000 DFC_Verb 0.00 906.000000000 FORMAT "%13.9" /end CHARACTERISTIC
/begin CHARACTERISTIC DFES_GrpRpr.DFC_CEngDsTImps_C "common MIL debouncing / group representative for common MIL debouncing of DFC_CEngDsTImps" VALUE 0x80504EE8 Val_Wu16 906.000000000 DFC_Verb 0.00 906.000000000 FORMAT "%13.9" /end CHARACTERISTIC
/begin CHARACTERISTIC DFES_GrpRpr.DFC_CEngDsTPlausHSC_C "common MIL debouncing / group representative for common MIL debouncing of DFC_CEngDsTPlausHSC" VALUE 0x80504EEA Val_Wu16 906.000000000 DFC_Verb 0.00 906.000000000 FORMAT "%13.9" /end CHARACTERISTIC
/begin CHARACTERISTIC DFES_GrpRpr.DFC_CEngDsTPlausLSC_C "common MIL debouncing / group representative for common MIL debouncing of DFC_CEngDsTPlausLSC" VALUE 0x80504EEC Val_Wu16 906.000000000 DFC_Verb 0.00 906.000000000 FORMAT "%13.9" /end CHARACTERISTIC
/begin CHARACTERISTIC DFES_GrpRpr.DFC_CEngDsTPlausSTC_C "common MIL debouncing / group representative for common MIL debouncing of DFC_CEngDsTPlausSTC" VALUE 0x80504EEE Val_Wu16 906.000000000 DFC_Verb 0.00 906.000000000 FORMAT "%13.9" /end CHARACTERISTIC
/begin CHARACTERISTIC DFES_GrpRpr.DFC_CEngDsTSRCMax_C "common MIL debouncing / group representative for common MIL debouncing of DFC_CEngDsTSRCMax" VALUE 0x80504EF0 Val_Wu16 906.000000000 DFC_Verb 0.00 906.000000000 FORMAT "%13.9" /end CHARACTERISTIC
/begin CHARACTERISTIC DFES_GrpRpr.DFC_CEngDsTSRCMin_C "common MIL debouncing / group representative for common MIL debouncing of DFC_CEngDsTSRCMin" VALUE 0x80504EF2 Val_Wu16 906.000000000 DFC_Verb 0.00 906.000000000 FORMAT "%13.9" /end CHARACTERISTIC
/begin CHARACTERISTIC DFES_GrpRpr.DFC_CEngDsTSig_C "common MIL debouncing / group representative for common MIL debouncing of DFC_CEngDsTSig" VALUE 0x80504EF4 Val_Wu16 906.000000000 DFC_Verb 0.00 906.000000000 FORMAT "%13.9" /end CHARACTERISTIC
/begin CHARACTERISTIC DFES_GrpRpr.DFC_CEngUsTColdStrtMax_C "common MIL debouncing / group representative for common MIL debouncing of DFC_CEngUsTColdStrtMax" VALUE 0x80504EF6 Val_Wu16 906.000000000 DFC_Verb 0.00 906.000000000 FORMAT "%13.9" /end CHARACTERISTIC
/begin CHARACTERISTIC DFES_GrpRpr.DFC_CEngUsTColdStrtMin_C "common MIL debouncing / group representative for common MIL debouncing of DFC_CEngUsTColdStrtMin" VALUE 0x80504EF8 Val_Wu16 906.000000000 DFC_Verb 0.00 906.000000000 FORMAT "%13.9" /end CHARACTERISTIC
/begin CHARACTERISTIC DFES_GrpRpr.DFC_CEngUsTLooseCnctn_C "common MIL debouncing / group representative for common MIL debouncing of DFC_CEngUsTLooseCnctn" VALUE 0x80504EFA Val_Wu16 906.000000000 DFC_Verb 0.00 906.000000000 FORMAT "%13.9" /end CHARACTERISTIC
/begin CHARACTERISTIC DFES_GrpRpr.DFC_CEngUsTSRCMax_C "common MIL debouncing / group representative for common MIL debouncing of DFC_CEngUsTSRCMax" VALUE 0x80504EFC Val_Wu16 906.000000000 DFC_Verb 0.00 906.000000000 FORMAT "%13.9" /end CHARACTERISTIC
/begin CHARACTERISTIC DFES_GrpRpr.DFC_CEngUsTSRCMin_C "common MIL debouncing / group representative for common MIL debouncing of DFC_CEngUsTSRCMin" VALUE 0x80504EFE Val_Wu16 906.000000000 DFC_Verb 0.00 906.000000000 FORMAT "%13.9" /end CHARACTERISTIC
/begin CHARACTERISTIC DFES_GrpRpr.DFC_ComDCDCACCFailr_C "common MIL debouncing / group representative for common MIL debouncing of DFC_ComDCDCACCFailr" VALUE 0x80504F00 Val_Wu16 906.000000000 DFC_Verb 0.00 906.000000000 FORMAT "%13.9" /end CHARACTERISTIC
/begin CHARACTERISTIC DFES_GrpRpr.DFC_DCDCFltDet_C "common MIL debouncing / group representative for common MIL debouncing of DFC_DCDCFltDet" VALUE 0x80504F02 Val_Wu16 906.000000000 DFC_Verb 0.00 906.000000000 FORMAT "%13.9" /end CHARACTERISTIC
/begin CHARACTERISTIC DFES_GrpRpr.DFC_DKRSA_C "common MIL debouncing / group representative for common MIL debouncing of DFC_DKRSA" VALUE 0x80504F04 Val_Wu16 906.000000000 DFC_Verb 0.00 906.000000000 FORMAT "%13.9" /end CHARACTERISTIC
/begin CHARACTERISTIC DFES_GrpRpr.DFC_DKVSmax_C "common MIL debouncing / group representative for common MIL debouncing of DFC_DKVSmax" VALUE 0x80504F06 Val_Wu16 906.000000000 DFC_Verb 0.00 906.000000000 FORMAT "%13.9" /end CHARACTERISTIC
/begin CHARACTERISTIC DFES_GrpRpr.DFC_DKnpl_C "common MIL debouncing / group representative for common MIL debouncing of DFC_DKnpl" VALUE 0x80504F08 Val_Wu16 906.000000000 DFC_Verb 0.00 906.000000000 FORMAT "%13.9" /end CHARACTERISTIC
/begin CHARACTERISTIC DFES_GrpRpr.DFC_DSKVRmax_C "common MIL debouncing / group representative for common MIL debouncing of DFC_DSKVRmax" VALUE 0x80504F0A Val_Wu16 906.000000000 DFC_Verb 0.00 906.000000000 FORMAT "%13.9" /end CHARACTERISTIC
/begin CHARACTERISTIC DFES_GrpRpr.DFC_DSKVRmin_C "common MIL debouncing / group representative for common MIL debouncing of DFC_DSKVRmin" VALUE 0x80504F0C Val_Wu16 906.000000000 DFC_Verb 0.00 906.000000000 FORMAT "%13.9" /end CHARACTERISTIC
/begin CHARACTERISTIC DFES_GrpRpr.DFC_DSKVRnpl_C "common MIL debouncing / group representative for common MIL debouncing of DFC_DSKVRnpl" VALUE 0x80504F0E Val_Wu16 906.000000000 DFC_Verb 0.00 906.000000000 FORMAT "%13.9" /end CHARACTERISTIC
/begin CHARACTERISTIC DFES_GrpRpr.DFC_DSKVRsig_C "common MIL debouncing / group representative for common MIL debouncing of DFC_DSKVRsig" VALUE 0x80504F10 Val_Wu16 906.000000000 DFC_Verb 0.00 906.000000000 FORMAT "%13.9" /end CHARACTERISTIC
/begin CHARACTERISTIC DFES_GrpRpr.DFC_DSKVSsig_C "common MIL debouncing / group representative for common MIL debouncing of DFC_DSKVSsig" VALUE 0x80504F12 Val_Wu16 906.000000000 DFC_Verb 0.00 906.000000000 FORMAT "%13.9" /end CHARACTERISTIC
/begin CHARACTERISTIC DFES_GrpRpr.DFC_DSSmax_C "common MIL debouncing / group representative for common MIL debouncing of DFC_DSSmax" VALUE 0x80504F14 Val_Wu16 906.000000000 DFC_Verb 0.00 906.000000000 FORMAT "%13.9" /end CHARACTERISTIC
/begin CHARACTERISTIC DFES_GrpRpr.DFC_DSTDmax_C "common MIL debouncing / group representative for common MIL debouncing of DFC_DSTDmax" VALUE 0x80504F16 Val_Wu16 906.000000000 DFC_Verb 0.00 906.000000000 FORMAT "%13.9" /end CHARACTERISTIC
/begin CHARACTERISTIC DFES_GrpRpr.DFC_DSTEmax_C "common MIL debouncing / group representative for common MIL debouncing of DFC_DSTEmax" VALUE 0x80504F18 Val_Wu16 906.000000000 DFC_Verb 0.00 906.000000000 FORMAT "%13.9" /end CHARACTERISTIC
/begin CHARACTERISTIC DFES_GrpRpr.DFC_DSTEmin_C "common MIL debouncing / group representative for common MIL debouncing of DFC_DSTEmin" VALUE 0x80504F1A Val_Wu16 906.000000000 DFC_Verb 0.00 906.000000000 FORMAT "%13.9" /end CHARACTERISTIC
/begin CHARACTERISTIC DFES_GrpRpr.DFC_DSTOFmax_C "common MIL debouncing / group representative for common MIL debouncing of DFC_DSTOFmax" VALUE 0x80504F1C Val_Wu16 906.000000000 DFC_Verb 0.00 906.000000000 FORMAT "%13.9" /end CHARACTERISTIC
/begin CHARACTERISTIC DFES_GrpRpr.DFC_DSTRmax_C "common MIL debouncing / group representative for common MIL debouncing of DFC_DSTRmax" VALUE 0x80504F1E Val_Wu16 906.000000000 DFC_Verb 0.00 906.000000000 FORMAT "%13.9" /end CHARACTERISTIC
/begin CHARACTERISTIC DFES_GrpRpr.DFC_DSTRmin_C "common MIL debouncing / group representative for common MIL debouncing of DFC_DSTRmin" VALUE 0x80504F20 Val_Wu16 906.000000000 DFC_Verb 0.00 906.000000000 FORMAT "%13.9" /end CHARACTERISTIC
/begin CHARACTERISTIC DFES_GrpRpr.DFC_DSTRnpl_C "common MIL debouncing / group representative for common MIL debouncing of DFC_DSTRnpl" VALUE 0x80504F22 Val_Wu16 906.000000000 DFC_Verb 0.00 906.000000000 FORMAT "%13.9" /end CHARACTERISTIC
/begin CHARACTERISTIC DFES_GrpRpr.DFC_DSTRsig_C "common MIL debouncing / group representative for common MIL debouncing of DFC_DSTRsig" VALUE 0x80504F24 Val_Wu16 906.000000000 DFC_Verb 0.00 906.000000000 FORMAT "%13.9" /end CHARACTERISTIC
/begin CHARACTERISTIC DFES_GrpRpr.DFC_DSTTI_C "common MIL debouncing / group representative for common MIL debouncing of DFC_DSTTI" VALUE 0x80504F26 Val_Wu16 906.000000000 DFC_Verb 0.00 906.000000000 FORMAT "%13.9" /end CHARACTERISTIC
/begin CHARACTERISTIC DFES_GrpRpr.DFC_DSUmax_C "common MIL debouncing / group representative for common MIL debouncing of DFC_DSUmax" VALUE 0x80504F28 Val_Wu16 906.000000000 DFC_Verb 0.00 906.000000000 FORMAT "%13.9" /end CHARACTERISTIC
/begin CHARACTERISTIC DFES_GrpRpr.DFC_DiagCpv1DteskLoLoadStuckClsd_C "common MIL debouncing / group representative for common MIL debouncing of DFC_DiagCpv1DteskLoLoadStuckClsd" VALUE 0x80504F2A Val_Wu16 906.000000000 DFC_Verb 0.00 906.000000000 FORMAT "%13.9" /end CHARACTERISTIC
/begin CHARACTERISTIC DFES_GrpRpr.DFC_DiagCpv1DteskLoLoadStuckOpen_C "common MIL debouncing / group representative for common MIL debouncing of DFC_DiagCpv1DteskLoLoadStuckOpen" VALUE 0x80504F2C Val_Wu16 906.000000000 DFC_Verb 0.00 906.000000000 FORMAT "%13.9" /end CHARACTERISTIC
/begin CHARACTERISTIC DFES_GrpRpr.DFC_EGRVlvDrftClsd_C "common MIL debouncing / group representative for common MIL debouncing of DFC_EGRVlvDrftClsd" VALUE 0x80504F2E Val_Wu16 906.000000000 DFC_Verb 0.00 906.000000000 FORMAT "%13.9" /end CHARACTERISTIC
/begin CHARACTERISTIC DFES_GrpRpr.DFC_EGRVlvDrftOpn_C "common MIL debouncing / group representative for common MIL debouncing of DFC_EGRVlvDrftOpn" VALUE 0x80504F30 Val_Wu16 906.000000000 DFC_Verb 0.00 906.000000000 FORMAT "%13.9" /end CHARACTERISTIC
/begin CHARACTERISTIC DFES_GrpRpr.DFC_EGRVlvJamVlvClsd_C "common MIL debouncing / group representative for common MIL debouncing of DFC_EGRVlvJamVlvClsd" VALUE 0x80504F32 Val_Wu16 906.000000000 DFC_Verb 0.00 906.000000000 FORMAT "%13.9" /end CHARACTERISTIC
/begin CHARACTERISTIC DFES_GrpRpr.DFC_EGRVlvJamVlvOpn_C "common MIL debouncing / group representative for common MIL debouncing of DFC_EGRVlvJamVlvOpn" VALUE 0x80504F34 Val_Wu16 906.000000000 DFC_Verb 0.00 906.000000000 FORMAT "%13.9" /end CHARACTERISTIC
/begin CHARACTERISTIC DFES_GrpRpr.DFC_EGRVlvSprgBrk_C "common MIL debouncing / group representative for common MIL debouncing of DFC_EGRVlvSprgBrk" VALUE 0x80504F36 Val_Wu16 906.000000000 DFC_Verb 0.00 906.000000000 FORMAT "%13.9" /end CHARACTERISTIC
/begin CHARACTERISTIC DFES_GrpRpr.DFC_EGRVlvTempMdlEEPErr_C "common MIL debouncing / group representative for common MIL debouncing of DFC_EGRVlvTempMdlEEPErr" VALUE 0x80504F38 Val_Wu16 906.000000000 DFC_Verb 0.00 906.000000000 FORMAT "%13.9" /end CHARACTERISTIC
/begin CHARACTERISTIC DFES_GrpRpr.DFC_EGRVlvTmpErr_C "common MIL debouncing / group representative for common MIL debouncing of DFC_EGRVlvTmpErr" VALUE 0x80504F3A Val_Wu16 906.000000000 DFC_Verb 0.00 906.000000000 FORMAT "%13.9" /end CHARACTERISTIC
/begin CHARACTERISTIC DFES_GrpRpr.DFC_EGSDUS2B1LtrDly_C "common MIL debouncing / group representative for common MIL debouncing of DFC_EGSDUS2B1LtrDly" VALUE 0x80504F3C Val_Wu16 906.000000000 DFC_Verb 0.00 906.000000000 FORMAT "%13.9" /end CHARACTERISTIC
/begin CHARACTERISTIC DFES_GrpRpr.DFC_EGSDUS2B1LtrPT1_C "common MIL debouncing / group representative for common MIL debouncing of DFC_EGSDUS2B1LtrPT1" VALUE 0x80504F3E Val_Wu16 906.000000000 DFC_Verb 0.00 906.000000000 FORMAT "%13.9" /end CHARACTERISTIC
/begin CHARACTERISTIC DFES_GrpRpr.DFC_EGSDUS2B1RtlDly_C "common MIL debouncing / group representative for common MIL debouncing of DFC_EGSDUS2B1RtlDly" VALUE 0x80504F40 Val_Wu16 906.000000000 DFC_Verb 0.00 906.000000000 FORMAT "%13.9" /end CHARACTERISTIC
/begin CHARACTERISTIC DFES_GrpRpr.DFC_EGSDUS2B1RtlPT1_C "common MIL debouncing / group representative for common MIL debouncing of DFC_EGSDUS2B1RtlPT1" VALUE 0x80504F42 Val_Wu16 906.000000000 DFC_Verb 0.00 906.000000000 FORMAT "%13.9" /end CHARACTERISTIC
/begin CHARACTERISTIC DFES_GrpRpr.DFC_EGSDUS2B1TarLean_C "common MIL debouncing / group representative for common MIL debouncing of DFC_EGSDUS2B1TarLean" VALUE 0x80504F44 Val_Wu16 906.000000000 DFC_Verb 0.00 906.000000000 FORMAT "%13.9" /end CHARACTERISTIC
/begin CHARACTERISTIC DFES_GrpRpr.DFC_EGSDUS2B1TarRich_C "common MIL debouncing / group representative for common MIL debouncing of DFC_EGSDUS2B1TarRich" VALUE 0x80504F46 Val_Wu16 906.000000000 DFC_Verb 0.00 906.000000000 FORMAT "%13.9" /end CHARACTERISTIC
/begin CHARACTERISTIC DFES_GrpRpr.DFC_EONVmax_C "common MIL debouncing / group representative for common MIL debouncing of DFC_EONVmax" VALUE 0x80504F48 Val_Wu16 906.000000000 DFC_Verb 0.00 906.000000000 FORMAT "%13.9" /end CHARACTERISTIC
/begin CHARACTERISTIC DFES_GrpRpr.DFC_ETAKHLmax_C "common MIL debouncing / group representative for common MIL debouncing of DFC_ETAKHLmax" VALUE 0x80504F4A Val_Wu16 906.000000000 DFC_Verb 0.00 906.000000000 FORMAT "%13.9" /end CHARACTERISTIC
/begin CHARACTERISTIC DFES_GrpRpr.DFC_ETAKHTmax_C "common MIL debouncing / group representative for common MIL debouncing of DFC_ETAKHTmax" VALUE 0x80504F4C Val_Wu16 906.000000000 DFC_Verb 0.00 906.000000000 FORMAT "%13.9" /end CHARACTERISTIC
/begin CHARACTERISTIC DFES_GrpRpr.DFC_ETHSEmax_C "common MIL debouncing / group representative for common MIL debouncing of DFC_ETHSEmax" VALUE 0x80504F4E Val_Wu16 906.000000000 DFC_Verb 0.00 906.000000000 FORMAT "%13.9" /end CHARACTERISTIC
/begin CHARACTERISTIC DFES_GrpRpr.DFC_ETHSEmin_C "common MIL debouncing / group representative for common MIL debouncing of DFC_ETHSEmin" VALUE 0x80504F50 Val_Wu16 906.000000000 DFC_Verb 0.00 906.000000000 FORMAT "%13.9" /end CHARACTERISTIC
/begin CHARACTERISTIC DFES_GrpRpr.DFC_ETHSFmax_C "common MIL debouncing / group representative for common MIL debouncing of DFC_ETHSFmax" VALUE 0x80504F52 Val_Wu16 906.000000000 DFC_Verb 0.00 906.000000000 FORMAT "%13.9" /end CHARACTERISTIC
/begin CHARACTERISTIC DFES_GrpRpr.DFC_ETHSFmin_C "common MIL debouncing / group representative for common MIL debouncing of DFC_ETHSFmin" VALUE 0x80504F54 Val_Wu16 906.000000000 DFC_Verb 0.00 906.000000000 FORMAT "%13.9" /end CHARACTERISTIC
/begin CHARACTERISTIC DFES_GrpRpr.DFC_ETHSFsig_C "common MIL debouncing / group representative for common MIL debouncing of DFC_ETHSFsig" VALUE 0x80504F56 Val_Wu16 906.000000000 DFC_Verb 0.00 906.000000000 FORMAT "%13.9" /end CHARACTERISTIC
/begin CHARACTERISTIC DFES_GrpRpr.DFC_ETHSNPWmax_C "common MIL debouncing / group representative for common MIL debouncing of DFC_ETHSNPWmax" VALUE 0x80504F58 Val_Wu16 906.000000000 DFC_Verb 0.00 906.000000000 FORMAT "%13.9" /end CHARACTERISTIC
/begin CHARACTERISTIC DFES_GrpRpr.DFC_ETHSNPWmin_C "common MIL debouncing / group representative for common MIL debouncing of DFC_ETHSNPWmin" VALUE 0x80504F5A Val_Wu16 906.000000000 DFC_Verb 0.00 906.000000000 FORMAT "%13.9" /end CHARACTERISTIC
/begin CHARACTERISTIC DFES_GrpRpr.DFC_ETHSNPWsig_C "common MIL debouncing / group representative for common MIL debouncing of DFC_ETHSNPWsig" VALUE 0x80504F5C Val_Wu16 906.000000000 DFC_Verb 0.00 906.000000000 FORMAT "%13.9" /end CHARACTERISTIC
/begin CHARACTERISTIC DFES_GrpRpr.DFC_ETHSPLnpl_C "common MIL debouncing / group representative for common MIL debouncing of DFC_ETHSPLnpl" VALUE 0x80504F5E Val_Wu16 906.000000000 DFC_Verb 0.00 906.000000000 FORMAT "%13.9" /end CHARACTERISTIC
/begin CHARACTERISTIC DFES_GrpRpr.DFC_ETHSTPLnpl_C "common MIL debouncing / group representative for common MIL debouncing of DFC_ETHSTPLnpl" VALUE 0x80504F60 Val_Wu16 906.000000000 DFC_Verb 0.00 906.000000000 FORMAT "%13.9" /end CHARACTERISTIC
/begin CHARACTERISTIC DFES_GrpRpr.DFC_EngICO_C "common MIL debouncing / group representative for common MIL debouncing of DFC_EngICO" VALUE 0x80504F62 Val_Wu16 906.000000000 DFC_Verb 0.00 906.000000000 FORMAT "%13.9" /end CHARACTERISTIC
/begin CHARACTERISTIC DFES_GrpRpr.DFC_EngPrtOvrSpdMon_C "common MIL debouncing / group representative for common MIL debouncing of DFC_EngPrtOvrSpdMon" VALUE 0x80504F64 Val_Wu16 906.000000000 DFC_Verb 0.00 906.000000000 FORMAT "%13.9" /end CHARACTERISTIC
/begin CHARACTERISTIC DFES_GrpRpr.DFC_EpmCaSI1ErrSig_C "common MIL debouncing / group representative for common MIL debouncing of DFC_EpmCaSI1ErrSig" VALUE 0x80504F66 Val_Wu16 906.000000000 DFC_Verb 0.00 906.000000000 FORMAT "%13.9" /end CHARACTERISTIC
/begin CHARACTERISTIC DFES_GrpRpr.DFC_EpmCaSI1MntErr_C "common MIL debouncing / group representative for common MIL debouncing of DFC_EpmCaSI1MntErr" VALUE 0x80504F68 Val_Wu16 906.000000000 DFC_Verb 0.00 906.000000000 FORMAT "%13.9" /end CHARACTERISTIC
/begin CHARACTERISTIC DFES_GrpRpr.DFC_EpmCaSI1NoSigMax_C "common MIL debouncing / group representative for common MIL debouncing of DFC_EpmCaSI1NoSigMax" VALUE 0x80504F6A Val_Wu16 906.000000000 DFC_Verb 0.00 906.000000000 FORMAT "%13.9" /end CHARACTERISTIC
/begin CHARACTERISTIC DFES_GrpRpr.DFC_EpmCaSI1NoSigMin_C "common MIL debouncing / group representative for common MIL debouncing of DFC_EpmCaSI1NoSigMin" VALUE 0x80504F6C Val_Wu16 906.000000000 DFC_Verb 0.00 906.000000000 FORMAT "%13.9" /end CHARACTERISTIC
/begin CHARACTERISTIC DFES_GrpRpr.DFC_EpmCaSI1OfsErr_C "common MIL debouncing / group representative for common MIL debouncing of DFC_EpmCaSI1OfsErr" VALUE 0x80504F6E Val_Wu16 906.000000000 DFC_Verb 0.00 906.000000000 FORMAT "%13.9" /end CHARACTERISTIC
/begin CHARACTERISTIC DFES_GrpRpr.DFC_EpmCrSDGI_C "common MIL debouncing / group representative for common MIL debouncing of DFC_EpmCrSDGI" VALUE 0x80504F70 Val_Wu16 906.000000000 DFC_Verb 0.00 906.000000000 FORMAT "%13.9" /end CHARACTERISTIC
/begin CHARACTERISTIC DFES_GrpRpr.DFC_EpmCrSErrSig_C "common MIL debouncing / group representative for common MIL debouncing of DFC_EpmCrSErrSig" VALUE 0x80504F72 Val_Wu16 906.000000000 DFC_Verb 0.00 906.000000000 FORMAT "%13.9" /end CHARACTERISTIC
/begin CHARACTERISTIC DFES_GrpRpr.DFC_EpmCrSNoSig_C "common MIL debouncing / group representative for common MIL debouncing of DFC_EpmCrSNoSig" VALUE 0x80504F74 Val_Wu16 906.000000000 DFC_Verb 0.00 906.000000000 FORMAT "%13.9" /end CHARACTERISTIC
/begin CHARACTERISTIC DFES_GrpRpr.DFC_EtaEngIdleNonCsers_C "common MIL debouncing / group representative for common MIL debouncing of DFC_EtaEngIdleNonCsers" VALUE 0x80504F76 Val_Wu16 906.000000000 DFC_Verb 0.00 906.000000000 FORMAT "%13.9" /end CHARACTERISTIC
/begin CHARACTERISTIC DFES_GrpRpr.DFC_EtaEngPtlNonCsers_C "common MIL debouncing / group representative for common MIL debouncing of DFC_EtaEngPtlNonCsers" VALUE 0x80504F78 Val_Wu16 906.000000000 DFC_Verb 0.00 906.000000000 FORMAT "%13.9" /end CHARACTERISTIC
/begin CHARACTERISTIC DFES_GrpRpr.DFC_FRAmax_C "common MIL debouncing / group representative for common MIL debouncing of DFC_FRAmax" VALUE 0x80504F7A Val_Wu16 906.000000000 DFC_Verb 0.00 906.000000000 FORMAT "%13.9" /end CHARACTERISTIC
/begin CHARACTERISTIC DFES_GrpRpr.DFC_FRAmin_C "common MIL debouncing / group representative for common MIL debouncing of DFC_FRAmin" VALUE 0x80504F7C Val_Wu16 906.000000000 DFC_Verb 0.00 906.000000000 FORMAT "%13.9" /end CHARACTERISTIC
/begin CHARACTERISTIC DFES_GrpRpr.DFC_FSTEmax_C "common MIL debouncing / group representative for common MIL debouncing of DFC_FSTEmax" VALUE 0x80504F7E Val_Wu16 906.000000000 DFC_Verb 0.00 906.000000000 FORMAT "%13.9" /end CHARACTERISTIC
/begin CHARACTERISTIC DFES_GrpRpr.DFC_FSTEmin_C "common MIL debouncing / group representative for common MIL debouncing of DFC_FSTEmin" VALUE 0x80504F80 Val_Wu16 906.000000000 DFC_Verb 0.00 906.000000000 FORMAT "%13.9" /end CHARACTERISTIC
/begin CHARACTERISTIC DFES_GrpRpr.DFC_FSTRmax_C "common MIL debouncing / group representative for common MIL debouncing of DFC_FSTRmax" VALUE 0x80504F82 Val_Wu16 906.000000000 DFC_Verb 0.00 906.000000000 FORMAT "%13.9" /end CHARACTERISTIC
/begin CHARACTERISTIC DFES_GrpRpr.DFC_FSTRmin_C "common MIL debouncing / group representative for common MIL debouncing of DFC_FSTRmin" VALUE 0x80504F84 Val_Wu16 906.000000000 DFC_Verb 0.00 906.000000000 FORMAT "%13.9" /end CHARACTERISTIC
/begin CHARACTERISTIC DFES_GrpRpr.DFC_FSTRnpl_C "common MIL debouncing / group representative for common MIL debouncing of DFC_FSTRnpl" VALUE 0x80504F86 Val_Wu16 906.000000000 DFC_Verb 0.00 906.000000000 FORMAT "%13.9" /end CHARACTERISTIC
/begin CHARACTERISTIC DFES_GrpRpr.DFC_FSTmax_C "common MIL debouncing / group representative for common MIL debouncing of DFC_FSTmax" VALUE 0x80504F88 Val_Wu16 906.000000000 DFC_Verb 0.00 906.000000000 FORMAT "%13.9" /end CHARACTERISTIC
/begin CHARACTERISTIC DFES_GrpRpr.DFC_FTDLAmax_C "common MIL debouncing / group representative for common MIL debouncing of DFC_FTDLAmax" VALUE 0x80504F8A Val_Wu16 906.000000000 DFC_Verb 0.00 906.000000000 FORMAT "%13.9" /end CHARACTERISTIC
/begin CHARACTERISTIC DFES_GrpRpr.DFC_FTDLAmin_C "common MIL debouncing / group representative for common MIL debouncing of DFC_FTDLAmin" VALUE 0x80504F8C Val_Wu16 906.000000000 DFC_Verb 0.00 906.000000000 FORMAT "%13.9" /end CHARACTERISTIC
/begin CHARACTERISTIC DFES_GrpRpr.DFC_FuPHiSnsrEleclmax_C "common MIL debouncing / group representative for common MIL debouncing of DFC_FuPHiSnsrEleclmax" VALUE 0x80504F8E Val_Wu16 906.000000000 DFC_Verb 0.00 906.000000000 FORMAT "%13.9" /end CHARACTERISTIC
/begin CHARACTERISTIC DFES_GrpRpr.DFC_FuPHiSnsrEleclmin_C "common MIL debouncing / group representative for common MIL debouncing of DFC_FuPHiSnsrEleclmin" VALUE 0x80504F90 Val_Wu16 906.000000000 DFC_Verb 0.00 906.000000000 FORMAT "%13.9" /end CHARACTERISTIC
/begin CHARACTERISTIC DFES_GrpRpr.DFC_FuPHiSnsrEleclnpl_C "common MIL debouncing / group representative for common MIL debouncing of DFC_FuPHiSnsrEleclnpl" VALUE 0x80504F92 Val_Wu16 906.000000000 DFC_Verb 0.00 906.000000000 FORMAT "%13.9" /end CHARACTERISTIC
/begin CHARACTERISTIC DFES_GrpRpr.DFC_FuPHiSnsrURngMax_C "common MIL debouncing / group representative for common MIL debouncing of DFC_FuPHiSnsrURngMax" VALUE 0x80504F94 Val_Wu16 906.000000000 DFC_Verb 0.00 906.000000000 FORMAT "%13.9" /end CHARACTERISTIC
/begin CHARACTERISTIC DFES_GrpRpr.DFC_FuPHiSnsrURngMin_C "common MIL debouncing / group representative for common MIL debouncing of DFC_FuPHiSnsrURngMin" VALUE 0x80504F96 Val_Wu16 906.000000000 DFC_Verb 0.00 906.000000000 FORMAT "%13.9" /end CHARACTERISTIC
/begin CHARACTERISTIC DFES_GrpRpr.DFC_FuSnsrPhyRngMaxErr_C "common MIL debouncing / group representative for common MIL debouncing of DFC_FuSnsrPhyRngMaxErr" VALUE 0x80504F98 Val_Wu16 906.000000000 DFC_Verb 0.00 906.000000000 FORMAT "%13.9" /end CHARACTERISTIC
/begin CHARACTERISTIC DFES_GrpRpr.DFC_FuSnsrPhyRngMinErr_C "common MIL debouncing / group representative for common MIL debouncing of DFC_FuSnsrPhyRngMinErr" VALUE 0x80504F9A Val_Wu16 906.000000000 DFC_Verb 0.00 906.000000000 FORMAT "%13.9" /end CHARACTERISTIC
/begin CHARACTERISTIC DFES_GrpRpr.DFC_GEVlvLockPinDiagIntkB1_C "common MIL debouncing / group representative for common MIL debouncing of DFC_GEVlvLockPinDiagIntkB1" VALUE 0x80504F9C Val_Wu16 906.000000000 DFC_Verb 0.00 906.000000000 FORMAT "%13.9" /end CHARACTERISTIC
/begin CHARACTERISTIC DFES_GrpRpr.DFC_GEVlvPhaSlowIntkB1_C "common MIL debouncing / group representative for common MIL debouncing of DFC_GEVlvPhaSlowIntkB1" VALUE 0x80504F9E Val_Wu16 906.000000000 DFC_Verb 0.00 906.000000000 FORMAT "%13.9" /end CHARACTERISTIC
/begin CHARACTERISTIC DFES_GrpRpr.DFC_GEVlvPhaTargIntkB1_C "common MIL debouncing / group representative for common MIL debouncing of DFC_GEVlvPhaTargIntkB1" VALUE 0x80504FA0 Val_Wu16 906.000000000 DFC_Verb 0.00 906.000000000 FORMAT "%13.9" /end CHARACTERISTIC
/begin CHARACTERISTIC DFES_GrpRpr.DFC_GbxRvsSwtStk_C "common MIL debouncing / group representative for common MIL debouncing of DFC_GbxRvsSwtStk" VALUE 0x80504FA2 Val_Wu16 906.000000000 DFC_Verb 0.00 906.000000000 FORMAT "%13.9" /end CHARACTERISTIC
/begin CHARACTERISTIC DFES_GrpRpr.DFC_HDRKHmax_C "common MIL debouncing / group representative for common MIL debouncing of DFC_HDRKHmax" VALUE 0x80504FA4 Val_Wu16 906.000000000 DFC_Verb 0.00 906.000000000 FORMAT "%13.9" /end CHARACTERISTIC
/begin CHARACTERISTIC DFES_GrpRpr.DFC_HDRKHmin_C "common MIL debouncing / group representative for common MIL debouncing of DFC_HDRKHmin" VALUE 0x80504FA6 Val_Wu16 906.000000000 DFC_Verb 0.00 906.000000000 FORMAT "%13.9" /end CHARACTERISTIC
/begin CHARACTERISTIC DFES_GrpRpr.DFC_HDRPLmax_C "common MIL debouncing / group representative for common MIL debouncing of DFC_HDRPLmax" VALUE 0x80504FA8 Val_Wu16 906.000000000 DFC_Verb 0.00 906.000000000 FORMAT "%13.9" /end CHARACTERISTIC
/begin CHARACTERISTIC DFES_GrpRpr.DFC_HDRPLmin_C "common MIL debouncing / group representative for common MIL debouncing of DFC_HDRPLmin" VALUE 0x80504FAA Val_Wu16 906.000000000 DFC_Verb 0.00 906.000000000 FORMAT "%13.9" /end CHARACTERISTIC
/begin CHARACTERISTIC DFES_GrpRpr.DFC_HDRmax_C "common MIL debouncing / group representative for common MIL debouncing of DFC_HDRmax" VALUE 0x80504FAC Val_Wu16 906.000000000 DFC_Verb 0.00 906.000000000 FORMAT "%13.9" /end CHARACTERISTIC
/begin CHARACTERISTIC DFES_GrpRpr.DFC_HDRmin_C "common MIL debouncing / group representative for common MIL debouncing of DFC_HDRmin" VALUE 0x80504FAE Val_Wu16 906.000000000 DFC_Verb 0.00 906.000000000 FORMAT "%13.9" /end CHARACTERISTIC
/begin CHARACTERISTIC DFES_GrpRpr.DFC_HEGOS2B1ElecMax_C "common MIL debouncing / group representative for common MIL debouncing of DFC_HEGOS2B1ElecMax" VALUE 0x80504FB0 Val_Wu16 906.000000000 DFC_Verb 0.00 906.000000000 FORMAT "%13.9" /end CHARACTERISTIC
/begin CHARACTERISTIC DFES_GrpRpr.DFC_HEGOS2B1ElecMin_C "common MIL debouncing / group representative for common MIL debouncing of DFC_HEGOS2B1ElecMin" VALUE 0x80504FB2 Val_Wu16 906.000000000 DFC_Verb 0.00 906.000000000 FORMAT "%13.9" /end CHARACTERISTIC
/begin CHARACTERISTIC DFES_GrpRpr.DFC_HEGOS2B1ElecSig_C "common MIL debouncing / group representative for common MIL debouncing of DFC_HEGOS2B1ElecSig" VALUE 0x80504FB4 Val_Wu16 906.000000000 DFC_Verb 0.00 906.000000000 FORMAT "%13.9" /end CHARACTERISTIC
/begin CHARACTERISTIC DFES_GrpRpr.DFC_HEGOS2B1HtgNpl_C "common MIL debouncing / group representative for common MIL debouncing of DFC_HEGOS2B1HtgNpl" VALUE 0x80504FB6 Val_Wu16 906.000000000 DFC_Verb 0.00 906.000000000 FORMAT "%13.9" /end CHARACTERISTIC
/begin CHARACTERISTIC DFES_GrpRpr.DFC_HEV00max_C "common MIL debouncing / group representative for common MIL debouncing of DFC_HEV00max" VALUE 0x80504FB8 Val_Wu16 906.000000000 DFC_Verb 0.00 906.000000000 FORMAT "%13.9" /end CHARACTERISTIC
/begin CHARACTERISTIC DFES_GrpRpr.DFC_HEV01max_C "common MIL debouncing / group representative for common MIL debouncing of DFC_HEV01max" VALUE 0x80504FBA Val_Wu16 906.000000000 DFC_Verb 0.00 906.000000000 FORMAT "%13.9" /end CHARACTERISTIC
/begin CHARACTERISTIC DFES_GrpRpr.DFC_HEV02max_C "common MIL debouncing / group representative for common MIL debouncing of DFC_HEV02max" VALUE 0x80504FBC Val_Wu16 906.000000000 DFC_Verb 0.00 906.000000000 FORMAT "%13.9" /end CHARACTERISTIC
/begin CHARACTERISTIC DFES_GrpRpr.DFC_HEV03max_C "common MIL debouncing / group representative for common MIL debouncing of DFC_HEV03max" VALUE 0x80504FBE Val_Wu16 906.000000000 DFC_Verb 0.00 906.000000000 FORMAT "%13.9" /end CHARACTERISTIC
/begin CHARACTERISTIC DFES_GrpRpr.DFC_HEVE0max_C "common MIL debouncing / group representative for common MIL debouncing of DFC_HEVE0max" VALUE 0x80504FC0 Val_Wu16 906.000000000 DFC_Verb 0.00 906.000000000 FORMAT "%13.9" /end CHARACTERISTIC
/begin CHARACTERISTIC DFES_GrpRpr.DFC_HEVE1max_C "common MIL debouncing / group representative for common MIL debouncing of DFC_HEVE1max" VALUE 0x80504FC2 Val_Wu16 906.000000000 DFC_Verb 0.00 906.000000000 FORMAT "%13.9" /end CHARACTERISTIC
/begin CHARACTERISTIC DFES_GrpRpr.DFC_HFMmax_C "common MIL debouncing / group representative for common MIL debouncing of DFC_HFMmax" VALUE 0x80504FC4 Val_Wu16 906.000000000 DFC_Verb 0.00 906.000000000 FORMAT "%13.9" /end CHARACTERISTIC
/begin CHARACTERISTIC DFES_GrpRpr.DFC_HiPSysHiPMaxLimExcdd_C "common MIL debouncing / group representative for common MIL debouncing of DFC_HiPSysHiPMaxLimExcdd" VALUE 0x80504FC6 Val_Wu16 906.000000000 DFC_Verb 0.00 906.000000000 FORMAT "%13.9" /end CHARACTERISTIC
/begin CHARACTERISTIC DFES_GrpRpr.DFC_IVGdiCtlCvoErrMax_0_C "common MIL debouncing / group representative for common MIL debouncing of DFC_IVGdiCtlCvoErrMax_0" VALUE 0x80504FC8 Val_Wu16 906.000000000 DFC_Verb 0.00 906.000000000 FORMAT "%13.9" /end CHARACTERISTIC
/begin CHARACTERISTIC DFES_GrpRpr.DFC_IVGdiCtlCvoErrMax_1_C "common MIL debouncing / group representative for common MIL debouncing of DFC_IVGdiCtlCvoErrMax_1" VALUE 0x80504FCA Val_Wu16 906.000000000 DFC_Verb 0.00 906.000000000 FORMAT "%13.9" /end CHARACTERISTIC
/begin CHARACTERISTIC DFES_GrpRpr.DFC_IVGdiCtlCvoErrMax_2_C "common MIL debouncing / group representative for common MIL debouncing of DFC_IVGdiCtlCvoErrMax_2" VALUE 0x80504FCC Val_Wu16 906.000000000 DFC_Verb 0.00 906.000000000 FORMAT "%13.9" /end CHARACTERISTIC
/begin CHARACTERISTIC DFES_GrpRpr.DFC_IVGdiCtlCvoErrMax_3_C "common MIL debouncing / group representative for common MIL debouncing of DFC_IVGdiCtlCvoErrMax_3" VALUE 0x80504FCE Val_Wu16 906.000000000 DFC_Verb 0.00 906.000000000 FORMAT "%13.9" /end CHARACTERISTIC
/begin CHARACTERISTIC DFES_GrpRpr.DFC_IVGdiCtlCvoErrMin_0_C "common MIL debouncing / group representative for common MIL debouncing of DFC_IVGdiCtlCvoErrMin_0" VALUE 0x80504FD0 Val_Wu16 906.000000000 DFC_Verb 0.00 906.000000000 FORMAT "%13.9" /end CHARACTERISTIC
/begin CHARACTERISTIC DFES_GrpRpr.DFC_IVGdiCtlCvoErrMin_1_C "common MIL debouncing / group representative for common MIL debouncing of DFC_IVGdiCtlCvoErrMin_1" VALUE 0x80504FD2 Val_Wu16 906.000000000 DFC_Verb 0.00 906.000000000 FORMAT "%13.9" /end CHARACTERISTIC
/begin CHARACTERISTIC DFES_GrpRpr.DFC_IVGdiCtlCvoErrMin_2_C "common MIL debouncing / group representative for common MIL debouncing of DFC_IVGdiCtlCvoErrMin_2" VALUE 0x80504FD4 Val_Wu16 906.000000000 DFC_Verb 0.00 906.000000000 FORMAT "%13.9" /end CHARACTERISTIC
/begin CHARACTERISTIC DFES_GrpRpr.DFC_IVGdiCtlCvoErrMin_3_C "common MIL debouncing / group representative for common MIL debouncing of DFC_IVGdiCtlCvoErrMin_3" VALUE 0x80504FD6 Val_Wu16 906.000000000 DFC_Verb 0.00 906.000000000 FORMAT "%13.9" /end CHARACTERISTIC
/begin CHARACTERISTIC DFES_GrpRpr.DFC_IVGdiCtlCvoErrMinMax_C "common MIL debouncing / group representative for common MIL debouncing of DFC_IVGdiCtlCvoErrMinMax" VALUE 0x80504FD8 Val_Wu16 906.000000000 DFC_Verb 0.00 906.000000000 FORMAT "%13.9" /end CHARACTERISTIC
/begin CHARACTERISTIC DFES_GrpRpr.DFC_IVGdiCtlCvoSigPlausErrSmrCdn_C "common MIL debouncing / group representative for common MIL debouncing of DFC_IVGdiCtlCvoSigPlausErrSmrCdn" VALUE 0x80504FDA Val_Wu16 906.000000000 DFC_Verb 0.00 906.000000000 FORMAT "%13.9" /end CHARACTERISTIC
/begin CHARACTERISTIC DFES_GrpRpr.DFC_IVGdiCtl_CvoErr_C "common MIL debouncing / group representative for common MIL debouncing of DFC_IVGdiCtl_CvoErr" VALUE 0x80504FDC Val_Wu16 906.000000000 DFC_Verb 0.00 906.000000000 FORMAT "%13.9" /end CHARACTERISTIC
/begin CHARACTERISTIC DFES_GrpRpr.DFC_IVGdiCtl_CvoSigPlaus_0_C "common MIL debouncing / group representative for common MIL debouncing of DFC_IVGdiCtl_CvoSigPlaus_0" VALUE 0x80504FDE Val_Wu16 906.000000000 DFC_Verb 0.00 906.000000000 FORMAT "%13.9" /end CHARACTERISTIC
/begin CHARACTERISTIC DFES_GrpRpr.DFC_IVGdiCtl_CvoSigPlaus_1_C "common MIL debouncing / group representative for common MIL debouncing of DFC_IVGdiCtl_CvoSigPlaus_1" VALUE 0x80504FE0 Val_Wu16 906.000000000 DFC_Verb 0.00 906.000000000 FORMAT "%13.9" /end CHARACTERISTIC
/begin CHARACTERISTIC DFES_GrpRpr.DFC_IVGdiCtl_CvoSigPlaus_2_C "common MIL debouncing / group representative for common MIL debouncing of DFC_IVGdiCtl_CvoSigPlaus_2" VALUE 0x80504FE2 Val_Wu16 906.000000000 DFC_Verb 0.00 906.000000000 FORMAT "%13.9" /end CHARACTERISTIC
/begin CHARACTERISTIC DFES_GrpRpr.DFC_IVGdiCtl_CvoSigPlaus_3_C "common MIL debouncing / group representative for common MIL debouncing of DFC_IVGdiCtl_CvoSigPlaus_3" VALUE 0x80504FE4 Val_Wu16 906.000000000 DFC_Verb 0.00 906.000000000 FORMAT "%13.9" /end CHARACTERISTIC
/begin CHARACTERISTIC DFES_GrpRpr.DFC_IntkAirTAirFltDsCrssMax_C "common MIL debouncing / group representative for common MIL debouncing of DFC_IntkAirTAirFltDsCrssMax" VALUE 0x80504FE6 Val_Wu16 906.000000000 DFC_Verb 0.00 906.000000000 FORMAT "%13.9" /end CHARACTERISTIC
/begin CHARACTERISTIC DFES_GrpRpr.DFC_IntkAirTAirFltDsCrssMin_C "common MIL debouncing / group representative for common MIL debouncing of DFC_IntkAirTAirFltDsCrssMin" VALUE 0x80504FE8 Val_Wu16 906.000000000 DFC_Verb 0.00 906.000000000 FORMAT "%13.9" /end CHARACTERISTIC
/begin CHARACTERISTIC DFES_GrpRpr.DFC_IntkAirTAirFltDsHSCMax_C "common MIL debouncing / group representative for common MIL debouncing of DFC_IntkAirTAirFltDsHSCMax" VALUE 0x80504FEA Val_Wu16 906.000000000 DFC_Verb 0.00 906.000000000 FORMAT "%13.9" /end CHARACTERISTIC
/begin CHARACTERISTIC DFES_GrpRpr.DFC_IntkAirTAirFltDsImps_C "common MIL debouncing / group representative for common MIL debouncing of DFC_IntkAirTAirFltDsImps" VALUE 0x80504FEC Val_Wu16 906.000000000 DFC_Verb 0.00 906.000000000 FORMAT "%13.9" /end CHARACTERISTIC
/begin CHARACTERISTIC DFES_GrpRpr.DFC_IntkAirTAirFltDsPRCMax_C "common MIL debouncing / group representative for common MIL debouncing of DFC_IntkAirTAirFltDsPRCMax" VALUE 0x80504FEE Val_Wu16 906.000000000 DFC_Verb 0.00 906.000000000 FORMAT "%13.9" /end CHARACTERISTIC
/begin CHARACTERISTIC DFES_GrpRpr.DFC_IntkAirTAirFltDsPRCMin_C "common MIL debouncing / group representative for common MIL debouncing of DFC_IntkAirTAirFltDsPRCMin" VALUE 0x80504FF0 Val_Wu16 906.000000000 DFC_Verb 0.00 906.000000000 FORMAT "%13.9" /end CHARACTERISTIC
/begin CHARACTERISTIC DFES_GrpRpr.DFC_IntkAirTAirFltDsSRCMax_C "common MIL debouncing / group representative for common MIL debouncing of DFC_IntkAirTAirFltDsSRCMax" VALUE 0x80504FF2 Val_Wu16 906.000000000 DFC_Verb 0.00 906.000000000 FORMAT "%13.9" /end CHARACTERISTIC
/begin CHARACTERISTIC DFES_GrpRpr.DFC_IntkAirTAirFltDsSRCMin_C "common MIL debouncing / group representative for common MIL debouncing of DFC_IntkAirTAirFltDsSRCMin" VALUE 0x80504FF4 Val_Wu16 906.000000000 DFC_Verb 0.00 906.000000000 FORMAT "%13.9" /end CHARACTERISTIC
/begin CHARACTERISTIC DFES_GrpRpr.DFC_IntkAirTAirFltDsSTC_C "common MIL debouncing / group representative for common MIL debouncing of DFC_IntkAirTAirFltDsSTC" VALUE 0x80504FF6 Val_Wu16 906.000000000 DFC_Verb 0.00 906.000000000 FORMAT "%13.9" /end CHARACTERISTIC
/begin CHARACTERISTIC DFES_GrpRpr.DFC_IntkAirTIntkMnfldCrssMax_C "common MIL debouncing / group representative for common MIL debouncing of DFC_IntkAirTIntkMnfldCrssMax" VALUE 0x80504FF8 Val_Wu16 906.000000000 DFC_Verb 0.00 906.000000000 FORMAT "%13.9" /end CHARACTERISTIC
/begin CHARACTERISTIC DFES_GrpRpr.DFC_IntkAirTIntkMnfldCrssMin_C "common MIL debouncing / group representative for common MIL debouncing of DFC_IntkAirTIntkMnfldCrssMin" VALUE 0x80504FFA Val_Wu16 906.000000000 DFC_Verb 0.00 906.000000000 FORMAT "%13.9" /end CHARACTERISTIC
/begin CHARACTERISTIC DFES_GrpRpr.DFC_IntkAirTIntkMnfldHSCMax_C "common MIL debouncing / group representative for common MIL debouncing of DFC_IntkAirTIntkMnfldHSCMax" VALUE 0x80504FFC Val_Wu16 906.000000000 DFC_Verb 0.00 906.000000000 FORMAT "%13.9" /end CHARACTERISTIC
/begin CHARACTERISTIC DFES_GrpRpr.DFC_IntkAirTIntkMnfldImps_C "common MIL debouncing / group representative for common MIL debouncing of DFC_IntkAirTIntkMnfldImps" VALUE 0x80504FFE Val_Wu16 906.000000000 DFC_Verb 0.00 906.000000000 FORMAT "%13.9" /end CHARACTERISTIC
/begin CHARACTERISTIC DFES_GrpRpr.DFC_IntkAirTIntkMnfldPRCMax_C "common MIL debouncing / group representative for common MIL debouncing of DFC_IntkAirTIntkMnfldPRCMax" VALUE 0x80505000 Val_Wu16 906.000000000 DFC_Verb 0.00 906.000000000 FORMAT "%13.9" /end CHARACTERISTIC
/begin CHARACTERISTIC DFES_GrpRpr.DFC_IntkAirTIntkMnfldPRCMin_C "common MIL debouncing / group representative for common MIL debouncing of DFC_IntkAirTIntkMnfldPRCMin" VALUE 0x80505002 Val_Wu16 906.000000000 DFC_Verb 0.00 906.000000000 FORMAT "%13.9" /end CHARACTERISTIC
/begin CHARACTERISTIC DFES_GrpRpr.DFC_IntkAirTIntkMnfldSRCMax_C "common MIL debouncing / group representative for common MIL debouncing of DFC_IntkAirTIntkMnfldSRCMax" VALUE 0x80505004 Val_Wu16 906.000000000 DFC_Verb 0.00 906.000000000 FORMAT "%13.9" /end CHARACTERISTIC
/begin CHARACTERISTIC DFES_GrpRpr.DFC_IntkAirTIntkMnfldSRCMin_C "common MIL debouncing / group representative for common MIL debouncing of DFC_IntkAirTIntkMnfldSRCMin" VALUE 0x80505006 Val_Wu16 906.000000000 DFC_Verb 0.00 906.000000000 FORMAT "%13.9" /end CHARACTERISTIC
/begin CHARACTERISTIC DFES_GrpRpr.DFC_IntkAirTIntkMnfldSTC_C "common MIL debouncing / group representative for common MIL debouncing of DFC_IntkAirTIntkMnfldSTC" VALUE 0x80505008 Val_Wu16 906.000000000 DFC_Verb 0.00 906.000000000 FORMAT "%13.9" /end CHARACTERISTIC
/begin CHARACTERISTIC DFES_GrpRpr.DFC_KRREGRLMX_C "common MIL debouncing / group representative for common MIL debouncing of DFC_KRREGRLMX" VALUE 0x8050500A Val_Wu16 906.000000000 DFC_Verb 0.00 906.000000000 FORMAT "%13.9" /end CHARACTERISTIC
/begin CHARACTERISTIC DFES_GrpRpr.DFC_KRVEKOCVLCI_C "common MIL debouncing / group representative for common MIL debouncing of DFC_KRVEKOCVLCI" VALUE 0x8050500C Val_Wu16 906.000000000 DFC_Verb 0.00 906.000000000 FORMAT "%13.9" /end CHARACTERISTIC
/begin CHARACTERISTIC DFES_GrpRpr.DFC_KRVEKOENCHMT_C "common MIL debouncing / group representative for common MIL debouncing of DFC_KRVEKOENCHMT" VALUE 0x8050500E Val_Wu16 906.000000000 DFC_Verb 0.00 906.000000000 FORMAT "%13.9" /end CHARACTERISTIC
/begin CHARACTERISTIC DFES_GrpRpr.DFC_KRVEKOENCHMT0_C "common MIL debouncing / group representative for common MIL debouncing of DFC_KRVEKOENCHMT0" VALUE 0x80505010 Val_Wu16 906.000000000 DFC_Verb 0.00 906.000000000 FORMAT "%13.9" /end CHARACTERISTIC
/begin CHARACTERISTIC DFES_GrpRpr.DFC_KRVEKOENCHMT1_C "common MIL debouncing / group representative for common MIL debouncing of DFC_KRVEKOENCHMT1" VALUE 0x80505012 Val_Wu16 906.000000000 DFC_Verb 0.00 906.000000000 FORMAT "%13.9" /end CHARACTERISTIC
/begin CHARACTERISTIC DFES_GrpRpr.DFC_KRVEKOENCHMT2_C "common MIL debouncing / group representative for common MIL debouncing of DFC_KRVEKOENCHMT2" VALUE 0x80505014 Val_Wu16 906.000000000 DFC_Verb 0.00 906.000000000 FORMAT "%13.9" /end CHARACTERISTIC
/begin CHARACTERISTIC DFES_GrpRpr.DFC_KRVEKOENCHMT3_C "common MIL debouncing / group representative for common MIL debouncing of DFC_KRVEKOENCHMT3" VALUE 0x80505016 Val_Wu16 906.000000000 DFC_Verb 0.00 906.000000000 FORMAT "%13.9" /end CHARACTERISTIC
/begin CHARACTERISTIC DFES_GrpRpr.DFC_KRVEKOENCHMT4_C "common MIL debouncing / group representative for common MIL debouncing of DFC_KRVEKOENCHMT4" VALUE 0x80505018 Val_Wu16 906.000000000 DFC_Verb 0.00 906.000000000 FORMAT "%13.9" /end CHARACTERISTIC
/begin CHARACTERISTIC DFES_GrpRpr.DFC_KRVEKOENCHMT5_C "common MIL debouncing / group representative for common MIL debouncing of DFC_KRVEKOENCHMT5" VALUE 0x8050501A Val_Wu16 906.000000000 DFC_Verb 0.00 906.000000000 FORMAT "%13.9" /end CHARACTERISTIC
/begin CHARACTERISTIC DFES_GrpRpr.DFC_KRVEKOENCHMT6_C "common MIL debouncing / group representative for common MIL debouncing of DFC_KRVEKOENCHMT6" VALUE 0x8050501C Val_Wu16 906.000000000 DFC_Verb 0.00 906.000000000 FORMAT "%13.9" /end CHARACTERISTIC
/begin CHARACTERISTIC DFES_GrpRpr.DFC_KRVEKOENCHMT7_C "common MIL debouncing / group representative for common MIL debouncing of DFC_KRVEKOENCHMT7" VALUE 0x8050501E Val_Wu16 906.000000000 DFC_Verb 0.00 906.000000000 FORMAT "%13.9" /end CHARACTERISTIC
/begin CHARACTERISTIC DFES_GrpRpr.DFC_KRVEKORLMX_C "common MIL debouncing / group representative for common MIL debouncing of DFC_KRVEKORLMX" VALUE 0x80505020 Val_Wu16 906.000000000 DFC_Verb 0.00 906.000000000 FORMAT "%13.9" /end CHARACTERISTIC
/begin CHARACTERISTIC DFES_GrpRpr.DFC_KRVEKORLMXL_C "common MIL debouncing / group representative for common MIL debouncing of DFC_KRVEKORLMXL" VALUE 0x80505022 Val_Wu16 906.000000000 DFC_Verb 0.00 906.000000000 FORMAT "%13.9" /end CHARACTERISTIC
/begin CHARACTERISTIC DFES_GrpRpr.DFC_KS1max_C "common MIL debouncing / group representative for common MIL debouncing of DFC_KS1max" VALUE 0x80505024 Val_Wu16 906.000000000 DFC_Verb 0.00 906.000000000 FORMAT "%13.9" /end CHARACTERISTIC
/begin CHARACTERISTIC DFES_GrpRpr.DFC_KS1min_C "common MIL debouncing / group representative for common MIL debouncing of DFC_KS1min" VALUE 0x80505026 Val_Wu16 906.000000000 DFC_Verb 0.00 906.000000000 FORMAT "%13.9" /end CHARACTERISTIC
/begin CHARACTERISTIC DFES_GrpRpr.DFC_LMmax_C "common MIL debouncing / group representative for common MIL debouncing of DFC_LMmax" VALUE 0x80505028 Val_Wu16 906.000000000 DFC_Verb 0.00 906.000000000 FORMAT "%13.9" /end CHARACTERISTIC
/begin CHARACTERISTIC DFES_GrpRpr.DFC_LZSRnpl_C "common MIL debouncing / group representative for common MIL debouncing of DFC_LZSRnpl" VALUE 0x8050502A Val_Wu16 906.000000000 DFC_Verb 0.00 906.000000000 FORMAT "%13.9" /end CHARACTERISTIC
/begin CHARACTERISTIC DFES_GrpRpr.DFC_LamDynDiagS1B1_C "common MIL debouncing / group representative for common MIL debouncing of DFC_LamDynDiagS1B1" VALUE 0x8050502C Val_Wu16 906.000000000 DFC_Verb 0.00 906.000000000 FORMAT "%13.9" /end CHARACTERISTIC
/begin CHARACTERISTIC DFES_GrpRpr.DFC_LeakIntkMnfldEmiInfl_C "common MIL debouncing / group representative for common MIL debouncing of DFC_LeakIntkMnfldEmiInfl" VALUE 0x8050502E Val_Wu16 906.000000000 DFC_Verb 0.00 906.000000000 FORMAT "%13.9" /end CHARACTERISTIC
/begin CHARACTERISTIC DFES_GrpRpr.DFC_LinFrameErrDCDC_C "common MIL debouncing / group representative for common MIL debouncing of DFC_LinFrameErrDCDC" VALUE 0x80505030 Val_Wu16 906.000000000 DFC_Verb 0.00 906.000000000 FORMAT "%13.9" /end CHARACTERISTIC
/begin CHARACTERISTIC DFES_GrpRpr.DFC_LinOverrunErrDCDC_C "common MIL debouncing / group representative for common MIL debouncing of DFC_LinOverrunErrDCDC" VALUE 0x80505032 Val_Wu16 906.000000000 DFC_Verb 0.00 906.000000000 FORMAT "%13.9" /end CHARACTERISTIC
/begin CHARACTERISTIC DFES_GrpRpr.DFC_MD00max_C "common MIL debouncing / group representative for common MIL debouncing of DFC_MD00max" VALUE 0x80505034 Val_Wu16 906.000000000 DFC_Verb 0.00 906.000000000 FORMAT "%13.9" /end CHARACTERISTIC
/begin CHARACTERISTIC DFES_GrpRpr.DFC_MDBmax_C "common MIL debouncing / group representative for common MIL debouncing of DFC_MDBmax" VALUE 0x80505036 Val_Wu16 906.000000000 DFC_Verb 0.00 906.000000000 FORMAT "%13.9" /end CHARACTERISTIC
/begin CHARACTERISTIC DFES_GrpRpr.DFC_MDCat_C "common MIL debouncing / group representative for common MIL debouncing of DFC_MDCat" VALUE 0x80505038 Val_Wu16 906.000000000 DFC_Verb 0.00 906.000000000 FORMAT "%13.9" /end CHARACTERISTIC
/begin CHARACTERISTIC DFES_GrpRpr.DFC_MDCatCrit_C "common MIL debouncing / group representative for common MIL debouncing of DFC_MDCatCrit" VALUE 0x8050503A Val_Wu16 906.000000000 DFC_Verb 0.00 906.000000000 FORMAT "%13.9" /end CHARACTERISTIC
/begin CHARACTERISTIC DFES_GrpRpr.DFC_MDCatCurr_C "common MIL debouncing / group representative for common MIL debouncing of DFC_MDCatCurr" VALUE 0x8050503C Val_Wu16 906.000000000 DFC_Verb 0.00 906.000000000 FORMAT "%13.9" /end CHARACTERISTIC
/begin CHARACTERISTIC DFES_GrpRpr.DFC_MDCyl_0_C "common MIL debouncing / group representative for common MIL debouncing of DFC_MDCyl_0" VALUE 0x8050503E Val_Wu16 906.000000000 DFC_Verb 0.00 906.000000000 FORMAT "%13.9" /end CHARACTERISTIC
/begin CHARACTERISTIC DFES_GrpRpr.DFC_MDCyl_1_C "common MIL debouncing / group representative for common MIL debouncing of DFC_MDCyl_1" VALUE 0x80505040 Val_Wu16 906.000000000 DFC_Verb 0.00 906.000000000 FORMAT "%13.9" /end CHARACTERISTIC
/begin CHARACTERISTIC DFES_GrpRpr.DFC_MDCyl_2_C "common MIL debouncing / group representative for common MIL debouncing of DFC_MDCyl_2" VALUE 0x80505042 Val_Wu16 906.000000000 DFC_Verb 0.00 906.000000000 FORMAT "%13.9" /end CHARACTERISTIC
/begin CHARACTERISTIC DFES_GrpRpr.DFC_MDCyl_3_C "common MIL debouncing / group representative for common MIL debouncing of DFC_MDCyl_3" VALUE 0x80505044 Val_Wu16 906.000000000 DFC_Verb 0.00 906.000000000 FORMAT "%13.9" /end CHARACTERISTIC
/begin CHARACTERISTIC DFES_GrpRpr.DFC_MDEmi_C "common MIL debouncing / group representative for common MIL debouncing of DFC_MDEmi" VALUE 0x80505046 Val_Wu16 906.000000000 DFC_Verb 0.00 906.000000000 FORMAT "%13.9" /end CHARACTERISTIC
/begin CHARACTERISTIC DFES_GrpRpr.DFC_MDEmiStrt_C "common MIL debouncing / group representative for common MIL debouncing of DFC_MDEmiStrt" VALUE 0x80505048 Val_Wu16 906.000000000 DFC_Verb 0.00 906.000000000 FORMAT "%13.9" /end CHARACTERISTIC
/begin CHARACTERISTIC DFES_GrpRpr.DFC_MDFco_C "common MIL debouncing / group representative for common MIL debouncing of DFC_MDFco" VALUE 0x8050504A Val_Wu16 906.000000000 DFC_Verb 0.00 906.000000000 FORMAT "%13.9" /end CHARACTERISTIC
/begin CHARACTERISTIC DFES_GrpRpr.DFC_MDMpl_C "common MIL debouncing / group representative for common MIL debouncing of DFC_MDMpl" VALUE 0x8050504C Val_Wu16 906.000000000 DFC_Verb 0.00 906.000000000 FORMAT "%13.9" /end CHARACTERISTIC
/begin CHARACTERISTIC DFES_GrpRpr.DFC_MDSegTiAdpn_C "common MIL debouncing / group representative for common MIL debouncing of DFC_MDSegTiAdpn" VALUE 0x8050504E Val_Wu16 906.000000000 DFC_Verb 0.00 906.000000000 FORMAT "%13.9" /end CHARACTERISTIC
/begin CHARACTERISTIC DFES_GrpRpr.DFC_MDmax_C "common MIL debouncing / group representative for common MIL debouncing of DFC_MDmax" VALUE 0x80505050 Val_Wu16 906.000000000 DFC_Verb 0.00 906.000000000 FORMAT "%13.9" /end CHARACTERISTIC
/begin CHARACTERISTIC DFES_GrpRpr.DFC_MFuOilMax_C "common MIL debouncing / group representative for common MIL debouncing of DFC_MFuOilMax" VALUE 0x80505052 Val_Wu16 906.000000000 DFC_Verb 0.00 906.000000000 FORMAT "%13.9" /end CHARACTERISTIC
/begin CHARACTERISTIC DFES_GrpRpr.DFC_MOXEMM_SMU_ALM0_0_C "common MIL debouncing / group representative for common MIL debouncing of DFC_MOXEMM_SMU_ALM0_0" VALUE 0x80505054 Val_Wu16 906.000000000 DFC_Verb 0.00 906.000000000 FORMAT "%13.9" /end CHARACTERISTIC
/begin CHARACTERISTIC DFES_GrpRpr.DFC_MOXEMM_SMU_ALM0_1_C "common MIL debouncing / group representative for common MIL debouncing of DFC_MOXEMM_SMU_ALM0_1" VALUE 0x80505056 Val_Wu16 906.000000000 DFC_Verb 0.00 906.000000000 FORMAT "%13.9" /end CHARACTERISTIC
/begin CHARACTERISTIC DFES_GrpRpr.DFC_MOXEMM_SMU_ALM0_10_C "common MIL debouncing / group representative for common MIL debouncing of DFC_MOXEMM_SMU_ALM0_10" VALUE 0x80505058 Val_Wu16 906.000000000 DFC_Verb 0.00 906.000000000 FORMAT "%13.9" /end CHARACTERISTIC
/begin CHARACTERISTIC DFES_GrpRpr.DFC_MOXEMM_SMU_ALM0_11_C "common MIL debouncing / group representative for common MIL debouncing of DFC_MOXEMM_SMU_ALM0_11" VALUE 0x8050505A Val_Wu16 906.000000000 DFC_Verb 0.00 906.000000000 FORMAT "%13.9" /end CHARACTERISTIC
/begin CHARACTERISTIC DFES_GrpRpr.DFC_MOXEMM_SMU_ALM0_13_C "common MIL debouncing / group representative for common MIL debouncing of DFC_MOXEMM_SMU_ALM0_13" VALUE 0x8050505C Val_Wu16 906.000000000 DFC_Verb 0.00 906.000000000 FORMAT "%13.9" /end CHARACTERISTIC
/begin CHARACTERISTIC DFES_GrpRpr.DFC_MOXEMM_SMU_ALM0_14_C "common MIL debouncing / group representative for common MIL debouncing of DFC_MOXEMM_SMU_ALM0_14" VALUE 0x8050505E Val_Wu16 906.000000000 DFC_Verb 0.00 906.000000000 FORMAT "%13.9" /end CHARACTERISTIC
/begin CHARACTERISTIC DFES_GrpRpr.DFC_MOXEMM_SMU_ALM0_2_C "common MIL debouncing / group representative for common MIL debouncing of DFC_MOXEMM_SMU_ALM0_2" VALUE 0x80505060 Val_Wu16 906.000000000 DFC_Verb 0.00 906.000000000 FORMAT "%13.9" /end CHARACTERISTIC
/begin CHARACTERISTIC DFES_GrpRpr.DFC_MOXEMM_SMU_ALM0_22_C "common MIL debouncing / group representative for common MIL debouncing of DFC_MOXEMM_SMU_ALM0_22" VALUE 0x80505062 Val_Wu16 906.000000000 DFC_Verb 0.00 906.000000000 FORMAT "%13.9" /end CHARACTERISTIC
/begin CHARACTERISTIC DFES_GrpRpr.DFC_MOXEMM_SMU_ALM0_23_C "common MIL debouncing / group representative for common MIL debouncing of DFC_MOXEMM_SMU_ALM0_23" VALUE 0x80505064 Val_Wu16 906.000000000 DFC_Verb 0.00 906.000000000 FORMAT "%13.9" /end CHARACTERISTIC
/begin CHARACTERISTIC DFES_GrpRpr.DFC_MOXEMM_SMU_ALM0_4_C "common MIL debouncing / group representative for common MIL debouncing of DFC_MOXEMM_SMU_ALM0_4" VALUE 0x80505066 Val_Wu16 906.000000000 DFC_Verb 0.00 906.000000000 FORMAT "%13.9" /end CHARACTERISTIC
/begin CHARACTERISTIC DFES_GrpRpr.DFC_MOXEMM_SMU_ALM0_5_C "common MIL debouncing / group representative for common MIL debouncing of DFC_MOXEMM_SMU_ALM0_5" VALUE 0x80505068 Val_Wu16 906.000000000 DFC_Verb 0.00 906.000000000 FORMAT "%13.9" /end CHARACTERISTIC
/begin CHARACTERISTIC DFES_GrpRpr.DFC_MOXEMM_SMU_ALM0_7_C "common MIL debouncing / group representative for common MIL debouncing of DFC_MOXEMM_SMU_ALM0_7" VALUE 0x8050506A Val_Wu16 906.000000000 DFC_Verb 0.00 906.000000000 FORMAT "%13.9" /end CHARACTERISTIC
/begin CHARACTERISTIC DFES_GrpRpr.DFC_MOXEMM_SMU_ALM0_8_C "common MIL debouncing / group representative for common MIL debouncing of DFC_MOXEMM_SMU_ALM0_8" VALUE 0x8050506C Val_Wu16 906.000000000 DFC_Verb 0.00 906.000000000 FORMAT "%13.9" /end CHARACTERISTIC
/begin CHARACTERISTIC DFES_GrpRpr.DFC_MOXEMM_SMU_ALM10_16_C "common MIL debouncing / group representative for common MIL debouncing of DFC_MOXEMM_SMU_ALM10_16" VALUE 0x8050506E Val_Wu16 906.000000000 DFC_Verb 0.00 906.000000000 FORMAT "%13.9" /end CHARACTERISTIC
/begin CHARACTERISTIC DFES_GrpRpr.DFC_MOXEMM_SMU_ALM10_17_C "common MIL debouncing / group representative for common MIL debouncing of DFC_MOXEMM_SMU_ALM10_17" VALUE 0x80505070 Val_Wu16 906.000000000 DFC_Verb 0.00 906.000000000 FORMAT "%13.9" /end CHARACTERISTIC
/begin CHARACTERISTIC DFES_GrpRpr.DFC_MOXEMM_SMU_ALM10_21_C "common MIL debouncing / group representative for common MIL debouncing of DFC_MOXEMM_SMU_ALM10_21" VALUE 0x80505072 Val_Wu16 906.000000000 DFC_Verb 0.00 906.000000000 FORMAT "%13.9" /end CHARACTERISTIC
/begin CHARACTERISTIC DFES_GrpRpr.DFC_MOXEMM_SMU_ALM11_0_C "common MIL debouncing / group representative for common MIL debouncing of DFC_MOXEMM_SMU_ALM11_0" VALUE 0x80505074 Val_Wu16 906.000000000 DFC_Verb 0.00 906.000000000 FORMAT "%13.9" /end CHARACTERISTIC
/begin CHARACTERISTIC DFES_GrpRpr.DFC_MOXEMM_SMU_ALM11_1_C "common MIL debouncing / group representative for common MIL debouncing of DFC_MOXEMM_SMU_ALM11_1" VALUE 0x80505076 Val_Wu16 906.000000000 DFC_Verb 0.00 906.000000000 FORMAT "%13.9" /end CHARACTERISTIC
/begin CHARACTERISTIC DFES_GrpRpr.DFC_MOXEMM_SMU_ALM11_2_C "common MIL debouncing / group representative for common MIL debouncing of DFC_MOXEMM_SMU_ALM11_2" VALUE 0x80505078 Val_Wu16 906.000000000 DFC_Verb 0.00 906.000000000 FORMAT "%13.9" /end CHARACTERISTIC
/begin CHARACTERISTIC DFES_GrpRpr.DFC_MOXEMM_SMU_ALM11_3_C "common MIL debouncing / group representative for common MIL debouncing of DFC_MOXEMM_SMU_ALM11_3" VALUE 0x8050507A Val_Wu16 906.000000000 DFC_Verb 0.00 906.000000000 FORMAT "%13.9" /end CHARACTERISTIC
/begin CHARACTERISTIC DFES_GrpRpr.DFC_MOXEMM_SMU_ALM11_4_C "common MIL debouncing / group representative for common MIL debouncing of DFC_MOXEMM_SMU_ALM11_4" VALUE 0x8050507C Val_Wu16 906.000000000 DFC_Verb 0.00 906.000000000 FORMAT "%13.9" /end CHARACTERISTIC
/begin CHARACTERISTIC DFES_GrpRpr.DFC_MOXEMM_SMU_ALM11_5_C "common MIL debouncing / group representative for common MIL debouncing of DFC_MOXEMM_SMU_ALM11_5" VALUE 0x8050507E Val_Wu16 906.000000000 DFC_Verb 0.00 906.000000000 FORMAT "%13.9" /end CHARACTERISTIC
/begin CHARACTERISTIC DFES_GrpRpr.DFC_MOXEMM_SMU_ALM11_8_C "common MIL debouncing / group representative for common MIL debouncing of DFC_MOXEMM_SMU_ALM11_8" VALUE 0x80505080 Val_Wu16 906.000000000 DFC_Verb 0.00 906.000000000 FORMAT "%13.9" /end CHARACTERISTIC
/begin CHARACTERISTIC DFES_GrpRpr.DFC_MOXEMM_SMU_ALM11_9_C "common MIL debouncing / group representative for common MIL debouncing of DFC_MOXEMM_SMU_ALM11_9" VALUE 0x80505082 Val_Wu16 906.000000000 DFC_Verb 0.00 906.000000000 FORMAT "%13.9" /end CHARACTERISTIC
/begin CHARACTERISTIC DFES_GrpRpr.DFC_MOXEMM_SMU_ALM1_0_C "common MIL debouncing / group representative for common MIL debouncing of DFC_MOXEMM_SMU_ALM1_0" VALUE 0x80505084 Val_Wu16 906.000000000 DFC_Verb 0.00 906.000000000 FORMAT "%13.9" /end CHARACTERISTIC
/begin CHARACTERISTIC DFES_GrpRpr.DFC_MOXEMM_SMU_ALM1_1_C "common MIL debouncing / group representative for common MIL debouncing of DFC_MOXEMM_SMU_ALM1_1" VALUE 0x80505086 Val_Wu16 906.000000000 DFC_Verb 0.00 906.000000000 FORMAT "%13.9" /end CHARACTERISTIC
/begin CHARACTERISTIC DFES_GrpRpr.DFC_MOXEMM_SMU_ALM1_10_C "common MIL debouncing / group representative for common MIL debouncing of DFC_MOXEMM_SMU_ALM1_10" VALUE 0x80505088 Val_Wu16 906.000000000 DFC_Verb 0.00 906.000000000 FORMAT "%13.9" /end CHARACTERISTIC
/begin CHARACTERISTIC DFES_GrpRpr.DFC_MOXEMM_SMU_ALM1_11_C "common MIL debouncing / group representative for common MIL debouncing of DFC_MOXEMM_SMU_ALM1_11" VALUE 0x8050508A Val_Wu16 906.000000000 DFC_Verb 0.00 906.000000000 FORMAT "%13.9" /end CHARACTERISTIC
/begin CHARACTERISTIC DFES_GrpRpr.DFC_MOXEMM_SMU_ALM1_13_C "common MIL debouncing / group representative for common MIL debouncing of DFC_MOXEMM_SMU_ALM1_13" VALUE 0x8050508C Val_Wu16 906.000000000 DFC_Verb 0.00 906.000000000 FORMAT "%13.9" /end CHARACTERISTIC
/begin CHARACTERISTIC DFES_GrpRpr.DFC_MOXEMM_SMU_ALM1_14_C "common MIL debouncing / group representative for common MIL debouncing of DFC_MOXEMM_SMU_ALM1_14" VALUE 0x8050508E Val_Wu16 906.000000000 DFC_Verb 0.00 906.000000000 FORMAT "%13.9" /end CHARACTERISTIC
/begin CHARACTERISTIC DFES_GrpRpr.DFC_MOXEMM_SMU_ALM1_2_C "common MIL debouncing / group representative for common MIL debouncing of DFC_MOXEMM_SMU_ALM1_2" VALUE 0x80505090 Val_Wu16 906.000000000 DFC_Verb 0.00 906.000000000 FORMAT "%13.9" /end CHARACTERISTIC
/begin CHARACTERISTIC DFES_GrpRpr.DFC_MOXEMM_SMU_ALM1_22_C "common MIL debouncing / group representative for common MIL debouncing of DFC_MOXEMM_SMU_ALM1_22" VALUE 0x80505092 Val_Wu16 906.000000000 DFC_Verb 0.00 906.000000000 FORMAT "%13.9" /end CHARACTERISTIC
/begin CHARACTERISTIC DFES_GrpRpr.DFC_MOXEMM_SMU_ALM1_23_C "common MIL debouncing / group representative for common MIL debouncing of DFC_MOXEMM_SMU_ALM1_23" VALUE 0x80505094 Val_Wu16 906.000000000 DFC_Verb 0.00 906.000000000 FORMAT "%13.9" /end CHARACTERISTIC
/begin CHARACTERISTIC DFES_GrpRpr.DFC_MOXEMM_SMU_ALM1_4_C "common MIL debouncing / group representative for common MIL debouncing of DFC_MOXEMM_SMU_ALM1_4" VALUE 0x80505096 Val_Wu16 906.000000000 DFC_Verb 0.00 906.000000000 FORMAT "%13.9" /end CHARACTERISTIC
/begin CHARACTERISTIC DFES_GrpRpr.DFC_MOXEMM_SMU_ALM1_5_C "common MIL debouncing / group representative for common MIL debouncing of DFC_MOXEMM_SMU_ALM1_5" VALUE 0x80505098 Val_Wu16 906.000000000 DFC_Verb 0.00 906.000000000 FORMAT "%13.9" /end CHARACTERISTIC
/begin CHARACTERISTIC DFES_GrpRpr.DFC_MOXEMM_SMU_ALM1_7_C "common MIL debouncing / group representative for common MIL debouncing of DFC_MOXEMM_SMU_ALM1_7" VALUE 0x8050509A Val_Wu16 906.000000000 DFC_Verb 0.00 906.000000000 FORMAT "%13.9" /end CHARACTERISTIC
/begin CHARACTERISTIC DFES_GrpRpr.DFC_MOXEMM_SMU_ALM1_8_C "common MIL debouncing / group representative for common MIL debouncing of DFC_MOXEMM_SMU_ALM1_8" VALUE 0x8050509C Val_Wu16 906.000000000 DFC_Verb 0.00 906.000000000 FORMAT "%13.9" /end CHARACTERISTIC
/begin CHARACTERISTIC DFES_GrpRpr.DFC_MOXEMM_SMU_ALM21_0_C "common MIL debouncing / group representative for common MIL debouncing of DFC_MOXEMM_SMU_ALM21_0" VALUE 0x8050509E Val_Wu16 906.000000000 DFC_Verb 0.00 906.000000000 FORMAT "%13.9" /end CHARACTERISTIC
/begin CHARACTERISTIC DFES_GrpRpr.DFC_MOXEMM_SMU_ALM21_16_C "common MIL debouncing / group representative for common MIL debouncing of DFC_MOXEMM_SMU_ALM21_16" VALUE 0x805050A0 Val_Wu16 906.000000000 DFC_Verb 0.00 906.000000000 FORMAT "%13.9" /end CHARACTERISTIC
/begin CHARACTERISTIC DFES_GrpRpr.DFC_MOXEMM_SMU_ALM21_3_C "common MIL debouncing / group representative for common MIL debouncing of DFC_MOXEMM_SMU_ALM21_3" VALUE 0x805050A2 Val_Wu16 906.000000000 DFC_Verb 0.00 906.000000000 FORMAT "%13.9" /end CHARACTERISTIC
/begin CHARACTERISTIC DFES_GrpRpr.DFC_MOXEMM_SMU_ALM2_1_C "common MIL debouncing / group representative for common MIL debouncing of DFC_MOXEMM_SMU_ALM2_1" VALUE 0x805050A4 Val_Wu16 906.000000000 DFC_Verb 0.00 906.000000000 FORMAT "%13.9" /end CHARACTERISTIC
/begin CHARACTERISTIC DFES_GrpRpr.DFC_MOXEMM_SMU_ALM2_10_C "common MIL debouncing / group representative for common MIL debouncing of DFC_MOXEMM_SMU_ALM2_10" VALUE 0x805050A6 Val_Wu16 906.000000000 DFC_Verb 0.00 906.000000000 FORMAT "%13.9" /end CHARACTERISTIC
/begin CHARACTERISTIC DFES_GrpRpr.DFC_MOXEMM_SMU_ALM2_11_C "common MIL debouncing / group representative for common MIL debouncing of DFC_MOXEMM_SMU_ALM2_11" VALUE 0x805050A8 Val_Wu16 906.000000000 DFC_Verb 0.00 906.000000000 FORMAT "%13.9" /end CHARACTERISTIC
/begin CHARACTERISTIC DFES_GrpRpr.DFC_MOXEMM_SMU_ALM2_13_C "common MIL debouncing / group representative for common MIL debouncing of DFC_MOXEMM_SMU_ALM2_13" VALUE 0x805050AA Val_Wu16 906.000000000 DFC_Verb 0.00 906.000000000 FORMAT "%13.9" /end CHARACTERISTIC
/begin CHARACTERISTIC DFES_GrpRpr.DFC_MOXEMM_SMU_ALM2_14_C "common MIL debouncing / group representative for common MIL debouncing of DFC_MOXEMM_SMU_ALM2_14" VALUE 0x805050AC Val_Wu16 906.000000000 DFC_Verb 0.00 906.000000000 FORMAT "%13.9" /end CHARACTERISTIC
/begin CHARACTERISTIC DFES_GrpRpr.DFC_MOXEMM_SMU_ALM2_22_C "common MIL debouncing / group representative for common MIL debouncing of DFC_MOXEMM_SMU_ALM2_22" VALUE 0x805050AE Val_Wu16 906.000000000 DFC_Verb 0.00 906.000000000 FORMAT "%13.9" /end CHARACTERISTIC
/begin CHARACTERISTIC DFES_GrpRpr.DFC_MOXEMM_SMU_ALM2_23_C "common MIL debouncing / group representative for common MIL debouncing of DFC_MOXEMM_SMU_ALM2_23" VALUE 0x805050B0 Val_Wu16 906.000000000 DFC_Verb 0.00 906.000000000 FORMAT "%13.9" /end CHARACTERISTIC
/begin CHARACTERISTIC DFES_GrpRpr.DFC_MOXEMM_SMU_ALM2_4_C "common MIL debouncing / group representative for common MIL debouncing of DFC_MOXEMM_SMU_ALM2_4" VALUE 0x805050B2 Val_Wu16 906.000000000 DFC_Verb 0.00 906.000000000 FORMAT "%13.9" /end CHARACTERISTIC
/begin CHARACTERISTIC DFES_GrpRpr.DFC_MOXEMM_SMU_ALM2_5_C "common MIL debouncing / group representative for common MIL debouncing of DFC_MOXEMM_SMU_ALM2_5" VALUE 0x805050B4 Val_Wu16 906.000000000 DFC_Verb 0.00 906.000000000 FORMAT "%13.9" /end CHARACTERISTIC
/begin CHARACTERISTIC DFES_GrpRpr.DFC_MOXEMM_SMU_ALM2_7_C "common MIL debouncing / group representative for common MIL debouncing of DFC_MOXEMM_SMU_ALM2_7" VALUE 0x805050B6 Val_Wu16 906.000000000 DFC_Verb 0.00 906.000000000 FORMAT "%13.9" /end CHARACTERISTIC
/begin CHARACTERISTIC DFES_GrpRpr.DFC_MOXEMM_SMU_ALM2_8_C "common MIL debouncing / group representative for common MIL debouncing of DFC_MOXEMM_SMU_ALM2_8" VALUE 0x805050B8 Val_Wu16 906.000000000 DFC_Verb 0.00 906.000000000 FORMAT "%13.9" /end CHARACTERISTIC
/begin CHARACTERISTIC DFES_GrpRpr.DFC_MOXEMM_SMU_ALM6_0_C "common MIL debouncing / group representative for common MIL debouncing of DFC_MOXEMM_SMU_ALM6_0" VALUE 0x805050BA Val_Wu16 906.000000000 DFC_Verb 0.00 906.000000000 FORMAT "%13.9" /end CHARACTERISTIC
/begin CHARACTERISTIC DFES_GrpRpr.DFC_MOXEMM_SMU_ALM6_11_C "common MIL debouncing / group representative for common MIL debouncing of DFC_MOXEMM_SMU_ALM6_11" VALUE 0x805050BC Val_Wu16 906.000000000 DFC_Verb 0.00 906.000000000 FORMAT "%13.9" /end CHARACTERISTIC
/begin CHARACTERISTIC DFES_GrpRpr.DFC_MOXEMM_SMU_ALM6_12_C "common MIL debouncing / group representative for common MIL debouncing of DFC_MOXEMM_SMU_ALM6_12" VALUE 0x805050BE Val_Wu16 906.000000000 DFC_Verb 0.00 906.000000000 FORMAT "%13.9" /end CHARACTERISTIC
/begin CHARACTERISTIC DFES_GrpRpr.DFC_MOXEMM_SMU_ALM6_14_C "common MIL debouncing / group representative for common MIL debouncing of DFC_MOXEMM_SMU_ALM6_14" VALUE 0x805050C0 Val_Wu16 906.000000000 DFC_Verb 0.00 906.000000000 FORMAT "%13.9" /end CHARACTERISTIC
/begin CHARACTERISTIC DFES_GrpRpr.DFC_MOXEMM_SMU_ALM6_15_C "common MIL debouncing / group representative for common MIL debouncing of DFC_MOXEMM_SMU_ALM6_15" VALUE 0x805050C2 Val_Wu16 906.000000000 DFC_Verb 0.00 906.000000000 FORMAT "%13.9" /end CHARACTERISTIC
/begin CHARACTERISTIC DFES_GrpRpr.DFC_MOXEMM_SMU_ALM6_17_C "common MIL debouncing / group representative for common MIL debouncing of DFC_MOXEMM_SMU_ALM6_17" VALUE 0x805050C4 Val_Wu16 906.000000000 DFC_Verb 0.00 906.000000000 FORMAT "%13.9" /end CHARACTERISTIC
/begin CHARACTERISTIC DFES_GrpRpr.DFC_MOXEMM_SMU_ALM6_18_C "common MIL debouncing / group representative for common MIL debouncing of DFC_MOXEMM_SMU_ALM6_18" VALUE 0x805050C6 Val_Wu16 906.000000000 DFC_Verb 0.00 906.000000000 FORMAT "%13.9" /end CHARACTERISTIC
/begin CHARACTERISTIC DFES_GrpRpr.DFC_MOXEMM_SMU_ALM6_20_C "common MIL debouncing / group representative for common MIL debouncing of DFC_MOXEMM_SMU_ALM6_20" VALUE 0x805050C8 Val_Wu16 906.000000000 DFC_Verb 0.00 906.000000000 FORMAT "%13.9" /end CHARACTERISTIC
/begin CHARACTERISTIC DFES_GrpRpr.DFC_MOXEMM_SMU_ALM6_21_C "common MIL debouncing / group representative for common MIL debouncing of DFC_MOXEMM_SMU_ALM6_21" VALUE 0x805050CA Val_Wu16 906.000000000 DFC_Verb 0.00 906.000000000 FORMAT "%13.9" /end CHARACTERISTIC
/begin CHARACTERISTIC DFES_GrpRpr.DFC_MOXEMM_SMU_ALM6_25_C "common MIL debouncing / group representative for common MIL debouncing of DFC_MOXEMM_SMU_ALM6_25" VALUE 0x805050CC Val_Wu16 906.000000000 DFC_Verb 0.00 906.000000000 FORMAT "%13.9" /end CHARACTERISTIC
/begin CHARACTERISTIC DFES_GrpRpr.DFC_MOXEMM_SMU_ALM6_4_C "common MIL debouncing / group representative for common MIL debouncing of DFC_MOXEMM_SMU_ALM6_4" VALUE 0x805050CE Val_Wu16 906.000000000 DFC_Verb 0.00 906.000000000 FORMAT "%13.9" /end CHARACTERISTIC
/begin CHARACTERISTIC DFES_GrpRpr.DFC_MOXEMM_SMU_ALM6_5_C "common MIL debouncing / group representative for common MIL debouncing of DFC_MOXEMM_SMU_ALM6_5" VALUE 0x805050D0 Val_Wu16 906.000000000 DFC_Verb 0.00 906.000000000 FORMAT "%13.9" /end CHARACTERISTIC
/begin CHARACTERISTIC DFES_GrpRpr.DFC_MOXEMM_SMU_ALM6_7_C "common MIL debouncing / group representative for common MIL debouncing of DFC_MOXEMM_SMU_ALM6_7" VALUE 0x805050D2 Val_Wu16 906.000000000 DFC_Verb 0.00 906.000000000 FORMAT "%13.9" /end CHARACTERISTIC
/begin CHARACTERISTIC DFES_GrpRpr.DFC_MOXEMM_SMU_ALM6_8_C "common MIL debouncing / group representative for common MIL debouncing of DFC_MOXEMM_SMU_ALM6_8" VALUE 0x805050D4 Val_Wu16 906.000000000 DFC_Verb 0.00 906.000000000 FORMAT "%13.9" /end CHARACTERISTIC
/begin CHARACTERISTIC DFES_GrpRpr.DFC_MOXEMM_SMU_ALM7_1_C "common MIL debouncing / group representative for common MIL debouncing of DFC_MOXEMM_SMU_ALM7_1" VALUE 0x805050D6 Val_Wu16 906.000000000 DFC_Verb 0.00 906.000000000 FORMAT "%13.9" /end CHARACTERISTIC
/begin CHARACTERISTIC DFES_GrpRpr.DFC_MOXEMM_SMU_ALM7_12_C "common MIL debouncing / group representative for common MIL debouncing of DFC_MOXEMM_SMU_ALM7_12" VALUE 0x805050D8 Val_Wu16 906.000000000 DFC_Verb 0.00 906.000000000 FORMAT "%13.9" /end CHARACTERISTIC
/begin CHARACTERISTIC DFES_GrpRpr.DFC_MOXEMM_SMU_ALM7_13_C "common MIL debouncing / group representative for common MIL debouncing of DFC_MOXEMM_SMU_ALM7_13" VALUE 0x805050DA Val_Wu16 906.000000000 DFC_Verb 0.00 906.000000000 FORMAT "%13.9" /end CHARACTERISTIC
/begin CHARACTERISTIC DFES_GrpRpr.DFC_MOXEMM_SMU_ALM7_14_C "common MIL debouncing / group representative for common MIL debouncing of DFC_MOXEMM_SMU_ALM7_14" VALUE 0x805050DC Val_Wu16 906.000000000 DFC_Verb 0.00 906.000000000 FORMAT "%13.9" /end CHARACTERISTIC
/begin CHARACTERISTIC DFES_GrpRpr.DFC_MOXEMM_SMU_ALM7_15_C "common MIL debouncing / group representative for common MIL debouncing of DFC_MOXEMM_SMU_ALM7_15" VALUE 0x805050DE Val_Wu16 906.000000000 DFC_Verb 0.00 906.000000000 FORMAT "%13.9" /end CHARACTERISTIC
/begin CHARACTERISTIC DFES_GrpRpr.DFC_MOXEMM_SMU_ALM7_16_C "common MIL debouncing / group representative for common MIL debouncing of DFC_MOXEMM_SMU_ALM7_16" VALUE 0x805050E0 Val_Wu16 906.000000000 DFC_Verb 0.00 906.000000000 FORMAT "%13.9" /end CHARACTERISTIC
/begin CHARACTERISTIC DFES_GrpRpr.DFC_MOXEMM_SMU_ALM7_17_C "common MIL debouncing / group representative for common MIL debouncing of DFC_MOXEMM_SMU_ALM7_17" VALUE 0x805050E2 Val_Wu16 906.000000000 DFC_Verb 0.00 906.000000000 FORMAT "%13.9" /end CHARACTERISTIC
/begin CHARACTERISTIC DFES_GrpRpr.DFC_MOXEMM_SMU_ALM7_2_C "common MIL debouncing / group representative for common MIL debouncing of DFC_MOXEMM_SMU_ALM7_2" VALUE 0x805050E4 Val_Wu16 906.000000000 DFC_Verb 0.00 906.000000000 FORMAT "%13.9" /end CHARACTERISTIC
/begin CHARACTERISTIC DFES_GrpRpr.DFC_MOXEMM_SMU_ALM7_20_C "common MIL debouncing / group representative for common MIL debouncing of DFC_MOXEMM_SMU_ALM7_20" VALUE 0x805050E6 Val_Wu16 906.000000000 DFC_Verb 0.00 906.000000000 FORMAT "%13.9" /end CHARACTERISTIC
/begin CHARACTERISTIC DFES_GrpRpr.DFC_MOXEMM_SMU_ALM7_25_C "common MIL debouncing / group representative for common MIL debouncing of DFC_MOXEMM_SMU_ALM7_25" VALUE 0x805050E8 Val_Wu16 906.000000000 DFC_Verb 0.00 906.000000000 FORMAT "%13.9" /end CHARACTERISTIC
/begin CHARACTERISTIC DFES_GrpRpr.DFC_MOXEMM_SMU_ALM7_26_C "common MIL debouncing / group representative for common MIL debouncing of DFC_MOXEMM_SMU_ALM7_26" VALUE 0x805050EA Val_Wu16 906.000000000 DFC_Verb 0.00 906.000000000 FORMAT "%13.9" /end CHARACTERISTIC
/begin CHARACTERISTIC DFES_GrpRpr.DFC_MOXEMM_SMU_ALM7_28_C "common MIL debouncing / group representative for common MIL debouncing of DFC_MOXEMM_SMU_ALM7_28" VALUE 0x805050EC Val_Wu16 906.000000000 DFC_Verb 0.00 906.000000000 FORMAT "%13.9" /end CHARACTERISTIC
/begin CHARACTERISTIC DFES_GrpRpr.DFC_MOXEMM_SMU_ALM7_29_C "common MIL debouncing / group representative for common MIL debouncing of DFC_MOXEMM_SMU_ALM7_29" VALUE 0x805050EE Val_Wu16 906.000000000 DFC_Verb 0.00 906.000000000 FORMAT "%13.9" /end CHARACTERISTIC
/begin CHARACTERISTIC DFES_GrpRpr.DFC_MOXEMM_SMU_ALM7_30_C "common MIL debouncing / group representative for common MIL debouncing of DFC_MOXEMM_SMU_ALM7_30" VALUE 0x805050F0 Val_Wu16 906.000000000 DFC_Verb 0.00 906.000000000 FORMAT "%13.9" /end CHARACTERISTIC
/begin CHARACTERISTIC DFES_GrpRpr.DFC_MOXEMM_SMU_ALM7_31_C "common MIL debouncing / group representative for common MIL debouncing of DFC_MOXEMM_SMU_ALM7_31" VALUE 0x805050F2 Val_Wu16 906.000000000 DFC_Verb 0.00 906.000000000 FORMAT "%13.9" /end CHARACTERISTIC
/begin CHARACTERISTIC DFES_GrpRpr.DFC_MOXEMM_SMU_ALM8_0_C "common MIL debouncing / group representative for common MIL debouncing of DFC_MOXEMM_SMU_ALM8_0" VALUE 0x805050F4 Val_Wu16 906.000000000 DFC_Verb 0.00 906.000000000 FORMAT "%13.9" /end CHARACTERISTIC
/begin CHARACTERISTIC DFES_GrpRpr.DFC_MOXEMM_SMU_ALM8_1_C "common MIL debouncing / group representative for common MIL debouncing of DFC_MOXEMM_SMU_ALM8_1" VALUE 0x805050F6 Val_Wu16 906.000000000 DFC_Verb 0.00 906.000000000 FORMAT "%13.9" /end CHARACTERISTIC
/begin CHARACTERISTIC DFES_GrpRpr.DFC_MOXEMM_SMU_ALM8_10_C "common MIL debouncing / group representative for common MIL debouncing of DFC_MOXEMM_SMU_ALM8_10" VALUE 0x805050F8 Val_Wu16 906.000000000 DFC_Verb 0.00 906.000000000 FORMAT "%13.9" /end CHARACTERISTIC
/begin CHARACTERISTIC DFES_GrpRpr.DFC_MOXEMM_SMU_ALM8_11_C "common MIL debouncing / group representative for common MIL debouncing of DFC_MOXEMM_SMU_ALM8_11" VALUE 0x805050FA Val_Wu16 906.000000000 DFC_Verb 0.00 906.000000000 FORMAT "%13.9" /end CHARACTERISTIC
/begin CHARACTERISTIC DFES_GrpRpr.DFC_MOXEMM_SMU_ALM8_12_C "common MIL debouncing / group representative for common MIL debouncing of DFC_MOXEMM_SMU_ALM8_12" VALUE 0x805050FC Val_Wu16 906.000000000 DFC_Verb 0.00 906.000000000 FORMAT "%13.9" /end CHARACTERISTIC
/begin CHARACTERISTIC DFES_GrpRpr.DFC_MOXEMM_SMU_ALM8_16_C "common MIL debouncing / group representative for common MIL debouncing of DFC_MOXEMM_SMU_ALM8_16" VALUE 0x805050FE Val_Wu16 906.000000000 DFC_Verb 0.00 906.000000000 FORMAT "%13.9" /end CHARACTERISTIC
/begin CHARACTERISTIC DFES_GrpRpr.DFC_MOXEMM_SMU_ALM8_18_C "common MIL debouncing / group representative for common MIL debouncing of DFC_MOXEMM_SMU_ALM8_18" VALUE 0x80505100 Val_Wu16 906.000000000 DFC_Verb 0.00 906.000000000 FORMAT "%13.9" /end CHARACTERISTIC
/begin CHARACTERISTIC DFES_GrpRpr.DFC_MOXEMM_SMU_ALM8_2_C "common MIL debouncing / group representative for common MIL debouncing of DFC_MOXEMM_SMU_ALM8_2" VALUE 0x80505102 Val_Wu16 906.000000000 DFC_Verb 0.00 906.000000000 FORMAT "%13.9" /end CHARACTERISTIC
/begin CHARACTERISTIC DFES_GrpRpr.DFC_MOXEMM_SMU_ALM8_3_C "common MIL debouncing / group representative for common MIL debouncing of DFC_MOXEMM_SMU_ALM8_3" VALUE 0x80505104 Val_Wu16 906.000000000 DFC_Verb 0.00 906.000000000 FORMAT "%13.9" /end CHARACTERISTIC
/begin CHARACTERISTIC DFES_GrpRpr.DFC_MOXEMM_SMU_ALM8_31_C "common MIL debouncing / group representative for common MIL debouncing of DFC_MOXEMM_SMU_ALM8_31" VALUE 0x80505106 Val_Wu16 906.000000000 DFC_Verb 0.00 906.000000000 FORMAT "%13.9" /end CHARACTERISTIC
/begin CHARACTERISTIC DFES_GrpRpr.DFC_MOXEMM_SMU_ALM8_4_C "common MIL debouncing / group representative for common MIL debouncing of DFC_MOXEMM_SMU_ALM8_4" VALUE 0x80505108 Val_Wu16 906.000000000 DFC_Verb 0.00 906.000000000 FORMAT "%13.9" /end CHARACTERISTIC
/begin CHARACTERISTIC DFES_GrpRpr.DFC_MOXEMM_SMU_ALM9_0_C "common MIL debouncing / group representative for common MIL debouncing of DFC_MOXEMM_SMU_ALM9_0" VALUE 0x8050510A Val_Wu16 906.000000000 DFC_Verb 0.00 906.000000000 FORMAT "%13.9" /end CHARACTERISTIC
/begin CHARACTERISTIC DFES_GrpRpr.DFC_MOXEMM_SMU_ALM9_15_C "common MIL debouncing / group representative for common MIL debouncing of DFC_MOXEMM_SMU_ALM9_15" VALUE 0x8050510C Val_Wu16 906.000000000 DFC_Verb 0.00 906.000000000 FORMAT "%13.9" /end CHARACTERISTIC
/begin CHARACTERISTIC DFES_GrpRpr.DFC_MOXEMM_SMU_ALM9_3_C "common MIL debouncing / group representative for common MIL debouncing of DFC_MOXEMM_SMU_ALM9_3" VALUE 0x8050510E Val_Wu16 906.000000000 DFC_Verb 0.00 906.000000000 FORMAT "%13.9" /end CHARACTERISTIC
/begin CHARACTERISTIC DFES_GrpRpr.DFC_MoCADCNTP_C "common MIL debouncing / group representative for common MIL debouncing of DFC_MoCADCNTP" VALUE 0x80505110 Val_Wu16 906.000000000 DFC_Verb 0.00 906.000000000 FORMAT "%13.9" /end CHARACTERISTIC
/begin CHARACTERISTIC DFES_GrpRpr.DFC_MoCADCTst_C "common MIL debouncing / group representative for common MIL debouncing of DFC_MoCADCTst" VALUE 0x80505112 Val_Wu16 906.000000000 DFC_Verb 0.00 906.000000000 FORMAT "%13.9" /end CHARACTERISTIC
/begin CHARACTERISTIC DFES_GrpRpr.DFC_MoCSOPICO_C "common MIL debouncing / group representative for common MIL debouncing of DFC_MoCSOPICO" VALUE 0x80505114 Val_Wu16 906.000000000 DFC_Verb 0.00 906.000000000 FORMAT "%13.9" /end CHARACTERISTIC
/begin CHARACTERISTIC DFES_GrpRpr.DFC_MoFAPP_C "common MIL debouncing / group representative for common MIL debouncing of DFC_MoFAPP" VALUE 0x80505116 Val_Wu16 906.000000000 DFC_Verb 0.00 906.000000000 FORMAT "%13.9" /end CHARACTERISTIC
/begin CHARACTERISTIC DFES_GrpRpr.DFC_MoFAirFilgPrdc_C "common MIL debouncing / group representative for common MIL debouncing of DFC_MoFAirFilgPrdc" VALUE 0x80505118 Val_Wu16 906.000000000 DFC_Verb 0.00 906.000000000 FORMAT "%13.9" /end CHARACTERISTIC
/begin CHARACTERISTIC DFES_GrpRpr.DFC_MoFAirFlCtOffGdi_C "common MIL debouncing / group representative for common MIL debouncing of DFC_MoFAirFlCtOffGdi" VALUE 0x8050511A Val_Wu16 906.000000000 DFC_Verb 0.00 906.000000000 FORMAT "%13.9" /end CHARACTERISTIC
/begin CHARACTERISTIC DFES_GrpRpr.DFC_MoFAirFlCylGdi_C "common MIL debouncing / group representative for common MIL debouncing of DFC_MoFAirFlCylGdi" VALUE 0x8050511C Val_Wu16 906.000000000 DFC_Verb 0.00 906.000000000 FORMAT "%13.9" /end CHARACTERISTIC
/begin CHARACTERISTIC DFES_GrpRpr.DFC_MoFAirFlFF_C "common MIL debouncing / group representative for common MIL debouncing of DFC_MoFAirFlFF" VALUE 0x8050511E Val_Wu16 906.000000000 DFC_Verb 0.00 906.000000000 FORMAT "%13.9" /end CHARACTERISTIC
/begin CHARACTERISTIC DFES_GrpRpr.DFC_MoFAirFlIn_C "common MIL debouncing / group representative for common MIL debouncing of DFC_MoFAirFlIn" VALUE 0x80505120 Val_Wu16 906.000000000 DFC_Verb 0.00 906.000000000 FORMAT "%13.9" /end CHARACTERISTIC
/begin CHARACTERISTIC DFES_GrpRpr.DFC_MoFAirFlMixCtlGdiChkAirFl_C "common MIL debouncing / group representative for common MIL debouncing of DFC_MoFAirFlMixCtlGdiChkAirFl" VALUE 0x80505122 Val_Wu16 906.000000000 DFC_Verb 0.00 906.000000000 FORMAT "%13.9" /end CHARACTERISTIC
/begin CHARACTERISTIC DFES_GrpRpr.DFC_MoFAirFlMixCtlGdiChkCtrl_C "common MIL debouncing / group representative for common MIL debouncing of DFC_MoFAirFlMixCtlGdiChkCtrl" VALUE 0x80505124 Val_Wu16 906.000000000 DFC_Verb 0.00 906.000000000 FORMAT "%13.9" /end CHARACTERISTIC
/begin CHARACTERISTIC DFES_GrpRpr.DFC_MoFAirFlMode_C "common MIL debouncing / group representative for common MIL debouncing of DFC_MoFAirFlMode" VALUE 0x80505126 Val_Wu16 906.000000000 DFC_Verb 0.00 906.000000000 FORMAT "%13.9" /end CHARACTERISTIC
/begin CHARACTERISTIC DFES_GrpRpr.DFC_MoFESpd_C "common MIL debouncing / group representative for common MIL debouncing of DFC_MoFESpd" VALUE 0x80505128 Val_Wu16 906.000000000 DFC_Verb 0.00 906.000000000 FORMAT "%13.9" /end CHARACTERISTIC
/begin CHARACTERISTIC DFES_GrpRpr.DFC_MoFIACo_C "common MIL debouncing / group representative for common MIL debouncing of DFC_MoFIACo" VALUE 0x8050512A Val_Wu16 906.000000000 DFC_Verb 0.00 906.000000000 FORMAT "%13.9" /end CHARACTERISTIC
/begin CHARACTERISTIC DFES_GrpRpr.DFC_MoFICOL1_C "common MIL debouncing / group representative for common MIL debouncing of DFC_MoFICOL1" VALUE 0x8050512C Val_Wu16 906.000000000 DFC_Verb 0.00 906.000000000 FORMAT "%13.9" /end CHARACTERISTIC
/begin CHARACTERISTIC DFES_GrpRpr.DFC_MoFICOL2_C "common MIL debouncing / group representative for common MIL debouncing of DFC_MoFICOL2" VALUE 0x8050512E Val_Wu16 906.000000000 DFC_Verb 0.00 906.000000000 FORMAT "%13.9" /end CHARACTERISTIC
/begin CHARACTERISTIC DFES_GrpRpr.DFC_MoFStrt_C "common MIL debouncing / group representative for common MIL debouncing of DFC_MoFStrt" VALUE 0x80505130 Val_Wu16 906.000000000 DFC_Verb 0.00 906.000000000 FORMAT "%13.9" /end CHARACTERISTIC
/begin CHARACTERISTIC DFES_GrpRpr.DFC_MoFTrqCmp_C "common MIL debouncing / group representative for common MIL debouncing of DFC_MoFTrqCmp" VALUE 0x80505132 Val_Wu16 906.000000000 DFC_Verb 0.00 906.000000000 FORMAT "%13.9" /end CHARACTERISTIC
/begin CHARACTERISTIC DFES_GrpRpr.DFC_MoFTrqCmpMax_C "common MIL debouncing / group representative for common MIL debouncing of DFC_MoFTrqCmpMax" VALUE 0x80505134 Val_Wu16 906.000000000 DFC_Verb 0.00 906.000000000 FORMAT "%13.9" /end CHARACTERISTIC
/begin CHARACTERISTIC DFES_GrpRpr.DFC_MoFTrqCmpMin_C "common MIL debouncing / group representative for common MIL debouncing of DFC_MoFTrqCmpMin" VALUE 0x80505136 Val_Wu16 906.000000000 DFC_Verb 0.00 906.000000000 FORMAT "%13.9" /end CHARACTERISTIC
/begin CHARACTERISTIC DFES_GrpRpr.DFC_MoFVarPostBldSel_C "common MIL debouncing / group representative for common MIL debouncing of DFC_MoFVarPostBldSel" VALUE 0x80505138 Val_Wu16 906.000000000 DFC_Verb 0.00 906.000000000 FORMAT "%13.9" /end CHARACTERISTIC
/begin CHARACTERISTIC DFES_GrpRpr.DFC_MoXEMMHwLTMCUFW_C "common MIL debouncing / group representative for common MIL debouncing of DFC_MoXEMMHwLTMCUFW" VALUE 0x8050513A Val_Wu16 906.000000000 DFC_Verb 0.00 906.000000000 FORMAT "%13.9" /end CHARACTERISTIC
/begin CHARACTERISTIC DFES_GrpRpr.DFC_MoXEMMHwLTMonBIST_C "common MIL debouncing / group representative for common MIL debouncing of DFC_MoXEMMHwLTMonBIST" VALUE 0x8050513C Val_Wu16 906.000000000 DFC_Verb 0.00 906.000000000 FORMAT "%13.9" /end CHARACTERISTIC
/begin CHARACTERISTIC DFES_GrpRpr.DFC_MoXEMMHwLTRegMonTest_C "common MIL debouncing / group representative for common MIL debouncing of DFC_MoXEMMHwLTRegMonTest" VALUE 0x8050513E Val_Wu16 906.000000000 DFC_Verb 0.00 906.000000000 FORMAT "%13.9" /end CHARACTERISTIC
/begin CHARACTERISTIC DFES_GrpRpr.DFC_MoXEMMHwLTStbySMUAlvTest_C "common MIL debouncing / group representative for common MIL debouncing of DFC_MoXEMMHwLTStbySMUAlvTest" VALUE 0x80505140 Val_Wu16 906.000000000 DFC_Verb 0.00 906.000000000 FORMAT "%13.9" /end CHARACTERISTIC
/begin CHARACTERISTIC DFES_GrpRpr.DFC_MoXEMMHwLTTempSens_C "common MIL debouncing / group representative for common MIL debouncing of DFC_MoXEMMHwLTTempSens" VALUE 0x80505142 Val_Wu16 906.000000000 DFC_Verb 0.00 906.000000000 FORMAT "%13.9" /end CHARACTERISTIC
/begin CHARACTERISTIC DFES_GrpRpr.DFC_MoXEMMHwLTUCBCfg_C "common MIL debouncing / group representative for common MIL debouncing of DFC_MoXEMMHwLTUCBCfg" VALUE 0x80505144 Val_Wu16 906.000000000 DFC_Verb 0.00 906.000000000 FORMAT "%13.9" /end CHARACTERISTIC
/begin CHARACTERISTIC DFES_GrpRpr.DFC_NWSEmax_C "common MIL debouncing / group representative for common MIL debouncing of DFC_NWSEmax" VALUE 0x80505146 Val_Wu16 906.000000000 DFC_Verb 0.00 906.000000000 FORMAT "%13.9" /end CHARACTERISTIC
/begin CHARACTERISTIC DFES_GrpRpr.DFC_NWSmax_C "common MIL debouncing / group representative for common MIL debouncing of DFC_NWSmax" VALUE 0x80505148 Val_Wu16 906.000000000 DFC_Verb 0.00 906.000000000 FORMAT "%13.9" /end CHARACTERISTIC
/begin CHARACTERISTIC DFES_GrpRpr.DFC_OCWDAABEActv_C "common MIL debouncing / group representative for common MIL debouncing of DFC_OCWDAABEActv" VALUE 0x8050514A Val_Wu16 906.000000000 DFC_Verb 0.00 906.000000000 FORMAT "%13.9" /end CHARACTERISTIC
/begin CHARACTERISTIC DFES_GrpRpr.DFC_OCWDACom_C "common MIL debouncing / group representative for common MIL debouncing of DFC_OCWDACom" VALUE 0x8050514C Val_Wu16 906.000000000 DFC_Verb 0.00 906.000000000 FORMAT "%13.9" /end CHARACTERISTIC
/begin CHARACTERISTIC DFES_GrpRpr.DFC_OCWDAErrPin_C "common MIL debouncing / group representative for common MIL debouncing of DFC_OCWDAErrPin" VALUE 0x8050514E Val_Wu16 906.000000000 DFC_Verb 0.00 906.000000000 FORMAT "%13.9" /end CHARACTERISTIC
/begin CHARACTERISTIC DFES_GrpRpr.DFC_OCWDAOvrVltg_C "common MIL debouncing / group representative for common MIL debouncing of DFC_OCWDAOvrVltg" VALUE 0x80505150 Val_Wu16 906.000000000 DFC_Verb 0.00 906.000000000 FORMAT "%13.9" /end CHARACTERISTIC
/begin CHARACTERISTIC DFES_GrpRpr.DFC_ORAmax_C "common MIL debouncing / group representative for common MIL debouncing of DFC_ORAmax" VALUE 0x80505152 Val_Wu16 906.000000000 DFC_Verb 0.00 906.000000000 FORMAT "%13.9" /end CHARACTERISTIC
/begin CHARACTERISTIC DFES_GrpRpr.DFC_ORAmin_C "common MIL debouncing / group representative for common MIL debouncing of DFC_ORAmin" VALUE 0x80505154 Val_Wu16 906.000000000 DFC_Verb 0.00 906.000000000 FORMAT "%13.9" /end CHARACTERISTIC
/begin CHARACTERISTIC DFES_GrpRpr.DFC_OilPPlaus_C "common MIL debouncing / group representative for common MIL debouncing of DFC_OilPPlaus" VALUE 0x80505156 Val_Wu16 906.000000000 DFC_Verb 0.00 906.000000000 FORMAT "%13.9" /end CHARACTERISTIC
/begin CHARACTERISTIC DFES_GrpRpr.DFC_PLLSUmax_C "common MIL debouncing / group representative for common MIL debouncing of DFC_PLLSUmax" VALUE 0x80505158 Val_Wu16 906.000000000 DFC_Verb 0.00 906.000000000 FORMAT "%13.9" /end CHARACTERISTIC
/begin CHARACTERISTIC DFES_GrpRpr.DFC_PLLSUmin_C "common MIL debouncing / group representative for common MIL debouncing of DFC_PLLSUmin" VALUE 0x8050515A Val_Wu16 906.000000000 DFC_Verb 0.00 906.000000000 FORMAT "%13.9" /end CHARACTERISTIC
/begin CHARACTERISTIC DFES_GrpRpr.DFC_PSR1max_C "common MIL debouncing / group representative for common MIL debouncing of DFC_PSR1max" VALUE 0x8050515C Val_Wu16 906.000000000 DFC_Verb 0.00 906.000000000 FORMAT "%13.9" /end CHARACTERISTIC
/begin CHARACTERISTIC DFES_GrpRpr.DFC_PSRBmax_C "common MIL debouncing / group representative for common MIL debouncing of DFC_PSRBmax" VALUE 0x8050515E Val_Wu16 906.000000000 DFC_Verb 0.00 906.000000000 FORMAT "%13.9" /end CHARACTERISTIC
/begin CHARACTERISTIC DFES_GrpRpr.DFC_PSRBmin_C "common MIL debouncing / group representative for common MIL debouncing of DFC_PSRBmin" VALUE 0x80505160 Val_Wu16 906.000000000 DFC_Verb 0.00 906.000000000 FORMAT "%13.9" /end CHARACTERISTIC
/begin CHARACTERISTIC DFES_GrpRpr.DFC_PSRPmax_C "common MIL debouncing / group representative for common MIL debouncing of DFC_PSRPmax" VALUE 0x80505162 Val_Wu16 906.000000000 DFC_Verb 0.00 906.000000000 FORMAT "%13.9" /end CHARACTERISTIC
/begin CHARACTERISTIC DFES_GrpRpr.DFC_PSRPmin_C "common MIL debouncing / group representative for common MIL debouncing of DFC_PSRPmin" VALUE 0x80505164 Val_Wu16 906.000000000 DFC_Verb 0.00 906.000000000 FORMAT "%13.9" /end CHARACTERISTIC
/begin CHARACTERISTIC DFES_GrpRpr.DFC_PSRPsig_C "common MIL debouncing / group representative for common MIL debouncing of DFC_PSRPsig" VALUE 0x80505166 Val_Wu16 906.000000000 DFC_Verb 0.00 906.000000000 FORMAT "%13.9" /end CHARACTERISTIC
/begin CHARACTERISTIC DFES_GrpRpr.DFC_PSRmax_C "common MIL debouncing / group representative for common MIL debouncing of DFC_PSRmax" VALUE 0x80505168 Val_Wu16 906.000000000 DFC_Verb 0.00 906.000000000 FORMAT "%13.9" /end CHARACTERISTIC
/begin CHARACTERISTIC DFES_GrpRpr.DFC_PUmax_C "common MIL debouncing / group representative for common MIL debouncing of DFC_PUmax" VALUE 0x8050516A Val_Wu16 906.000000000 DFC_Verb 0.00 906.000000000 FORMAT "%13.9" /end CHARACTERISTIC
/begin CHARACTERISTIC DFES_GrpRpr.DFC_P_VSE11_OL_C "common MIL debouncing / group representative for common MIL debouncing of DFC_P_VSE11_OL" VALUE 0x8050516C Val_Wu16 906.000000000 DFC_Verb 0.00 906.000000000 FORMAT "%13.9" /end CHARACTERISTIC
/begin CHARACTERISTIC DFES_GrpRpr.DFC_P_VSE11_SCB_C "common MIL debouncing / group representative for common MIL debouncing of DFC_P_VSE11_SCB" VALUE 0x8050516E Val_Wu16 906.000000000 DFC_Verb 0.00 906.000000000 FORMAT "%13.9" /end CHARACTERISTIC
/begin CHARACTERISTIC DFES_GrpRpr.DFC_P_VSE11_SCG_C "common MIL debouncing / group representative for common MIL debouncing of DFC_P_VSE11_SCG" VALUE 0x80505170 Val_Wu16 906.000000000 DFC_Verb 0.00 906.000000000 FORMAT "%13.9" /end CHARACTERISTIC
/begin CHARACTERISTIC DFES_GrpRpr.DFC_PhyHighAPP1_C "common MIL debouncing / group representative for common MIL debouncing of DFC_PhyHighAPP1" VALUE 0x80505172 Val_Wu16 906.000000000 DFC_Verb 0.00 906.000000000 FORMAT "%13.9" /end CHARACTERISTIC
/begin CHARACTERISTIC DFES_GrpRpr.DFC_PhyHighAPP2_C "common MIL debouncing / group representative for common MIL debouncing of DFC_PhyHighAPP2" VALUE 0x80505174 Val_Wu16 906.000000000 DFC_Verb 0.00 906.000000000 FORMAT "%13.9" /end CHARACTERISTIC
/begin CHARACTERISTIC DFES_GrpRpr.DFC_PhyLowAPP1_C "common MIL debouncing / group representative for common MIL debouncing of DFC_PhyLowAPP1" VALUE 0x80505176 Val_Wu16 906.000000000 DFC_Verb 0.00 906.000000000 FORMAT "%13.9" /end CHARACTERISTIC
/begin CHARACTERISTIC DFES_GrpRpr.DFC_PhyLowAPP2_C "common MIL debouncing / group representative for common MIL debouncing of DFC_PhyLowAPP2" VALUE 0x80505178 Val_Wu16 906.000000000 DFC_Verb 0.00 906.000000000 FORMAT "%13.9" /end CHARACTERISTIC
/begin CHARACTERISTIC DFES_GrpRpr.DFC_SRCHighAPP1_C "common MIL debouncing / group representative for common MIL debouncing of DFC_SRCHighAPP1" VALUE 0x8050517A Val_Wu16 906.000000000 DFC_Verb 0.00 906.000000000 FORMAT "%13.9" /end CHARACTERISTIC
/begin CHARACTERISTIC DFES_GrpRpr.DFC_SRCHighAPP2_C "common MIL debouncing / group representative for common MIL debouncing of DFC_SRCHighAPP2" VALUE 0x8050517C Val_Wu16 906.000000000 DFC_Verb 0.00 906.000000000 FORMAT "%13.9" /end CHARACTERISTIC
/begin CHARACTERISTIC DFES_GrpRpr.DFC_SRCLowAPP1_C "common MIL debouncing / group representative for common MIL debouncing of DFC_SRCLowAPP1" VALUE 0x8050517E Val_Wu16 906.000000000 DFC_Verb 0.00 906.000000000 FORMAT "%13.9" /end CHARACTERISTIC
/begin CHARACTERISTIC DFES_GrpRpr.DFC_SRCLowAPP2_C "common MIL debouncing / group representative for common MIL debouncing of DFC_SRCLowAPP2" VALUE 0x80505180 Val_Wu16 906.000000000 DFC_Verb 0.00 906.000000000 FORMAT "%13.9" /end CHARACTERISTIC
/begin CHARACTERISTIC DFES_GrpRpr.DFC_SSpMon2_C "common MIL debouncing / group representative for common MIL debouncing of DFC_SSpMon2" VALUE 0x80505182 Val_Wu16 906.000000000 DFC_Verb 0.00 906.000000000 FORMAT "%13.9" /end CHARACTERISTIC
/begin CHARACTERISTIC DFES_GrpRpr.DFC_STHDRmax_C "common MIL debouncing / group representative for common MIL debouncing of DFC_STHDRmax" VALUE 0x80505184 Val_Wu16 906.000000000 DFC_Verb 0.00 906.000000000 FORMAT "%13.9" /end CHARACTERISTIC
/begin CHARACTERISTIC DFES_GrpRpr.DFC_SWReset_0_C "common MIL debouncing / group representative for common MIL debouncing of DFC_SWReset_0" VALUE 0x80505186 Val_Wu16 906.000000000 DFC_Verb 0.00 906.000000000 FORMAT "%13.9" /end CHARACTERISTIC
/begin CHARACTERISTIC DFES_GrpRpr.DFC_SWReset_1_C "common MIL debouncing / group representative for common MIL debouncing of DFC_SWReset_1" VALUE 0x80505188 Val_Wu16 906.000000000 DFC_Verb 0.00 906.000000000 FORMAT "%13.9" /end CHARACTERISTIC
/begin CHARACTERISTIC DFES_GrpRpr.DFC_SWReset_2_C "common MIL debouncing / group representative for common MIL debouncing of DFC_SWReset_2" VALUE 0x8050518A Val_Wu16 906.000000000 DFC_Verb 0.00 906.000000000 FORMAT "%13.9" /end CHARACTERISTIC
/begin CHARACTERISTIC DFES_GrpRpr.DFC_SyncAPP_C "common MIL debouncing / group representative for common MIL debouncing of DFC_SyncAPP" VALUE 0x8050518C Val_Wu16 906.000000000 DFC_Verb 0.00 906.000000000 FORMAT "%13.9" /end CHARACTERISTIC
/begin CHARACTERISTIC DFES_GrpRpr.DFC_TANKLnpl_C "common MIL debouncing / group representative for common MIL debouncing of DFC_TANKLnpl" VALUE 0x8050518E Val_Wu16 906.000000000 DFC_Verb 0.00 906.000000000 FORMAT "%13.9" /end CHARACTERISTIC
/begin CHARACTERISTIC DFES_GrpRpr.DFC_TAmax_Dummy_C "common MIL debouncing / group representative for common MIL debouncing of DFC_TAmax_Dummy" VALUE 0x80505190 Val_Wu16 906.000000000 DFC_Verb 0.00 906.000000000 FORMAT "%13.9" /end CHARACTERISTIC
/begin CHARACTERISTIC DFES_GrpRpr.DFC_TESFmax_C "common MIL debouncing / group representative for common MIL debouncing of DFC_TESFmax" VALUE 0x80505192 Val_Wu16 906.000000000 DFC_Verb 0.00 906.000000000 FORMAT "%13.9" /end CHARACTERISTIC
/begin CHARACTERISTIC DFES_GrpRpr.DFC_TESGmax_C "common MIL debouncing / group representative for common MIL debouncing of DFC_TESGmax" VALUE 0x80505194 Val_Wu16 906.000000000 DFC_Verb 0.00 906.000000000 FORMAT "%13.9" /end CHARACTERISTIC
/begin CHARACTERISTIC DFES_GrpRpr.DFC_TKAEmax_C "common MIL debouncing / group representative for common MIL debouncing of DFC_TKAEmax" VALUE 0x80505196 Val_Wu16 906.000000000 DFC_Verb 0.00 906.000000000 FORMAT "%13.9" /end CHARACTERISTIC
/begin CHARACTERISTIC DFES_GrpRpr.DFC_TKAEmin_C "common MIL debouncing / group representative for common MIL debouncing of DFC_TKAEmin" VALUE 0x80505198 Val_Wu16 906.000000000 DFC_Verb 0.00 906.000000000 FORMAT "%13.9" /end CHARACTERISTIC
/begin CHARACTERISTIC DFES_GrpRpr.DFC_TKARmax_C "common MIL debouncing / group representative for common MIL debouncing of DFC_TKARmax" VALUE 0x8050519A Val_Wu16 906.000000000 DFC_Verb 0.00 906.000000000 FORMAT "%13.9" /end CHARACTERISTIC
/begin CHARACTERISTIC DFES_GrpRpr.DFC_TKARnpl_C "common MIL debouncing / group representative for common MIL debouncing of DFC_TKARnpl" VALUE 0x8050519C Val_Wu16 906.000000000 DFC_Verb 0.00 906.000000000 FORMAT "%13.9" /end CHARACTERISTIC
/begin CHARACTERISTIC DFES_GrpRpr.DFC_TMmax_Dummy_C "common MIL debouncing / group representative for common MIL debouncing of DFC_TMmax_Dummy" VALUE 0x8050519E Val_Wu16 906.000000000 DFC_Verb 0.00 906.000000000 FORMAT "%13.9" /end CHARACTERISTIC
/begin CHARACTERISTIC DFES_GrpRpr.DFC_TUMmax_Dummy_C "common MIL debouncing / group representative for common MIL debouncing of DFC_TUMmax_Dummy" VALUE 0x805051A0 Val_Wu16 906.000000000 DFC_Verb 0.00 906.000000000 FORMAT "%13.9" /end CHARACTERISTIC
/begin CHARACTERISTIC DFES_GrpRpr.DFC_TWCDPriCatB1_C "common MIL debouncing / group representative for common MIL debouncing of DFC_TWCDPriCatB1" VALUE 0x805051A2 Val_Wu16 906.000000000 DFC_Verb 0.00 906.000000000 FORMAT "%13.9" /end CHARACTERISTIC
/begin CHARACTERISTIC DFES_GrpRpr.DFC_ThrVlvClsdPosnFirstOffsLrnImpoB1_C "common MIL debouncing / group representative for common MIL debouncing of DFC_ThrVlvClsdPosnFirstOffsLrnImpoB1" VALUE 0x805051A4 Val_Wu16 906.000000000 DFC_Verb 0.00 906.000000000 FORMAT "%13.9" /end CHARACTERISTIC
/begin CHARACTERISTIC DFES_GrpRpr.DFC_ThrVlvClsdPosnOffsLrnImpoB1_C "common MIL debouncing / group representative for common MIL debouncing of DFC_ThrVlvClsdPosnOffsLrnImpoB1" VALUE 0x805051A6 Val_Wu16 906.000000000 DFC_Verb 0.00 906.000000000 FORMAT "%13.9" /end CHARACTERISTIC
/begin CHARACTERISTIC DFES_GrpRpr.DFC_ThrVlvClsdPosnOffsLrnMaxB1_C "common MIL debouncing / group representative for common MIL debouncing of DFC_ThrVlvClsdPosnOffsLrnMaxB1" VALUE 0x805051A8 Val_Wu16 906.000000000 DFC_Verb 0.00 906.000000000 FORMAT "%13.9" /end CHARACTERISTIC
/begin CHARACTERISTIC DFES_GrpRpr.DFC_ThrVlvClsdPosnOffsLrnMinB1_C "common MIL debouncing / group representative for common MIL debouncing of DFC_ThrVlvClsdPosnOffsLrnMinB1" VALUE 0x805051AA Val_Wu16 906.000000000 DFC_Verb 0.00 906.000000000 FORMAT "%13.9" /end CHARACTERISTIC
/begin CHARACTERISTIC DFES_GrpRpr.DFC_ThrVlvCtrlDeB1_C "common MIL debouncing / group representative for common MIL debouncing of DFC_ThrVlvCtrlDeB1" VALUE 0x805051AC Val_Wu16 906.000000000 DFC_Verb 0.00 906.000000000 FORMAT "%13.9" /end CHARACTERISTIC
/begin CHARACTERISTIC DFES_GrpRpr.DFC_ThrVlvDycB1_C "common MIL debouncing / group representative for common MIL debouncing of DFC_ThrVlvDycB1" VALUE 0x805051AE Val_Wu16 906.000000000 DFC_Verb 0.00 906.000000000 FORMAT "%13.9" /end CHARACTERISTIC
/begin CHARACTERISTIC DFES_GrpRpr.DFC_ThrVlvLimpAirPosnMaxAbsltDriftB1_C "common MIL debouncing / group representative for common MIL debouncing of DFC_ThrVlvLimpAirPosnMaxAbsltDriftB1" VALUE 0x805051B0 Val_Wu16 906.000000000 DFC_Verb 0.00 906.000000000 FORMAT "%13.9" /end CHARACTERISTIC
/begin CHARACTERISTIC DFES_GrpRpr.DFC_ThrVlvLimpAirPosnMaxB1_C "common MIL debouncing / group representative for common MIL debouncing of DFC_ThrVlvLimpAirPosnMaxB1" VALUE 0x805051B2 Val_Wu16 906.000000000 DFC_Verb 0.00 906.000000000 FORMAT "%13.9" /end CHARACTERISTIC
/begin CHARACTERISTIC DFES_GrpRpr.DFC_ThrVlvLimpAirPosnMaxRelDriftB1_C "common MIL debouncing / group representative for common MIL debouncing of DFC_ThrVlvLimpAirPosnMaxRelDriftB1" VALUE 0x805051B4 Val_Wu16 906.000000000 DFC_Verb 0.00 906.000000000 FORMAT "%13.9" /end CHARACTERISTIC
/begin CHARACTERISTIC DFES_GrpRpr.DFC_ThrVlvLimpAirPosnMinB1_C "common MIL debouncing / group representative for common MIL debouncing of DFC_ThrVlvLimpAirPosnMinB1" VALUE 0x805051B6 Val_Wu16 906.000000000 DFC_Verb 0.00 906.000000000 FORMAT "%13.9" /end CHARACTERISTIC
/begin CHARACTERISTIC DFES_GrpRpr.DFC_ThrVlvOpenLoadB1_C "common MIL debouncing / group representative for common MIL debouncing of DFC_ThrVlvOpenLoadB1" VALUE 0x805051B8 Val_Wu16 906.000000000 DFC_Verb 0.00 906.000000000 FORMAT "%13.9" /end CHARACTERISTIC
/begin CHARACTERISTIC DFES_GrpRpr.DFC_ThrVlvOpenSprgB1_C "common MIL debouncing / group representative for common MIL debouncing of DFC_ThrVlvOpenSprgB1" VALUE 0x805051BA Val_Wu16 906.000000000 DFC_Verb 0.00 906.000000000 FORMAT "%13.9" /end CHARACTERISTIC
/begin CHARACTERISTIC DFES_GrpRpr.DFC_ThrVlvOpenSprgSprdB1_C "common MIL debouncing / group representative for common MIL debouncing of DFC_ThrVlvOpenSprgSprdB1" VALUE 0x805051BC Val_Wu16 906.000000000 DFC_Verb 0.00 906.000000000 FORMAT "%13.9" /end CHARACTERISTIC
/begin CHARACTERISTIC DFES_GrpRpr.DFC_ThrVlvOpenSprgTwnB1_C "common MIL debouncing / group representative for common MIL debouncing of DFC_ThrVlvOpenSprgTwnB1" VALUE 0x805051BE Val_Wu16 906.000000000 DFC_Verb 0.00 906.000000000 FORMAT "%13.9" /end CHARACTERISTIC
/begin CHARACTERISTIC DFES_GrpRpr.DFC_ThrVlvOverTB1_C "common MIL debouncing / group representative for common MIL debouncing of DFC_ThrVlvOverTB1" VALUE 0x805051C0 Val_Wu16 906.000000000 DFC_Verb 0.00 906.000000000 FORMAT "%13.9" /end CHARACTERISTIC
/begin CHARACTERISTIC DFES_GrpRpr.DFC_ThrVlvRetSprgB1_C "common MIL debouncing / group representative for common MIL debouncing of DFC_ThrVlvRetSprgB1" VALUE 0x805051C2 Val_Wu16 906.000000000 DFC_Verb 0.00 906.000000000 FORMAT "%13.9" /end CHARACTERISTIC
/begin CHARACTERISTIC DFES_GrpRpr.DFC_ThrVlvRetSprgSprdB1_C "common MIL debouncing / group representative for common MIL debouncing of DFC_ThrVlvRetSprgSprdB1" VALUE 0x805051C4 Val_Wu16 906.000000000 DFC_Verb 0.00 906.000000000 FORMAT "%13.9" /end CHARACTERISTIC
/begin CHARACTERISTIC DFES_GrpRpr.DFC_ThrVlvRetSprgTwnB1_C "common MIL debouncing / group representative for common MIL debouncing of DFC_ThrVlvRetSprgTwnB1" VALUE 0x805051C6 Val_Wu16 906.000000000 DFC_Verb 0.00 906.000000000 FORMAT "%13.9" /end CHARACTERISTIC
/begin CHARACTERISTIC DFES_GrpRpr.DFC_ThrVlvSens1MaxB1_C "common MIL debouncing / group representative for common MIL debouncing of DFC_ThrVlvSens1MaxB1" VALUE 0x805051C8 Val_Wu16 906.000000000 DFC_Verb 0.00 906.000000000 FORMAT "%13.9" /end CHARACTERISTIC
/begin CHARACTERISTIC DFES_GrpRpr.DFC_ThrVlvSens1NplB1_C "common MIL debouncing / group representative for common MIL debouncing of DFC_ThrVlvSens1NplB1" VALUE 0x805051CA Val_Wu16 906.000000000 DFC_Verb 0.00 906.000000000 FORMAT "%13.9" /end CHARACTERISTIC
/begin CHARACTERISTIC DFES_GrpRpr.DFC_ThrVlvSens2MaxB1_C "common MIL debouncing / group representative for common MIL debouncing of DFC_ThrVlvSens2MaxB1" VALUE 0x805051CC Val_Wu16 906.000000000 DFC_Verb 0.00 906.000000000 FORMAT "%13.9" /end CHARACTERISTIC
/begin CHARACTERISTIC DFES_GrpRpr.DFC_ThrVlvSens2MinB1_C "common MIL debouncing / group representative for common MIL debouncing of DFC_ThrVlvSens2MinB1" VALUE 0x805051CE Val_Wu16 906.000000000 DFC_Verb 0.00 906.000000000 FORMAT "%13.9" /end CHARACTERISTIC
/begin CHARACTERISTIC DFES_GrpRpr.DFC_ThrVlvSens2NplB1_C "common MIL debouncing / group representative for common MIL debouncing of DFC_ThrVlvSens2NplB1" VALUE 0x805051D0 Val_Wu16 906.000000000 DFC_Verb 0.00 906.000000000 FORMAT "%13.9" /end CHARACTERISTIC
/begin CHARACTERISTIC DFES_GrpRpr.DFC_ThrVlvShoCircB1_C "common MIL debouncing / group representative for common MIL debouncing of DFC_ThrVlvShoCircB1" VALUE 0x805051D2 Val_Wu16 906.000000000 DFC_Verb 0.00 906.000000000 FORMAT "%13.9" /end CHARACTERISTIC
/begin CHARACTERISTIC DFES_GrpRpr.DFC_ThrVlvSpiErrB1_C "common MIL debouncing / group representative for common MIL debouncing of DFC_ThrVlvSpiErrB1" VALUE 0x805051D4 Val_Wu16 906.000000000 DFC_Verb 0.00 906.000000000 FORMAT "%13.9" /end CHARACTERISTIC
/begin CHARACTERISTIC DFES_GrpRpr.DFC_ThrvlvSens1MinB1_C "common MIL debouncing / group representative for common MIL debouncing of DFC_ThrvlvSens1MinB1" VALUE 0x805051D6 Val_Wu16 906.000000000 DFC_Verb 0.00 906.000000000 FORMAT "%13.9" /end CHARACTERISTIC
/begin CHARACTERISTIC DFES_GrpRpr.DFC_TiOffTBasdChkFast_C "common MIL debouncing / group representative for common MIL debouncing of DFC_TiOffTBasdChkFast" VALUE 0x805051D8 Val_Wu16 906.000000000 DFC_Verb 0.00 906.000000000 FORMAT "%13.9" /end CHARACTERISTIC
/begin CHARACTERISTIC DFES_GrpRpr.DFC_TiOffTBasdChkSlow_C "common MIL debouncing / group representative for common MIL debouncing of DFC_TiOffTBasdChkSlow" VALUE 0x805051DA Val_Wu16 906.000000000 DFC_Verb 0.00 906.000000000 FORMAT "%13.9" /end CHARACTERISTIC
/begin CHARACTERISTIC DFES_GrpRpr.DFC_UEGOSnsrMntdS1B1_C "common MIL debouncing / group representative for common MIL debouncing of DFC_UEGOSnsrMntdS1B1" VALUE 0x805051DC Val_Wu16 906.000000000 DFC_Verb 0.00 906.000000000 FORMAT "%13.9" /end CHARACTERISTIC
/begin CHARACTERISTIC DFES_GrpRpr.DFC_VehVSig_C "common MIL debouncing / group representative for common MIL debouncing of DFC_VehVSig" VALUE 0x805051DE Val_Wu16 906.000000000 DFC_Verb 0.00 906.000000000 FORMAT "%13.9" /end CHARACTERISTIC
/begin CHARACTERISTIC DFES_GrpRpr.DFC_VlvLftFbSwtIntk11SpclFail_C "common MIL debouncing / group representative for common MIL debouncing of DFC_VlvLftFbSwtIntk11SpclFail" VALUE 0x805051E0 Val_Wu16 906.000000000 DFC_Verb 0.00 906.000000000 FORMAT "%13.9" /end CHARACTERISTIC
/begin CHARACTERISTIC DFES_GrpRpr.DFC_VlvLftFbSwtIntk11StdFail_C "common MIL debouncing / group representative for common MIL debouncing of DFC_VlvLftFbSwtIntk11StdFail" VALUE 0x805051E2 Val_Wu16 906.000000000 DFC_Verb 0.00 906.000000000 FORMAT "%13.9" /end CHARACTERISTIC
/begin CHARACTERISTIC DFES_MonEvtMSK0_C "Event filter mask of Monitoring - Mask Id mast have 0 at bit mask 0 positions" VALUE 0x804D9768 Val_Wu16 65535.00 OneToOne 0.00 65535.00 FORMAT "%8.2" /end CHARACTERISTIC
/begin CHARACTERISTIC DFES_MonEvtMSK1_C "Event filter mask of Monitoring - Mask Id mast have 1 at bit mask 1 positions" VALUE 0x804D976A Val_Wu16 65535.00 OneToOne 0.00 65535.00 FORMAT "%8.2" /end CHARACTERISTIC
/begin CHARACTERISTIC DFES_MonRepeat_C "switch to ignore same kind of monitoring events, set to 0 to suppress identical events in a row" VALUE 0x804D976C Val_Wu8 255.0 OneToOne 0.00 255.0 FORMAT "%5.1" /end CHARACTERISTIC
/begin CHARACTERISTIC DFES_numClsDlt_CA "Fault class parameter: Number of cycles for OBD delete counter" VAL_BLK 0x804D976D ValA_Wu8 255.0 DFES_OneToOne 0.00 255.0 FORMAT "%5.1" NUMBER 31 /end CHARACTERISTIC
/begin CHARACTERISTIC DFES_numClsFaultCycl_CA "Fault class parameter: Number of cycles for fault counter" VAL_BLK 0x804D978C ValA_Wu8 255.0 DFES_OneToOne 0.00 255.0 FORMAT "%5.1" NUMBER 31 /end CHARACTERISTIC
/begin CHARACTERISTIC DFES_numClsHealCycl_CA "Fault class parameter: Number of cycles for healing counter" VAL_BLK 0x804D97AB ValA_Wu8 255.0 DFES_OneToOne 0.00 255.0 FORMAT "%5.1" NUMBER 31 /end CHARACTERISTIC
/begin CHARACTERISTIC DFES_numClsPndDlt_CA "Fault class parameter: Number of cycles for pending delete counter" VAL_BLK 0x804D97CA ValA_Wu8 255.0 DFES_OneToOne 0.00 255.0 FORMAT "%5.1" NUMBER 31 /end CHARACTERISTIC
/begin CHARACTERISTIC DFES_numClsSvcDlt_CA "Fault class parameter: Number of cycles for delete counter" VAL_BLK 0x804D97E9 ValA_Wu8 255.0 DFES_OneToOne 0.00 255.0 FORMAT "%5.1" NUMBER 31 /end CHARACTERISTIC
/begin CHARACTERISTIC DFES_numClsSVSFaultCycl_CA "Fault class parameter: Number of cycles for SVS lamp fault counter" VAL_BLK 0x804D9808 ValA_Wu8 255.0 DFES_OneToOne 0.00 255.0 FORMAT "%5.1" NUMBER 31 /end CHARACTERISTIC
/begin CHARACTERISTIC DFES_numClsSVSHealCycl_CA "Fault class parameter: Number of cycles for SVS lamp healing counter" VAL_BLK 0x804D9827 ValA_Wu8 255.0 DFES_OneToOne 0.00 255.0 FORMAT "%5.1" NUMBER 31 /end CHARACTERISTIC
/begin CHARACTERISTIC DFES_numPDTC_C "Number of permanent DTCs (from 0 to configured maximum value)" VALUE 0x804D9846 Val_Wu8 5.000 DFES_OneToOne 0.00 5.000 FORMAT "%5.3" EXTENDED_LIMITS 0.00 255.0 /end CHARACTERISTIC
/begin CHARACTERISTIC DFES_ThresSimCond.n_C "" VALUE 0x804D9848 Val_Wu16 16383.75 DFES_nPID0C 0.00 16383.75 FORMAT "%8.2" /end CHARACTERISTIC
/begin CHARACTERISTIC DFES_ThresSimCond.r_C "" VALUE 0x804D984A Val_Wu8 100.0 DFES_rPID04 0.00 100.0 FORMAT "%5.1" /end CHARACTERISTIC
/begin CHARACTERISTIC DFES_ThresSimCond.t_C "" VALUE 0x804D984B Val_Wu8 255.0 DFES_tPID05 -40.0 215.0 FORMAT "%5.1" /end CHARACTERISTIC
/begin FUNCTION DFES "30000.73.0_2.0.0Diagnostic Fault Event Storage"
 /begin DEF_CHARACTERISTIC DFES_GrpRpr.DFC_GbxPNPosnDrvCdn_C DFES_GrpRpr.DFC_GbxPNPosnPlausy_C DFES_GrpRpr.DFC_AfsSigErrLineHiB1_C DFES_GrpRpr.DFC_AfsSigErrLineLoB1_C DFES_GrpRpr.DFC_PEnvCcMax_C DFES_GrpRpr.DFC_PEnvCcMin_C DFES_GrpRpr.DFC_PEnvRngChkMax_C DFES_GrpRpr.DFC_PEnvRngChkMin_C DFES_GrpRpr.DFC_PEnvSnsrPlaus_C DFES_GrpRpr.DFC_UEGOHeatrRlyPsOLS1B1_C DFES_GrpRpr.DFC_UEGOHeatrRlyPsSCBS1B1_C DFES_GrpRpr.DFC_UEGOHeatrRlyPsSCGS1B1_C DFES_GrpRpr.DFC_UegoHeatrWireOlS1B1_C DFES_GrpRpr.DFC_UegoHeatrWireScbS1B1_C DFES_GrpRpr.DFC_UegoHeatrWireScgS1B1_C DFES_GrpRpr.DFC_KnDetSens1PortAMax_C DFES_GrpRpr.DFC_KnDetSens1PortAMin_C DFES_GrpRpr.DFC_KnDetSens1PortBMax_C DFES_GrpRpr.DFC_KnDetSens1PortBMin_C DFES_GrpRpr.DFC_Clth2ONStuck_C DFES_GrpRpr.DFC_Clth2ONStuckLdc_C DFES_GrpRpr.DFC_Clth3ONStuckLdc_C DFES_GrpRpr.DFC_Clth3ONStuckPostDrv_C DFES_GrpRpr.DFC_Clth4ONStuck_C DFES_GrpRpr.DFC_Clth4ONStuckLdc_C DFES_GrpRpr.DFC_ComBCMUnit_C DFES_GrpRpr.DFC_ComDLCTCU01_C DFES_GrpRpr.DFC_ComDLCTCU02_C DFES_GrpRpr.DFC_ComDLCTCU1_C DFES_GrpRpr.DFC_ComDLCTCU11_C DFES_GrpRpr.DFC_ComDLCTCU12_C DFES_GrpRpr.DFC_ComDLCTCU13_C DFES_GrpRpr.DFC_ComDLCTCU14_C DFES_GrpRpr.DFC_ComDLCTCU2_C DFES_GrpRpr.DFC_ComDLCTCU3_C DFES_GrpRpr.DFC_ComDLCTCU4_C DFES_GrpRpr.DFC_ComEPSUnit_C DFES_GrpRpr.DFC_ComIDASBUnit_C DFES_GrpRpr.DFC_ComIMGUnit_C DFES_GrpRpr.DFC_ComMETUnit_C DFES_GrpRpr.DFC_ComSRSUnit_C DFES_GrpRpr.DFC_ComVSAUnit_C DFES_GrpRpr.DFC_EbsSocFlt_C DFES_GrpRpr.DFC_I14229VINErr_C DFES_GrpRpr.DFC_InjCatHeatgErr_C DFES_GrpRpr.DFC_InjSysMulInjDiagErr_C DFES_GrpRpr.DFC_LLRHmax_C DFES_GrpRpr.DFC_LLRHmin_C DFES_GrpRpr.DFC_LLRHnpl_C DFES_GrpRpr.DFC_LLRKHmax_C DFES_GrpRpr.DFC_LLRKHmin_C DFES_GrpRpr.DFC_LLRKHnpl_C DFES_GrpRpr.DFC_LinACGUnit_C DFES_GrpRpr.DFC_LinAEVUnit_C DFES_GrpRpr.DFC_LinEBSUnit_C DFES_GrpRpr.DFC_RoughRoad_C DFES_GrpRpr.DFC_SiaEEPRdErr_C DFES_GrpRpr.DFC_SiaEEPWrngCod_C DFES_GrpRpr.DFC_UegoHeatrStrtS1B1_C DFES_GrpRpr.DFC_BusDiagCANAPPLBusOff_C DFES_GrpRpr.DFC_BusDiagCANCANCBusOff_C DFES_GrpRpr.DFC_BusDiagCANVEHICLEBusOff_C DFES_GrpRpr.DFC_RBA_IODIAGPWR_rba_IoExtCy329_SignalVltSply_0_C DFES_GrpRpr.DFC_RBA_IODIAGPWR_rba_IoExtCy329_SignalVltSply_0OT_C DFES_GrpRpr.DFC_RBA_IODIAGPWR_rba_IoExtCy329_SignalVltSply_0OV_C DFES_GrpRpr.DFC_RBA_IODIAGPWR_rba_IoExtCy329_SignalVltSply_0SCG_C DFES_GrpRpr.DFC_RBA_IODIAGPWR_rba_IoExtCy329_SignalVltSply_0UV_C DFES_GrpRpr.DFC_RBA_IODIAGPWR_rba_IoExtCy329_SignalVltSply_1_C DFES_GrpRpr.DFC_RBA_IODIAGPWR_rba_IoExtCy329_SignalVltSply_1OT_C DFES_GrpRpr.DFC_RBA_IODIAGPWR_rba_IoExtCy329_SignalVltSply_1OV_C DFES_GrpRpr.DFC_RBA_IODIAGPWR_rba_IoExtCy329_SignalVltSply_1SCG_C DFES_GrpRpr.DFC_RBA_IODIAGPWR_rba_IoExtCy329_SignalVltSply_1UV_C DFES_GrpRpr.DFC_RBA_IODIAGPWR_rba_IoExtCy329_SignalVltSply_2_C DFES_GrpRpr.DFC_RBA_IODIAGPWR_rba_IoExtCy329_SignalVltSply_2OT_C DFES_GrpRpr.DFC_RBA_IODIAGPWR_rba_IoExtCy329_SignalVltSply_2OV_C DFES_GrpRpr.DFC_RBA_IODIAGPWR_rba_IoExtCy329_SignalVltSply_2SCG_C DFES_GrpRpr.DFC_RBA_IODIAGPWR_rba_IoExtCy329_SignalVltSply_2UV_C DFES_GrpRpr.DFC_CAN_E_TIMEOUT_C DFES_GrpRpr.DFC_LIN_E_TIMEOUT_C DFES_GrpRpr.DFC_MRlyOL_C DFES_GrpRpr.DFC_MRlySCB_C DFES_GrpRpr.DFC_MRlySCG_C DFES_GrpRpr.DFC_rba_MultiStackTrace_Threshold_C DFES_GrpRpr.DFC_BSWM_E_ACTION_FAILED_C DFES_GrpRpr.DFC_BSWM_E_INTRPTQUEUE_FULL_C DFES_GrpRpr.DFC_RBA_IOEXTLIB_KEEPALIVE_DRV_C DFES_GrpRpr.DFC_RBA_IOEXTLIB_KEEPALIVE_INI_C DFES_GrpRpr.DFC_rba_IoSigRtc_StopCounter_C DFES_GrpRpr.DFC_rba_MRly_Diag_Stk_Event_C DFES_GrpRpr.DFC_rba_MemDiag_MemReadErr_C DFES_GrpRpr.DFC_rba_MemDiag_MemWrErr_C DFES_GrpRpr.DFC_rba_SyC_IrrSwOffTrigEngRun_Event_C DFES_GrpRpr.DFC_rba_T15_Diag_ComInVld_Event_C DFES_GrpRpr.DFC_rba_T15_Diag_ComOff_HwOn_Event_C DFES_GrpRpr.DFC_rba_T15_Diag_ComOn_HwOff_Event_C DFES_GrpRpr.DFC_AAVmin_C DFES_GrpRpr.DFC_AGRSUS_C DFES_GrpRpr.DFC_AfsPlausDiagHi_C DFES_GrpRpr.DFC_AfsPlausDiagLo_C DFES_GrpRpr.DFC_AfsVrntDiagErrB1_C DFES_GrpRpr.DFC_AppAllSnsrDfct_C DFES_GrpRpr.DFC_BBKRnldg_C DFES_GrpRpr.DFC_BBKRsyne_C DFES_GrpRpr.DFC_BattUStdbyDiaOL_C DFES_GrpRpr.DFC_BigLeakIntkMnfldEmiInfl_C DFES_GrpRpr.DFC_BlkdLineTank_C DFES_GrpRpr.DFC_BrkMnSwtContOnWarnLmp_C DFES_GrpRpr.DFC_BrkMnSwtNotStpWarnLmp_C DFES_GrpRpr.DFC_BrkRdntSwtContOnWarnLmp_C DFES_GrpRpr.DFC_BrkRdntSwtNotStpWarnLmp_C DFES_GrpRpr.DFC_CEngDsTColdStrtMax_C DFES_GrpRpr.DFC_CEngDsTColdStrtMin_C DFES_GrpRpr.DFC_CEngDsTImps_C DFES_GrpRpr.DFC_CEngDsTPlausHSC_C DFES_GrpRpr.DFC_CEngDsTPlausLSC_C DFES_GrpRpr.DFC_CEngDsTPlausSTC_C DFES_GrpRpr.DFC_CEngDsTSRCMax_C DFES_GrpRpr.DFC_CEngDsTSRCMin_C DFES_GrpRpr.DFC_CEngDsTSig_C DFES_GrpRpr.DFC_CEngUsTColdStrtMax_C DFES_GrpRpr.DFC_CEngUsTColdStrtMin_C DFES_GrpRpr.DFC_CEngUsTLooseCnctn_C DFES_GrpRpr.DFC_CEngUsTSRCMax_C DFES_GrpRpr.DFC_CEngUsTSRCMin_C DFES_GrpRpr.DFC_ComDCDCACCFailr_C DFES_GrpRpr.DFC_DCDCFltDet_C DFES_GrpRpr.DFC_DKRSA_C DFES_GrpRpr.DFC_DKVSmax_C DFES_GrpRpr.DFC_DKnpl_C DFES_GrpRpr.DFC_DSKVRmax_C DFES_GrpRpr.DFC_DSKVRmin_C DFES_GrpRpr.DFC_DSKVRnpl_C DFES_GrpRpr.DFC_DSKVRsig_C DFES_GrpRpr.DFC_DSKVSsig_C DFES_GrpRpr.DFC_DSSmax_C DFES_GrpRpr.DFC_DSTDmax_C DFES_GrpRpr.DFC_DSTEmax_C DFES_GrpRpr.DFC_DSTEmin_C DFES_GrpRpr.DFC_DSTOFmax_C DFES_GrpRpr.DFC_DSTRmax_C DFES_GrpRpr.DFC_DSTRmin_C DFES_GrpRpr.DFC_DSTRnpl_C DFES_GrpRpr.DFC_DSTRsig_C DFES_GrpRpr.DFC_DSTTI_C DFES_GrpRpr.DFC_DSUmax_C DFES_GrpRpr.DFC_DiagCpv1DteskLoLoadStuckClsd_C DFES_GrpRpr.DFC_DiagCpv1DteskLoLoadStuckOpen_C DFES_GrpRpr.DFC_EGRVlvDrftClsd_C DFES_GrpRpr.DFC_EGRVlvDrftOpn_C DFES_GrpRpr.DFC_EGRVlvJamVlvClsd_C DFES_GrpRpr.DFC_EGRVlvJamVlvOpn_C DFES_GrpRpr.DFC_EGRVlvSprgBrk_C DFES_GrpRpr.DFC_EGRVlvTempMdlEEPErr_C DFES_GrpRpr.DFC_EGRVlvTmpErr_C DFES_GrpRpr.DFC_EGSDUS2B1LtrDly_C DFES_GrpRpr.DFC_EGSDUS2B1LtrPT1_C DFES_GrpRpr.DFC_EGSDUS2B1RtlDly_C DFES_GrpRpr.DFC_EGSDUS2B1RtlPT1_C DFES_GrpRpr.DFC_EGSDUS2B1TarLean_C DFES_GrpRpr.DFC_EGSDUS2B1TarRich_C DFES_GrpRpr.DFC_EONVmax_C DFES_GrpRpr.DFC_ETAKHLmax_C DFES_GrpRpr.DFC_ETAKHTmax_C DFES_GrpRpr.DFC_ETHSEmax_C DFES_GrpRpr.DFC_ETHSEmin_C DFES_GrpRpr.DFC_ETHSFmax_C DFES_GrpRpr.DFC_ETHSFmin_C DFES_GrpRpr.DFC_ETHSFsig_C DFES_GrpRpr.DFC_ETHSNPWmax_C DFES_GrpRpr.DFC_ETHSNPWmin_C DFES_GrpRpr.DFC_ETHSNPWsig_C DFES_GrpRpr.DFC_ETHSPLnpl_C DFES_GrpRpr.DFC_ETHSTPLnpl_C DFES_GrpRpr.DFC_EngICO_C DFES_GrpRpr.DFC_EngPrtOvrSpdMon_C DFES_GrpRpr.DFC_EpmCaSI1ErrSig_C DFES_GrpRpr.DFC_EpmCaSI1MntErr_C DFES_GrpRpr.DFC_EpmCaSI1NoSigMax_C DFES_GrpRpr.DFC_EpmCaSI1NoSigMin_C DFES_GrpRpr.DFC_EpmCaSI1OfsErr_C DFES_GrpRpr.DFC_EpmCrSDGI_C DFES_GrpRpr.DFC_EpmCrSErrSig_C DFES_GrpRpr.DFC_EpmCrSNoSig_C DFES_GrpRpr.DFC_EtaEngIdleNonCsers_C DFES_GrpRpr.DFC_EtaEngPtlNonCsers_C DFES_GrpRpr.DFC_FRAmax_C DFES_GrpRpr.DFC_FRAmin_C DFES_GrpRpr.DFC_FSTEmax_C DFES_GrpRpr.DFC_FSTEmin_C DFES_GrpRpr.DFC_FSTRmax_C DFES_GrpRpr.DFC_FSTRmin_C DFES_GrpRpr.DFC_FSTRnpl_C DFES_GrpRpr.DFC_FSTmax_C DFES_GrpRpr.DFC_FTDLAmax_C DFES_GrpRpr.DFC_FTDLAmin_C DFES_GrpRpr.DFC_FuPHiSnsrEleclmax_C DFES_GrpRpr.DFC_FuPHiSnsrEleclmin_C DFES_GrpRpr.DFC_FuPHiSnsrEleclnpl_C DFES_GrpRpr.DFC_FuPHiSnsrURngMax_C DFES_GrpRpr.DFC_FuPHiSnsrURngMin_C DFES_GrpRpr.DFC_FuSnsrPhyRngMaxErr_C DFES_GrpRpr.DFC_FuSnsrPhyRngMinErr_C DFES_GrpRpr.DFC_GEVlvLockPinDiagIntkB1_C DFES_GrpRpr.DFC_GEVlvPhaSlowIntkB1_C DFES_GrpRpr.DFC_GEVlvPhaTargIntkB1_C DFES_GrpRpr.DFC_GbxRvsSwtStk_C DFES_GrpRpr.DFC_HDRKHmax_C DFES_GrpRpr.DFC_HDRKHmin_C DFES_GrpRpr.DFC_HDRPLmax_C DFES_GrpRpr.DFC_HDRPLmin_C DFES_GrpRpr.DFC_HDRmax_C DFES_GrpRpr.DFC_HDRmin_C DFES_GrpRpr.DFC_HEGOS2B1ElecMax_C DFES_GrpRpr.DFC_HEGOS2B1ElecMin_C DFES_GrpRpr.DFC_HEGOS2B1ElecSig_C DFES_GrpRpr.DFC_HEGOS2B1HtgNpl_C DFES_GrpRpr.DFC_HEV00max_C DFES_GrpRpr.DFC_HEV01max_C DFES_GrpRpr.DFC_HEV02max_C DFES_GrpRpr.DFC_HEV03max_C DFES_GrpRpr.DFC_HEVE0max_C DFES_GrpRpr.DFC_HEVE1max_C DFES_GrpRpr.DFC_HFMmax_C DFES_GrpRpr.DFC_HiPSysHiPMaxLimExcdd_C DFES_GrpRpr.DFC_IVGdiCtlCvoErrMax_0_C DFES_GrpRpr.DFC_IVGdiCtlCvoErrMax_1_C DFES_GrpRpr.DFC_IVGdiCtlCvoErrMax_2_C DFES_GrpRpr.DFC_IVGdiCtlCvoErrMax_3_C DFES_GrpRpr.DFC_IVGdiCtlCvoErrMin_0_C DFES_GrpRpr.DFC_IVGdiCtlCvoErrMin_1_C DFES_GrpRpr.DFC_IVGdiCtlCvoErrMin_2_C DFES_GrpRpr.DFC_IVGdiCtlCvoErrMin_3_C DFES_GrpRpr.DFC_IVGdiCtlCvoErrMinMax_C DFES_GrpRpr.DFC_IVGdiCtlCvoSigPlausErrSmrCdn_C DFES_GrpRpr.DFC_IVGdiCtl_CvoErr_C DFES_GrpRpr.DFC_IVGdiCtl_CvoSigPlaus_0_C DFES_GrpRpr.DFC_IVGdiCtl_CvoSigPlaus_1_C DFES_GrpRpr.DFC_IVGdiCtl_CvoSigPlaus_2_C DFES_GrpRpr.DFC_IVGdiCtl_CvoSigPlaus_3_C DFES_GrpRpr.DFC_IntkAirTAirFltDsCrssMax_C DFES_GrpRpr.DFC_IntkAirTAirFltDsCrssMin_C DFES_GrpRpr.DFC_IntkAirTAirFltDsHSCMax_C DFES_GrpRpr.DFC_IntkAirTAirFltDsImps_C DFES_GrpRpr.DFC_IntkAirTAirFltDsPRCMax_C DFES_GrpRpr.DFC_IntkAirTAirFltDsPRCMin_C DFES_GrpRpr.DFC_IntkAirTAirFltDsSRCMax_C DFES_GrpRpr.DFC_IntkAirTAirFltDsSRCMin_C DFES_GrpRpr.DFC_IntkAirTAirFltDsSTC_C DFES_GrpRpr.DFC_IntkAirTIntkMnfldCrssMax_C DFES_GrpRpr.DFC_IntkAirTIntkMnfldCrssMin_C DFES_GrpRpr.DFC_IntkAirTIntkMnfldHSCMax_C DFES_GrpRpr.DFC_IntkAirTIntkMnfldImps_C DFES_GrpRpr.DFC_IntkAirTIntkMnfldPRCMax_C DFES_GrpRpr.DFC_IntkAirTIntkMnfldPRCMin_C DFES_GrpRpr.DFC_IntkAirTIntkMnfldSRCMax_C DFES_GrpRpr.DFC_IntkAirTIntkMnfldSRCMin_C DFES_GrpRpr.DFC_IntkAirTIntkMnfldSTC_C DFES_GrpRpr.DFC_KRREGRLMX_C DFES_GrpRpr.DFC_KRVEKOCVLCI_C DFES_GrpRpr.DFC_KRVEKOENCHMT_C DFES_GrpRpr.DFC_KRVEKOENCHMT0_C DFES_GrpRpr.DFC_KRVEKOENCHMT1_C DFES_GrpRpr.DFC_KRVEKOENCHMT2_C DFES_GrpRpr.DFC_KRVEKOENCHMT3_C DFES_GrpRpr.DFC_KRVEKOENCHMT4_C DFES_GrpRpr.DFC_KRVEKOENCHMT5_C DFES_GrpRpr.DFC_KRVEKOENCHMT6_C DFES_GrpRpr.DFC_KRVEKOENCHMT7_C DFES_GrpRpr.DFC_KRVEKORLMX_C DFES_GrpRpr.DFC_KRVEKORLMXL_C DFES_GrpRpr.DFC_KS1max_C DFES_GrpRpr.DFC_KS1min_C DFES_GrpRpr.DFC_LMmax_C DFES_GrpRpr.DFC_LZSRnpl_C DFES_GrpRpr.DFC_LamDynDiagS1B1_C DFES_GrpRpr.DFC_LeakIntkMnfldEmiInfl_C DFES_GrpRpr.DFC_LinFrameErrDCDC_C DFES_GrpRpr.DFC_LinOverrunErrDCDC_C DFES_GrpRpr.DFC_MD00max_C DFES_GrpRpr.DFC_MDBmax_C DFES_GrpRpr.DFC_MDCat_C DFES_GrpRpr.DFC_MDCatCrit_C DFES_GrpRpr.DFC_MDCatCurr_C DFES_GrpRpr.DFC_MDCyl_0_C DFES_GrpRpr.DFC_MDCyl_1_C DFES_GrpRpr.DFC_MDCyl_2_C DFES_GrpRpr.DFC_MDCyl_3_C DFES_GrpRpr.DFC_MDEmi_C DFES_GrpRpr.DFC_MDEmiStrt_C DFES_GrpRpr.DFC_MDFco_C DFES_GrpRpr.DFC_MDMpl_C DFES_GrpRpr.DFC_MDSegTiAdpn_C DFES_GrpRpr.DFC_MDmax_C DFES_GrpRpr.DFC_MFuOilMax_C DFES_GrpRpr.DFC_MOXEMM_SMU_ALM0_0_C DFES_GrpRpr.DFC_MOXEMM_SMU_ALM0_1_C DFES_GrpRpr.DFC_MOXEMM_SMU_ALM0_10_C DFES_GrpRpr.DFC_MOXEMM_SMU_ALM0_11_C DFES_GrpRpr.DFC_MOXEMM_SMU_ALM0_13_C DFES_GrpRpr.DFC_MOXEMM_SMU_ALM0_14_C DFES_GrpRpr.DFC_MOXEMM_SMU_ALM0_2_C DFES_GrpRpr.DFC_MOXEMM_SMU_ALM0_22_C DFES_GrpRpr.DFC_MOXEMM_SMU_ALM0_23_C DFES_GrpRpr.DFC_MOXEMM_SMU_ALM0_4_C DFES_GrpRpr.DFC_MOXEMM_SMU_ALM0_5_C DFES_GrpRpr.DFC_MOXEMM_SMU_ALM0_7_C DFES_GrpRpr.DFC_MOXEMM_SMU_ALM0_8_C DFES_GrpRpr.DFC_MOXEMM_SMU_ALM10_16_C DFES_GrpRpr.DFC_MOXEMM_SMU_ALM10_17_C DFES_GrpRpr.DFC_MOXEMM_SMU_ALM10_21_C DFES_GrpRpr.DFC_MOXEMM_SMU_ALM11_0_C DFES_GrpRpr.DFC_MOXEMM_SMU_ALM11_1_C DFES_GrpRpr.DFC_MOXEMM_SMU_ALM11_2_C DFES_GrpRpr.DFC_MOXEMM_SMU_ALM11_3_C DFES_GrpRpr.DFC_MOXEMM_SMU_ALM11_4_C DFES_GrpRpr.DFC_MOXEMM_SMU_ALM11_5_C DFES_GrpRpr.DFC_MOXEMM_SMU_ALM11_8_C DFES_GrpRpr.DFC_MOXEMM_SMU_ALM11_9_C DFES_GrpRpr.DFC_MOXEMM_SMU_ALM1_0_C DFES_GrpRpr.DFC_MOXEMM_SMU_ALM1_1_C DFES_GrpRpr.DFC_MOXEMM_SMU_ALM1_10_C DFES_GrpRpr.DFC_MOXEMM_SMU_ALM1_11_C DFES_GrpRpr.DFC_MOXEMM_SMU_ALM1_13_C DFES_GrpRpr.DFC_MOXEMM_SMU_ALM1_14_C DFES_GrpRpr.DFC_MOXEMM_SMU_ALM1_2_C DFES_GrpRpr.DFC_MOXEMM_SMU_ALM1_22_C DFES_GrpRpr.DFC_MOXEMM_SMU_ALM1_23_C DFES_GrpRpr.DFC_MOXEMM_SMU_ALM1_4_C DFES_GrpRpr.DFC_MOXEMM_SMU_ALM1_5_C DFES_GrpRpr.DFC_MOXEMM_SMU_ALM1_7_C DFES_GrpRpr.DFC_MOXEMM_SMU_ALM1_8_C DFES_GrpRpr.DFC_MOXEMM_SMU_ALM21_0_C DFES_GrpRpr.DFC_MOXEMM_SMU_ALM21_16_C DFES_GrpRpr.DFC_MOXEMM_SMU_ALM21_3_C DFES_GrpRpr.DFC_MOXEMM_SMU_ALM2_1_C DFES_GrpRpr.DFC_MOXEMM_SMU_ALM2_10_C DFES_GrpRpr.DFC_MOXEMM_SMU_ALM2_11_C DFES_GrpRpr.DFC_MOXEMM_SMU_ALM2_13_C DFES_GrpRpr.DFC_MOXEMM_SMU_ALM2_14_C DFES_GrpRpr.DFC_MOXEMM_SMU_ALM2_22_C DFES_GrpRpr.DFC_MOXEMM_SMU_ALM2_23_C DFES_GrpRpr.DFC_MOXEMM_SMU_ALM2_4_C DFES_GrpRpr.DFC_MOXEMM_SMU_ALM2_5_C DFES_GrpRpr.DFC_MOXEMM_SMU_ALM2_7_C DFES_GrpRpr.DFC_MOXEMM_SMU_ALM2_8_C DFES_GrpRpr.DFC_MOXEMM_SMU_ALM6_0_C DFES_GrpRpr.DFC_MOXEMM_SMU_ALM6_11_C DFES_GrpRpr.DFC_MOXEMM_SMU_ALM6_12_C DFES_GrpRpr.DFC_MOXEMM_SMU_ALM6_14_C DFES_GrpRpr.DFC_MOXEMM_SMU_ALM6_15_C DFES_GrpRpr.DFC_MOXEMM_SMU_ALM6_17_C DFES_GrpRpr.DFC_MOXEMM_SMU_ALM6_18_C DFES_GrpRpr.DFC_MOXEMM_SMU_ALM6_20_C DFES_GrpRpr.DFC_MOXEMM_SMU_ALM6_21_C DFES_GrpRpr.DFC_MOXEMM_SMU_ALM6_25_C DFES_GrpRpr.DFC_MOXEMM_SMU_ALM6_4_C DFES_GrpRpr.DFC_MOXEMM_SMU_ALM6_5_C DFES_GrpRpr.DFC_MOXEMM_SMU_ALM6_7_C DFES_GrpRpr.DFC_MOXEMM_SMU_ALM6_8_C DFES_GrpRpr.DFC_MOXEMM_SMU_ALM7_1_C DFES_GrpRpr.DFC_MOXEMM_SMU_ALM7_12_C DFES_GrpRpr.DFC_MOXEMM_SMU_ALM7_13_C DFES_GrpRpr.DFC_MOXEMM_SMU_ALM7_14_C DFES_GrpRpr.DFC_MOXEMM_SMU_ALM7_15_C DFES_GrpRpr.DFC_MOXEMM_SMU_ALM7_16_C DFES_GrpRpr.DFC_MOXEMM_SMU_ALM7_17_C DFES_GrpRpr.DFC_MOXEMM_SMU_ALM7_2_C DFES_GrpRpr.DFC_MOXEMM_SMU_ALM7_20_C DFES_GrpRpr.DFC_MOXEMM_SMU_ALM7_25_C DFES_GrpRpr.DFC_MOXEMM_SMU_ALM7_26_C DFES_GrpRpr.DFC_MOXEMM_SMU_ALM7_28_C DFES_GrpRpr.DFC_MOXEMM_SMU_ALM7_29_C DFES_GrpRpr.DFC_MOXEMM_SMU_ALM7_30_C DFES_GrpRpr.DFC_MOXEMM_SMU_ALM7_31_C DFES_GrpRpr.DFC_MOXEMM_SMU_ALM8_0_C DFES_GrpRpr.DFC_MOXEMM_SMU_ALM8_1_C DFES_GrpRpr.DFC_MOXEMM_SMU_ALM8_10_C DFES_GrpRpr.DFC_MOXEMM_SMU_ALM8_11_C DFES_GrpRpr.DFC_MOXEMM_SMU_ALM8_12_C DFES_GrpRpr.DFC_MOXEMM_SMU_ALM8_16_C DFES_GrpRpr.DFC_MOXEMM_SMU_ALM8_18_C DFES_GrpRpr.DFC_MOXEMM_SMU_ALM8_2_C DFES_GrpRpr.DFC_MOXEMM_SMU_ALM8_3_C DFES_GrpRpr.DFC_MOXEMM_SMU_ALM8_31_C DFES_GrpRpr.DFC_MOXEMM_SMU_ALM8_4_C DFES_GrpRpr.DFC_MOXEMM_SMU_ALM9_0_C DFES_GrpRpr.DFC_MOXEMM_SMU_ALM9_15_C DFES_GrpRpr.DFC_MOXEMM_SMU_ALM9_3_C DFES_GrpRpr.DFC_MoCADCNTP_C DFES_GrpRpr.DFC_MoCADCTst_C DFES_GrpRpr.DFC_MoCSOPICO_C DFES_GrpRpr.DFC_MoFAPP_C DFES_GrpRpr.DFC_MoFAirFilgPrdc_C DFES_GrpRpr.DFC_MoFAirFlCtOffGdi_C DFES_GrpRpr.DFC_MoFAirFlCylGdi_C DFES_GrpRpr.DFC_MoFAirFlFF_C DFES_GrpRpr.DFC_MoFAirFlIn_C DFES_GrpRpr.DFC_MoFAirFlMixCtlGdiChkAirFl_C DFES_GrpRpr.DFC_MoFAirFlMixCtlGdiChkCtrl_C DFES_GrpRpr.DFC_MoFAirFlMode_C DFES_GrpRpr.DFC_MoFESpd_C DFES_GrpRpr.DFC_MoFIACo_C DFES_GrpRpr.DFC_MoFICOL1_C DFES_GrpRpr.DFC_MoFICOL2_C DFES_GrpRpr.DFC_MoFStrt_C DFES_GrpRpr.DFC_MoFTrqCmp_C DFES_GrpRpr.DFC_MoFTrqCmpMax_C DFES_GrpRpr.DFC_MoFTrqCmpMin_C DFES_GrpRpr.DFC_MoFVarPostBldSel_C DFES_GrpRpr.DFC_MoXEMMHwLTMCUFW_C DFES_GrpRpr.DFC_MoXEMMHwLTMonBIST_C DFES_GrpRpr.DFC_MoXEMMHwLTRegMonTest_C DFES_GrpRpr.DFC_MoXEMMHwLTStbySMUAlvTest_C DFES_GrpRpr.DFC_MoXEMMHwLTTempSens_C DFES_GrpRpr.DFC_MoXEMMHwLTUCBCfg_C DFES_GrpRpr.DFC_NWSEmax_C DFES_GrpRpr.DFC_NWSmax_C DFES_GrpRpr.DFC_OCWDAABEActv_C DFES_GrpRpr.DFC_OCWDACom_C DFES_GrpRpr.DFC_OCWDAErrPin_C DFES_GrpRpr.DFC_OCWDAOvrVltg_C DFES_GrpRpr.DFC_ORAmax_C DFES_GrpRpr.DFC_ORAmin_C DFES_GrpRpr.DFC_OilPPlaus_C DFES_GrpRpr.DFC_PLLSUmax_C DFES_GrpRpr.DFC_PLLSUmin_C DFES_GrpRpr.DFC_PSR1max_C DFES_GrpRpr.DFC_PSRBmax_C DFES_GrpRpr.DFC_PSRBmin_C DFES_GrpRpr.DFC_PSRPmax_C DFES_GrpRpr.DFC_PSRPmin_C DFES_GrpRpr.DFC_PSRPsig_C DFES_GrpRpr.DFC_PSRmax_C DFES_GrpRpr.DFC_PUmax_C DFES_GrpRpr.DFC_P_VSE11_OL_C DFES_GrpRpr.DFC_P_VSE11_SCB_C DFES_GrpRpr.DFC_P_VSE11_SCG_C DFES_GrpRpr.DFC_PhyHighAPP1_C DFES_GrpRpr.DFC_PhyHighAPP2_C DFES_GrpRpr.DFC_PhyLowAPP1_C DFES_GrpRpr.DFC_PhyLowAPP2_C DFES_GrpRpr.DFC_SRCHighAPP1_C DFES_GrpRpr.DFC_SRCHighAPP2_C DFES_GrpRpr.DFC_SRCLowAPP1_C DFES_GrpRpr.DFC_SRCLowAPP2_C DFES_GrpRpr.DFC_SSpMon2_C DFES_GrpRpr.DFC_STHDRmax_C DFES_GrpRpr.DFC_SWReset_0_C DFES_GrpRpr.DFC_SWReset_1_C DFES_GrpRpr.DFC_SWReset_2_C DFES_GrpRpr.DFC_SyncAPP_C DFES_GrpRpr.DFC_TANKLnpl_C DFES_GrpRpr.DFC_TAmax_Dummy_C DFES_GrpRpr.DFC_TESFmax_C DFES_GrpRpr.DFC_TESGmax_C DFES_GrpRpr.DFC_TKAEmax_C DFES_GrpRpr.DFC_TKAEmin_C DFES_GrpRpr.DFC_TKARmax_C DFES_GrpRpr.DFC_TKARnpl_C DFES_GrpRpr.DFC_TMmax_Dummy_C DFES_GrpRpr.DFC_TUMmax_Dummy_C DFES_GrpRpr.DFC_TWCDPriCatB1_C DFES_GrpRpr.DFC_ThrVlvClsdPosnFirstOffsLrnImpoB1_C DFES_GrpRpr.DFC_ThrVlvClsdPosnOffsLrnImpoB1_C DFES_GrpRpr.DFC_ThrVlvClsdPosnOffsLrnMaxB1_C DFES_GrpRpr.DFC_ThrVlvClsdPosnOffsLrnMinB1_C DFES_GrpRpr.DFC_ThrVlvCtrlDeB1_C DFES_GrpRpr.DFC_ThrVlvDycB1_C DFES_GrpRpr.DFC_ThrVlvLimpAirPosnMaxAbsltDriftB1_C DFES_GrpRpr.DFC_ThrVlvLimpAirPosnMaxB1_C DFES_GrpRpr.DFC_ThrVlvLimpAirPosnMaxRelDriftB1_C DFES_GrpRpr.DFC_ThrVlvLimpAirPosnMinB1_C DFES_GrpRpr.DFC_ThrVlvOpenLoadB1_C DFES_GrpRpr.DFC_ThrVlvOpenSprgB1_C DFES_GrpRpr.DFC_ThrVlvOpenSprgSprdB1_C DFES_GrpRpr.DFC_ThrVlvOpenSprgTwnB1_C DFES_GrpRpr.DFC_ThrVlvOverTB1_C DFES_GrpRpr.DFC_ThrVlvRetSprgB1_C DFES_GrpRpr.DFC_ThrVlvRetSprgSprdB1_C DFES_GrpRpr.DFC_ThrVlvRetSprgTwnB1_C DFES_GrpRpr.DFC_ThrVlvSens1MaxB1_C DFES_GrpRpr.DFC_ThrVlvSens1NplB1_C DFES_GrpRpr.DFC_ThrVlvSens2MaxB1_C DFES_GrpRpr.DFC_ThrVlvSens2MinB1_C DFES_GrpRpr.DFC_ThrVlvSens2NplB1_C DFES_GrpRpr.DFC_ThrVlvShoCircB1_C DFES_GrpRpr.DFC_ThrVlvSpiErrB1_C DFES_GrpRpr.DFC_ThrvlvSens1MinB1_C DFES_GrpRpr.DFC_TiOffTBasdChkFast_C DFES_GrpRpr.DFC_TiOffTBasdChkSlow_C DFES_GrpRpr.DFC_UEGOSnsrMntdS1B1_C DFES_GrpRpr.DFC_VehVSig_C DFES_GrpRpr.DFC_VlvLftFbSwtIntk11SpclFail_C DFES_GrpRpr.DFC_VlvLftFbSwtIntk11StdFail_C DFES_MonEvtMSK0_C DFES_MonEvtMSK1_C DFES_MonRepeat_C DFES_numClsDlt_CA DFES_numClsFaultCycl_CA DFES_numClsHealCycl_CA DFES_numClsPndDlt_CA DFES_numClsSvcDlt_CA DFES_numClsSVSFaultCycl_CA DFES_numClsSVSHealCycl_CA DFES_numPDTC_C DFES_ThresSimCond.n_C DFES_ThresSimCond.r_C DFES_ThresSimCond.t_C /end DEF_CHARACTERISTIC
 FUNCTION_VERSION "30000.73.0_2.0.0" /end FUNCTION
/begin COMPU_METHOD DFC_Verb "" TAB_VERB "%6.3" "-" COMPU_TAB_REF DFC_Verb /end COMPU_METHOD
/begin COMPU_VTAB DFC_Verb "" TAB_VERB 907 0 "DFC_Unused" 1 "DFC_AAVEmax" 2 "DFC_AAVEmin" 3 "DFC_AAVEsig" 508 "DFC_AAVmin" 379 "DFC_ACEvpTPhysRngHi" 380 "DFC_ACEvpTPhysRngLo" 381 "DFC_ACEvpTSRCMax" 382 "DFC_ACEvpTSRCMin" 288 "DFC_AfsPhyRngHiB1" 289 "DFC_AfsPhyRngLoB1" 510 "DFC_AfsPlausDiagHi" 511 "DFC_AfsPlausDiagLo" 383 "DFC_AfsRawSigRngHiB1" 384 "DFC_AfsRawSigRngLoB1" 415 "DFC_AfsSigErrLineHiB1" 416 "DFC_AfsSigErrLineLoB1" 385 "DFC_AfsSnsrErrB1" 512 "DFC_AfsVrntDiagErrB1" 509 "DFC_AGRSUS" 386 "DFC_AirCClntPAnaSRCMax" 387 "DFC_AirCClntPAnaSRCMin" 290 "DFC_AirCCmprOL" 291 "DFC_AirCCmprOvrTemp" 292 "DFC_AirCCmprSCB" 293 "DFC_AirCCmprSCG" 388 "DFC_AirCSwtNpl" 389 "DFC_AirCSwtSig" 294 "DFC_AltErr" 4 "DFC_AltIOACGFailr" 5 "DFC_AltIOACGHiVltg" 6 "DFC_AltIOACGLoVltg" 7 "DFC_AltIOACGTHi" 8 "DFC_AltIODConnACG" 513 "DFC_AppAllSnsrDfct" 10 "DFC_BattUHiFailr" 11 "DFC_BattULoFailr" 295 "DFC_BattUSRCMax" 296 "DFC_BattUSRCMin" 516 "DFC_BattUStdbyDiaOL" 514 "DFC_BBKRnldg" 515 "DFC_BBKRsyne" 9 "DFC_BGOELWAF" 517 "DFC_BigLeakIntkMnfldEmiInfl" 518 "DFC_BlkdLineTank" 390 "DFC_Brk" 12 "DFC_BrkBstPDriftHiErr" 13 "DFC_BrkBstPDriftLoErr" 14 "DFC_BrkBstPSnsrStuck" 391 "DFC_BrkBstSensSCB" 392 "DFC_BrkBstSensSCG" 15 "DFC_BrkMnSwtContOn" 519 "DFC_BrkMnSwtContOnWarnLmp" 16 "DFC_BrkMnSwtNotStp" 520 "DFC_BrkMnSwtNotStpWarnLmp" 17 "DFC_BrkNpl" 18 "DFC_BrkRdntSwtContOn" 521 "DFC_BrkRdntSwtContOnWarnLmp" 19 "DFC_BrkRdntSwtNotStp" 522 "DFC_BrkRdntSwtNotStpWarnLmp" 393 "DFC_BrkSig" 496 "DFC_BSWM_E_ACTION_FAILED" 497 "DFC_BSWM_E_INTRPTQUEUE_FULL" 472 "DFC_BusDiagCANAPPLBusOff" 473 "DFC_BusDiagCANCANCBusOff" 474 "DFC_BusDiagCANVEHICLEBusOff" 490 "DFC_CAN_E_TIMEOUT" 523 "DFC_CEngDsTColdStrtMax" 524 "DFC_CEngDsTColdStrtMin" 525 "DFC_CEngDsTImps" 526 "DFC_CEngDsTPlausHSC" 527 "DFC_CEngDsTPlausLSC" 528 "DFC_CEngDsTPlausSTC" 531 "DFC_CEngDsTSig" 529 "DFC_CEngDsTSRCMax" 530 "DFC_CEngDsTSRCMin" 532 "DFC_CEngUsTColdStrtMax" 533 "DFC_CEngUsTColdStrtMin" 534 "DFC_CEngUsTLooseCnctn" 535 "DFC_CEngUsTSRCMax" 536 "DFC_CEngUsTSRCMin" 432 "DFC_Clth2ONStuck" 433 "DFC_Clth2ONStuckLdc" 20 "DFC_Clth3ONStuck" 434 "DFC_Clth3ONStuckLdc" 435 "DFC_Clth3ONStuckPostDrv" 21 "DFC_Clth4OFFStuck" 436 "DFC_Clth4ONStuck" 437 "DFC_Clth4ONStuckLdc" 260 "DFC_ClthMax" 412 "DFC_ClthNpl" 22 "DFC_ClthOFFStuck" 23 "DFC_ClthONStuck" 394 "DFC_ClthSig" 24 "DFC_ClthStkFailInfo" 25 "DFC_ComACFailInfo" 26 "DFC_ComATFTValErr" 27 "DFC_ComATMILReq" 28 "DFC_ComAYCAChksum" 29 "DFC_ComAYCARingCnt" 30 "DFC_ComAYCATOut" 31 "DFC_ComAYCDChkSum" 32 "DFC_ComAYCDTOut" 33 "DFC_ComAYCFChksum" 34 "DFC_ComAYCFRingCnt" 35 "DFC_ComAYCFTOut" 36 "DFC_ComAYCGChksum" 37 "DFC_ComAYCGRingCnt" 38 "DFC_ComAYCGTOut" 39 "DFC_ComAYCIChkSum" 40 "DFC_ComAYCIRingCnt" 41 "DFC_ComAYCITOut" 42 "DFC_ComBCM1ChkSum" 43 "DFC_ComBCM1RingCnt" 44 "DFC_ComBCM1TOut" 438 "DFC_ComBCMUnit" 45 "DFC_ComCANABusOffErr" 46 "DFC_ComCANBBusOffErr" 47 "DFC_ComCANCBusOffErr" 48 "DFC_ComCGW1ChkSum" 49 "DFC_ComCGW1RingCnt" 50 "DFC_ComCGW1TOut" 297 "DFC_ComChksTCU1" 298 "DFC_ComChksTCU11" 299 "DFC_ComChksTCU12" 300 "DFC_ComChksTCU13" 301 "DFC_ComChksTCU2" 302 "DFC_ComChksTCU3" 303 "DFC_ComChksTCU4" 304 "DFC_ComCntTCU1" 305 "DFC_ComCntTCU11" 306 "DFC_ComCntTCU12" 307 "DFC_ComCntTCU13" 308 "DFC_ComCntTCU2" 309 "DFC_ComCntTCU3" 310 "DFC_ComCntTCU4" 51 "DFC_ComConvBoostErr" 52 "DFC_ComConvSlipErr" 537 "DFC_ComDCDCACCFailr" 53 "DFC_ComDCDCPrfmncErr" 54 "DFC_ComDCDCTempWarn" 439 "DFC_ComDLCTCU01" 440 "DFC_ComDLCTCU02" 441 "DFC_ComDLCTCU1" 442 "DFC_ComDLCTCU11" 443 "DFC_ComDLCTCU12" 444 "DFC_ComDLCTCU13" 445 "DFC_ComDLCTCU14" 446 "DFC_ComDLCTCU2" 447 "DFC_ComDLCTCU3" 448 "DFC_ComDLCTCU4" 55 "DFC_ComEAT10Chksum" 56 "DFC_ComEAT10RingCnt" 57 "DFC_ComEAT10TOut" 58 "DFC_ComEAT11ChkSum" 59 "DFC_ComEAT11RingCnt" 60 "DFC_ComEAT11TOut" 61 "DFC_ComEAT12ChkSum" 62 "DFC_ComEAT12RingCnt" 63 "DFC_ComEAT12TOut" 64 "DFC_ComEAT13ChkSum" 65 "DFC_ComEAT13RingCnt" 66 "DFC_ComEAT13TOut" 67 "DFC_ComEAT1Chksum" 68 "DFC_ComEAT1RingCnt" 69 "DFC_ComEAT1TOut" 70 "DFC_ComEAT2ChkSum" 71 "DFC_ComEAT2RingCnt" 72 "DFC_ComEAT2TOut" 73 "DFC_ComEAT4ChkSum" 74 "DFC_ComEAT4RingCnt" 75 "DFC_ComEAT4TOut" 76 "DFC_ComEAT6Chksum" 77 "DFC_ComEAT6RingCnt" 78 "DFC_ComEAT6TOut" 79 "DFC_ComEAT7Chksum" 80 "DFC_ComEAT7RingCnt" 81 "DFC_ComEAT7TOut" 82 "DFC_ComEAT8Chksum" 83 "DFC_ComEAT8RingCnt" 84 "DFC_ComEAT8TOut" 85 "DFC_ComEATAChksum" 86 "DFC_ComEATARingCnt" 87 "DFC_ComEATATOut" 88 "DFC_ComEATBChkSum" 89 "DFC_ComEATBRingCnt" 90 "DFC_ComEATBTOut" 91 "DFC_ComEATCChksum" 92 "DFC_ComEATCRingCnt" 93 "DFC_ComEATCTOut" 103 "DFC_ComEngCanRxErr" 94 "DFC_ComEPBBChkSum" 95 "DFC_ComEPBBRingCnt" 96 "DFC_ComEPBBTOut" 97 "DFC_ComEPBChksum" 99 "DFC_ComEPBctRing" 98 "DFC_ComEPBTOut" 100 "DFC_ComEPS1Chksum" 101 "DFC_ComEPS1RingCnt" 102 "DFC_ComEPS1TOut" 449 "DFC_ComEPSUnit" 104 "DFC_ComGrvySnsrErr" 105 "DFC_ComGwIMG1ChkSum" 106 "DFC_ComGwIMG1RingCnt" 107 "DFC_ComGwIMG1TOut" 108 "DFC_ComGwIMG3ChkSum" 109 "DFC_ComGwIMG3RingCnt" 110 "DFC_ComGwIMG3TOut" 111 "DFC_ComGwIMG4ChkSum" 112 "DFC_ComGwIMG4RingCnt" 113 "DFC_ComGwIMG4TOut" 114 "DFC_ComGwIMG5ChkSum" 115 "DFC_ComGwIMG5RingCnt" 116 "DFC_ComGwIMG5TOut" 117 "DFC_ComGwIMG6ChkSum" 118 "DFC_ComGwIMG6RingCnt" 119 "DFC_ComGwIMG6TOut" 120 "DFC_ComIDASBChksum" 121 "DFC_ComIDASBRingCnt" 122 "DFC_ComIDASBTOut" 450 "DFC_ComIDASBUnit" 123 "DFC_ComIMGMILReq" 451 "DFC_ComIMGUnit" 124 "DFC_ComISSPrms" 125 "DFC_ComMETAChksum" 126 "DFC_ComMETAChksumPstDrv" 127 "DFC_ComMETARingCnt" 128 "DFC_ComMETARingCntPstDrv" 129 "DFC_ComMETATOut" 130 "DFC_ComMETATOutPstDrv" 131 "DFC_ComMETCChksum" 132 "DFC_ComMETCRingCnt" 133 "DFC_ComMETCTOut" 134 "DFC_ComMETDChksum" 135 "DFC_ComMETDRingCnt" 136 "DFC_ComMETDTOut" 137 "DFC_ComMETE2Chksum" 138 "DFC_ComMETE2RingCnt" 139 "DFC_ComMETE2TOut" 140 "DFC_ComMETFChksum" 141 "DFC_ComMETFRingCnt" 142 "DFC_ComMETFTOut" 143 "DFC_ComMETGChksum" 144 "DFC_ComMETGRingCnt" 145 "DFC_ComMETGTOut" 146 "DFC_ComMETH2Chksum" 147 "DFC_ComMETH2RingCnt" 148 "DFC_ComMETH2TOut" 149 "DFC_ComMETHChksum" 150 "DFC_ComMETHRingCnt" 151 "DFC_ComMETHTOut" 152 "DFC_ComMETIChksum" 153 "DFC_ComMETIRingCnt" 154 "DFC_ComMETITOut" 155 "DFC_ComMETKChksum" 156 "DFC_ComMETKRingCnt" 157 "DFC_ComMETKTOut" 158 "DFC_ComMETLChksum" 159 "DFC_ComMETLRingCnt" 160 "DFC_ComMETLTOut" 161 "DFC_ComMETMChksum" 162 "DFC_ComMETMRingCnt" 163 "DFC_ComMETMTOut" 164 "DFC_ComMETNChksum" 165 "DFC_ComMETNRingCnt" 166 "DFC_ComMETNTOut" 452 "DFC_ComMETUnit" 167 "DFC_ComMtrCom" 168 "DFC_ComPCUChkSum" 169 "DFC_ComPCURingCnt" 170 "DFC_ComPCUTOut" 171 "DFC_ComSRSAChksum" 172 "DFC_ComSRSARingCnt" 173 "DFC_ComSRSATOut" 174 "DFC_ComSRSBChksum" 175 "DFC_ComSRSBRingCnt" 176 "DFC_ComSRSBTOut" 177 "DFC_ComSRSChksum" 178 "DFC_ComSRSErr" 179 "DFC_ComSRSRingCnt" 180 "DFC_ComSRSTOut" 453 "DFC_ComSRSUnit" 311 "DFC_ComTOutTCU01" 312 "DFC_ComTOutTCU02" 313 "DFC_ComTOutTCU1" 314 "DFC_ComTOutTCU11" 315 "DFC_ComTOutTCU12" 316 "DFC_ComTOutTCU13" 317 "DFC_ComTOutTCU14" 318 "DFC_ComTOutTCU2" 319 "DFC_ComTOutTCU3" 320 "DFC_ComTOutTCU4" 181 "DFC_ComVehSpdPndFltTCU" 454 "DFC_ComVSAUnit" 538 "DFC_DCDCFltDet" 321 "DFC_DevLibBattUHi" 322 "DFC_DevLibBattULo" 357 "DFC_DHFHD" 558 "DFC_DiagCpv1DteskLoLoadStuckClsd" 559 "DFC_DiagCpv1DteskLoLoadStuckOpen" 541 "DFC_DKnpl" 539 "DFC_DKRSA" 540 "DFC_DKVSmax" 542 "DFC_DSKVRmax" 543 "DFC_DSKVRmin" 544 "DFC_DSKVRnpl" 545 "DFC_DSKVRsig" 546 "DFC_DSKVSsig" 547 "DFC_DSSmax" 548 "DFC_DSTDmax" 549 "DFC_DSTEmax" 550 "DFC_DSTEmin" 551 "DFC_DSTOFmax" 552 "DFC_DSTRmax" 553 "DFC_DSTRmin" 554 "DFC_DSTRnpl" 555 "DFC_DSTRsig" 556 "DFC_DSTTI" 557 "DFC_DSUmax" 182 "DFC_EbsChartcCurrErr" 183 "DFC_EbsSelfDiagErr" 455 "DFC_EbsSocFlt" 395 "DFC_EGRVlvCurrLim" 560 "DFC_EGRVlvDrftClsd" 561 "DFC_EGRVlvDrftOpn" 323 "DFC_EGRVlvFailSafeActv" 324 "DFC_EGRVlvGovDvtCld" 562 "DFC_EGRVlvJamVlvClsd" 563 "DFC_EGRVlvJamVlvOpn" 396 "DFC_EGRVlvOL" 397 "DFC_EGRVlvOvrTemp" 325 "DFC_EGRVlvPhysSRCMax" 326 "DFC_EGRVlvPhysSRCMin" 398 "DFC_EGRVlvSCB" 399 "DFC_EGRVlvSCG" 564 "DFC_EGRVlvSprgBrk" 400 "DFC_EGRVlvSRCMax" 401 "DFC_EGRVlvSRCMin" 565 "DFC_EGRVlvTempMdlEEPErr" 566 "DFC_EGRVlvTmpErr" 567 "DFC_EGSDUS2B1LtrDly" 568 "DFC_EGSDUS2B1LtrPT1" 569 "DFC_EGSDUS2B1RtlDly" 570 "DFC_EGSDUS2B1RtlPT1" 571 "DFC_EGSDUS2B1TarLean" 572 "DFC_EGSDUS2B1TarRich" 586 "DFC_EngICO" 587 "DFC_EngPrtOvrSpdMon" 573 "DFC_EONVmax" 588 "DFC_EpmCaSI1ErrSig" 589 "DFC_EpmCaSI1MntErr" 590 "DFC_EpmCaSI1NoSigMax" 591 "DFC_EpmCaSI1NoSigMin" 592 "DFC_EpmCaSI1OfsErr" 593 "DFC_EpmCrSDGI" 594 "DFC_EpmCrSErrSig" 595 "DFC_EpmCrSNoSig" 596 "DFC_EtaEngIdleNonCsers" 597 "DFC_EtaEngPtlNonCsers" 574 "DFC_ETAKHLmax" 575 "DFC_ETAKHTmax" 576 "DFC_ETHSEmax" 577 "DFC_ETHSEmin" 578 "DFC_ETHSFmax" 579 "DFC_ETHSFmin" 580 "DFC_ETHSFsig" 581 "DFC_ETHSNPWmax" 582 "DFC_ETHSNPWmin" 583 "DFC_ETHSNPWsig" 584 "DFC_ETHSPLnpl" 585 "DFC_ETHSTPLnpl" 327 "DFC_FanDIOOL_0" 328 "DFC_FanDIOOL_1" 329 "DFC_FanDIOOvrTemp_0" 330 "DFC_FanDIOOvrTemp_1" 331 "DFC_FanDIOSCB_0" 332 "DFC_FanDIOSCB_1" 333 "DFC_FanDIOSCG_0" 334 "DFC_FanDIOSCG_1" 598 "DFC_FRAmax" 599 "DFC_FRAmin" 600 "DFC_FSTEmax" 601 "DFC_FSTEmin" 605 "DFC_FSTmax" 602 "DFC_FSTRmax" 603 "DFC_FSTRmin" 604 "DFC_FSTRnpl" 606 "DFC_FTDLAmax" 607 "DFC_FTDLAmin" 608 "DFC_FuPHiSnsrEleclmax" 609 "DFC_FuPHiSnsrEleclmin" 610 "DFC_FuPHiSnsrEleclnpl" 611 "DFC_FuPHiSnsrURngMax" 612 "DFC_FuPHiSnsrURngMin" 613 "DFC_FuSnsrPhyRngMaxErr" 614 "DFC_FuSnsrPhyRngMinErr" 188 "DFC_GbxCANDigPlausErr" 189 "DFC_GbxNPos1SRCMax" 190 "DFC_GbxNPos1SRCMin" 191 "DFC_GbxNPos2SRCMax" 192 "DFC_GbxNPos2SRCMin" 193 "DFC_GbxNPosAlvChk" 194 "DFC_GbxNPosSyncErr" 413 "DFC_GbxPNPosnDrvCdn" 414 "DFC_GbxPNPosnPlausy" 618 "DFC_GbxRvsSwtStk" 615 "DFC_GEVlvLockPinDiagIntkB1" 184 "DFC_GEVlvPhaCsersIntkB1" 185 "DFC_GEVlvPhaPsOpenLoadIntkB1" 186 "DFC_GEVlvPhaPsShoToBattIntkB1" 187 "DFC_GEVlvPhaPsShoToGndIntkB1" 616 "DFC_GEVlvPhaSlowIntkB1" 617 "DFC_GEVlvPhaTargIntkB1" 619 "DFC_HDRKHmax" 620 "DFC_HDRKHmin" 623 "DFC_HDRmax" 624 "DFC_HDRmin" 621 "DFC_HDRPLmax" 622 "DFC_HDRPLmin" 625 "DFC_HEGOS2B1ElecMax" 626 "DFC_HEGOS2B1ElecMin" 627 "DFC_HEGOS2B1ElecSig" 628 "DFC_HEGOS2B1HtgNpl" 195 "DFC_HEGOS2B1HtrPsMax" 196 "DFC_HEGOS2B1HtrPsMin" 197 "DFC_HEGOS2B1HtrPsSig" 629 "DFC_HEV00max" 630 "DFC_HEV01max" 631 "DFC_HEV02max" 632 "DFC_HEV03max" 633 "DFC_HEVE0max" 634 "DFC_HEVE1max" 635 "DFC_HFMmax" 636 "DFC_HiPSysHiPMaxLimExcdd" 402 "DFC_HLSDemOvhtEngLim" 456 "DFC_I14229VINErr" 261 "DFC_IgnClPs_DevComErr" 262 "DFC_IgnClPs_LineOl_0" 263 "DFC_IgnClPs_LineOl_1" 264 "DFC_IgnClPs_LineOl_2" 265 "DFC_IgnClPs_LineOl_3" 266 "DFC_IgnClPs_LineScb_0" 267 "DFC_IgnClPs_LineScb_1" 268 "DFC_IgnClPs_LineScb_2" 269 "DFC_IgnClPs_LineScb_3" 270 "DFC_IgnClPs_LineScg_0" 271 "DFC_IgnClPs_LineScg_1" 272 "DFC_IgnClPs_LineScg_2" 273 "DFC_IgnClPs_LineScg_3" 457 "DFC_InjCatHeatgErr" 458 "DFC_InjSysMulInjDiagErr" 358 "DFC_InjVlv_DI_DcDc" 359 "DFC_InjVlv_DI_NoLd_0" 360 "DFC_InjVlv_DI_NoLd_1" 361 "DFC_InjVlv_DI_NoLd_2" 362 "DFC_InjVlv_DI_NoLd_3" 363 "DFC_InjVlv_DI_ScBnk_0" 364 "DFC_InjVlv_DI_ScBnk_1" 365 "DFC_InjVlv_DI_ScBnk_2" 366 "DFC_InjVlv_DI_ScBnk_3" 367 "DFC_InjVlv_DI_ScCyl_0" 368 "DFC_InjVlv_DI_ScCyl_1" 369 "DFC_InjVlv_DI_ScCyl_2" 370 "DFC_InjVlv_DI_ScCyl_3" 371 "DFC_InjVlv_DI_ScHsLs_0" 372 "DFC_InjVlv_DI_ScHsLs_1" 373 "DFC_InjVlv_DI_ScHsLs_2" 374 "DFC_InjVlv_DI_ScHsLs_3" 652 "DFC_IntkAirTAirFltDsCrssMax" 653 "DFC_IntkAirTAirFltDsCrssMin" 654 "DFC_IntkAirTAirFltDsHSCMax" 655 "DFC_IntkAirTAirFltDsImps" 656 "DFC_IntkAirTAirFltDsPRCMax" 657 "DFC_IntkAirTAirFltDsPRCMin" 658 "DFC_IntkAirTAirFltDsSRCMax" 659 "DFC_IntkAirTAirFltDsSRCMin" 660 "DFC_IntkAirTAirFltDsSTC" 661 "DFC_IntkAirTIntkMnfldCrssMax" 662 "DFC_IntkAirTIntkMnfldCrssMin" 663 "DFC_IntkAirTIntkMnfldHSCMax" 664 "DFC_IntkAirTIntkMnfldImps" 665 "DFC_IntkAirTIntkMnfldPRCMax" 666 "DFC_IntkAirTIntkMnfldPRCMin" 667 "DFC_IntkAirTIntkMnfldSRCMax" 668 "DFC_IntkAirTIntkMnfldSRCMin" 669 "DFC_IntkAirTIntkMnfldSTC" 647 "DFC_IVGdiCtl_CvoErr" 648 "DFC_IVGdiCtl_CvoSigPlaus_0" 649 "DFC_IVGdiCtl_CvoSigPlaus_1" 650 "DFC_IVGdiCtl_CvoSigPlaus_2" 651 "DFC_IVGdiCtl_CvoSigPlaus_3" 637 "DFC_IVGdiCtlCvoErrMax_0" 638 "DFC_IVGdiCtlCvoErrMax_1" 639 "DFC_IVGdiCtlCvoErrMax_2" 640 "DFC_IVGdiCtlCvoErrMax_3" 641 "DFC_IVGdiCtlCvoErrMin_0" 642 "DFC_IVGdiCtlCvoErrMin_1" 643 "DFC_IVGdiCtlCvoErrMin_2" 644 "DFC_IVGdiCtlCvoErrMin_3" 645 "DFC_IVGdiCtlCvoErrMinMax" 646 "DFC_IVGdiCtlCvoSigPlausErrSmrCdn" 428 "DFC_KnDetSens1PortAMax" 429 "DFC_KnDetSens1PortAMin" 430 "DFC_KnDetSens1PortBMax" 431 "DFC_KnDetSens1PortBMin" 670 "DFC_KRREGRLMX" 671 "DFC_KRVEKOCVLCI" 672 "DFC_KRVEKOENCHMT" 673 "DFC_KRVEKOENCHMT0" 674 "DFC_KRVEKOENCHMT1" 675 "DFC_KRVEKOENCHMT2" 676 "DFC_KRVEKOENCHMT3" 677 "DFC_KRVEKOENCHMT4" 678 "DFC_KRVEKOENCHMT5" 679 "DFC_KRVEKOENCHMT6" 680 "DFC_KRVEKOENCHMT7" 274 "DFC_KRVEKOEVAB" 275 "DFC_KRVEKOEVAB0" 276 "DFC_KRVEKOEVAB1" 277 "DFC_KRVEKOEVAB2" 278 "DFC_KRVEKOEVAB3" 681 "DFC_KRVEKORLMX" 682 "DFC_KRVEKORLMXL" 683 "DFC_KS1max" 684 "DFC_KS1min" 687 "DFC_LamDynDiagS1B1" 688 "DFC_LeakIntkMnfldEmiInfl" 491 "DFC_LIN_E_TIMEOUT" 465 "DFC_LinACGUnit" 466 "DFC_LinAEVUnit" 198 "DFC_LinCSErrACG" 199 "DFC_LinCSErrAEV" 200 "DFC_LinCSErrDCDC" 201 "DFC_LinCSErrEBS" 467 "DFC_LinEBSUnit" 689 "DFC_LinFrameErrDCDC" 202 "DFC_LinHdrTimeoutErrACG" 203 "DFC_LinHdrTimeoutErrAEV" 204 "DFC_LinHdrTimeoutErrDCDC" 205 "DFC_LinHdrTimeoutErrEBS" 206 "DFC_LinMsgTimeoutErrACG" 207 "DFC_LinMsgTimeoutErrAEV" 208 "DFC_LinMsgTimeoutErrDCDC" 209 "DFC_LinMsgTimeoutErrEBS" 210 "DFC_LinNoStrtComErr" 690 "DFC_LinOverrunErrDCDC" 459 "DFC_LLRHmax" 460 "DFC_LLRHmin" 461 "DFC_LLRHnpl" 462 "DFC_LLRKHmax" 463 "DFC_LLRKHmin" 464 "DFC_LLRKHnpl" 685 "DFC_LMmax" 211 "DFC_LowPresOilP" 686 "DFC_LZSRnpl" 691 "DFC_MD00max" 692 "DFC_MDBmax" 693 "DFC_MDCat" 694 "DFC_MDCatCrit" 695 "DFC_MDCatCurr" 696 "DFC_MDCyl_0" 697 "DFC_MDCyl_1" 698 "DFC_MDCyl_2" 699 "DFC_MDCyl_3" 700 "DFC_MDEmi" 701 "DFC_MDEmiStrt" 702 "DFC_MDFco" 705 "DFC_MDmax" 703 "DFC_MDMpl" 704 "DFC_MDSegTiAdpn" 375 "DFC_MfPsDiaOpenLoad1" 376 "DFC_MfPsDiaScHiS1" 377 "DFC_MfPsDiaScHiSLowS1" 378 "DFC_MfPsDiaScLowS1" 706 "DFC_MFuOilMax" 228 "DFC_MisfDetdVWhlFrntLePlaus" 229 "DFC_MisfDetdVWhlFrntRiPlaus" 230 "DFC_MisfDetdVWhlReLePlaus" 231 "DFC_MisfDetdVWhlReRiPlaus" 212 "DFC_MisfDetVWhlFrntLeOORHi" 213 "DFC_MisfDetVWhlFrntLeRatyHi" 214 "DFC_MisfDetVWhlFrntLeRatyLo" 215 "DFC_MisfDetVWhlFrntLeStuck" 216 "DFC_MisfDetVWhlFrntRiOORHi" 217 "DFC_MisfDetVWhlFrntRiRatyHi" 218 "DFC_MisfDetVWhlFrntRiRatyLo" 219 "DFC_MisfDetVWhlFrntRiStuck" 220 "DFC_MisfDetVWhlReLeOORHi" 221 "DFC_MisfDetVWhlReLeRatyHi" 222 "DFC_MisfDetVWhlReLeRatyLo" 223 "DFC_MisfDetVWhlReLeStuck" 224 "DFC_MisfDetVWhlReRiOORHi" 225 "DFC_MisfDetVWhlReRiRatyHi" 226 "DFC_MisfDetVWhlReRiRatyLo" 227 "DFC_MisfDetVWhlReRiStuck" 801 "DFC_MoCADCNTP" 802 "DFC_MoCADCTst" 803 "DFC_MoCSOPICO" 805 "DFC_MoFAirFilgPrdc" 806 "DFC_MoFAirFlCtOffGdi" 807 "DFC_MoFAirFlCylGdi" 808 "DFC_MoFAirFlFF" 809 "DFC_MoFAirFlIn" 810 "DFC_MoFAirFlMixCtlGdiChkAirFl" 811 "DFC_MoFAirFlMixCtlGdiChkCtrl" 812 "DFC_MoFAirFlMode" 804 "DFC_MoFAPP" 813 "DFC_MoFESpd" 814 "DFC_MoFIACo" 815 "DFC_MoFICOL1" 816 "DFC_MoFICOL2" 817 "DFC_MoFStrt" 818 "DFC_MoFTrqCmp" 819 "DFC_MoFTrqCmpMax" 820 "DFC_MoFTrqCmpMin" 821 "DFC_MoFVarPostBldSel" 707 "DFC_MOXEMM_SMU_ALM0_0" 708 "DFC_MOXEMM_SMU_ALM0_1" 709 "DFC_MOXEMM_SMU_ALM0_10" 710 "DFC_MOXEMM_SMU_ALM0_11" 711 "DFC_MOXEMM_SMU_ALM0_13" 712 "DFC_MOXEMM_SMU_ALM0_14" 713 "DFC_MOXEMM_SMU_ALM0_2" 714 "DFC_MOXEMM_SMU_ALM0_22" 715 "DFC_MOXEMM_SMU_ALM0_23" 716 "DFC_MOXEMM_SMU_ALM0_4" 717 "DFC_MOXEMM_SMU_ALM0_5" 718 "DFC_MOXEMM_SMU_ALM0_7" 719 "DFC_MOXEMM_SMU_ALM0_8" 720 "DFC_MOXEMM_SMU_ALM10_16" 721 "DFC_MOXEMM_SMU_ALM10_17" 722 "DFC_MOXEMM_SMU_ALM10_21" 723 "DFC_MOXEMM_SMU_ALM11_0" 724 "DFC_MOXEMM_SMU_ALM11_1" 725 "DFC_MOXEMM_SMU_ALM11_2" 726 "DFC_MOXEMM_SMU_ALM11_3" 727 "DFC_MOXEMM_SMU_ALM11_4" 728 "DFC_MOXEMM_SMU_ALM11_5" 729 "DFC_MOXEMM_SMU_ALM11_8" 730 "DFC_MOXEMM_SMU_ALM11_9" 731 "DFC_MOXEMM_SMU_ALM1_0" 732 "DFC_MOXEMM_SMU_ALM1_1" 733 "DFC_MOXEMM_SMU_ALM1_10" 734 "DFC_MOXEMM_SMU_ALM1_11" 735 "DFC_MOXEMM_SMU_ALM1_13" 736 "DFC_MOXEMM_SMU_ALM1_14" 737 "DFC_MOXEMM_SMU_ALM1_2" 738 "DFC_MOXEMM_SMU_ALM1_22" 739 "DFC_MOXEMM_SMU_ALM1_23" 740 "DFC_MOXEMM_SMU_ALM1_4" 741 "DFC_MOXEMM_SMU_ALM1_5" 742 "DFC_MOXEMM_SMU_ALM1_7" 743 "DFC_MOXEMM_SMU_ALM1_8" 744 "DFC_MOXEMM_SMU_ALM21_0" 745 "DFC_MOXEMM_SMU_ALM21_16" 746 "DFC_MOXEMM_SMU_ALM21_3" 747 "DFC_MOXEMM_SMU_ALM2_1" 748 "DFC_MOXEMM_SMU_ALM2_10" 749 "DFC_MOXEMM_SMU_ALM2_11" 750 "DFC_MOXEMM_SMU_ALM2_13" 751 "DFC_MOXEMM_SMU_ALM2_14" 752 "DFC_MOXEMM_SMU_ALM2_22" 753 "DFC_MOXEMM_SMU_ALM2_23" 754 "DFC_MOXEMM_SMU_ALM2_4" 755 "DFC_MOXEMM_SMU_ALM2_5" 756 "DFC_MOXEMM_SMU_ALM2_7" 757 "DFC_MOXEMM_SMU_ALM2_8" 758 "DFC_MOXEMM_SMU_ALM6_0" 759 "DFC_MOXEMM_SMU_ALM6_11" 760 "DFC_MOXEMM_SMU_ALM6_12" 761 "DFC_MOXEMM_SMU_ALM6_14" 762 "DFC_MOXEMM_SMU_ALM6_15" 763 "DFC_MOXEMM_SMU_ALM6_17" 764 "DFC_MOXEMM_SMU_ALM6_18" 765 "DFC_MOXEMM_SMU_ALM6_20" 766 "DFC_MOXEMM_SMU_ALM6_21" 767 "DFC_MOXEMM_SMU_ALM6_25" 768 "DFC_MOXEMM_SMU_ALM6_4" 769 "DFC_MOXEMM_SMU_ALM6_5" 770 "DFC_MOXEMM_SMU_ALM6_7" 771 "DFC_MOXEMM_SMU_ALM6_8" 772 "DFC_MOXEMM_SMU_ALM7_1" 773 "DFC_MOXEMM_SMU_ALM7_12" 774 "DFC_MOXEMM_SMU_ALM7_13" 775 "DFC_MOXEMM_SMU_ALM7_14" 776 "DFC_MOXEMM_SMU_ALM7_15" 777 "DFC_MOXEMM_SMU_ALM7_16" 778 "DFC_MOXEMM_SMU_ALM7_17" 779 "DFC_MOXEMM_SMU_ALM7_2" 780 "DFC_MOXEMM_SMU_ALM7_20" 781 "DFC_MOXEMM_SMU_ALM7_25" 782 "DFC_MOXEMM_SMU_ALM7_26" 783 "DFC_MOXEMM_SMU_ALM7_28" 784 "DFC_MOXEMM_SMU_ALM7_29" 785 "DFC_MOXEMM_SMU_ALM7_30" 786 "DFC_MOXEMM_SMU_ALM7_31" 787 "DFC_MOXEMM_SMU_ALM8_0" 788 "DFC_MOXEMM_SMU_ALM8_1" 789 "DFC_MOXEMM_SMU_ALM8_10" 790 "DFC_MOXEMM_SMU_ALM8_11" 791 "DFC_MOXEMM_SMU_ALM8_12" 792 "DFC_MOXEMM_SMU_ALM8_16" 793 "DFC_MOXEMM_SMU_ALM8_18" 794 "DFC_MOXEMM_SMU_ALM8_2" 795 "DFC_MOXEMM_SMU_ALM8_3" 796 "DFC_MOXEMM_SMU_ALM8_31" 797 "DFC_MOXEMM_SMU_ALM8_4" 798 "DFC_MOXEMM_SMU_ALM9_0" 799 "DFC_MOXEMM_SMU_ALM9_15" 800 "DFC_MOXEMM_SMU_ALM9_3" 822 "DFC_MoXEMMHwLTMCUFW" 823 "DFC_MoXEMMHwLTMonBIST" 824 "DFC_MoXEMMHwLTRegMonTest" 825 "DFC_MoXEMMHwLTStbySMUAlvTest" 826 "DFC_MoXEMMHwLTTempSens" 827 "DFC_MoXEMMHwLTUCBCfg" 335 "DFC_MRlyDcOL" 336 "DFC_MRlyDcSCB" 337 "DFC_MRlyDcSCG" 492 "DFC_MRlyOL" 493 "DFC_MRlySCB" 494 "DFC_MRlySCG" 828 "DFC_NWSEmax" 829 "DFC_NWSmax" 830 "DFC_OCWDAABEActv" 831 "DFC_OCWDACom" 832 "DFC_OCWDAErrPin" 833 "DFC_OCWDAOvrVltg" 836 "DFC_OilPPlaus" 403 "DFC_OilPSwmpSRCMax" 404 "DFC_OilPSwmpSRCMin" 834 "DFC_ORAmax" 835 "DFC_ORAmin" 847 "DFC_P_VSE11_OL" 848 "DFC_P_VSE11_SCB" 849 "DFC_P_VSE11_SCG" 417 "DFC_PEnvCcMax" 418 "DFC_PEnvCcMin" 419 "DFC_PEnvRngChkMax" 420 "DFC_PEnvRngChkMin" 232 "DFC_PEnvSigRngMax" 233 "DFC_PEnvSigRngMin" 421 "DFC_PEnvSnsrPlaus" 850 "DFC_PhyHighAPP1" 851 "DFC_PhyHighAPP2" 852 "DFC_PhyLowAPP1" 853 "DFC_PhyLowAPP2" 405 "DFC_PIntkVUsLineHiB1" 406 "DFC_PIntkVUsLineLoB1" 837 "DFC_PLLSUmax" 838 "DFC_PLLSUmin" 338 "DFC_PSPOL" 339 "DFC_PSPOvrTemp" 340 "DFC_PSPSCB" 341 "DFC_PSPSCG" 839 "DFC_PSR1max" 840 "DFC_PSRBmax" 841 "DFC_PSRBmin" 845 "DFC_PSRmax" 842 "DFC_PSRPmax" 843 "DFC_PSRPmin" 844 "DFC_PSRPsig" 846 "DFC_PUmax" 475 "DFC_RBA_IODIAGPWR_rba_IoExtCy329_SignalVltSply_0" 476 "DFC_RBA_IODIAGPWR_rba_IoExtCy329_SignalVltSply_0OT" 477 "DFC_RBA_IODIAGPWR_rba_IoExtCy329_SignalVltSply_0OV" 478 "DFC_RBA_IODIAGPWR_rba_IoExtCy329_SignalVltSply_0SCG" 479 "DFC_RBA_IODIAGPWR_rba_IoExtCy329_SignalVltSply_0UV" 480 "DFC_RBA_IODIAGPWR_rba_IoExtCy329_SignalVltSply_1" 481 "DFC_RBA_IODIAGPWR_rba_IoExtCy329_SignalVltSply_1OT" 482 "DFC_RBA_IODIAGPWR_rba_IoExtCy329_SignalVltSply_1OV" 483 "DFC_RBA_IODIAGPWR_rba_IoExtCy329_SignalVltSply_1SCG" 484 "DFC_RBA_IODIAGPWR_rba_IoExtCy329_SignalVltSply_1UV" 485 "DFC_RBA_IODIAGPWR_rba_IoExtCy329_SignalVltSply_2" 486 "DFC_RBA_IODIAGPWR_rba_IoExtCy329_SignalVltSply_2OT" 487 "DFC_RBA_IODIAGPWR_rba_IoExtCy329_SignalVltSply_2OV" 488 "DFC_RBA_IODIAGPWR_rba_IoExtCy329_SignalVltSply_2SCG" 489 "DFC_RBA_IODIAGPWR_rba_IoExtCy329_SignalVltSply_2UV" 498 "DFC_RBA_IOEXTLIB_KEEPALIVE_DRV" 499 "DFC_RBA_IOEXTLIB_KEEPALIVE_INI" 500 "DFC_rba_IoSigRtc_StopCounter" 502 "DFC_rba_MemDiag_MemReadErr" 503 "DFC_rba_MemDiag_MemWrErr" 501 "DFC_rba_MRly_Diag_Stk_Event" 495 "DFC_rba_MultiStackTrace_Threshold" 504 "DFC_rba_SyC_IrrSwOffTrigEngRun_Event" 505 "DFC_rba_T15_Diag_ComInVld_Event" 506 "DFC_rba_T15_Diag_ComOff_HwOn_Event" 507 "DFC_rba_T15_Diag_ComOn_HwOff_Event" 468 "DFC_RoughRoad" 469 "DFC_SiaEEPRdErr" 470 "DFC_SiaEEPWrngCod" 854 "DFC_SRCHighAPP1" 855 "DFC_SRCHighAPP2" 856 "DFC_SRCLowAPP1" 857 "DFC_SRCLowAPP2" 858 "DFC_SSpMon2" 859 "DFC_STHDRmax" 234 "DFC_StmFault" 236 "DFC_StrtCtlErr" 235 "DFC_StrtCtOffPth" 237 "DFC_StrtFault" 238 "DFC_StrtLckJudg1" 239 "DFC_StrtLckJudg2" 240 "DFC_StrtOL" 241 "DFC_StrtOL2" 242 "DFC_StrtSCB" 243 "DFC_StrtSCB2" 244 "DFC_StrtSCG" 245 "DFC_StrtSCG2" 246 "DFC_StrtStkRly1" 247 "DFC_StrtStkRly2" 860 "DFC_SWReset_0" 861 "DFC_SWReset_1" 862 "DFC_SWReset_2" 863 "DFC_SyncAPP" 342 "DFC_T50Err" 865 "DFC_TAmax_Dummy" 864 "DFC_TANKLnpl" 866 "DFC_TESFmax" 867 "DFC_TESGmax" 248 "DFC_TEVEmax" 249 "DFC_TEVEmin" 250 "DFC_TEVEsig" 875 "DFC_ThrVlvClsdPosnFirstOffsLrnImpoB1" 876 "DFC_ThrVlvClsdPosnOffsLrnImpoB1" 877 "DFC_ThrVlvClsdPosnOffsLrnMaxB1" 878 "DFC_ThrVlvClsdPosnOffsLrnMinB1" 879 "DFC_ThrVlvCtrlDeB1" 880 "DFC_ThrVlvDycB1" 881 "DFC_ThrVlvLimpAirPosnMaxAbsltDriftB1" 882 "DFC_ThrVlvLimpAirPosnMaxB1" 883 "DFC_ThrVlvLimpAirPosnMaxRelDriftB1" 884 "DFC_ThrVlvLimpAirPosnMinB1" 343 "DFC_ThrVlvLoBattB1" 885 "DFC_ThrVlvOpenLoadB1" 886 "DFC_ThrVlvOpenSprgB1" 887 "DFC_ThrVlvOpenSprgSprdB1" 888 "DFC_ThrVlvOpenSprgTwnB1" 889 "DFC_ThrVlvOverTB1" 890 "DFC_ThrVlvRetSprgB1" 891 "DFC_ThrVlvRetSprgSprdB1" 892 "DFC_ThrVlvRetSprgTwnB1" 893 "DFC_ThrVlvSens1MaxB1" 900 "DFC_ThrvlvSens1MinB1" 894 "DFC_ThrVlvSens1NplB1" 895 "DFC_ThrVlvSens2MaxB1" 896 "DFC_ThrVlvSens2MinB1" 897 "DFC_ThrVlvSens2NplB1" 898 "DFC_ThrVlvShoCircB1" 899 "DFC_ThrVlvSpiErrB1" 901 "DFC_TiOffTBasdChkFast" 902 "DFC_TiOffTBasdChkSlow" 868 "DFC_TKAEmax" 869 "DFC_TKAEmin" 870 "DFC_TKARmax" 871 "DFC_TKARnpl" 872 "DFC_TMmax_Dummy" 873 "DFC_TUMmax_Dummy" 874 "DFC_TWCDPriCatB1" 251 "DFC_UegoHeatrPrfmncLoS1B1" 422 "DFC_UEGOHeatrRlyPsOLS1B1" 423 "DFC_UEGOHeatrRlyPsSCBS1B1" 424 "DFC_UEGOHeatrRlyPsSCGS1B1" 471 "DFC_UegoHeatrStrtS1B1" 425 "DFC_UegoHeatrWireOlS1B1" 426 "DFC_UegoHeatrWireScbS1B1" 427 "DFC_UegoHeatrWireScgS1B1" 279 "DFC_UegoSigEcuAsicS1B1" 280 "DFC_UegoSigEcuComS1B1" 344 "DFC_UegoSigOperPlausS1B1" 281 "DFC_UegoSigSnsrS1B1" 282 "DFC_UegoSigWireOlApesS1B1" 283 "DFC_UegoSigWireOlIpeS1B1" 284 "DFC_UegoSigWireOlReS1B1" 285 "DFC_UegoSigWireRCmpS1B1" 286 "DFC_UegoSigWireScbS1B1" 287 "DFC_UegoSigWireScgS1B1" 903 "DFC_UEGOSnsrMntdS1B1" 252 "DFC_VehVAllPlaus" 253 "DFC_VehVNCSnsrElecFailr" 345 "DFC_VehVPhysRngHi" 407 "DFC_VehVPhysRngLo" 254 "DFC_VehVPlausCan" 255 "DFC_VehVPlausFco" 256 "DFC_VehVPlausPwr" 257 "DFC_VehVPlausV2N" 346 "DFC_VehVSclOutOL" 347 "DFC_VehVSclOutOT" 348 "DFC_VehVSclOutSCB" 349 "DFC_VehVSclOutSCG" 904 "DFC_VehVSig" 408 "DFC_VehVSigCan" 409 "DFC_VehVSigCanSafe" 350 "DFC_VehVSigFL" 351 "DFC_VehVSigFR" 352 "DFC_VehVSigRL" 353 "DFC_VehVSigRR" 354 "DFC_VehVSnsrARngHi" 355 "DFC_VehVSnsrBRngHi" 356 "DFC_VehVSpdRtyDiag" 258 "DFC_VehVSpdSnsrAElecFailr" 259 "DFC_VehVSpdSnsrBElecFailr" 410 "DFC_VlvLftFbOilPSnsrIntk11SRCMax" 411 "DFC_VlvLftFbOilPSnsrIntk11SRCMin" 905 "DFC_VlvLftFbSwtIntk11SpclFail" 906 "DFC_VlvLftFbSwtIntk11StdFail" DEFAULT_VALUE "---" /end COMPU_VTAB
/begin COMPU_METHOD DFES_nPID0C "" RAT_FUNC "%6.3" "rpm" COEFFS 0 4 0 0 0 1 /end COMPU_METHOD
/begin COMPU_METHOD DFES_OneToOne "" RAT_FUNC "%6.2" "-" COEFFS 0 1 0 0 0 1 /end COMPU_METHOD
/begin COMPU_METHOD DFES_rPID04 "" RAT_FUNC "%6.3" "%" COEFFS 0 2.55 0 0 0 1 /end COMPU_METHOD
/begin COMPU_METHOD DFES_tPID05 "" RAT_FUNC "%6.2" "deg C" COEFFS 0 1 40 0 0 1 /end COMPU_METHOD
/begin COMPU_METHOD OneToOne "" RAT_FUNC "%6.2" "-" COEFFS 0 1 0 0 0 1 /end COMPU_METHOD
/begin RECORD_LAYOUT ValA_Wu8 FNC_VALUES 1 UBYTE COLUMN_DIR DIRECT /end RECORD_LAYOUT
/begin RECORD_LAYOUT Val_Wu16 FNC_VALUES 1 UWORD COLUMN_DIR DIRECT /end RECORD_LAYOUT
/begin RECORD_LAYOUT Val_Wu8 FNC_VALUES 1 UBYTE COLUMN_DIR DIRECT /end RECORD_LAYOUT
/end MODULE
/end PROJECT
