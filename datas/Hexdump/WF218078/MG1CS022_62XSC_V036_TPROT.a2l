ASAP2_VERSION 1 60
/begin PROJECT MG1CS022 "MG1CS022"
/begin HEADER "" VERSION "MG1CS022_62XSC_V036_TPROT" PROJECT_NO MG1CS022 /end HEADER
/begin MODULE DIM ""
/begin MOD_COMMON "" BYTE_ORDER MSB_LAST ALIGNMENT_BYTE 1 ALIGNMENT_WORD 2 ALIGNMENT_LONG 4 ALIGNMENT_INT64 4 ALIGNMENT_FLOAT32_IEEE 4 ALIGNMENT_FLOAT64_IEEE 4 DATA_SIZE 32 /end MOD_COMMON
/begin CHARACTERISTIC AirMod_facDia_T "Factor delta ignition angle for AirMod" CURVE 0x8051F928 RB_Curve_S8_U16_Static 1.000000 fak_uw_b2 0.00 1.000000 FORMAT "%8.6" EXTENDED_LIMITS 0.00 1.999969
 /begin AXIS_DESCR STD_AXIS AirMod_dia kw_q0p75 6 -96.00 95.25 FORMAT "%5.2" DEPOSIT ABSOLUTE /end AXIS_DESCR
/end CHARACTERISTIC
/begin CHARACTERISTIC AirMod_facFcoCorrnRampIn_C "ramp in calibration factor for correction of charge modell at fuel cut of" VALUE 0x8051F93C RB_Val_Wu16 1.000000 fak_uw_b2 0.00 1.000000 FORMAT "%8.6" EXTENDED_LIMITS 0.00 1.999969 /end CHARACTERISTIC
/begin CHARACTERISTIC AirMod_facFcoCorrnRampOut_C "ramp out calibration factor for correction of charge modell at fuel cut of" VALUE 0x8051F93E RB_Val_Wu16 1.000000 fak_uw_b2 0.00 1.000000 FORMAT "%8.6" EXTENDED_LIMITS 0.00 1.999969 /end CHARACTERISTIC
/begin CHARACTERISTIC AirMod_FacFilDmCyl2ExhMnfld_T "Filter time constant of Mass flow scavenged from combustion chamber to exhaust manifold" CURVE 0x8051F940 RB_Curve_U16_U16 0.9999847 fak_uw_b1 0.00 0.9999847 FORMAT "%9.7"
 /begin AXIS_DESCR STD_AXIS vpsrabg_w fak_uw_b2 5 0.00 1.999969 FORMAT "%8.6" DEPOSIT ABSOLUTE /end AXIS_DESCR
/end CHARACTERISTIC
/begin CHARACTERISTIC AirMod_flgEnblRefPos_C "Switch to choose current or target VVT angle to compare with reference position" VALUE 0x8051F956 RB_Val_Wboolean 1.00000000000 B_TRUE 0.00 1.00000000000 FORMAT "%13.11" /end CHARACTERISTIC
/begin CHARACTERISTIC AirMod_nrSynAirChrgToIgnCalcn_C "Amount of cylinders between charge and ignition(paramter)" VALUE 0x8052191E RB_Val_Wu8 255.0 OneToOne 0.00 255.0 FORMAT "%5.1" /end CHARACTERISTIC
/begin CHARACTERISTIC AirMod_pExhDeltaDia_M "Delta pressure exhaust gas depending on delta ignition angle" MAP 0x8051F958 RB_Map_U16S16_S16 5119.922 p_sw_q0p078 -2560.000 2559.922 FORMAT "%8.3"
 /begin AXIS_DESCR STD_AXIS vpsrpuakt_w fak_uw_b4 10 0.00 3.999939 FORMAT "%8.6" DEPOSIT ABSOLUTE /end AXIS_DESCR
 /begin AXIS_DESCR STD_AXIS nmotsw_w EngN 10 -16384.00 16383.50 FORMAT "%8.2" DEPOSIT ABSOLUTE /end AXIS_DESCR
/end CHARACTERISTIC
/begin CHARACTERISTIC AirMod_pOffsCorrnFcoLoLft_M "pressure offset correction of charge modell at fuel cut off for low lift" MAP 0x8051FA4C RB_Map_S16U16_S16 2559.961 p_sw_q0p039 -1280.000 1279.961 FORMAT "%8.3"
 /begin AXIS_DESCR STD_AXIS Epm_nEng10ms EngN 14 -16384.00 16383.50 FORMAT "%8.2" DEPOSIT ABSOLUTE /end AXIS_DESCR
 /begin AXIS_DESCR STD_AXIS PEnv_p p_uw_q0p039 4 0.00 2559.961 FORMAT "%8.3" DEPOSIT ABSOLUTE /end AXIS_DESCR
/end CHARACTERISTIC
/begin CHARACTERISTIC AirMod_pOffsCorrnFco_M "pressure offset correction of charge modell at fuel cut off" MAP 0x8051FAE4 RB_Map_S16U16_S16 2559.961 p_sw_q0p039 -1280.000 1279.961 FORMAT "%8.3"
 /begin AXIS_DESCR STD_AXIS Epm_nEng10ms EngN 14 -16384.00 16383.50 FORMAT "%8.2" DEPOSIT ABSOLUTE /end AXIS_DESCR
 /begin AXIS_DESCR STD_AXIS PEnv_p p_uw_q0p039 4 0.00 2559.961 FORMAT "%8.3" DEPOSIT ABSOLUTE /end AXIS_DESCR
/end CHARACTERISTIC
/begin CHARACTERISTIC AirMod_stChrCorrGslSp_C "Code word for desired cam shaft position for slope correction for the adaption of intake manifold pressure to air pressure in the combustion chamber" VALUE 0x8051FB7C RB_Val_Wu32 4294967295.00 dez 0.00 4294967295.00 FORMAT "%13.2" /end CHARACTERISTIC
/begin CHARACTERISTIC AirMod_tiResetFkorCalc_C "Time delay to judge if cam shaft position is in reference position in idling." VALUE 0x8051FB80 RB_Val_Wu16 655.3500 t_q0p01 0.00 655.3500 FORMAT "%8.4" /end CHARACTERISTIC
/begin CHARACTERISTIC AirMod_tiThdpSysStrt_C "Time threshold of charge determination for start based on p-system" VALUE 0x80521920 RB_Val_Wu16 6553.500 t_q0p1 0.00 6553.500 FORMAT "%8.3" /end CHARACTERISTIC
/begin CHARACTERISTIC ChrCtl_facCorrnChrgTn_T "Correction factor for time constant for settling of rlsol" CURVE 0x80521642 RB_Curve_S16_U16_Static 1.999969 fak_uw_b2 0.00 1.999969 FORMAT "%8.6"
 /begin AXIS_DESCR STD_AXIS Epm_dnEngFlt EngNGrd 5 -16384.00 16383.50 FORMAT "%8.2" DEPOSIT ABSOLUTE /end AXIS_DESCR
/end CHARACTERISTIC
/begin CHARACTERISTIC ChrCtl_facMfUGD_C "factor for switch over to WOT calculation of actual massflow for fast throttle movements" VALUE 0x80521400 RB_Val_Wu16 1.999969 fak_uw_b2 0.00 1.999969 FORMAT "%8.6" /end CHARACTERISTIC
/begin CHARACTERISTIC ChrCtl_facSuctnRefLoLft_T "Storage reference value fupsrl for correction factor engine speed addressing WOT low valve lift" CURVE 0x80521402 RB_Curve_S16_U16_Static 0.2999908 rel_uw_b0p3 0.0000046 0.2999954 FORMAT "%9.7" EXTENDED_LIMITS 0.00 0.2999954
 /begin AXIS_DESCR STD_AXIS Epm_nEng EngN 5 -16384.00 16383.50 FORMAT "%8.2" DEPOSIT ABSOLUTE /end AXIS_DESCR
/end CHARACTERISTIC
/begin CHARACTERISTIC ChrCtl_facSuctnRef_T "Storage reference value fupsrl for correction factor engine speed addressing WOT" CURVE 0x80521418 RB_Curve_S16_U16_Static 0.2999908 rel_uw_b0p3 0.0000046 0.2999954 FORMAT "%9.7" EXTENDED_LIMITS 0.00 0.2999954
 /begin AXIS_DESCR STD_AXIS Epm_nEng EngN 5 -16384.00 16383.50 FORMAT "%8.2" DEPOSIT ABSOLUTE /end AXIS_DESCR
/end CHARACTERISTIC
/begin CHARACTERISTIC ChrCtl_mfAfsMax_C "air mass flow upper limit for detection short circuits of HFM" VALUE 0x8052142E RB_Val_Wu16 6553.500 m_q0p1 0.00 6553.500 FORMAT "%8.3" /end CHARACTERISTIC
/begin CHARACTERISTIC ChrCtl_nEngMinLoadMfCorrn_C "Minimum engine speed for calculation of correction factor: load to mass flow" VALUE 0x80521658 RB_Val_Ws16 32767.50 EngN -16384.00 16383.50 FORMAT "%8.2" /end CHARACTERISTIC
/begin CHARACTERISTIC ChrCtl_pDifOpenThrRefLoLft_T "Storage reference value (pressure difference) for correction factor engine speed addressing WOT low valve lift" CURVE 0x80521430 RB_Curve_S16_U16_Static 5119.844 p_q0p078 0.078 5119.922 FORMAT "%8.3" EXTENDED_LIMITS 0.00 5119.922
 /begin AXIS_DESCR STD_AXIS Epm_nEng EngN 5 -16384.00 16383.50 FORMAT "%8.2" DEPOSIT ABSOLUTE /end AXIS_DESCR
/end CHARACTERISTIC
/begin CHARACTERISTIC ChrCtl_pDifOpenThrRef_T "Storage reference value (pressure difference) for correction factor engine speed addressing WOT" CURVE 0x80521446 RB_Curve_S16_U16_Static 5119.844 p_q0p078 0.078 5119.922 FORMAT "%8.3" EXTENDED_LIMITS 0.00 5119.922
 /begin AXIS_DESCR STD_AXIS Epm_nEng EngN 5 -16384.00 16383.50 FORMAT "%8.2" DEPOSIT ABSOLUTE /end AXIS_DESCR
/end CHARACTERISTIC
/begin CHARACTERISTIC ChrCtl_ratChrgMinOffs_C "The charge offset to reduce the lower limit of the deadzone at the end of fuel cut off" VALUE 0x8052165A RB_Val_Wu16 1535.977 rel_q0p02344 0.00 1535.977 FORMAT "%8.3" /end CHARACTERISTIC
/begin CHARACTERISTIC ChrCtl_tiCnvMfRatChrg_M "Time constant filter conversion massflow-ratio charge" MAP 0x8052165C RB_Map_S16S16_U16 655.3500 t_q0p01 0.00 655.3500 FORMAT "%8.4"
 /begin AXIS_DESCR STD_AXIS Epm_nEng EngN 4 -16384.00 16383.50 FORMAT "%8.2" DEPOSIT ABSOLUTE /end AXIS_DESCR
 /begin AXIS_DESCR STD_AXIS Epm_dnEngFlt EngNGrd 4 -16384.00 16383.50 FORMAT "%8.2" DEPOSIT ABSOLUTE /end AXIS_DESCR
/end CHARACTERISTIC
/begin CHARACTERISTIC ChrCtl_tiFcoEndDlyd_C "Time delay to prevent the effect of end of fuel cut off in air mass value calculation" VALUE 0x80521690 RB_Val_Wu16 655.3500 t_q0p01 0.00 655.3500 FORMAT "%8.4" /end CHARACTERISTIC
/begin CHARACTERISTIC ChrCtl_tiMFlowAdpnConNeutVal_C "integrator speed for constant mass flow adaption with egr" VALUE 0x8051F758 RB_Val_Wu16 4.990000 t_q0p01 0.010000 5.000000 FORMAT "%8.6" EXTENDED_LIMITS 0.00 655.3500 /end CHARACTERISTIC
/begin CHARACTERISTIC ChrCtl_tiMFlowAdpnFastEngStop_C "integrator speed for fast constant mass flow adaption for engine stop" VALUE 0x8051F75A RB_Val_Wu16 4.990000 t_q0p01 0.010000 5.000000 FORMAT "%8.6" EXTENDED_LIMITS 0.00 655.3500 /end CHARACTERISTIC
/begin CHARACTERISTIC ChrCtl_tiMFlowAdpnFastNeutVal_C "integrator speed for fast constant mass flow adaption with EGR or unthrottled" VALUE 0x8051F75C RB_Val_Wu16 4.990000 t_q0p01 0.010000 5.000000 FORMAT "%8.6" EXTENDED_LIMITS 0.00 655.3500 /end CHARACTERISTIC
/begin CHARACTERISTIC ChrCtl_tiMFlowAdpnFast_C "integrator speed for fast constant mass-flow adaption(short trip)" VALUE 0x8051F75E RB_Val_Wu16 1.990000 t_q0p01 0.010000 2.000000 FORMAT "%8.6" EXTENDED_LIMITS 0.00 655.3500 /end CHARACTERISTIC
/begin CHARACTERISTIC ChrCtl_tiMFlowAdpnFast_T "Integrator speed for fast constant mass-flow adaption f(pressure ratio over throttle valve)" CURVE 0x8051F760 RB_Curve_U16_U16 1.990000 t_q0p01 0.010000 2.000000 FORMAT "%8.6" EXTENDED_LIMITS 0.00 655.3500
 /begin AXIS_DESCR STD_AXIS vpsrvd_w_msg fak_uw_b2 8 0.00 1.999969 FORMAT "%8.6" DEPOSIT ABSOLUTE /end AXIS_DESCR
/end CHARACTERISTIC
/begin CHARACTERISTIC ChrCtl_tiMFlowAdpnSlowEol_C "integrator speed for slow constant mass-flow adaption quik trip" VALUE 0x8051F782 RB_Val_Wu16 6553.400 t_q0p1 0.100 6553.500 FORMAT "%8.3" EXTENDED_LIMITS 0.00 6553.500 /end CHARACTERISTIC
/begin CHARACTERISTIC ChrCtl_tiMFlowAdpnSlow_T "integrator speed for slow constant mass-flow adaption" CURVE 0x8051F784 RB_Curve_U16_U16 6553.400 t_q0p1 0.100 6553.500 FORMAT "%8.3" EXTENDED_LIMITS 0.00 6553.500
 /begin AXIS_DESCR STD_AXIS vpsrvd_w_msg fak_uw_b2 3 0.00 1.999969 FORMAT "%8.6" DEPOSIT ABSOLUTE /end AXIS_DESCR
/end CHARACTERISTIC
/begin CHARACTERISTIC ChrCtl_tiMFlowFacFastAdjmtRst_C "Time constant reset mass flow adjustment fkmsdk" VALUE 0x8051F792 RB_Val_Wu16 655.3000 t_q0p01 0.0500 655.3500 FORMAT "%8.4" EXTENDED_LIMITS 0.00 655.3500 /end CHARACTERISTIC
/begin CHARACTERISTIC ChrCtl_tiMFlowLeakFltMaiLoadSnsr_C "Filter time constant for ofmsndk if fault HFMDSS" VALUE 0x8051F794 RB_Val_Wu16 6553.400 t_q0p1 0.100 6553.500 FORMAT "%8.3" EXTENDED_LIMITS 0.00 6553.500 /end CHARACTERISTIC
/begin CHARACTERISTIC ChrCtl_tiThrVlvMFlowLeakAdpnEol_C "Correction value for idling air mass integrator for E gas for quik trip" VALUE 0x8051F796 RB_Val_Wu16 255.9922 q0p00390625_s_h_DIV_kg 0.0039 255.9961 FORMAT "%8.4" EXTENDED_LIMITS 0.00 255.9961 /end CHARACTERISTIC
/begin CHARACTERISTIC ChrCtl_tiThrVlvMFlowLeakAdpnLeak_C "Time constant for fast adaptaion of throttle blade during leakage" VALUE 0x8051F798 RB_Val_Wu16 255.9922 q0p00390625_s_h_DIV_kg 0.0039 255.9961 FORMAT "%8.4" EXTENDED_LIMITS 0.00 255.9961 /end CHARACTERISTIC
/begin CHARACTERISTIC ChrCtl_tiThrVlvMFlowLeakAdpnLrgDe_C "Correction value for idling air mass integrator for E gas for great differences" VALUE 0x8051F79A RB_Val_Wu16 255.9922 q0p00390625_s_h_DIV_kg 0.0039 255.9961 FORMAT "%8.4" EXTENDED_LIMITS 0.00 255.9961 /end CHARACTERISTIC
/begin CHARACTERISTIC ChrCtl_tiThrVlvMFlowLeakAdpn_C "Correction value for idling air mass integrator for E gas" VALUE 0x8051F79C RB_Val_Wu16 255.9922 q0p00390625_s_h_DIV_kg 0.0039 255.9961 FORMAT "%8.4" EXTENDED_LIMITS 0.00 255.9961 /end CHARACTERISTIC
/begin CHARACTERISTIC CWBGFKMS "code word for BGFKMS" VALUE 0x8051F79E RB_Val_Wu16 65535.00 dez 0.00 65535.00 FORMAT "%8.2" /end CHARACTERISTIC
/begin CHARACTERISTIC CWBGKV "codeword for configuration of %BGKV" VALUE 0x8051F82E RB_Val_Wu8 255.0 dez 0.00 255.0 FORMAT "%5.1" /end CHARACTERISTIC
/begin CHARACTERISTIC CWBGLASO "Code word for function BGLASO (calculation of lambda setpoint in exhaust)" VALUE 0x8051F91A RB_Val_Wu8 255.0 dez 0.00 255.0 FORMAT "%5.1" /end CHARACTERISTIC
/begin CHARACTERISTIC CWBGLWM "Code word %BGLWM" VALUE 0x8051FB82 RB_Val_Wu8 255.0 dez 0.00 255.0 FORMAT "%5.1" /end CHARACTERISTIC
/begin CHARACTERISTIC CWBGLWM2 "Code word BGLWM 2" VALUE 0x8051FB83 RB_Val_Wu8 255.0 dez 0.00 255.0 FORMAT "%5.1" /end CHARACTERISTIC
/begin CHARACTERISTIC CWBGLWMNWK2A "Code word for outlet VVT state condition to reset a slope correction factor" VALUE 0x8051FB84 RB_Val_Wu16 65535.00 OneToOne 0.00 65535.00 FORMAT "%8.2" /end CHARACTERISTIC
/begin CHARACTERISTIC CWBGLWMNWK2E "Code word for inlet VVT state condition to reset a slope correction factor" VALUE 0x8051FB86 RB_Val_Wu16 65535.00 OneToOne 0.00 65535.00 FORMAT "%8.2" /end CHARACTERISTIC
/begin CHARACTERISTIC CWBGLWMNWK3 "Code word to consider an idle condition for camshaft phase control in order to reset a slope correction factor for intakeand outtake camshaft" VALUE 0x8051FB88 RB_Val_Wu16 65535.00 OneToOne 0.00 65535.00 FORMAT "%8.2" /end CHARACTERISTIC
/begin CHARACTERISTIC CWBGLWMNWK4 "Code word 4 for desired cam shaft position for slope correction for the adaption of intake manifold pressure to air pressure in the combustion chamber" VALUE 0x8051FB8A RB_Val_Wu16 65535.00 OneToOne 0.00 65535.00 FORMAT "%8.2" /end CHARACTERISTIC
/begin CHARACTERISTIC CWBGMSDK "code word for BGMSDK" VALUE 0x8052145C RB_Val_Wu16 65535.00 OneToOne 0.00 65535.00 FORMAT "%8.2" /end CHARACTERISTIC
/begin CHARACTERISTIC CWBGMSDKS "code word for BGMSDKS" VALUE 0x80521692 RB_Val_Wu8 255.0 dez 0.00 255.0 FORMAT "%5.1" /end CHARACTERISTIC
/begin CHARACTERISTIC CWBGMSHMDK "code word for BGMSHMDK" VALUE 0x80521878 RB_Val_Wu8 255.0 dez 0.00 255.0 FORMAT "%5.1" /end CHARACTERISTIC
/begin CHARACTERISTIC CWBGRL "code word for BGRL" VALUE 0x80521922 RB_Val_Wu8 255.0 dez 0.00 255.0 FORMAT "%5.1" /end CHARACTERISTIC
/begin CHARACTERISTIC CWPABEF "Code word for Calculation of effective exhaust gas backpressure for charge models" VALUE 0x8051FB8C RB_Val_Wu8 255.0 dez 0.00 255.0 FORMAT "%5.1" /end CHARACTERISTIC
/begin CHARACTERISTIC CWPABNAV "Codeword for the modelling of the exhaust backpressure" VALUE 0x80521879 RB_Val_Wu8 255.0 dez 0.00 255.0 FORMAT "%5.1" /end CHARACTERISTIC
/begin CHARACTERISTIC CWPBRKBG "Code word for slope correction for the adaption of intake manifold pressure to air pressure in the combustion chamber in background calculation" VALUE 0x8051FB90 RB_Val_Wu32 4294967295.00 dez 0.00 4294967295.00 FORMAT "%13.2" /end CHARACTERISTIC
/begin CHARACTERISTIC CWPIRGKL1 "Code word for configuration of the 1st flap" VALUE 0x8051FB94 RB_Val_Wu8 255.0 dez 0.00 255.0 FORMAT "%5.1" /end CHARACTERISTIC
/begin CHARACTERISTIC DANZSYN "Number of synchros for dynamics delay" VALUE 0x8052145E RB_Val_Wu8 255.0 OneToOne 0.00 255.0 FORMAT "%5.1" /end CHARACTERISTIC
/begin CHARACTERISTIC DFAFKPVDKE "Threshold of fast adjust. as of multiplicative throttle valve adapt. steady" VALUE 0x8051F7A0 RB_Val_Wu16 1.999969 fak_uw_b2 0.00 1.999969 FORMAT "%8.6" /end CHARACTERISTIC
/begin CHARACTERISTIC DFAOMSNDE "Threshold of the fast adjust. as of the offset throttle valve adapt. steady" VALUE 0x8051F7A2 RB_Val_Wu16 1.999969 fak_uw_b2 0.00 1.999969 FORMAT "%8.6" /end CHARACTERISTIC
/begin CHARACTERISTIC DFEADKE "Threshold for adjust. HFS to NFS, as of the throttle valve adapt. steady" VALUE 0x8051F7A4 RB_Val_Wu16 1.999969 fak_uw_b2 0.00 1.999969 FORMAT "%8.6" /end CHARACTERISTIC
/begin CHARACTERISTIC DFHYSAOMSNDE "Hysteresis threshold of the fast adjust. as of the offset throttle valve adapt. steady" VALUE 0x8051F7A6 RB_Val_Wu16 1.999969 fak_uw_b2 0.00 1.999969 FORMAT "%8.6" /end CHARACTERISTIC
/begin CHARACTERISTIC DFKMSDKSMA "expansion of fkmsdks-borders with external egr during fuel controlled operation modes" VALUE 0x8051F7A8 RB_Val_Wu16 0.2000122 fak_q6p1035Em5 0.00 0.2000122 FORMAT "%9.7" EXTENDED_LIMITS 0.00 3.999939 /end CHARACTERISTIC
/begin CHARACTERISTIC DFKMSDSTZ "dead zone for throttle adaptation" VALUE 0x8051F7AA RB_Val_Ws16 0.9999695 fak_sw_b1 0.00 0.9999695 FORMAT "%9.7" EXTENDED_LIMITS -1.000000 0.9999695 /end CHARACTERISTIC
/begin CHARACTERISTIC DFPBRK "Gradient of switch to slope correction for the adaption of intake manifold pressure to air pressure in the combustion chamber" VALUE 0x8051FB96 RB_Val_Wu16 1.999969 fak_uw_b2 0.00 1.999969 FORMAT "%8.6" /end CHARACTERISTIC
/begin CHARACTERISTIC DFPBRKREF "Gradient in idle condition of switch to slope correction for the adaption of intake manifold pressure to air pressure in the combustion chamber" VALUE 0x8051FB98 RB_Val_Wu16 1.999969 fak_uw_b2 0.00 1.999969 FORMAT "%8.6" /end CHARACTERISTIC
/begin CHARACTERISTIC DNWREFABGLWM "Angle threshold to judge outlet cam shaft position is in reference position" VALUE 0x8051FB9A RB_Val_Wu16 1023.984 kw_q0p0156 0.00 1023.984 FORMAT "%8.3" /end CHARACTERISTIC
/begin CHARACTERISTIC DNWREFEBGLWM "Angle threshold to judge intake cam shaft position is in reference position" VALUE 0x8051FB9C RB_Val_Wu16 1023.984 kw_q0p0156 0.00 1023.984 FORMAT "%8.3" /end CHARACTERISTIC
/begin CHARACTERISTIC DOFMSNDMSLL "Curve: Normalised mass flow upper threshold correction due to big leakage into intake manifold" CURVE 0x8051F7AC RB_Curve_S16_U16_Static 6553.500 m_q0p1 0.00 6553.500 FORMAT "%8.3"
 /begin AXIS_DESCR STD_AXIS Epm_nEng EngN 5 -16384.00 16383.50 FORMAT "%8.2" DEPOSIT ABSOLUTE /end AXIS_DESCR
/end CHARACTERISTIC
/begin CHARACTERISTIC DPABEFO "Offset on upper limit of effective exhaust gas backpressure for charge models" VALUE 0x8051FB9E RB_Val_Wu16 5119.922 p_uw_q0p078 0.00 5119.922 FORMAT "%8.3" /end CHARACTERISTIC
/begin CHARACTERISTIC DPABEFU "Offset on lower limit of effective exhaust gas backpressure for charge models" VALUE 0x8051FBA0 RB_Val_Wu16 5119.922 p_uw_q0p078 0.00 5119.922 FORMAT "%8.3" /end CHARACTERISTIC
/begin CHARACTERISTIC DPBRINTTN "Minimum delta pbrint due to model tolerances" VALUE 0x8051FBA2 RB_Val_Wu16 2559.961 p_uw_q0p039 0.00 2559.961 FORMAT "%8.3" /end CHARACTERISTIC
/begin CHARACTERISTIC DPBRINTTX "Maximum delta pbrint due to model tolerances" VALUE 0x8051FBA4 RB_Val_Wu16 2559.961 p_uw_q0p039 0.00 2559.961 FORMAT "%8.3" /end CHARACTERISTIC
/begin CHARACTERISTIC DRLFRMNTST "min. delta between rlsol and rl for inclusion in charge controller calculation" CURVE 0x80521694 RB_Curve_U16_S16_Static 768.0000 rel_q0p02344 -768.0000 0.00 FORMAT "%8.4" EXTENDED_LIMITS -768.0000 767.9766
 /begin AXIS_DESCR STD_AXIS tnst_w_msg t_q0p01 2 0.00 655.3500 FORMAT "%8.4" DEPOSIT ABSOLUTE /end AXIS_DESCR
/end CHARACTERISTIC
/begin CHARACTERISTIC DRLFRMXTST "max. delta between rlsol and rl for inclusion in charge controller calculation" CURVE 0x8052169E RB_Curve_U16_S16_Static 767.9766 rel_q0p02344 0.00 767.9766 FORMAT "%8.4" EXTENDED_LIMITS -768.0000 767.9766
 /begin AXIS_DESCR STD_AXIS tnst_w_msg t_q0p01 2 0.00 655.3500 FORMAT "%8.4" DEPOSIT ABSOLUTE /end AXIS_DESCR
/end CHARACTERISTIC
/begin CHARACTERISTIC DTAFKPVDKE "delta delay time for condition adaption fkpvdk not in steady-state" VALUE 0x8051F7C2 RB_Val_Wu8 10.00 t_q0p1 0.00 10.00 FORMAT "%5.2" EXTENDED_LIMITS 0.00 25.50 /end CHARACTERISTIC
/begin CHARACTERISTIC DTAOMSNDKE "Delay delta for condition adaptation of ofmsndk no longer steady" VALUE 0x8051F7C3 RB_Val_Wu8 10.00 t_q0p1 0.00 10.00 FORMAT "%5.2" EXTENDED_LIMITS 0.00 25.50 /end CHARACTERISTIC
/begin CHARACTERISTIC DWDKMXWDK "max. error of throttle balde angle dependent on angle" CURVE 0x80521460 RB_Curve_U16_U16 99.99847 rel_uw_b100 0.00 99.99847 FORMAT "%8.5"
 /begin AXIS_DESCR STD_AXIS wdkm_w rel_uw_b100 3 0.00 99.99847 FORMAT "%8.5" DEPOSIT ABSOLUTE /end AXIS_DESCR
/end CHARACTERISTIC
/begin CHARACTERISTIC DWGVLIMFE "for charge detemination permitted (calibrated) camshaft range below and above the ideal range of a new engine" VALUE 0x8051FBA6 RB_Val_Ws16 1023.9688 kw_sw_q0p0156 -511.98438 511.98438 EXTENDED_LIMITS -512.00000 511.98438 /end CHARACTERISTIC
/begin CHARACTERISTIC EXP1DKAPPA "Curve exponent 1/Kappa" CURVE 0x8051FBA8 RB_Curve_U16_U16 3.999939 fak_uw_b4 0.00 3.999939 FORMAT "%8.6" READ_ONLY
 /begin AXIS_DESCR STD_AXIS vpexpkap_w fak_uw_b4 9 0.00 3.999939 FORMAT "%8.6" DEPOSIT ABSOLUTE /end AXIS_DESCR
/end CHARACTERISTIC
/begin CHARACTERISTIC EXPKAPPA "Curve exponent Kappa" CURVE 0x8051FBCE RB_Curve_U16_U16 3.999939 fak_uw_b4 0.00 3.999939 FORMAT "%8.6" READ_ONLY
 /begin AXIS_DESCR STD_AXIS vvexpkap_w fak_uw_b4 9 0.00 3.999939 FORMAT "%8.6" DEPOSIT ABSOLUTE /end AXIS_DESCR
/end CHARACTERISTIC
/begin CHARACTERISTIC EXPTERMKAP "Curve function with exponent 1/Kappa" CURVE 0x8051FBF4 RB_Curve_U16_U16 3.999939 fak_uw_b4 0.00 3.999939 FORMAT "%8.6" READ_ONLY
 /begin AXIS_DESCR STD_AXIS vpexpkap_w fak_uw_b4 9 0.00 3.999939 FORMAT "%8.6" DEPOSIT ABSOLUTE /end AXIS_DESCR
/end CHARACTERISTIC
/begin CHARACTERISTIC FAFRSPVP "KLAF for reaspirated inert gas" CURVE 0x8051FC1A RB_Curve_U16_U16 1.999969 fak_uw_b2 0.00 1.999969 FORMAT "%8.6"
 /begin AXIS_DESCR STD_AXIS vpsrabg_w fak_uw_b2 10 0.00 1.999969 FORMAT "%8.6" DEPOSIT ABSOLUTE /end AXIS_DESCR
/end CHARACTERISTIC
/begin CHARACTERISTIC FEETEPNUN "lower threshold, above higher tolerances of air charge are expected(for low manifold pressure)" VALUE 0x80521924 RB_Val_Ws16 1023.984 kw_q0p0156 -512.0000 511.9844 FORMAT "%8.4" /end CHARACTERISTIC
/begin CHARACTERISTIC FEETEPNVPX "upper threshold, below higher tolerances of air charge are expected(for low manifold pressure)" VALUE 0x80521926 RB_Val_Wu16 1.999969 fak_uw_b2 0.00 1.999969 FORMAT "%8.6" /end CHARACTERISTIC
/begin CHARACTERISTIC FFUPSRLTN "Minimum factor fupsrl due to model tolerances" VALUE 0x8051FC44 RB_Val_Wu16 1.999969 fak_uw_b2 0.00 1.999969 FORMAT "%8.6" /end CHARACTERISTIC
/begin CHARACTERISTIC FFUPSRLTX "Maximum factor fupsrl due to model tolerances" VALUE 0x8051FC46 RB_Val_Wu16 1.999969 fak_uw_b2 0.00 1.999969 FORMAT "%8.6" /end CHARACTERISTIC
/begin CHARACTERISTIC FIMXFADK "Factor for interpolation to pulsation correction for wide opend throttle" CURVE 0x8051FC48 RB_Curve_S16_U16_Static 1.999969 fak_uw_b2 0.00 1.999969 FORMAT "%8.6"
 /begin AXIS_DESCR STD_AXIS ThrVlv_ratActPosnB1 rel_q0p0078125 10 -256.0000 255.9922 FORMAT "%8.4" DEPOSIT ABSOLUTE /end AXIS_DESCR
/end CHARACTERISTIC
/begin CHARACTERISTIC FIMXVP "Interpolation factor for pulsation correction depending on pressure ration at throttle valve" CURVE 0x8051FC72 RB_Curve_U16_U16 1.000000 fak_uw_b2 0.00 1.000000 FORMAT "%8.6" EXTENDED_LIMITS 0.00 1.999969
 /begin AXIS_DESCR STD_AXIS vpsrvdk_w_msg fak_uw_b2 10 0.00 1.999969 FORMAT "%8.6" DEPOSIT ABSOLUTE /end AXIS_DESCR
/end CHARACTERISTIC
/begin CHARACTERISTIC FIMXVPVHE "Interpolation factor for pulsation correction depending on pressure ration at throttle valve for operation points with gas exchange valves on 2nd inlet valve lift" CURVE 0x8051FC9C RB_Curve_U16_U16 1.000000 fak_uw_b2 0.00 1.000000 FORMAT "%8.6" EXTENDED_LIMITS 0.00 1.999969
 /begin AXIS_DESCR STD_AXIS vpsrvdk_w_msg fak_uw_b2 10 0.00 1.999969 FORMAT "%8.6" DEPOSIT ABSOLUTE /end AXIS_DESCR
/end CHARACTERISTIC
/begin CHARACTERISTIC FIUWMSDKVHEKXN "Portion of the overtravel as of which the maximum mass flow flows, small cam" CURVE 0x8052146E RB_Curve_S16_U16_Static 1.999969 fak_q3p0518Em5 0.00 1.999969 FORMAT "%8.6"
 /begin AXIS_DESCR STD_AXIS ChrCtl_nEngCorrd EngN 5 -16384.00 16383.50 FORMAT "%8.2" DEPOSIT ABSOLUTE /end AXIS_DESCR
/end CHARACTERISTIC
/begin CHARACTERISTIC FIUWMSDKXN "Portion of the overtravel as of which the maximum mass flow flows" CURVE 0x80521484 RB_Curve_S16_U16_Static 1.999969 fak_uw_b2 0.00 1.999969 FORMAT "%8.6"
 /begin AXIS_DESCR STD_AXIS ChrCtl_nEngCorrd EngN 5 -16384.00 16383.50 FORMAT "%8.2" DEPOSIT ABSOLUTE /end AXIS_DESCR
/end CHARACTERISTIC
/begin CHARACTERISTIC FKDTRFRINT "Curve for correction of Air charge deviation with E85 fuel" CURVE 0x8051FCC6 RB_Curve_U16_U16 1.999969 fak_uw_b2 0.00 1.999969 FORMAT "%8.6"
 /begin AXIS_DESCR STD_AXIS FfPrm_facEth fak_uw_b2 5 0.00 1.999969 FORMAT "%8.6" DEPOSIT ABSOLUTE /end AXIS_DESCR
/end CHARACTERISTIC
/begin CHARACTERISTIC FKDTRFRINT2 "Curve for correction of Air charge deviation with E85 fuel" CURVE 0x8051FCDC RB_Curve_U16_U16 1.999969 fak_uw_b2 0.00 1.999969 FORMAT "%8.6"
 /begin AXIS_DESCR STD_AXIS rfrintro_w rel_q0p02344 10 0.00 1535.977 FORMAT "%8.3" DEPOSIT ABSOLUTE /end AXIS_DESCR
/end CHARACTERISTIC
/begin CHARACTERISTIC FKMSDKMN "low limit for fast mass-flow correction of throttle valve" VALUE 0x8051F7C4 RB_Val_Wu16 3.999939 fak_q6p1035Em5 0.00 3.999939 FORMAT "%8.6" /end CHARACTERISTIC
/begin CHARACTERISTIC FKMSDKMX "high limit for fast mass-flow correction of throttle valve" VALUE 0x8051F7C6 RB_Val_Wu16 3.999939 fak_q6p1035Em5 0.00 3.999939 FORMAT "%8.6" /end CHARACTERISTIC
/begin CHARACTERISTIC FKPVDKMN "lower limit for mass-flow correction of throttle valve" VALUE 0x8051F7C8 RB_Val_Wu16 3.999939 fak_q6p1035Em5 0.00 3.999939 FORMAT "%8.6" /end CHARACTERISTIC
/begin CHARACTERISTIC FKPVDKMSMN "Threshold normed desireds air mass flow for enable adaption of fkpvdk" VALUE 0x8051F7CA RB_Val_Wu16 6553.500 m_q0p1 0.00 6553.500 FORMAT "%8.3" /end CHARACTERISTIC
/begin CHARACTERISTIC FKPVDKMX "high limit for mass-flow correction of throttle valve" VALUE 0x8051F7CC RB_Val_Wu16 3.999939 fak_q6p1035Em5 0.00 3.999939 FORMAT "%8.6" /end CHARACTERISTIC
/begin CHARACTERISTIC FKPVDKPMN "pressure ration for enable adaption of fkpvdk" VALUE 0x8051F7CE RB_Val_Wu16 1.999969 fak_uw_b2 0.00 1.999969 FORMAT "%8.6" /end CHARACTERISTIC
/begin CHARACTERISTIC FKPVDKPUGD "Press. ratio from which on fkpvdk_w will not be calculated anymore" VALUE 0x8051F7D0 RB_Val_Wu16 1.999969 fak_uw_b2 0.00 1.999969 FORMAT "%8.6" /end CHARACTERISTIC
/begin CHARACTERISTIC FKVDVP "characteristic of Saint-Venant" CURVE 0x8052149A RB_FixCurve_U16_U16 1.999969 fak_uw_b2 0.00 1.999969 FORMAT "%8.6" READ_ONLY
 /begin AXIS_DESCR FIX_AXIS vpsrvdb_w_msg fak_uw_b2 30 0.5000000 0.9531250 FORMAT "%9.7" FIX_AXIS_PAR 16384 9 30 /end AXIS_DESCR
/end CHARACTERISTIC
/begin CHARACTERISTIC FMSNDKTN "Minimum factor msndk due to rise tolerances of the throttle valve" VALUE 0x805214D6 RB_Val_Wu16 1.999969 fak_q3p0518Em5 0.00 1.999969 FORMAT "%8.6" /end CHARACTERISTIC
/begin CHARACTERISTIC FMSNDKTX "Maximum factor msndk due to rise tolerances of the throttle valve" VALUE 0x805214D8 RB_Val_Wu16 1.999969 fak_q3p0518Em5 0.00 1.999969 FORMAT "%8.6" /end CHARACTERISTIC
/begin CHARACTERISTIC FMSPULSDKMN "Factor reduced massflow od throttle Valve through pulsations is max" VALUE 0x805216A8 RB_Val_Wu16 1.999969 fak_uw_b2 0.00 1.999969 FORMAT "%8.6" /end CHARACTERISTIC
/begin CHARACTERISTIC FMSPULSMN "Factor max masflow-amplitude depending on pulsation" VALUE 0x805214DA RB_Val_Wu16 1.999969 fak_q3p0518Em5 0.00 1.999969 FORMAT "%8.6" /end CHARACTERISTIC
/begin CHARACTERISTIC FMSPULSMX "Factor min masflow-amplitude depending on pulsation" VALUE 0x805214DC RB_Val_Wu16 1.999969 fak_q3p0518Em5 0.00 1.999969 FORMAT "%8.6" /end CHARACTERISTIC
/begin CHARACTERISTIC FRIRLABBR "ratio of air mass to exhaust mass in case of stoichiometry (i.e. 14.7 divided by (1+14.7))" VALUE 0x8051F91C RB_Val_Wu16 1.999969 fak_q3p0518Em5 0.00 1.999969 FORMAT "%8.6" /end CHARACTERISTIC
/begin CHARACTERISTIC FTMSDV "Characteristic curve: factor temperature C for mass flow (root)" CURVE 0x8051FD06 RB_Curve_U16_U16 1.999939 fak_uw_b2 0.000031 1.999969 FORMAT "%8.6" EXTENDED_LIMITS 0.00 1.999969
 /begin AXIS_DESCR STD_AXIS NO_INPUT_QUANTITY temp_q0p0234_o273 16 -273.150 1262.827 FORMAT "%8.3" DEPOSIT ABSOLUTE /end AXIS_DESCR
/end CHARACTERISTIC
/begin CHARACTERISTIC FUPSRLMN "Calculation factor pressure to load minimum" VALUE 0x8051FD48 RB_Val_Wu16 0.2999954 rel_uw_b0p3 0.00 0.2999954 FORMAT "%9.7" /end CHARACTERISTIC
/begin CHARACTERISTIC FUPSRLMX "Calculation factor pressure to load maximum" VALUE 0x8051FD4A RB_Val_Wu16 0.2999954 rel_uw_b0p3 0.00 0.2999954 FORMAT "%9.7" /end CHARACTERISTIC
/begin CHARACTERISTIC FVBR "Fact. volume f. input angle to stroke volume of a cylinder" CURVE 0x8051FD4C RB_Curve_S16_U16_Static 1.999969 fak_uw_b2 0.00 1.999969 FORMAT "%8.6"
 /begin AXIS_DESCR STD_AXIS GEVCtl_agIntkClsd kw_q0p0156 20 -512.0000 511.9844 FORMAT "%8.4" DEPOSIT ABSOLUTE /end AXIS_DESCR
/end CHARACTERISTIC
/begin CHARACTERISTIC InjSys_facCorFuCons_M "Factor for calculation fuel consumption" MAP 0x8051F830 RB_Map_S16U16_U16 1.999969 fak_uw_b2 0.00 1.999969 FORMAT "%8.6"
 /begin AXIS_DESCR STD_AXIS Epm_nEng EngN 6 -16384.00 16383.50 FORMAT "%8.2" DEPOSIT ABSOLUTE /end AXIS_DESCR
 /begin AXIS_DESCR STD_AXIS rkme_w_msg rel_uw_b3072 6 0.00 3071.953 FORMAT "%8.3" DEPOSIT ABSOLUTE /end AXIS_DESCR
/end CHARACTERISTIC
/begin CHARACTERISTIC InjSys_facCorrnDensFuCns_T "Factor for correction fuel consumption calculation based on fuel temperature" CURVE 0x8051F894 RB_Curve_U8_U8 1.992188 fak_ub_b2 0.00 1.992188 FORMAT "%8.6"
 /begin AXIS_DESCR STD_AXIS ffudens_msg fak_ub_b2 3 0.00 1.992188 FORMAT "%8.6" DEPOSIT ABSOLUTE /end AXIS_DESCR
/end CHARACTERISTIC
/begin CHARACTERISTIC InjSys_facCorrnFuT_T "Factor for correction fuel consumption calculation based on fuel temperature" CURVE 0x8051F89B RB_Curve_U8_U8 1.992188 fak_ub_b2 0.00 1.992188 FORMAT "%8.6"
 /begin AXIS_DESCR STD_AXIS InjSys_tFuSnsr temp_ub_q0p75_o48 8 -48.0 143.3 FORMAT "%5.1" DEPOSIT ABSOLUTE /end AXIS_DESCR
/end CHARACTERISTIC
/begin CHARACTERISTIC InjSys_facFuCorrnEthnlCns_M "Map for fuel correction ethanol consumption factor" MAP 0x8051F8AC RB_Map_S16U16_U16 1.999969 fak_uw_b2 0.00 1.999969 FORMAT "%8.6"
 /begin AXIS_DESCR STD_AXIS Epm_nEng EngN 6 -16384.00 16383.50 FORMAT "%8.2" DEPOSIT ABSOLUTE /end AXIS_DESCR
 /begin AXIS_DESCR STD_AXIS rkme_w_msg rel_uw_b3072 6 0.00 3071.953 FORMAT "%8.3" DEPOSIT ABSOLUTE /end AXIS_DESCR
/end CHARACTERISTIC
/begin CHARACTERISTIC InjSys_flgInjTiOpenActv_C "switch for differentiating between injector opening time and activation time period" VALUE 0x80521904 RB_Val_Wboolean 1.00000000000 B_TRUE 0.00 1.00000000000 FORMAT "%13.11" /end CHARACTERISTIC
/begin CHARACTERISTIC InjSys_idxInjPlsQuoTiMin_T "Assignment of injection pulse to injection mode for consideration of quotient ti TIMIN (table)" CURVE 0x80521905 RB_CurveGroup_U8 4.000 OneToOne 0.00 4.000 FORMAT "%5.3" EXTENDED_LIMITS 0.00 255.0
 /begin AXIS_DESCR COM_AXIS NO_INPUT_QUANTITY InjSys_InjMode_Set_COMPU_VERB 20 0.00 19.0000000000 FORMAT "%13.10" AXIS_PTS_REF InjSys_stInjMod_AX /end AXIS_DESCR
/end CHARACTERISTIC
/begin AXIS_PTS InjSys_stInjMod_AX "base point distribution current injection mode" 0x8055908E NO_INPUT_QUANTITY RB_Axis_U8 19.0000000000 InjSys_InjMode_Set_COMPU_VERB 20 0.00 19.0000000000 FORMAT "%13.10" DEPOSIT ABSOLUTE /end AXIS_PTS
/begin CHARACTERISTIC InjSys_tiMinRatCvoIdle_C "minimum injection time during idle for calculation of quotient ti to timin for purge control regarding CVO" VALUE 0x8052191A RB_Val_Wu16 65.53500 t_q0p001_ms 0.00 65.53500 FORMAT "%8.5" /end CHARACTERISTIC
/begin CHARACTERISTIC InjSys_tiMinRatCvo_C "minimum injection time for calculation of quotient ti to timin for purge control regarding CVO" VALUE 0x8052191C RB_Val_Wu16 65.53500 t_q0p001_ms 0.00 65.53500 FORMAT "%8.5" /end CHARACTERISTIC
/begin CHARACTERISTIC KFDIPABERGVP "Delta interpolation factor for calculation of effective exhaust gas backpressure for model of internal EGR" MAP 0x8051FD9E RB_Map_U16S16_S16 2.999939 fak_sw_b2 -1.000000 1.999939 FORMAT "%8.6" EXTENDED_LIMITS -2.000000 1.999939
 /begin AXIS_DESCR STD_AXIS vpsab_w fak_uw_b4 10 0.00 3.999939 FORMAT "%8.6" DEPOSIT ABSOLUTE /end AXIS_DESCR
 /begin AXIS_DESCR STD_AXIS Epm_nEng10ms EngN 18 -16384.00 16383.50 FORMAT "%8.2" DEPOSIT ABSOLUTE /end AXIS_DESCR
/end CHARACTERISTIC
/begin CHARACTERISTIC KFDIPABERGVP1 "Delta interpolation factor for calculation of effective exhaust gas backpressure for model of internal EGR 1" MAP 0x8051FF42 RB_Map_U16S16_S16 2.999939 fak_sw_b2 -1.000000 1.999939 FORMAT "%8.6" EXTENDED_LIMITS -2.000000 1.999939
 /begin AXIS_DESCR STD_AXIS vpsab_w fak_uw_b4 10 0.00 3.999939 FORMAT "%8.6" DEPOSIT ABSOLUTE /end AXIS_DESCR
 /begin AXIS_DESCR STD_AXIS Epm_nEng10ms EngN 18 -16384.00 16383.50 FORMAT "%8.2" DEPOSIT ABSOLUTE /end AXIS_DESCR
/end CHARACTERISTIC
/begin CHARACTERISTIC KFDPBRMXWE "map: correction value of fupsrl for wide opend trottle valve" MAP 0x805200E6 RB_Map_S16S16_S16 0.9999847 fak_q1p526Em5 -0.5000000 0.4999847 FORMAT "%9.7"
 /begin AXIS_DESCR STD_AXIS GEVCtl_agIntkClsd kw_q0p0156 10 -512.0000 511.9844 FORMAT "%8.4" DEPOSIT ABSOLUTE /end AXIS_DESCR
 /begin AXIS_DESCR STD_AXIS nmottkor_w EngN 24 -16384.00 16383.50 FORMAT "%8.2" DEPOSIT ABSOLUTE /end AXIS_DESCR
/end CHARACTERISTIC
/begin CHARACTERISTIC KFDPBRMXWE1 "map: correction value of fupsrl for wide opend trottle valve flap1 active" MAP 0x8052030E RB_Map_S16S16_S16 0.9999847 fak_q1p526Em5 -0.5000000 0.4999847 FORMAT "%9.7"
 /begin AXIS_DESCR STD_AXIS GEVCtl_agIntkClsd kw_q0p0156 10 -512.0000 511.9844 FORMAT "%8.4" DEPOSIT ABSOLUTE /end AXIS_DESCR
 /begin AXIS_DESCR STD_AXIS nmottkor_w EngN 18 -16384.00 16383.50 FORMAT "%8.2" DEPOSIT ABSOLUTE /end AXIS_DESCR
/end CHARACTERISTIC
/begin CHARACTERISTIC KFDPBRMXWU1 "map: correction value of fupsrl for wide opend trottle valve adressed by valve overlap flap1 active" MAP 0x805204B2 RB_Map_S16S16_S16 0.9999847 fak_q1p526Em5 -0.5000000 0.4999847 FORMAT "%9.7"
 /begin AXIS_DESCR STD_AXIS wgvum_w_msg kw_q0p0156 10 -512.0000 511.9844 FORMAT "%8.4" DEPOSIT ABSOLUTE /end AXIS_DESCR
 /begin AXIS_DESCR STD_AXIS nmottkor_w EngN 18 -16384.00 16383.50 FORMAT "%8.2" DEPOSIT ABSOLUTE /end AXIS_DESCR
/end CHARACTERISTIC
/begin CHARACTERISTIC KFDPBRWE "map: correction value of fupsrl" MAP 0x80520656 RB_Map_S16S16_S16 0.9999847 fak_q1p526Em5 -0.5000000 0.4999847 FORMAT "%9.7"
 /begin AXIS_DESCR STD_AXIS GEVCtl_agIntkClsd kw_q0p0156 10 -512.0000 511.9844 FORMAT "%8.4" DEPOSIT ABSOLUTE /end AXIS_DESCR
 /begin AXIS_DESCR STD_AXIS nmottkor_w EngN 24 -16384.00 16383.50 FORMAT "%8.2" DEPOSIT ABSOLUTE /end AXIS_DESCR
/end CHARACTERISTIC
/begin CHARACTERISTIC KFDPBRWE1 "map: correction value of fupsrl flap1 activ" MAP 0x8052087E RB_Map_S16S16_S16 0.9999847 fak_q1p526Em5 -0.5000000 0.4999847 FORMAT "%9.7"
 /begin AXIS_DESCR STD_AXIS GEVCtl_agIntkClsd kw_q0p0156 10 -512.0000 511.9844 FORMAT "%8.4" DEPOSIT ABSOLUTE /end AXIS_DESCR
 /begin AXIS_DESCR STD_AXIS nmottkor_w EngN 18 -16384.00 16383.50 FORMAT "%8.2" DEPOSIT ABSOLUTE /end AXIS_DESCR
/end CHARACTERISTIC
/begin CHARACTERISTIC KFDRLFRMN "min. delta between rlsol and rl for inclusion in charge controller calculation for gasoline (tnst_w, tmot)" MAP 0x805216AA RB_Map_U16S16_S16 1535.977 rel_q0p02344 -768.0000 767.9766 FORMAT "%8.4"
 /begin AXIS_DESCR STD_AXIS tnst_w_msg t_q0p01 5 0.00 655.3500 FORMAT "%8.4" DEPOSIT ABSOLUTE /end AXIS_DESCR
 /begin AXIS_DESCR STD_AXIS CEngDsT_t Temp_Cels 5 -3549.940 3003.560 FORMAT "%8.3" DEPOSIT ABSOLUTE /end AXIS_DESCR
/end CHARACTERISTIC
/begin CHARACTERISTIC KFDRLFRMNE "min. delta between rlsol and rl for inclusion in charge controller calculation for E100 (tnst_w, tmot)" MAP 0x805216F4 RB_Map_U16S16_S16 1535.977 rel_q0p02344 -768.0000 767.9766 FORMAT "%8.4"
 /begin AXIS_DESCR STD_AXIS tnst_w_msg t_q0p01 5 0.00 655.3500 FORMAT "%8.4" DEPOSIT ABSOLUTE /end AXIS_DESCR
 /begin AXIS_DESCR STD_AXIS CEngDsT_t Temp_Cels 5 -3549.940 3003.560 FORMAT "%8.3" DEPOSIT ABSOLUTE /end AXIS_DESCR
/end CHARACTERISTIC
/begin CHARACTERISTIC KFDRLFRMX "max. delta between rlsol and rl for inclusion in charge controller calculation for gasoline (tnst_w, tmot)" MAP 0x8052173E RB_Map_U16S16_S16 1535.977 rel_q0p02344 -768.0000 767.9766 FORMAT "%8.4"
 /begin AXIS_DESCR STD_AXIS tnst_w_msg t_q0p01 5 0.00 655.3500 FORMAT "%8.4" DEPOSIT ABSOLUTE /end AXIS_DESCR
 /begin AXIS_DESCR STD_AXIS CEngDsT_t Temp_Cels 5 -3549.940 3003.560 FORMAT "%8.3" DEPOSIT ABSOLUTE /end AXIS_DESCR
/end CHARACTERISTIC
/begin CHARACTERISTIC KFDRLFRMXE "max. delta between rlsol and rl for inclusion in charge controller calculation for E100 (tnst_w, tmot)" MAP 0x80521788 RB_Map_U16S16_S16 1535.977 rel_q0p02344 -768.0000 767.9766 FORMAT "%8.4"
 /begin AXIS_DESCR STD_AXIS tnst_w_msg t_q0p01 5 0.00 655.3500 FORMAT "%8.4" DEPOSIT ABSOLUTE /end AXIS_DESCR
 /begin AXIS_DESCR STD_AXIS CEngDsT_t Temp_Cels 5 -3549.940 3003.560 FORMAT "%8.3" DEPOSIT ABSOLUTE /end AXIS_DESCR
/end CHARACTERISTIC
/begin CHARACTERISTIC KFDTRFRINT "Map for correction of Air charge deviation with E85 fuel" MAP 0x80520A22 RB_Map_U16S16_U16 180.0000 temp_q0p0234_o273 -180.0094 -0.0094 FORMAT "%8.4" EXTENDED_LIMITS -273.1500 1262.827
 /begin AXIS_DESCR STD_AXIS psr_w_msg p_uw_q0p078 14 0.00 5119.922 FORMAT "%8.3" DEPOSIT ABSOLUTE /end AXIS_DESCR
 /begin AXIS_DESCR STD_AXIS Epm_nEng EngN 24 0.00 16383.50 FORMAT "%8.2" EXTENDED_LIMITS -16384.00 16383.50 DEPOSIT ABSOLUTE /end AXIS_DESCR
/end CHARACTERISTIC
/begin CHARACTERISTIC KFFPBRKSVN "Map slope correction for the adaption of intake manifold pressure to air pressure in the combustion chamber" MAP 0x80520D12 RB_Map_U16S16_S16 3.999939 fak_sw_b2 -2.000000 1.999939 FORMAT "%8.6"
 /begin AXIS_DESCR STD_AXIS vpsrpuakt_w fak_uw_b4 18 0.00 3.999939 FORMAT "%8.6" DEPOSIT ABSOLUTE /end AXIS_DESCR
 /begin AXIS_DESCR STD_AXIS nmotsw_w EngN 12 -16384.00 16383.50 FORMAT "%8.2" DEPOSIT ABSOLUTE /end AXIS_DESCR
/end CHARACTERISTIC
/begin CHARACTERISTIC KFFPBRKSVN1 "Map slope correction for the adaption of intake manifold pressure to air pressure in the combustion chamber 1" MAP 0x80520F02 RB_Map_U16S16_S16 3.999939 fak_sw_b2 -2.000000 1.999939 FORMAT "%8.6"
 /begin AXIS_DESCR STD_AXIS vpsrpuakt_w fak_uw_b4 18 0.00 3.999939 FORMAT "%8.6" DEPOSIT ABSOLUTE /end AXIS_DESCR
 /begin AXIS_DESCR STD_AXIS nmotsw_w EngN 12 -16384.00 16383.50 FORMAT "%8.2" DEPOSIT ABSOLUTE /end AXIS_DESCR
/end CHARACTERISTIC
/begin CHARACTERISTIC KFIPABERG "Interpolation factor for calculation of effective exhaust gas backpressure for model of internal EGR" MAP 0x805210F2 RB_Map_S16S16_S16 2.999939 fak_sw_b2 -1.000000 1.999939 FORMAT "%8.6" EXTENDED_LIMITS -2.000000 1.999939
 /begin AXIS_DESCR STD_AXIS wgvum_w_msg kw_q0p0156 10 -512.0000 511.9844 FORMAT "%8.4" DEPOSIT ABSOLUTE /end AXIS_DESCR
 /begin AXIS_DESCR STD_AXIS nmotsw_w EngN 24 -16384.00 16383.50 FORMAT "%8.2" DEPOSIT ABSOLUTE /end AXIS_DESCR
/end CHARACTERISTIC
/begin CHARACTERISTIC KFMSNWDKVP "standardised air mass flow through throttle valve" MAP 0x805214DE RB_Map_U16U16_U16 6553.500 m_q0p1 0.00 6553.500 FORMAT "%8.3"
 /begin AXIS_DESCR STD_AXIS NO_INPUT_QUANTITY rel_uw_b100 18 0.00 99.99847 FORMAT "%8.5" DEPOSIT ABSOLUTE /end AXIS_DESCR
 /begin AXIS_DESCR STD_AXIS vpsrvdb_w_msg fak_uw_b2 8 0.00 1.999969 FORMAT "%8.6" DEPOSIT ABSOLUTE /end AXIS_DESCR
/end CHARACTERISTIC
/begin CHARACTERISTIC KFTEIRLRLSN "Map time constants for stabalization of rlrlsol" MAP 0x805217D2 RB_Map_S16S16_U16 65.51500 t_q0p001 0.02000 65.53500 FORMAT "%8.5" EXTENDED_LIMITS 0.00 65.53500
 /begin AXIS_DESCR STD_AXIS Epm_nEng EngN 5 -16384.00 16383.50 FORMAT "%8.2" DEPOSIT ABSOLUTE /end AXIS_DESCR
 /begin AXIS_DESCR STD_AXIS drlm_w_msg rel_q0p02344 5 -768.0000 767.9766 FORMAT "%8.4" DEPOSIT ABSOLUTE /end AXIS_DESCR
/end CHARACTERISTIC
/begin CHARACTERISTIC KFTEIRLRLSZN "Map time constants for stabalization of rlrlsol at rlsolrl less than rl" MAP 0x8052181C RB_Map_S16S16_U16 65.51500 t_q0p001 0.02000 65.53500 FORMAT "%8.5" EXTENDED_LIMITS 0.00 65.53500
 /begin AXIS_DESCR STD_AXIS Epm_nEng EngN 5 -16384.00 16383.50 FORMAT "%8.2" DEPOSIT ABSOLUTE /end AXIS_DESCR
 /begin AXIS_DESCR STD_AXIS drlm_w_msg rel_q0p02344 5 -768.0000 767.9766 FORMAT "%8.4" DEPOSIT ABSOLUTE /end AXIS_DESCR
/end CHARACTERISTIC
/begin CHARACTERISTIC KLFPBRGRVIVC "combustion chamber pressure balance correction for inlet calve closing" CURVE 0x8052131A RB_Curve_S16_U16_Static 1.999969 fak_uw_b2 0.00 1.999969 FORMAT "%8.6"
 /begin AXIS_DESCR STD_AXIS grfvbr_w fak_sw_q64 12 -512.0000 511.9844 FORMAT "%8.4" DEPOSIT ABSOLUTE /end AXIS_DESCR
/end CHARACTERISTIC
/begin CHARACTERISTIC KLFPBRGRVIVCVHE "combustion chamber pressure balance correction for operation points with gas exchange valves on 2nd inlet valve lift for inlet valve closing" CURVE 0x8052134C RB_Curve_S16_U16_Static 1.999969 fak_uw_b2 0.00 1.999969 FORMAT "%8.6"
 /begin AXIS_DESCR STD_AXIS grfvbr_w fak_sw_q64 12 -512.0000 511.9844 FORMAT "%8.4" DEPOSIT ABSOLUTE /end AXIS_DESCR
/end CHARACTERISTIC
/begin CHARACTERISTIC KLGRFVBRWVHE "volume change of cumbustion chamber at inlet valve closing for operation points with gas exchange valves on 2nd inlet valve lift" CURVE 0x8052137E RB_Curve_S16_S16 63.99902 vol_q9p766Em4_L -32.00000 31.99902 FORMAT "%8.5"
 /begin AXIS_DESCR STD_AXIS GEVCtl_agIntkClsd kw_q0p0156 20 -512.0000 511.9844 FORMAT "%8.4" DEPOSIT ABSOLUTE /end AXIS_DESCR
/end CHARACTERISTIC
/begin CHARACTERISTIC KLIDRLETH "Interpolation curve between ethanol and gasoline depending on ethanol content for min. max. delta between rlsol and rl for inclusion in charge controller calculation" CURVE 0x80521866 RB_Curve_U16_U8_Static 0.9961 fak_ub_b1 0.00 0.9961
 /begin AXIS_DESCR STD_AXIS FfPrm_facEth fak_uw_b2 4 0.00 1.999969 FORMAT "%8.6" DEPOSIT ABSOLUTE /end AXIS_DESCR
/end CHARACTERISTIC
/begin CHARACTERISTIC KLMCO2L "Curve: mass CO2 per fuel liter (ethanol content dependent) in g/L" CURVE 0x8051F910 RB_Curve_U16_U16 6553.500 m_q0p1_g_DIV_L 0.00 6553.500 FORMAT "%8.3"
 /begin AXIS_DESCR STD_AXIS FfPrm_facEth fak_uw_b2 2 0.00 1.999969 FORMAT "%8.6" DEPOSIT ABSOLUTE /end AXIS_DESCR
/end CHARACTERISTIC
/begin CHARACTERISTIC KLREDOSP "Characteristic line to reduce overshoot problem for prediction psr_w to end of segment" CURVE 0x805218BE RB_Curve_S16_U16_Static 1.999969 fak_uw_b2 0.00 1.999969 FORMAT "%8.6"
 /begin AXIS_DESCR STD_AXIS Epm_nEng EngN 4 -16384.00 16383.50 FORMAT "%8.2" DEPOSIT ABSOLUTE /end AXIS_DESCR
/end CHARACTERISTIC
/begin CHARACTERISTIC KLTPPSRIFD "lowpass filter psrif_w" CURVE 0x805218D0 RB_Curve_U16_U16 1.999969 fak_q3p0518Em5 0.00 1.999969 FORMAT "%8.6"
 /begin AXIS_DESCR STD_AXIS fdpslma_w fak_q3p0518Em5 5 0.00 1.999969 FORMAT "%8.6" DEPOSIT ABSOLUTE /end AXIS_DESCR
/end CHARACTERISTIC
/begin CHARACTERISTIC KLTPPSRIFH "lowpass filter psrif_w in Half Engine Mode" CURVE 0x805218E6 RB_Curve_U16_U16 1.999969 fak_q3p0518Em5 0.00 1.999969 FORMAT "%8.6"
 /begin AXIS_DESCR STD_AXIS fdpslma_w fak_q3p0518Em5 5 0.00 1.999969 FORMAT "%8.6" DEPOSIT ABSOLUTE /end AXIS_DESCR
/end CHARACTERISTIC
/begin CHARACTERISTIC KLVPSPVDMNFASA "Curve: correction in pressure ratio threshold due to a big leakage into intake manifold" CURVE 0x8051F7D2 RB_Curve_S16_U16_Static 1.999969 fak_uw_b2 0.00 1.999969 FORMAT "%8.6"
 /begin AXIS_DESCR STD_AXIS Epm_nEng EngN 5 -16384.00 16383.50 FORMAT "%8.2" DEPOSIT ABSOLUTE /end AXIS_DESCR
/end CHARACTERISTIC
/begin CHARACTERISTIC KMSDK "gain factor for filtering msdk" VALUE 0x80521636 RB_Val_Wu16 7.999878 fak_q1p22Em4 0.00 7.999878 FORMAT "%8.6" /end CHARACTERISTIC
/begin CHARACTERISTIC LamCtrl_flgFixdIninAftSpst_C "Initialization of lambda setpoint with fixed value after stop-phase" VALUE 0x8051F91E RB_Val_Wu8 1.00000000000 B_TRUE 0.00 1.00000000000 FORMAT "%13.11" /end CHARACTERISTIC
/begin CHARACTERISTIC LamCtrl_ratLamIninAftSpst_C "Initialization value for lambda set point after start-stop" VALUE 0x8051F920 RB_Val_Wu16 15.99976 fak_uw_b16 0.00 15.99976 FORMAT "%8.5" /end CHARACTERISTIC
/begin CHARACTERISTIC LASTCMN "Lower bound for stoichiometric lambda" VALUE 0x8051F922 RB_Val_Wu16 15.99976 fak_q0p000244 0.00 15.99976 FORMAT "%8.5" /end CHARACTERISTIC
/begin CHARACTERISTIC LASTCMX "Upper bound for stoichiometric lambda" VALUE 0x8051F924 RB_Val_Wu16 15.99976 fak_q0p000244 0.00 15.99976 FORMAT "%8.5" /end CHARACTERISTIC
/begin CHARACTERISTIC MSNRIRSP "Curve stand. mass flow of re-asp. inert gas" CURVE 0x805213D0 RB_Curve_S16_U16_Static 204.7969 m_q0p0031 0.00 204.7969 FORMAT "%8.4"
 /begin AXIS_DESCR STD_AXIS wgvum_w_msg kw_sw_q0p0156 10 -512.00000 511.98438 DEPOSIT ABSOLUTE /end AXIS_DESCR
/end CHARACTERISTIC
/begin CHARACTERISTIC MTOLMSTE "Massflow tolerance of TEV massflow" CURVE 0x8051F7E8 RB_Curve_U8_U8 25.50 m_ub_b25p6 0.00 25.50 FORMAT "%5.2"
 /begin AXIS_DESCR STD_AXIS mste_msg m_ub_b25p6 6 0.00 25.50 FORMAT "%5.2" DEPOSIT ABSOLUTE /end AXIS_DESCR
/end CHARACTERISTIC
/begin CHARACTERISTIC MXVVVEKN "Map maximum compression ratio for low lift" CURVE 0x8052187C RB_Curve_S16_U16_Static 7.999878 fak_uw_b8 0.00 7.999878 FORMAT "%8.6"
 /begin AXIS_DESCR STD_AXIS Epm_nEng EngN 16 -16384.00 16383.50 FORMAT "%8.2" DEPOSIT ABSOLUTE /end AXIS_DESCR
/end CHARACTERISTIC
/begin CHARACTERISTIC NMOTFADKMN "engine speed for enable adaption of fkpvdk(min)" VALUE 0x8051F7F6 RB_Val_Ws16 32767.50 EngN -16384.00 16383.50 FORMAT "%8.2" /end CHARACTERISTIC
/begin CHARACTERISTIC NMOTFADKMX "engine speed for enable adaption of fkpvdk(max)" VALUE 0x8051F7F8 RB_Val_Ws16 32767.50 EngN -16384.00 16383.50 FORMAT "%8.2" /end CHARACTERISTIC
/begin CHARACTERISTIC NMOTOFDKMN "Engine speed for enable adaptation of ofmsndk min." VALUE 0x8051F7FA RB_Val_Ws16 32767.50 EngN -16384.00 16383.50 FORMAT "%8.2" /end CHARACTERISTIC
/begin CHARACTERISTIC NMOTOFDKMN2 "Engine speed for enable adaptation of ofmsndk minimum (in window region 2)" VALUE 0x8051F7FC RB_Val_Ws16 32767.50 EngN -16384.00 16383.50 FORMAT "%8.2" /end CHARACTERISTIC
/begin CHARACTERISTIC NMOTOFDKMX "Engine speed for enable adaptation of ofmsndk max." VALUE 0x8051F7FE RB_Val_Ws16 32767.50 EngN -16384.00 16383.50 FORMAT "%8.2" /end CHARACTERISTIC
/begin CHARACTERISTIC NMOTOFDKMX2 "Engine speed for enable adaptation of ofmsndk maximum (in window region 2)" VALUE 0x8051F800 RB_Val_Ws16 32767.50 EngN -16384.00 16383.50 FORMAT "%8.2" /end CHARACTERISTIC
/begin CHARACTERISTIC NPNDKGMN "engine speed limit for calculating pressure in syn for pressure downstream trottle valve" VALUE 0x8052187A RB_Val_Ws16 32767.50 EngN -16384.00 16383.50 FORMAT "%8.2" /end CHARACTERISTIC
/begin CHARACTERISTIC NPSRSEG "Engine speed threshold for switching to segment raster" VALUE 0x805218FC RB_Val_Ws16 16383.50 EngN 0.00 16383.50 FORMAT "%8.2" EXTENDED_LIMITS -16384.00 16383.50 /end CHARACTERISTIC
/begin CHARACTERISTIC NPULSMN "engine speed limit where pulsation at manifold appears" VALUE 0x805218FE RB_Val_Ws16 16383.50 EngN 0.00 16383.50 FORMAT "%8.2" EXTENDED_LIMITS -16384.00 16383.50 /end CHARACTERISTIC
/begin CHARACTERISTIC NRLMN "lowest engine speed for calculation of umsrln" VALUE 0x80521874 RB_Val_Wu16 8191.500 nmot_q0p25 0.250 8191.750 FORMAT "%8.3" EXTENDED_LIMITS 0.00 16383.75 /end CHARACTERISTIC
/begin CHARACTERISTIC OFMSNDKINI "Initialisation value normized massflow through throttle blade" VALUE 0x8051F802 RB_Val_Ws16 6553.500 m_q0p1 -3276.800 3276.700 FORMAT "%8.3" /end CHARACTERISTIC
/begin CHARACTERISTIC OFMSNDKINI2 "Initialisation value normized massflow through throttle blade in second adaptation region" VALUE 0x8051F804 RB_Val_Ws16 6553.500 m_q0p1 -3276.800 3276.700 FORMAT "%8.3" /end CHARACTERISTIC
/begin CHARACTERISTIC OFMSNDKMN "minimum value offset norm air mass flow through throttle" VALUE 0x8051F806 RB_Val_Ws16 6553.500 m_q0p1 -3276.800 3276.700 FORMAT "%8.3" /end CHARACTERISTIC
/begin CHARACTERISTIC OFMSNDKMN2 "minimum value offset norm air mass flow through throttle (window region 2)" VALUE 0x8051F808 RB_Val_Ws16 6553.500 m_q0p1 -3276.800 3276.700 FORMAT "%8.3" /end CHARACTERISTIC
/begin CHARACTERISTIC OFMSNDKMX "maximum value offset norm air mass flow through throttle" VALUE 0x8051F80A RB_Val_Ws16 6553.500 m_q0p1 -3276.800 3276.700 FORMAT "%8.3" /end CHARACTERISTIC
/begin CHARACTERISTIC OFMSNDKMX2 "maximum value offset norm air mass flow through throttle (window region 2)" VALUE 0x8051F80C RB_Val_Ws16 6553.500 m_q0p1 -3276.800 3276.700 FORMAT "%8.3" /end CHARACTERISTIC
/begin CHARACTERISTIC OFMSNDKTN "min. leakage of throttle blade for model based diagnosis" VALUE 0x80521638 RB_Val_Ws16 6553.500 m_q0p1 -3276.800 3276.700 FORMAT "%8.3" /end CHARACTERISTIC
/begin CHARACTERISTIC OFMSNDKTX "max. leakage of throttle blade for model based diagnosis" VALUE 0x8052163A RB_Val_Ws16 6553.500 m_q0p1 -3276.800 3276.700 FORMAT "%8.3" /end CHARACTERISTIC
/begin CHARACTERISTIC OFMSNDMSMN "Threshold normed desireds air mass flow for enable adaption of ofmsndk" VALUE 0x8051F80E RB_Val_Wu16 6553.500 m_q0p1 0.00 6553.500 FORMAT "%8.3" /end CHARACTERISTIC
/begin CHARACTERISTIC OFMSNDMSMN2 "Threshold normed desired air mass flow for enable adaption of ofmsndk (in window region 2)" VALUE 0x8051F810 RB_Val_Wu16 6553.500 m_q0p1 0.00 6553.500 FORMAT "%8.3" /end CHARACTERISTIC
/begin CHARACTERISTIC OFMSNDMSMX "Maximum threshold normed desireds air mass flow for enable adaption of ofmsndk" VALUE 0x8051F812 RB_Val_Wu16 6553.500 m_q0p1 0.00 6553.500 FORMAT "%8.3" /end CHARACTERISTIC
/begin CHARACTERISTIC OFMSNDMSMX2 "Maximum threshold normed desireds air mass flow for enable adaption of ofmsndk (in window region 2)" VALUE 0x8051F814 RB_Val_Wu16 6553.500 m_q0p1 0.00 6553.500 FORMAT "%8.3" /end CHARACTERISTIC
/begin CHARACTERISTIC OFMSNDMSMX3 "Maximum threshold normed desired air mass flow for back interpolation to ofmsndk in window region 1" VALUE 0x8051F816 RB_Val_Wu16 6553.500 m_q0p1 0.00 6553.500 FORMAT "%8.3" /end CHARACTERISTIC
/begin CHARACTERISTIC PBRINTMN "partial pressure residual gas in chamber minimum" VALUE 0x805213FA RB_Val_Wu16 2559.961 p_uw_q0p039 0.00 2559.961 FORMAT "%8.3" /end CHARACTERISTIC
/begin CHARACTERISTIC PBRINTMX "partial pressure residual gas in chamber maximum" VALUE 0x805213FC RB_Val_Wu16 2559.961 p_uw_q0p039 0.00 2559.961 FORMAT "%8.3" /end CHARACTERISTIC
/begin CHARACTERISTIC PIntkVUs_tiSwtFilPrm_C "time, other filterparameter are used in case of change of the intake valve lift" VALUE 0x80521900 RB_Val_Wu16 655.3500 t_q0p01 0.00 655.3500 FORMAT "%8.4" /end CHARACTERISTIC
/begin CHARACTERISTIC RRSEXTSABG "threshold of rate of external egr in intake manifold below throttle blade adaptation in p-based systems is enabled" VALUE 0x8051F818 RB_Val_Wu16 99.99847 rel_uw_b100 0.00 99.99847 FORMAT "%8.5" /end CHARACTERISTIC
/begin CHARACTERISTIC SAPSRR "Startvalue fade in adaption psrr_w" VALUE 0x80521902 RB_Val_Wu16 5119.922 p_q0p078 0.00 5119.922 FORMAT "%8.3" /end CHARACTERISTIC
/begin CHARACTERISTIC TAFKPVDKE "delay time for condition adaption fkpvdk in steady-state" VALUE 0x8051F81A RB_Val_Wu8 25.50 t_q0p1 0.00 25.50 FORMAT "%5.2" /end CHARACTERISTIC
/begin CHARACTERISTIC TAOFMSNDKE "Time constant for determining leakage air adaptation throttle valve steady" VALUE 0x8051F81B RB_Val_Wu8 25.50 t_q0p1 0.00 25.50 FORMAT "%5.2" /end CHARACTERISTIC
/begin CHARACTERISTIC TDABGLST "Delay enable adjustment after cranking" VALUE 0x8051F81C RB_Val_Wu16 655.3500 t_q0p01 0.00 655.3500 FORMAT "%8.4" /end CHARACTERISTIC
/begin CHARACTERISTIC TDDTEVFGAB "Time delay after %DTEV for enabling of throttle adaption" VALUE 0x8051F81E RB_Val_Wu16 655.3500 t_q0p01 0.00 655.3500 FORMAT "%8.4" /end CHARACTERISTIC
/begin CHARACTERISTIC TDFGABOAGR "delay time of !B_agron for enabling of fkmsdk_w" VALUE 0x8051F820 RB_Val_Wu16 6553.500 t_q0p1 0.00 6553.500 FORMAT "%8.3" /end CHARACTERISTIC
/begin CHARACTERISTIC TDFKMSDKMA "time constant for DFKMSDKSMA ramp" VALUE 0x8051F822 RB_Val_Wu16 2.9962383795 zk10msxs_uw_b655 0.0100001526 3.0062385321 FORMAT "%12.10" EXTENDED_LIMITS 0.010000152590 655.36000000 /end CHARACTERISTIC
/begin CHARACTERISTIC TDSAFGABGL "Time delay after Bit B_sa for enabling of throttle adaption" VALUE 0x8051F824 RB_Val_Wu16 655.3500 t_q0p01 0.00 655.3500 FORMAT "%8.4" /end CHARACTERISTIC
/begin CHARACTERISTIC TDSAOFMNDP "Time delay after Bit B_sa for enabling B_ofmsndkp" VALUE 0x8051F826 RB_Val_Wu16 6553.500 t_q0p1 0.00 6553.500 FORMAT "%8.3" /end CHARACTERISTIC
/begin CHARACTERISTIC TDSDAGRSS "Time delay for the enable of the throttle valve adaptation after EGR diagnosis" VALUE 0x8051F828 RB_Val_Wu16 655.3500 t_q0p01 0.00 655.3500 FORMAT "%8.4" /end CHARACTERISTIC
/begin CHARACTERISTIC TDWDKSUGD "delay time for B_wdksugd" VALUE 0x8051F82A RB_Val_Wu8 0.1000 t_q0p01 0.00 0.1000 EXTENDED_LIMITS 0.00 2.550 /end CHARACTERISTIC
/begin CHARACTERISTIC TRLRLSDKMN "min.time constant for time constant rl/rlsol-low-pass filter in the suction area" VALUE 0x80521876 RB_Val_Wu16 0.1900000 t_q0p001 0.0100000 0.2000000 FORMAT "%9.7" EXTENDED_LIMITS 0.00 65.53500 /end CHARACTERISTIC
/begin CHARACTERISTIC TUGDTX "Time delay of the ugd condition calculated with the tolerance-bound throttle valve angle" VALUE 0x8052163C RB_Val_Wu8 2.550 t_q0p01 0.00 2.550 FORMAT "%5.3" /end CHARACTERISTIC
/begin CHARACTERISTIC VPSPVDMNFA "min. pressure ration ps/pvdkds for enabling of throttle adaption" VALUE 0x8051F82C RB_Val_Wu16 1.999969 fak_uw_b2 0.00 1.999969 FORMAT "%8.6" /end CHARACTERISTIC
/begin CHARACTERISTIC VPSRMHVDUG "Ratio (desired manifold pressure/basic boost pressure) for enabling WOT for MAF-Sensor diagnosis" VALUE 0x8052163E RB_Val_Wu16 1.999969 fak_q3p0518Em5 0.00 1.999969 FORMAT "%8.6" /end CHARACTERISTIC
/begin CHARACTERISTIC VPSRVDUGD "ratio of intake manifold pressure to pressure upstream throttle is 0.95" VALUE 0x80521640 RB_Val_Wu16 1.999969 fak_uw_b2 0.00 1.999969 FORMAT "%8.6" READ_ONLY /end CHARACTERISTIC
/begin CHARACTERISTIC VSONTL "Volume between lambda sensor and outlet of the turbocharger" VALUE 0x8051F926 RB_Val_Wu16 19999.69 vol_q0p306_cme3 0.00 19999.69 FORMAT "%8.2" /end CHARACTERISTIC
/begin MEASUREMENT AirMod_dia "Delta ignition angle for AirMod" SBYTE kw_q0p75 1 100 -96.00 95.25 FORMAT "%5.2" ECU_ADDRESS 0x60001170 /end MEASUREMENT
/begin MEASUREMENT AirMod_facDia "Factor delta ignition angle for AirMod" UWORD fak_uw_b2 1 100 0.00 1.000000 FORMAT "%8.6" ECU_ADDRESS 0x6000116E /end MEASUREMENT
/begin MEASUREMENT AirMod_facFcoCorrnRamp "ramp factor for correction of charge modell at fuel cut of" UWORD fak_uw_b2 1 100 0.00 1.000000 FORMAT "%8.6" ECU_ADDRESS 0x6000116C /end MEASUREMENT
/begin MEASUREMENT AirMod_flgRstFkorCalc "Flag to reset a slope correction factor if idle VTC map is selected and VTC position in reference" UBYTE B_TRUE 1 100 0.00 1.00000000000 BIT_MASK 0x1 FORMAT "%13.11" ECU_ADDRESS 0x6000116B /end MEASUREMENT
/begin MEASUREMENT AirMod_flgRstFkorCalcAftDly "Flag with delay to reset a slope correction factor if idle VTC map is selected and VTC position is in reference" UBYTE B_TRUE 1 100 0.00 1.00000000000 BIT_MASK 0x1 FORMAT "%13.11" ECU_ADDRESS 0x6000116A /end MEASUREMENT
/begin MEASUREMENT AirMod_flgRstFkorCalcHomBg "Flag to reset a slope correction factor if idle VTC map is selected and VTC position in reference in HOM" UBYTE B_TRUE 1 100 0.00 1.00000000000 BIT_MASK 0x1 FORMAT "%13.11" ECU_ADDRESS 0x6000112A /end MEASUREMENT
/begin MEASUREMENT AirMod_flgRstFkorCalcVhegBg "Flag to reset a slope correction factor if idle VTC map is selected and VTC position in reference in VHEG" UBYTE B_TRUE 1 100 0.00 1.00000000000 BIT_MASK 0x1 FORMAT "%13.11" ECU_ADDRESS 0x60001129 /end MEASUREMENT
/begin MEASUREMENT AirMod_flgRstFkorCalcVhekBg "Flag to reset a slope correction factor if idle VTC map is selected and VTC position in reference in VHEK" UBYTE B_TRUE 1 100 0.00 1.00000000000 BIT_MASK 0x1 FORMAT "%13.11" ECU_ADDRESS 0x60001128 /end MEASUREMENT
/begin MEASUREMENT AirMod_idxCylAirChrg "Cyliner index for Air Charge" UBYTE OneToOne 1 100 0.00 255.0 FORMAT "%5.1" ECU_ADDRESS 0x50000984 /end MEASUREMENT
/begin MEASUREMENT AirMod_idxCylAirChrgPredHom "Index on cylinder for air charge prediction with homogeneous" UBYTE OneToOne 1 100 0.00 255.0 FORMAT "%5.1" ECU_ADDRESS 0x600008AA /end MEASUREMENT
/begin MEASUREMENT AirMod_idxCylAirChrgPredOld "Index on cylinder for air charge prediction(old value)" UBYTE OneToOne 1 100 0.00 255.0 FORMAT "%5.1" ECU_ADDRESS 0x7000314D /end MEASUREMENT
/begin MEASUREMENT AirMod_mfAirCyl "Burned air mass flow" SWORD m_q0p1 1 100 -3276.800 3276.700 FORMAT "%8.3" ECU_ADDRESS 0x6000064A /end MEASUREMENT
/begin MEASUREMENT AirMod_nrSynAirChrgPredOld "Amount of cylinders between charge and charge prediction(old value)" UBYTE OneToOne 1 100 0.00 255.0 FORMAT "%5.1" ECU_ADDRESS 0x5000094A /end MEASUREMENT
/begin MEASUREMENT AirMod_nrSynAirChrgToIgnCalcn "Amount of cylinders between charge and ignition" UBYTE OneToOne 1 100 0.00 255.0 FORMAT "%5.1" ECU_ADDRESS 0x50000987 /end MEASUREMENT
/begin MEASUREMENT AirMod_pOffsCorrnFco "pressure offset correction of charge modell at fuel cut off" SWORD p_sw_q0p039 1 100 -1280.000 1279.961 FORMAT "%8.3" ECU_ADDRESS 0x60001168 /end MEASUREMENT
/begin MEASUREMENT AirMod_pOffsCorrnFcoDes "setpoint for pressure offset correction of charge modell at fuel cut off" SWORD p_sw_q0p039 1 100 -1280.000 1279.961 FORMAT "%8.3" ECU_ADDRESS 0x60001166 /end MEASUREMENT
/begin MEASUREMENT AirMod_ratChrgAirCyl "Relative charge of air in the cylinder" UWORD rel_q0p0234 1 100 0.00 1535.977 FORMAT "%8.3" ECU_ADDRESS 0x6000064E /end MEASUREMENT
/begin MEASUREMENT AirMod_ratChrgAirCylAdv_a "Relative charge of air in the cylinder" UWORD rel_q0p0234 1 100 0.00 1535.977 FORMAT "%8.3" ARRAY_SIZE 4 ECU_ADDRESS 0x5000058C /end MEASUREMENT
/begin MEASUREMENT AirMod_ratChrgAirCylAftSwtPred "Predicted relative charge of air in the cylinder after switch" UWORD rel_q0p0234 1 100 0.00 1535.977 FORMAT "%8.3" ECU_ADDRESS 0x60000CB8 /end MEASUREMENT
/begin MEASUREMENT AirMod_ratChrgAirCylLoResl "relative air charge" UBYTE rel_q0p75 1 100 0.00 191.3 FORMAT "%5.1" ECU_ADDRESS 0x60000930 /end MEASUREMENT
/begin MEASUREMENT AirMod_ratChrgAirEgrCyl "AGR relative air-load over int. and ext. EGR" UWORD rel_q0p0234 1 100 0.00 1535.977 FORMAT "%8.3" ECU_ADDRESS 0x7000398E /end MEASUREMENT
/begin MEASUREMENT AirMod_ratChrgInertCyl "relative inert gas charge from int. and ext. EGR" UWORD rel_q0p0234 1 100 0.00 1535.977 FORMAT "%8.3" ECU_ADDRESS 0x7000398C /end MEASUREMENT
/begin MEASUREMENT AirMod_ratInertCyl "Inert gas rate in the cylinder" UWORD rel_uw_b100 1 100 0.00 99.99847 FORMAT "%8.5" ECU_ADDRESS 0x500007CC /end MEASUREMENT
/begin MEASUREMENT AirMod_ratInertCylAdv_a "Inert gas rate in the cylinder assigend to cylinder" UWORD rel_uw_b100 1 100 0.00 99.99847 FORMAT "%8.5" ARRAY_SIZE 4 ECU_ADDRESS 0x5000059C /end MEASUREMENT
/begin MEASUREMENT AirMod_ratInertCylPred "Inert gas rate in the cylinder predicted" UWORD rel_uw_b100 1 100 0.00 99.99847 FORMAT "%8.5" ECU_ADDRESS 0x7000398A /end MEASUREMENT
/begin MEASUREMENT AirMod_ratInertEgrExtCyl "desired inertgas ratio from ext. EGR (Exhaust Gas Recirculation)" UWORD rel_uw_b100 1 100 0.00 99.99847 FORMAT "%8.5" ECU_ADDRESS 0x60000658 /end MEASUREMENT
/begin MEASUREMENT AirMod_ratInertEgrIntCyl "desired inertgas ratio from internal. EGR (Exhaust Gas Recirculation)" UWORD rel_uw_b100 1 100 0.00 99.99847 FORMAT "%8.5" ECU_ADDRESS 0x500007D0 /end MEASUREMENT
/begin MEASUREMENT AirMod_ratInertGasCylCorrnFco "rate inert gas correction of charge modell at fuel cut off" SWORD rel_q0p02344 1 100 -768.0000 767.9766 FORMAT "%8.4" ECU_ADDRESS 0x60001164 /end MEASUREMENT
/begin MEASUREMENT AirMod_ratInertGasCylCorrnFcoDes "rate inert gas correction of charge modell at fuel cut off desired" SWORD rel_q0p02344 1 100 -768.0000 767.9766 FORMAT "%8.4" ECU_ADDRESS 0x60001162 /end MEASUREMENT
/begin MEASUREMENT AirMod_ratRelAirM "relative air mass (calc. load value) acc. to SAE J1979" UBYTE rel_q0p392 1 100 0.00 100.0 FORMAT "%5.1" ECU_ADDRESS 0x60001423 /end MEASUREMENT
/begin MEASUREMENT B_2synpmX_msg "Condition: psrmmn_w, psrmmx_w, msdkpmn_w and msdkpmx_w are calculated with half sample time (i.e. twice per computation step)" UBYTE B_TRUE 1 100 0.00 1.00000000000 BIT_MASK 0x1 FORMAT "%13.11" ECU_ADDRESS 0x70000C43 /end MEASUREMENT
/begin MEASUREMENT B_adkhe_msg "Cond. adapt. throt. valve to HFM steady (throt. valve released as charge sensor)" UBYTE B_TRUE 1 100 0.00 1.00000000000 BIT_MASK 0x1 FORMAT "%13.11" ECU_ADDRESS 0x60036E43 /end MEASUREMENT
/begin MEASUREMENT B_adkose_msg "Throttle valve adaptation settled (msndko_w and fkpvdk_w)" UBYTE B_TRUE 1 100 0.00 1.00000000000 BIT_MASK 0x1 FORMAT "%13.11" ECU_ADDRESS 0x6000025D /end MEASUREMENT
/begin MEASUREMENT B_adkoshe_msg "Cond. adapt. values from throttle valve to HFM, valid(Offset and gradient)" UBYTE B_TRUE 1 100 0.00 1.00000000000 BIT_MASK 0x1 FORMAT "%13.11" ECU_ADDRESS 0x6000025C /end MEASUREMENT
/begin MEASUREMENT B_adkospe_msg "Condition, adaptation value throttle valve to DSS Valid(Offset and gradient)" UBYTE B_TRUE 1 100 0.00 1.00000000000 BIT_MASK 0x1 FORMAT "%13.11" ECU_ADDRESS 0x6000025B /end MEASUREMENT
/begin MEASUREMENT B_adkpe_msg "Cond. adapt. throt. valve to DSS steady (throt. valve released as charge sensor)" UBYTE B_TRUE 1 100 0.00 1.00000000000 BIT_MASK 0x1 FORMAT "%13.11" ECU_ADDRESS 0x60036E42 /end MEASUREMENT
/begin MEASUREMENT B_afkpvdei "Condition: adaptation fkpvdk internally stabilized" UBYTE B_TRUE 1 100 0.00 1.00000000000 BIT_MASK 0x1 FORMAT "%13.11" ECU_ADDRESS 0x60036DF0 /end MEASUREMENT
/begin MEASUREMENT B_afkpvdhe_msg "Condition, adaptation gradient, throttle valve to HFM steady" UBYTE B_TRUE 1 100 0.00 1.00000000000 BIT_MASK 0x1 FORMAT "%13.11" ECU_ADDRESS 0x60036E41 /end MEASUREMENT
/begin MEASUREMENT B_afkpvdke_msg "Condition: adaptation fkpvdk stabilized" UBYTE B_TRUE 1 100 0.00 1.00000000000 BIT_MASK 0x1 FORMAT "%13.11" ECU_ADDRESS 0x6000025A /end MEASUREMENT
/begin MEASUREMENT B_afkpvdpe_msg "Condition, adaptation gradient, throttle valve to DSS steady" UBYTE B_TRUE 1 100 0.00 1.00000000000 BIT_MASK 0x1 FORMAT "%13.11" ECU_ADDRESS 0x60000259 /end MEASUREMENT
/begin MEASUREMENT B_agrinsr_msg "condition for residual exhaust gas in manifold" UBYTE B_TRUE 1 100 0.00 1.00000000000 BIT_MASK 0x1 FORMAT "%13.11" ECU_ADDRESS 0x60000252 /end MEASUREMENT
/begin MEASUREMENT B_ahfsnfsa_msg "Condition: adjustment of main charge sensor/secondary charge sensor active" UBYTE B_TRUE 1 100 0.00 1.00000000000 BIT_MASK 0x1 FORMAT "%13.11" ECU_ADDRESS 0x6000024D /end MEASUREMENT
/begin MEASUREMENT B_amsndkoe_msg "Cond.: slow, additive mass flow adapt. stabilized" UBYTE B_TRUE 1 100 0.00 1.00000000000 BIT_MASK 0x1 FORMAT "%13.11" ECU_ADDRESS 0x6000024C /end MEASUREMENT
/begin MEASUREMENT B_aomsndhe_msg "Offset adaptation throttle valve to HFM steady" UBYTE B_TRUE 1 100 0.00 1.00000000000 BIT_MASK 0x1 FORMAT "%13.11" ECU_ADDRESS 0x6000024B /end MEASUREMENT
/begin MEASUREMENT B_aomsndpe_msg "Offset adaptation throttle valve to DSS steady" UBYTE B_TRUE 1 100 0.00 1.00000000000 BIT_MASK 0x1 FORMAT "%13.11" ECU_ADDRESS 0x60036E40 /end MEASUREMENT
/begin MEASUREMENT B_dschlldk_msg "Condition disable stratified mode during idle speed" UBYTE B_TRUE 1 100 0.00 1.00000000000 BIT_MASK 0x1 FORMAT "%13.11" ECU_ADDRESS 0x6000023F /end MEASUREMENT
/begin MEASUREMENT B_dsshfs_msg "Condition, DSS is main charge sensor" UBYTE B_TRUE 1 100 0.00 1.00000000000 BIT_MASK 0x1 FORMAT "%13.11" ECU_ADDRESS 0x60001503 /end MEASUREMENT
/begin MEASUREMENT B_dugdhtx "Condition: Filtering max HFM mass flow after cond. ugd" UBYTE B_TRUE 1 100 0.00 1.00000000000 BIT_MASK 0x1 FORMAT "%13.11" ECU_ADDRESS 0x700003FB /end MEASUREMENT
/begin MEASUREMENT B_dugdtx_msg "Condition: Throttle valve angle unthrottled delayed for the maximum tolerance" UBYTE B_TRUE 1 100 0.00 1.00000000000 BIT_MASK 0x1 FORMAT "%13.11" ECU_ADDRESS 0x70000BFF /end MEASUREMENT
/begin MEASUREMENT B_fabgagr "Condition: throttle blade adaptation is enabled by EGR" UBYTE B_TRUE 1 100 0.00 1.00000000000 BIT_MASK 0x1 FORMAT "%13.11" ECU_ADDRESS 0x60000149 /end MEASUREMENT
/begin MEASUREMENT B_fadkoap_msg "Condition, throttle valve adaptation to DSS, released depending on EGR" UBYTE B_TRUE 1 100 0.00 1.00000000000 BIT_MASK 0x1 FORMAT "%13.11" ECU_ADDRESS 0x60000228 /end MEASUREMENT
/begin MEASUREMENT B_fagrfe_msg "EGR release from the air charge determination" UBYTE B_TRUE 1 100 0.00 1.00000000000 BIT_MASK 0x1 FORMAT "%13.11" ECU_ADDRESS 0x60001501 /end MEASUREMENT
/begin MEASUREMENT B_fedkahb_msg "Cond. throt. valve-based charge determination and throt. valve to HFM adapted" UBYTE B_TRUE 1 100 0.00 1.00000000000 BIT_MASK 0x1 FORMAT "%13.11" ECU_ADDRESS 0x60001500 /end MEASUREMENT
/begin MEASUREMENT B_fedkapb_msg "Cond. throt. valve-based charge determination and throt. valve to DSS adapted" UBYTE B_TRUE 1 100 0.00 1.00000000000 BIT_MASK 0x1 FORMAT "%13.11" ECU_ADDRESS 0x600014FF /end MEASUREMENT
/begin MEASUREMENT B_fedkb_msg "Condition load calculated from throttle valve potentiometer" UBYTE B_TRUE 1 100 0.00 1.00000000000 BIT_MASK 0x1 FORMAT "%13.11" ECU_ADDRESS 0x600014FE /end MEASUREMENT
/begin MEASUREMENT B_fedkoab_msg "Cnd. thrt. vlv-bsd chrg. dterm. & thrt. vlv not main chrg. dterm. sens. adpt." UBYTE B_TRUE 1 100 0.00 1.00000000000 BIT_MASK 0x1 FORMAT "%13.11" ECU_ADDRESS 0x600014FD /end MEASUREMENT
/begin MEASUREMENT B_fedssb_msg "Condition, charge determination based on intake manifold pressure sensor" UBYTE B_TRUE 1 100 0.00 1.00000000000 BIT_MASK 0x1 FORMAT "%13.11" ECU_ADDRESS 0x70003646 /end MEASUREMENT
/begin MEASUREMENT B_feete_msg "increased tolerances of air charge determination expected" UBYTE B_TRUE 1 100 0.00 1.00000000000 BIT_MASK 0x1 FORMAT "%13.11" ECU_ADDRESS 0x600014FC /end MEASUREMENT
/begin MEASUREMENT B_fehfmb_msg "Condition, charge determination based on HFM" UBYTE B_TRUE 1 100 0.00 1.00000000000 BIT_MASK 0x1 FORMAT "%13.11" ECU_ADDRESS 0x600014FB /end MEASUREMENT
/begin MEASUREMENT B_ferlnotb_msg "Condition charge determination based on RLNOT characteristic curve" UBYTE B_TRUE 1 100 0.00 1.00000000000 BIT_MASK 0x1 FORMAT "%13.11" ECU_ADDRESS 0x600014FA /end MEASUREMENT
/begin MEASUREMENT B_fgabgla_msg "condition: general enable condition for throttle blade adaptation" UBYTE B_TRUE 1 100 0.00 1.00000000000 BIT_MASK 0x1 FORMAT "%13.11" ECU_ADDRESS 0x60000220 /end MEASUREMENT
/begin MEASUREMENT B_fgabglh "Condition, release throttle valve adjustment for HFM" UBYTE B_TRUE 1 100 0.00 1.00000000000 BIT_MASK 0x1 FORMAT "%13.11" ECU_ADDRESS 0x60000148 /end MEASUREMENT
/begin MEASUREMENT B_fgabglp_msg "Condition, release throttle valve adjustment for DSS" UBYTE B_TRUE 1 100 0.00 1.00000000000 BIT_MASK 0x1 FORMAT "%13.11" ECU_ADDRESS 0x6000021F /end MEASUREMENT
/begin MEASUREMENT B_fgabgl_msg "Condition: Enable charging compensation" UBYTE B_TRUE 1 100 0.00 1.00000000000 BIT_MASK 0x1 FORMAT "%13.11" ECU_ADDRESS 0x60000221 /end MEASUREMENT
/begin MEASUREMENT B_fgsabglp_msg "Condition, release fast throttle valve adjustment for DSS" UBYTE B_TRUE 1 100 0.00 1.00000000000 BIT_MASK 0x1 FORMAT "%13.11" ECU_ADDRESS 0x6000021D /end MEASUREMENT
/begin MEASUREMENT B_fgsabhm "Condition, release throttle valve adjustment" UBYTE B_TRUE 1 100 0.00 1.00000000000 BIT_MASK 0x1 FORMAT "%13.11" ECU_ADDRESS 0x60000147 /end MEASUREMENT
/begin MEASUREMENT B_fkpvdkh "Condition, slow multiplicative throttle valve adjustment for HFM" UBYTE B_TRUE 1 100 0.00 1.00000000000 BIT_MASK 0x1 FORMAT "%13.11" ECU_ADDRESS 0x60000146 /end MEASUREMENT
/begin MEASUREMENT B_fkpvdkp_msg "Condition, release slow multiplicative throttle valve for DSS" UBYTE B_TRUE 1 100 0.00 1.00000000000 BIT_MASK 0x1 FORMAT "%13.11" ECU_ADDRESS 0x6000021A /end MEASUREMENT
/begin MEASUREMENT B_fkpvdk_msg "Confition for the release of the slow multiplicative load trim" UBYTE B_TRUE 1 100 0.00 1.00000000000 BIT_MASK 0x1 FORMAT "%13.11" ECU_ADDRESS 0x6000021B /end MEASUREMENT
/begin MEASUREMENT B_fsabpagr_msg "enable of fast mass flow adaptation for p-based systems from external egr" UBYTE B_TRUE 1 100 0.00 1.00000000000 BIT_MASK 0x1 FORMAT "%13.11" ECU_ADDRESS 0x60000219 /end MEASUREMENT
/begin MEASUREMENT B_fupivheg_msg "condition pbrint and fupsrl calculation based on high valve lift" UBYTE B_TRUE 1 100 0.00 1.00000000000 BIT_MASK 0x1 FORMAT "%13.11" ECU_ADDRESS 0x600014F8 /end MEASUREMENT
/begin MEASUREMENT B_hfmhfs_msg "Condition, mass flow sensor is main charge sensor" UBYTE B_TRUE 1 100 0.00 1.00000000000 BIT_MASK 0x1 FORMAT "%13.11" ECU_ADDRESS 0x60039554 /end MEASUREMENT
/begin MEASUREMENT B_iniabga_msg "condition: general reset condition for throttle blade adaptation" UBYTE B_TRUE 1 100 0.00 1.00000000000 BIT_MASK 0x1 FORMAT "%13.11" ECU_ADDRESS 0x6000020D /end MEASUREMENT
/begin MEASUREMENT B_inilabgp_msg "Condition, initialization slow throttle valve adjustment to DSS" UBYTE B_TRUE 1 100 0.00 1.00000000000 BIT_MASK 0x1 FORMAT "%13.11" ECU_ADDRESS 0x6000020C /end MEASUREMENT
/begin MEASUREMENT B_inisabgh "Condition, initialization fast throttle valve adjustment to HFM" UBYTE B_TRUE 1 100 0.00 1.00000000000 BIT_MASK 0x1 FORMAT "%13.11" ECU_ADDRESS 0x60000145 /end MEASUREMENT
/begin MEASUREMENT B_inisabgp "Condition, initialization fast throttle valve adjustment to DSS" UBYTE B_TRUE 1 100 0.00 1.00000000000 BIT_MASK 0x1 FORMAT "%13.11" ECU_ADDRESS 0x60000144 /end MEASUREMENT
/begin MEASUREMENT B_lasostc_msg "Flag lambda setpoint for sensor equal to 1 (stoichiometric)" UBYTE B_TRUE 1 100 0.00 1.00000000000 BIT_MASK 0x1 FORMAT "%13.11" ECU_ADDRESS 0x70000B8C /end MEASUREMENT
/begin MEASUREMENT B_msddkg_msg "Condition massflow over throttle blade based on throttle angle valid" UBYTE B_TRUE 1 100 0.00 1.00000000000 BIT_MASK 0x1 FORMAT "%13.11" ECU_ADDRESS 0x60000202 /end MEASUREMENT
/begin MEASUREMENT B_msdkdsg_msg "Condition Mass flow at the DK calculated from the sensor signal of the DSS valid" UBYTE B_TRUE 1 100 0.00 1.00000000000 BIT_MASK 0x1 FORMAT "%13.11" ECU_ADDRESS 0x600014F1 /end MEASUREMENT
/begin MEASUREMENT B_msdkhfsg_msg "Condition: mass flow main charge sensor active" UBYTE B_TRUE 1 100 0.00 1.00000000000 BIT_MASK 0x1 FORMAT "%13.11" ECU_ADDRESS 0x600014F0 /end MEASUREMENT
/begin MEASUREMENT B_msdkhnxg_msg "Condition massflow through throttle blade for MAF-diagnosis valid" UBYTE B_TRUE 1 100 0.00 1.00000000000 BIT_MASK 0x1 FORMAT "%13.11" ECU_ADDRESS 0x60000200 /end MEASUREMENT
/begin MEASUREMENT B_msdkpnxg_msg "Condition massflow through throttle blade for MAP-diagnosis valid" UBYTE B_TRUE 1 100 0.00 1.00000000000 BIT_MASK 0x1 FORMAT "%13.11" ECU_ADDRESS 0x600001FF /end MEASUREMENT
/begin MEASUREMENT B_msdpg_msg "Condition predicted massflow through throttle blade valid" UBYTE B_TRUE 1 100 0.00 1.00000000000 BIT_MASK 0x1 FORMAT "%13.11" ECU_ADDRESS 0x600001FE /end MEASUREMENT
/begin MEASUREMENT B_mshfmdkg_msg "model. air mass flow based on throttle at installed position of MAFsensor valid" UBYTE B_TRUE 1 100 0.00 1.00000000000 BIT_MASK 0x1 FORMAT "%13.11" ECU_ADDRESS 0x600001FD /end MEASUREMENT
/begin MEASUREMENT B_mshfmdsg_msg "model. air mass fl. based on MAPsensor at installed position of MAFsensor valid" UBYTE B_TRUE 1 100 0.00 1.00000000000 BIT_MASK 0x1 FORMAT "%13.11" ECU_ADDRESS 0x600001FC /end MEASUREMENT
/begin MEASUREMENT B_mshmdnxg_msg "Condition massflow at MAF position based on throttle blade model (for MAF-diagnosis) valid" UBYTE B_TRUE 1 100 0.00 1.00000000000 BIT_MASK 0x1 FORMAT "%13.11" ECU_ADDRESS 0x600001FB /end MEASUREMENT
/begin MEASUREMENT B_ofmsndhb "condition: ofmsndkh limited by integrator limits (for MAF)" UBYTE B_TRUE 1 100 0.00 1.00000000000 BIT_MASK 0x1 FORMAT "%13.11" ECU_ADDRESS 0x60000143 /end MEASUREMENT
/begin MEASUREMENT B_ofmsndhb1 "condition: ofmsndkh limited by integrator limits (for MAF), Bank1" UBYTE B_TRUE 1 100 0.00 1.00000000000 BIT_MASK 0x1 FORMAT "%13.11" ECU_ADDRESS 0x60000142 /end MEASUREMENT
/begin MEASUREMENT B_ofmsndhb2 "condition: ofmsndkh limited by integrator limits (for MAF), Bank2" UBYTE B_TRUE 1 100 0.00 1.00000000000 BIT_MASK 0x1 FORMAT "%13.11" ECU_ADDRESS 0x60000141 /end MEASUREMENT
/begin MEASUREMENT B_ofmsndkh "Condition release leakage air adaptation throttle valve to HFM" UBYTE B_TRUE 1 100 0.00 1.00000000000 BIT_MASK 0x1 FORMAT "%13.11" ECU_ADDRESS 0x60000140 /end MEASUREMENT
/begin MEASUREMENT B_ofmsndkh1_msg "Condition release leakage air adaptation throttle valve to HFM in mass flow adaptation window region 1" UBYTE B_TRUE 1 100 0.00 1.00000000000 BIT_MASK 0x1 FORMAT "%13.11" ECU_ADDRESS 0x600001EB /end MEASUREMENT
/begin MEASUREMENT B_ofmsndkh2_msg "Condition release leakage air adaptation throttle valve to HFM in mass flow adaptation window region 2" UBYTE B_TRUE 1 100 0.00 1.00000000000 BIT_MASK 0x1 FORMAT "%13.11" ECU_ADDRESS 0x600001EA /end MEASUREMENT
/begin MEASUREMENT B_ofmsndkh_msg "Condition release leakage air adaptation throttle valve to HFM" UBYTE B_TRUE 1 100 0.00 1.00000000000 BIT_MASK 0x1 FORMAT "%13.11" ECU_ADDRESS 0x600001E9 /end MEASUREMENT
/begin MEASUREMENT B_ofmsndkp1_msg "Condition release leakage air adaptation throttle valve to DSS (in window region 1)" UBYTE B_TRUE 1 100 0.00 1.00000000000 BIT_MASK 0x1 FORMAT "%13.11" ECU_ADDRESS 0x600001E8 /end MEASUREMENT
/begin MEASUREMENT B_ofmsndkp2_msg "Condition release leakage air adaptation throttle valve to DSS (in window region 2)" UBYTE B_TRUE 1 100 0.00 1.00000000000 BIT_MASK 0x1 FORMAT "%13.11" ECU_ADDRESS 0x600001E7 /end MEASUREMENT
/begin MEASUREMENT B_ofmsndkp_msg "Condition release leakage air adaptation throttle valve to DSS" UBYTE B_TRUE 1 100 0.00 1.00000000000 BIT_MASK 0x1 FORMAT "%13.11" ECU_ADDRESS 0x600001E6 /end MEASUREMENT
/begin MEASUREMENT B_ofmsndk_msg "release condition for slow add. Mass flow balancing" UBYTE B_TRUE 1 100 0.00 1.00000000000 BIT_MASK 0x1 FORMAT "%13.11" ECU_ADDRESS 0x600001EC /end MEASUREMENT
/begin MEASUREMENT B_pndkg_msg "condition: pressure downstream throttle valve valid" UBYTE B_TRUE 1 100 0.00 1.00000000000 BIT_MASK 0x1 FORMAT "%13.11" ECU_ADDRESS 0x70000B46 /end MEASUREMENT
/begin MEASUREMENT B_psrg1_msg "validity of the pressure value (best of) of the intake manifold - bank 1" UBYTE B_TRUE 1 100 0.00 1.00000000000 BIT_MASK 0x1 FORMAT "%13.11" ECU_ADDRESS 0x70000B43 /end MEASUREMENT
/begin MEASUREMENT B_psrgg1_msg "validity of the pressure value (sensor) of the intake manifold - bank 1" UBYTE B_TRUE 1 100 0.00 1.00000000000 BIT_MASK 0x1 FORMAT "%13.11" ECU_ADDRESS 0x70000B41 /end MEASUREMENT
/begin MEASUREMENT B_psrgg_msg "validity of the pressure value (sensor) of the intake manifold" UBYTE B_TRUE 1 100 0.00 1.00000000000 BIT_MASK 0x1 FORMAT "%13.11" ECU_ADDRESS 0x70000B40 /end MEASUREMENT
/begin MEASUREMENT B_psrg_msg "validity of the pressure value (best of) of the intake manifold" UBYTE B_TRUE 1 100 0.00 1.00000000000 BIT_MASK 0x1 FORMAT "%13.11" ECU_ADDRESS 0x70000B42 /end MEASUREMENT
/begin MEASUREMENT B_pugd "condition: pressure ratio pspvdkds_w > 0.95" UBYTE B_TRUE 1 100 0.00 1.00000000000 BIT_MASK 0x1 FORMAT "%13.11" ECU_ADDRESS 0x700003FA /end MEASUREMENT
/begin MEASUREMENT B_pugdp "condition: predicted pressure ration over throttle blade > 0.95" UBYTE B_TRUE 1 100 0.00 1.00000000000 BIT_MASK 0x1 FORMAT "%13.11" ECU_ADDRESS 0x700003F9 /end MEASUREMENT
/begin MEASUREMENT B_rlvheg_msg "condition calculation of rl at active cam lift" UBYTE B_TRUE 1 100 0.00 1.00000000000 BIT_MASK 0x1 FORMAT "%13.11" ECU_ADDRESS 0x7000363C /end MEASUREMENT
/begin MEASUREMENT B_totab "Flag all cylinders of bank 1 cut off" UBYTE B_TRUE 1 100 0.00 1.00000000000 BIT_MASK 0x1 FORMAT "%13.11" ECU_ADDRESS 0x60000138 /end MEASUREMENT
/begin MEASUREMENT B_ugdtx_msg "Condition: Throttle valve angle unthrottled for maximum tolerance" UBYTE B_TRUE 1 100 0.00 1.00000000000 BIT_MASK 0x1 FORMAT "%13.11" ECU_ADDRESS 0x600001BF /end MEASUREMENT
/begin MEASUREMENT B_ugd_msg "condition: throttle angle greater or equal wdkugd" UBYTE B_TRUE 1 100 0.00 1.00000000000 BIT_MASK 0x1 FORMAT "%13.11" ECU_ADDRESS 0x70000AF5 /end MEASUREMENT
/begin MEASUREMENT B_vpdkugd_msg "condition: pressure ratio at throttle blade greater than 0.95(incl. pressure correction dependent on fkmsdk)" UBYTE B_TRUE 1 100 0.00 1.00000000000 BIT_MASK 0x1 FORMAT "%13.11" ECU_ADDRESS 0x70000AED /end MEASUREMENT
/begin MEASUREMENT B_vpspvd "Condition, release throttle valve adjustment" UBYTE B_TRUE 1 100 0.00 1.00000000000 BIT_MASK 0x1 FORMAT "%13.11" ECU_ADDRESS 0x6000013F /end MEASUREMENT
/begin MEASUREMENT B_wugdp "condition wdkbap greater equal wdkugd" UBYTE B_TRUE 1 100 0.00 1.00000000000 BIT_MASK 0x1 FORMAT "%13.11" ECU_ADDRESS 0x700003F8 /end MEASUREMENT
/begin MEASUREMENT B_zwfdkah_msg "condition ignition angle release due to throttle adaption (e.g. at bedstop) with HFM" UBYTE B_TRUE 1 100 0.00 1.00000000000 BIT_MASK 0x1 FORMAT "%13.11" ECU_ADDRESS 0x600001B9 /end MEASUREMENT
/begin MEASUREMENT B_zwfdkap_msg "condition ignition angle release due to throttle adaption (e.g. at bedstop) with DSS" UBYTE B_TRUE 1 100 0.00 1.00000000000 BIT_MASK 0x1 FORMAT "%13.11" ECU_ADDRESS 0x600001B8 /end MEASUREMENT
/begin MEASUREMENT B_zwfdka_msg "condition ignition angle release due to throttle adaption (e.g. at bedstop)" UBYTE B_TRUE 1 100 0.00 1.00000000000 BIT_MASK 0x1 FORMAT "%13.11" ECU_ADDRESS 0x600001BA /end MEASUREMENT
/begin MEASUREMENT ChrCtl_facPCorrnOpenThr "Correction factor pressure based for engine speed addressing WOT" UWORD fak_q1p22Em4 1 100 0.00 7.999878 FORMAT "%8.6" ECU_ADDRESS 0x60001122 /end MEASUREMENT
/begin MEASUREMENT ChrCtl_facSuctnCorrnOpenThr "Correction factor fupsrl based for engine speed addressing WOT" UWORD fak_q1p22Em4 1 100 0.00 7.999878 FORMAT "%8.6" ECU_ADDRESS 0x60001120 /end MEASUREMENT
/begin MEASUREMENT ChrCtl_flgChrgCalcnTiBasd "flag: charge calculation is time based" UBYTE B_TRUE 1 100 0.00 1.00000000000 BIT_MASK 0x1 FORMAT "%13.11" ECU_ADDRESS 0x70000A7A /end MEASUREMENT
/begin MEASUREMENT ChrCtl_flgRstDsmAdpnEtc100ms "fcmclear flag for reset adaptation" UBYTE B_TRUE 1 100 0.00 1.00000000000 BIT_MASK 0x1 FORMAT "%13.11" ECU_ADDRESS 0x6000013E /end MEASUREMENT
/begin MEASUREMENT ChrCtl_flgRstDsmAdpnEtc10ms "fcmclear flag for reset adaptation" UBYTE B_TRUE 1 100 0.00 1.00000000000 BIT_MASK 0x1 FORMAT "%13.11" ECU_ADDRESS 0x6000013D /end MEASUREMENT
/begin MEASUREMENT ChrCtl_flgRstDsmAdpnEtcGen "condition reset adaptation general" UBYTE B_TRUE 1 100 0.00 1.00000000000 BIT_MASK 0x1 FORMAT "%13.11" ECU_ADDRESS 0x6000013C /end MEASUREMENT
/begin MEASUREMENT ChrCtl_flgRstDsmAdpnEtcMAF "condition reset adaptation MAF" UBYTE B_TRUE 1 100 0.00 1.00000000000 BIT_MASK 0x1 FORMAT "%13.11" ECU_ADDRESS 0x6000013B /end MEASUREMENT
/begin MEASUREMENT ChrCtl_flgRstDsmAdpnEtcMAP "condition reset adaptation MAP" UBYTE B_TRUE 1 100 0.00 1.00000000000 BIT_MASK 0x1 FORMAT "%13.11" ECU_ADDRESS 0x6000013A /end MEASUREMENT
/begin MEASUREMENT ChrCtl_nEngCorrd "Corrected engine speed for addressing WOT" SWORD EngN 1 100 -16384.00 16383.50 FORMAT "%8.2" ECU_ADDRESS 0x6000111E /end MEASUREMENT
/begin MEASUREMENT Chrctl_stAirChrgCtrlr "Status for computing the filter for air charge controller" UBYTE B_TRUE 1 100 0.00 1.00000000000 BIT_MASK 0x1 FORMAT "%13.11" ECU_ADDRESS 0x70003631 /end MEASUREMENT
/begin MEASUREMENT ChrCtl_stInactvCpvAts "Inactive CPV ATS Status" UBYTE B_TRUE 1 100 0.00 1.00000000000 BIT_MASK 0x1 FORMAT "%13.11" ECU_ADDRESS 0x60000139 /end MEASUREMENT
/begin MEASUREMENT ChrCtl_tiMFlowAdpnFastAfsBasd "integrator speed for fast constant mass-flow adaption HFM based" UWORD t_q0p01 1 100 0.0100 655.3500 FORMAT "%8.4" ECU_ADDRESS 0x60001190 /end MEASUREMENT
/begin MEASUREMENT ChrCtl_tiMFlowAdpnFastBasdIntkMnfldSnsr "integrator speed for fast constant mass-flow adaption intake manifold sensor based" UWORD t_q0p01 1 100 0.0100 655.3500 FORMAT "%8.4" ECU_ADDRESS 0x6000118E /end MEASUREMENT
/begin MEASUREMENT ChrCtl_tiThrVlvMFlowLeakAdpnMAF "time constant for leakage adaptation of throttle blade (general condition)" UWORD q0p00390625_s_h_DIV_kg 1 100 0.0039 255.9961 FORMAT "%8.4" ECU_ADDRESS 0x60001182 /end MEASUREMENT
/begin MEASUREMENT ChrCtl_tiThrVlvMFlowLeakAdpnMAP "time constant for leakage adaptation of throttle blade (general condition)" UWORD q0p00390625_s_h_DIV_kg 1 100 0.0039 255.9961 FORMAT "%8.4" ECU_ADDRESS 0x60001180 /end MEASUREMENT
/begin MEASUREMENT cycbgkv_w "cycle time BGKV" SLONG Time_Dt 1 100 -2147.48364800 2147.48364700 FORMAT "%13.8" ECU_ADDRESS 0x600031C8 /end MEASUREMENT
/begin MEASUREMENT dfkmsdsh_w "Delta fast mass flow adjustment to one (HFM)" SWORD fak_sw_b1 1 100 -1.000000 0.999969 FORMAT "%8.6" ECU_ADDRESS 0x6000117E /end MEASUREMENT
/begin MEASUREMENT dfkmsdsp_w "Delta fast mass flow adjustment to one (DSS)" SWORD fak_sw_b1 1 100 -1.000000 0.999969 FORMAT "%8.6" ECU_ADDRESS 0x6000117C /end MEASUREMENT
/begin MEASUREMENT dfmsdsp_w "Delta factor mass flow from throttle valve/DSS to one" SWORD fak_sw_b1 1 100 -1.000000 0.999969 FORMAT "%8.6" ECU_ADDRESS 0x6000117A /end MEASUREMENT
/begin MEASUREMENT dfuelanh_w "Input integrator fast throttle valve adjustment (HFM)" SWORD fak_sw_b1 1 100 -0.1800232 0.1800232 FORMAT "%9.7" ECU_ADDRESS 0x60000CA2 /end MEASUREMENT
/begin MEASUREMENT dfuelanp_w "Input integrator fast throttle valve adjustment(HFM)" SWORD fak_sw_b1 1 100 -0.1800232 0.1800232 FORMAT "%9.7" ECU_ADDRESS 0x60000CA4 /end MEASUREMENT
/begin MEASUREMENT dfuelsan_w_msg "Delta charge sensor to alpha/n-systems" SWORD fak_sw_b1 1 100 -1.000000 0.999969 FORMAT "%8.6" ECU_ADDRESS 0x60001646 /end MEASUREMENT
/begin MEASUREMENT dkpsrmh_w_msg "correction of modelled intake manifold pressure for calculation of speed of air mass through throttle blade" SWORD p_sw_q0p078 1 100 -2560.000 2559.922 FORMAT "%8.3" ECU_ADDRESS 0x60000CC2 /end MEASUREMENT
/begin MEASUREMENT dmsdkugd_w_msg "delta air mass flow at ps/pvdkds>0.95" UWORD m_q0p1 1 100 0.00 6553.500 FORMAT "%8.3" ECU_ADDRESS 0x60000CC6 /end MEASUREMENT
/begin MEASUREMENT dmsdkugp_w "Predicted mass flow delta at ps/pvdkds>0.95 (in overtravel)" UWORD m_q0p1 1 100 0.00 6553.500 FORMAT "%8.3" ECU_ADDRESS 0x60000CA6 /end MEASUREMENT
/begin MEASUREMENT dmsfue_w "correction offset by air mass controller" SWORD m_q0p1 1 100 -3276.800 3276.700 FORMAT "%8.3" ECU_ADDRESS 0x6000111A /end MEASUREMENT
/begin MEASUREMENT dofmsndmsll_w "Normalised mass flow upper threshold correction due to big leakage into intake manifold" UWORD m_q0p1 1 100 0.00 6553.500 FORMAT "%8.3" ECU_ADDRESS 0x60000CA8 /end MEASUREMENT
/begin MEASUREMENT dpbreops_w "Delta Pressure between pressure inlet valve opens and intake manifold" SWORD p_sw_q0p078 1 100 -2560.000 2559.922 FORMAT "%8.3" ECU_ADDRESS 0x60001160 /end MEASUREMENT
/begin MEASUREMENT dpsrfg_w_msg "delta fresh air partial pressure in manifold" SWORD p_q0p078 1 100 -2560.000 2559.922 FORMAT "%8.3" ECU_ADDRESS 0x5000089A /end MEASUREMENT
/begin MEASUREMENT dpsrg1_w_msg "difference of pressure to a previous segment - bank 1" SWORD p_q0p078 1 100 -2560.000 2559.922 FORMAT "%8.3" ECU_ADDRESS 0x500008A0 /end MEASUREMENT
/begin MEASUREMENT dpsrg_w_msg "difference of pressure to a previous segment - bank 1" SWORD p_q0p078 1 100 -2560.000 2559.922 FORMAT "%8.3" ECU_ADDRESS 0x500008A2 /end MEASUREMENT
/begin MEASUREMENT drldvls_w_msg "Dynamic pre-contr. rel. air charge f. DK when switching air actuators" SWORD rel_q0p0234 1 100 -768.0000 767.9766 FORMAT "%8.4" ECU_ADDRESS 0x50000F70 /end MEASUREMENT
/begin MEASUREMENT drlm_w_msg "nominal / actual value difference of air mass controller" SWORD rel_q0p02344 1 100 -768.0000 767.9766 FORMAT "%8.4" ECU_ADDRESS 0x60001642 /end MEASUREMENT
/begin MEASUREMENT drlvhepsrs_w_msg "Change of air charge during cam profil switching at desired manifold pressure" SWORD rel_q0p0234 1 100 -768.0000 767.9766 FORMAT "%8.4" ECU_ADDRESS 0x60001640 /end MEASUREMENT
/begin MEASUREMENT drl_w_msg "charge change (Word)" SWORD rel_q0p0234 1 100 -768.0000 767.9766 FORMAT "%8.4" ECU_ADDRESS 0x6000077C /end MEASUREMENT
/begin MEASUREMENT evabkor_w "Correction factor for modelled lambda setpoint at engine outlet in case of injection valve cutoff" UWORD fak_q4p883Em4 1 100 0.00 31.99951 FORMAT "%8.5" ECU_ADDRESS 0x60001176 /end MEASUREMENT
/begin MEASUREMENT fapsrr_w "factor adaption psrr_w" SWORD fak_q3p0518Em5 1 100 -1.000000 0.999969 FORMAT "%8.6" ECU_ADDRESS 0x600005F6 /end MEASUREMENT
/begin MEASUREMENT fdpslma_w "factor delta pslm_w absolute" UWORD fak_q3p0518Em5 1 100 0.00 1.999969 FORMAT "%8.6" ECU_ADDRESS 0x600005F8 /end MEASUREMENT
/begin MEASUREMENT fiuewdk_w_msg "interpolationfactor at wide open throtte" UWORD fak_uw_b2 1 100 0.00 1.999969 FORMAT "%8.6" ECU_ADDRESS 0x60000CCA /end MEASUREMENT
/begin MEASUREMENT fkl1_w "factor flap 1" UWORD fak_uw_b2 1 100 0.00 1.999969 FORMAT "%8.6" ECU_ADDRESS 0x6000115E /end MEASUREMENT
/begin MEASUREMENT fkl2_w "factor flap 2" UWORD fak_uw_b2 1 100 0.00 1.999969 FORMAT "%8.6" ECU_ADDRESS 0x6000115C /end MEASUREMENT
/begin MEASUREMENT fklafa_w_msg "Faktor Ausfluss including adaptation" UWORD fak_uw_b2 1 100 0.00 1.999969 FORMAT "%8.6" ECU_ADDRESS 0x700037A2 /end MEASUREMENT
/begin MEASUREMENT fkmsdkh_w_msg "Correction factor mass flow secondary charge signal(HFM-based)" UWORD fak_q6p1035Em5 1 100 0.00 3.999939 FORMAT "%8.6" ECU_ADDRESS 0x60001608 /end MEASUREMENT
/begin MEASUREMENT fkmsdkp_w_msg "Correction factor mass flow secondary charge signal(DSS-based)" UWORD fak_q6p1035Em5 1 100 0.00 3.999939 FORMAT "%8.6" ECU_ADDRESS 0x60001606 /end MEASUREMENT
/begin MEASUREMENT fkmsdksh_w "Correct. factor fast mass flow adjustment secondary charge signal(HFM-based)" UWORD fak_q6p1035Em5 1 100 0.00 3.999939 FORMAT "%8.6" ECU_ADDRESS 0x6000118C /end MEASUREMENT
/begin MEASUREMENT fkmsdksp_w_msg "Correct. factor fast mass flow adjustment secondary charge signal(DSS-based)" UWORD fak_q6p1035Em5 1 100 0.00 3.999939 FORMAT "%8.6" ECU_ADDRESS 0x60001604 /end MEASUREMENT
/begin MEASUREMENT fkmsdks_w_msg "correction factor for fast mass flow signal" UWORD fak_q6p1035Em5 1 100 0.00 3.999939 FORMAT "%8.6" ECU_ADDRESS 0x60000CD2 /end MEASUREMENT
/begin MEASUREMENT fkmsdk_w_msg "correction factor for mass-flow substitute load signal" UWORD fak_q6p1035Em5 1 100 0.00 3.999939 FORMAT "%8.6" ECU_ADDRESS 0x6000160A /end MEASUREMENT
/begin MEASUREMENT fkorbgvheg_w "Factor correction active in background VHEG" UWORD fak_uw_b2 1 100 0.00 1.000000 FORMAT "%8.6" ECU_ADDRESS 0x60001126 /end MEASUREMENT
/begin MEASUREMENT fkorbgvhek_w "Factor correction active in background VHEK" UWORD fak_uw_b2 1 100 0.00 1.000000 FORMAT "%8.6" ECU_ADDRESS 0x60001124 /end MEASUREMENT
/begin MEASUREMENT fkor_w_msg "Factor correction active" UWORD fak_uw_b2 1 100 0.00 1.999969 FORMAT "%8.6" ECU_ADDRESS 0x60001602 /end MEASUREMENT
/begin MEASUREMENT fkpvdkah_w "Old val.: Correct. fact. slow mass flow adjust. second. chrg. sig.(HFM-based)" UWORD fak_q6p1035Em5 1 100 0.00 3.999939 FORMAT "%8.6" ECU_ADDRESS 0x600394A6 /end MEASUREMENT
/begin MEASUREMENT fkpvdkap_w "Old val.: Correct. fact. slow mass flow adjust. second. chrg. sig.(DSS-based)" UWORD fak_q6p1035Em5 1 100 0.00 3.999939 FORMAT "%8.6" ECU_ADDRESS 0x600394A4 /end MEASUREMENT
/begin MEASUREMENT fkpvdkh_w "Correct. factor slow mass flow adjustment secondary charge signal(HFM-based)" UWORD fak_q6p1035Em5 1 100 0.00 3.999939 FORMAT "%8.6" ECU_ADDRESS 0x600394A2 /end MEASUREMENT
/begin MEASUREMENT fkpvdkp_w_msg "Correct. factor slow mass flow adjustment secondary charge signal(DSS-based)" UWORD fak_q6p1035Em5 1 100 0.00 3.999939 FORMAT "%8.6" ECU_ADDRESS 0x6003957A /end MEASUREMENT
/begin MEASUREMENT fkpvdk_w_msg "correction factor for slow mass flow signal" UWORD fak_q6p1035Em5 1 100 0.00 3.999939 FORMAT "%8.6" ECU_ADDRESS 0x60000CD6 /end MEASUREMENT
/begin MEASUREMENT fpabnav_w_msg "Correction factor exhaust gas pressure (word)" UWORD fak_uw_b8 1 100 0.00 7.999878 FORMAT "%8.6" ECU_ADDRESS 0x60000CD8 /end MEASUREMENT
/begin MEASUREMENT fpbrpsg_w "pulsation correction from base maps" UWORD fak_uw_b4 1 100 0.00 3.999939 FORMAT "%8.6" ECU_ADDRESS 0x6000115A /end MEASUREMENT
/begin MEASUREMENT fpbrpsmx_w "pulsation correction with complete open throttle" UWORD fak_uw_b4 1 100 0.00 3.999939 FORMAT "%8.6" ECU_ADDRESS 0x60001158 /end MEASUREMENT
/begin MEASUREMENT fpbrpsug_w "pulsation correction at pressure ratio over throttle 0.95" UWORD fak_uw_b4 1 100 0.00 3.999939 FORMAT "%8.6" ECU_ADDRESS 0x60001156 /end MEASUREMENT
/begin MEASUREMENT fpbrps_w_msg "Fa. for adap. of intake manifold pres. to comb. space pres. (at act. valve pos.)" UWORD fak_uw_b4 1 100 0.00 3.999939 FORMAT "%8.6" ECU_ADDRESS 0x600015F6 /end MEASUREMENT
/begin MEASUREMENT fpbrsrs_w_msg "target value factor for adap. of intake manifold pres. to comb. space pres. (at act. valve pos.)" UWORD fak_uw_b4 1 100 0.00 3.999939 FORMAT "%8.6" ECU_ADDRESS 0x600015F4 /end MEASUREMENT
/begin MEASUREMENT fpndk_w_msg "correction factor for pressure downstream throttle valve" UWORD fak_uw_b8 1 100 0.00 7.999878 FORMAT "%8.6" ECU_ADDRESS 0x700037A0 /end MEASUREMENT
/begin MEASUREMENT ftpavdn_w_msg "factor min correction air density for throttle valve flow f(intake air temp.,altit.)" UWORD fak_uw_b8 1 100 0.00 7.999878 FORMAT "%8.6" ECU_ADDRESS 0x600007B0 /end MEASUREMENT
/begin MEASUREMENT ftpavdx_w_msg "factor max correction air density for throttle valve flow f(intake air temp.,altit.)" UWORD fak_uw_b8 1 100 0.00 7.999878 FORMAT "%8.6" ECU_ADDRESS 0x600007B4 /end MEASUREMENT
/begin MEASUREMENT ftpavd_w_msg "factor correction air density for throttle valve flow f(intake air temp.,altit.)" UWORD fak_uw_b8 1 100 0.00 7.999878 FORMAT "%8.6" ECU_ADDRESS 0x60000CE4 /end MEASUREMENT
/begin MEASUREMENT ftpvd_w_msg "factor temperature + pressure upstream throttle" UWORD fak_uw_b8 1 100 0.00 7.999878 FORMAT "%8.6" ECU_ADDRESS 0x600015EE /end MEASUREMENT
/begin MEASUREMENT fupshoms_w_msg "target factor system related transformation pressure to load in hom. mode" UWORD rel_uw_b0p3 1 100 0.00 0.2999954 FORMAT "%9.7" ECU_ADDRESS 0x60001476 /end MEASUREMENT
/begin MEASUREMENT fupshsps_w_msg "factor conversion pressure to air charge in HSP operation mode" UWORD rel_uw_b0p3 1 100 0.00 0.2999954 FORMAT "%9.7" ECU_ADDRESS 0x60001474 /end MEASUREMENT
/begin MEASUREMENT fupsrlmx_w_msg "factor system related transformation pressure to load (16-Bit)" UWORD rel_uw_b0p3 1 100 0.00 0.2999954 FORMAT "%9.7" ECU_ADDRESS 0x600015EC /end MEASUREMENT
/begin MEASUREMENT fupsrlro_w "factor for conversion pressure in cylinder filling" UWORD rel_uw_b0p3 1 100 0.00 0.2999954 FORMAT "%9.7" ECU_ADDRESS 0x60001154 /end MEASUREMENT
/begin MEASUREMENT fupsrls_w_msg "Desired factor system related transformation pressure to load (16-Bit)" UWORD rel_uw_b0p3 1 100 0.00 0.2999954 FORMAT "%9.7" ECU_ADDRESS 0x50000F7E /end MEASUREMENT
/begin MEASUREMENT fupsrltn_w_msg "minimum factor due to tolerances for conversion of pressure to charge" UWORD rel_uw_b0p3 1 100 0.00 0.2999954 FORMAT "%9.7" ECU_ADDRESS 0x60000CEA /end MEASUREMENT
/begin MEASUREMENT fupsrltx_w_msg "maximum factor due to tolerances for conversion of pressure to charge" UWORD rel_uw_b0p3 1 100 0.00 0.2999954 FORMAT "%9.7" ECU_ADDRESS 0x60000CEC /end MEASUREMENT
/begin MEASUREMENT fupsrlug_w_msg "factor system related transformation pressure to load (16-Bit)" UWORD rel_uw_b0p3 1 100 0.00 0.2999954 FORMAT "%9.7" ECU_ADDRESS 0x600015EA /end MEASUREMENT
/begin MEASUREMENT fupsrl_w_msg "factor system related transformation pressure to load (16-Bit)" UWORD rel_uw_b0p3 1 100 0.00 0.2999954 FORMAT "%9.7" ECU_ADDRESS 0x60000CE8 /end MEASUREMENT
/begin MEASUREMENT fupsvheg_w_msg "target factor system related transformation pressure to load in VHE mode" UWORD rel_uw_b0p3 1 100 0.00 0.2999954 FORMAT "%9.7" ECU_ADDRESS 0x60001472 /end MEASUREMENT
/begin MEASUREMENT fupsvhek_w_msg "target factor system related transformation pressure to load in VHE mode small cam" UWORD rel_uw_b0p3 1 100 0.00 0.2999954 FORMAT "%9.7" ECU_ADDRESS 0x60001470 /end MEASUREMENT
/begin MEASUREMENT grfvbr_w "gradient of combustion chamber volume at inlet valve closing" SWORD fak_sw_q64 1 100 -512.0000 511.9844 FORMAT "%8.4" ECU_ADDRESS 0x60000600 /end MEASUREMENT
/begin MEASUREMENT InjSys_dmCo2 "CO2 output (kg per h)" UWORD m_uw_b1536 1 100 0.00 1535.977 FORMAT "%8.3" ECU_ADDRESS 0x600085E0 /end MEASUREMENT
/begin MEASUREMENT InjSys_dvolFu "Volumetric flow of fuel in L per s" UWORD q1p1921Em6_L_DIV_s 1 100 0.00 0.07812381 FORMAT "%10.8" ECU_ADDRESS 0x60013F94 /end MEASUREMENT
/begin MEASUREMENT InjSys_dvolFuInjr "Calculated fuel volume flow fuel injection valves [l per s]" UWORD q1p1921Em6_L_DIV_s 1 100 0.00 0.07812381 FORMAT "%10.8" ECU_ADDRESS 0x600085DE /end MEASUREMENT
/begin MEASUREMENT InjSys_dvolFumL "volumetric flow of fuel in ml per s" UWORD q1p1921Em3_mL_DIV_s 1 100 0.00 78.12381 FORMAT "%8.5" ECU_ADDRESS 0x600085DC /end MEASUREMENT
/begin MEASUREMENT InjSys_dvolFuPerHr "Volumetric flow of fuel in L per h" UWORD vol_q8p583Em3 1 100 0.00 562.4914 FORMAT "%8.4" ECU_ADDRESS 0x60007832 /end MEASUREMENT
/begin MEASUREMENT InjSys_facCorrnFuT "Correction factor based on Fuel Temperature" UBYTE fak_ub_b2 1 100 0.00 1.992188 FORMAT "%8.6" ECU_ADDRESS 0x6000E8E9 /end MEASUREMENT
/begin MEASUREMENT InjSys_mCo2PerLFu "CO2 output per liter fuel (g per L)" UWORD m_q0p1_g_DIV_L 1 100 0.00 6553.500 FORMAT "%8.3" ECU_ADDRESS 0x600085D6 /end MEASUREMENT
/begin MEASUREMENT InjSys_mfEngFuRate "Engine fuel rate" UWORD RBPtCel_mf_0p02_1 1 100 0.00 1310.700 FORMAT "%8.3" ECU_ADDRESS 0x600085D4 /end MEASUREMENT
/begin MEASUREMENT InjSys_mfFuMCmbToOilDelta "Delta fuel mass exchanged between combustion chamber and oil sump over 1000ms" SWORD m_q0p032_g 1 100 -1048.576 1048.544 FORMAT "%8.3" ECU_ADDRESS 0x6000882E /end MEASUREMENT
/begin MEASUREMENT InjSys_mFuMIntgl "Integral of absolute fuel mass in 100milliseconds" ULONG ASCET_tmp6 1 100 0.00 201.326591953 FORMAT "%13.9" ECU_ADDRESS 0x600031C4 /end MEASUREMENT
/begin MEASUREMENT InjSys_mFuMIT "Absolute fuel mass calculated every synchro for IT" ULONG ASCET_tmp7 1 100 0.00 20.1326591953 FORMAT "%13.10" ECU_ADDRESS 0x7000317C /end MEASUREMENT
/begin MEASUREMENT InjSys_mFuMPID5E "Absolute fuel mass calculated every synchro for PID5E" ULONG ASCET_tmp7 1 100 0.00 20.1326591953 FORMAT "%13.10" ECU_ADDRESS 0x70003178 /end MEASUREMENT
/begin MEASUREMENT InjSys_mFuMPID9D "Absolute fuel mass calculated every synchro for PID9D" ULONG ASCET_tmp7 1 100 0.00 20.1326591953 FORMAT "%13.10" ECU_ADDRESS 0x70003174 /end MEASUREMENT
/begin MEASUREMENT InjSys_mFuMSumPID5E "Sum of fuel quantity accumulated per second for PID5E" ULONG ASCET_tmp6 1 100 0.00 201.326591953 FORMAT "%13.9" ECU_ADDRESS 0x70003170 /end MEASUREMENT
/begin MEASUREMENT InjSys_mFuMSumPID9D "Sum of fuel quantity accumulated per second for PID9D" ULONG ASCET_tmp6 1 100 0.00 201.326591953 FORMAT "%13.9" ECU_ADDRESS 0x7000316C /end MEASUREMENT
/begin MEASUREMENT InjSys_mFuOilDiff "Difference in mass of fuel in engine oil every 200ms" SWORD m_q0p032_g 1 100 -1048.576 1048.544 FORMAT "%8.3" ECU_ADDRESS 0x60007830 /end MEASUREMENT
/begin MEASUREMENT InjSys_mFuOilOld "Mass of fuel in engine oil (Old)" UWORD m_q0p032_g 1 100 0.00 2097.120 FORMAT "%8.3" ECU_ADDRESS 0x6000782E /end MEASUREMENT
/begin MEASUREMENT InjSys_mfVehFuRate "Vehicle Fuel rate" UWORD RBPtCel_mf_0p02_1 1 100 0.00 1310.700 FORMAT "%8.3" ECU_ADDRESS 0x600085D2 /end MEASUREMENT
/begin MEASUREMENT InjSys_ratFuMIT "Relative fuel mass calculated every synchro for IT" UWORD rel_uw_b3072 1 100 0.00 3071.953 FORMAT "%8.3" ECU_ADDRESS 0x7000316A /end MEASUREMENT
/begin MEASUREMENT InjSys_ratFuMPID5E "Relative fuel mass calculated every synchro for PID5E" UWORD rel_uw_b3072 1 100 0.00 3071.953 FORMAT "%8.3" ECU_ADDRESS 0x70003168 /end MEASUREMENT
/begin MEASUREMENT InjSys_ratFuMPID9D "Relative fuel mass calculated every synchro for PID9D" UWORD rel_uw_b3072 1 100 0.00 3071.953 FORMAT "%8.3" ECU_ADDRESS 0x70003166 /end MEASUREMENT
/begin MEASUREMENT InjSys_tFuSnsr "local variable for fuel temperature" UBYTE temp_ub_q0p75_o48 1 100 -48.0 143.3 FORMAT "%5.1" ECU_ADDRESS 0x6000E8E8 /end MEASUREMENT
/begin MEASUREMENT InjSys_tiMaiInj "Array of all cylinder main injection timings" ULONG t_q0p0004_ms 1 100 0.00 1717986.91800 FORMAT "%13.5" ARRAY_SIZE 4 ECU_ADDRESS 0x70003CF8 /end MEASUREMENT
/begin MEASUREMENT InjSys_tiSynPerCyc "sum of sychro duration per calculation cycle in BGKV" SLONG Time_Dt 1 100 -2147.48364800 2147.48364700 FORMAT "%13.8" ECU_ADDRESS 0x50001AB8 /end MEASUREMENT
/begin MEASUREMENT InjSys_volEngFuCnsPerHr "Engine fuel rate in liter per hour" UWORD volgrd_q0p05_L_DIV_h 1 100 0.00 3276.750 FORMAT "%8.3" ECU_ADDRESS 0x600085B8 /end MEASUREMENT
/begin MEASUREMENT InjSys_volEngFuCnsPerSec "Engine fuel rate in liter per second" ULONG vol_q6p1035Em7 1 100 0.00 2621.43999939 FORMAT "%13.8" ECU_ADDRESS 0x600031C0 /end MEASUREMENT
/begin MEASUREMENT InjSys_volFuConsDrvCyc "fuel consumption in driving cycle [L]" SWORD Vol 1 100 -327.6800 327.6700 FORMAT "%8.4" ECU_ADDRESS 0x60013F96 /end MEASUREMENT
/begin MEASUREMENT InjSys_volFuConsDrvCycCAN "fuel consumption in driving cycle in cubic centimetre for transmission on CAN" ULONG vol_q0p1_cm3 1 100 0.00 429496729.500 FORMAT "%13.3" ECU_ADDRESS 0x60003754 /end MEASUREMENT
/begin MEASUREMENT InjSys_volFuConsDrvgCycTstrSrv "fuel consumption in driving cycle [L]" ULONG Vol 1 100 0.00 42949672.9500 FORMAT "%13.4" ECU_ADDRESS 0x60003750 /end MEASUREMENT
/begin MEASUREMENT klvpspv_w "correction in pressure ratio threshold due to a big leakage into intake manifold" UWORD fak_uw_b2 1 100 0.00 1.999969 FORMAT "%8.6" ECU_ADDRESS 0x60000CAE /end MEASUREMENT
/begin MEASUREMENT kmsdk_w "gain factor for filtering msdk" UWORD fak_q1p526Em5 1 100 0.00 0.9999847 FORMAT "%9.7" ECU_ADDRESS 0x50000F68 /end MEASUREMENT
/begin MEASUREMENT labbris_w "Lambda of burning cylinder for calculation of internal residual gas" UWORD fak_uw_b16 1 100 0.00 15.99976 FORMAT "%8.5" ECU_ADDRESS 0x60000CB0 /end MEASUREMENT
/begin MEASUREMENT labbrm_w_msg "Lambda setpoint for the gas in the fired combustion chambers" UWORD fak_q0p000244 1 100 0.00 15.99976 FORMAT "%8.5" ECU_ADDRESS 0x6001401A /end MEASUREMENT
/begin MEASUREMENT labrgs_w_msg "Lambda setpoint of the mixture of all cylinders" UWORD fak_q0p000244 1 100 0.00 15.99976 FORMAT "%8.5" ECU_ADDRESS 0x6001401C /end MEASUREMENT
/begin MEASUREMENT LamCtrl_flgIninSpB1 "Initialization of lambda set point (e.g., after fuel cut-off or start-stop, bank 1)" UBYTE B_TRUE 1 100 0.00 1.00000000000 BIT_MASK 0x1 FORMAT "%13.11" ECU_ADDRESS 0x60000137 /end MEASUREMENT
/begin MEASUREMENT LamCtrl_ratLamSpNoDynS1B1 "Lambda setpoint without dynamics, i.e. without dead time and time constant (sensor 1, bank 1)" UWORD fak_q0p000244 1 100 0.00 15.99976 FORMAT "%8.5" ECU_ADDRESS 0x60008BCA /end MEASUREMENT
/begin MEASUREMENT LamCtrl_ratLamSpS1B1 "Lambda setpoint with adapted plant parameters (sensor 1, bank 1)" UWORD fak_q0p000244 1 100 0.00 15.99976 FORMAT "%8.5" ECU_ADDRESS 0x60008BC8 /end MEASUREMENT
/begin MEASUREMENT LamCtrl_tiDeadTiCorrdHomStratBnk1 "Corrected plant dead time for stratified or homogeneous stratified operation" UWORD t_q0p01 1 100 0.00 655.3500 FORMAT "%8.4" ECU_ADDRESS 0x60008BC6 /end MEASUREMENT
/begin MEASUREMENT LamCtrl_tiDeadTiSnsrToDsChrgrBnk1 "Transport delay (dead time) from lambda sensor to downstream of turbocharger" UWORD t_q0p01 1 100 0.00 655.3500 FORMAT "%8.4" ECU_ADDRESS 0x60008BC4 /end MEASUREMENT
/begin MEASUREMENT lamsbrs_w_msg "lambda setpoint at engine outlet (considering scavenging or secondary air, if available)" UWORD fak_q0p000244 1 100 0.00 15.99976 FORMAT "%8.5" ECU_ADDRESS 0x60008AFE /end MEASUREMENT
/begin MEASUREMENT lamsobd_w_msg "required lambda for OBD service 01 and 02" UWORD fak_q0p000244 1 100 0.00 15.99976 FORMAT "%8.5" ECU_ADDRESS 0x60014022 /end MEASUREMENT
/begin MEASUREMENT lamsons_w_msg "lambda setpoint at sensor mounting position" UWORD fak_q0p000244 1 100 0.00 15.99976 FORMAT "%8.5" ECU_ADDRESS 0x60008AFC /end MEASUREMENT
/begin MEASUREMENT laontlm_w_msg "Lambda downstream of turbocharger without modulation, model" UWORD fak_q0p000244 1 100 0.00 15.99976 FORMAT "%8.5" ECU_ADDRESS 0x60014026 /end MEASUREMENT
/begin MEASUREMENT laonvkm_w_msg "Lambda downstream of front catalyst without modulation, model" UWORD fak_q0p000244 1 100 0.00 15.99976 FORMAT "%8.5" ECU_ADDRESS 0x60008AF8 /end MEASUREMENT
/begin MEASUREMENT lassa_w_msg "Lambda setpoint taking into account secondary air" UWORD fak_q0p000244 1 100 0.00 15.99976 FORMAT "%8.5" ECU_ADDRESS 0x60014028 /end MEASUREMENT
/begin MEASUREMENT ml_msg "air mass flow into cylinder" UBYTE m_q4_kg_DIV_h 1 100 0.00 1020. FORMAT "%5.0" ECU_ADDRESS 0x70003659 /end MEASUREMENT
/begin MEASUREMENT ml_w_msg "air mass flow into cylinder" UWORD m_q0p1 1 100 0.00 6553.500 FORMAT "%8.3" ECU_ADDRESS 0x600007E0 /end MEASUREMENT
/begin MEASUREMENT msdhmn_w "min. air massflow over throttle blade for MAF-diagnosis without WOT area" UWORD m_q0p1 1 100 0.00 6553.500 FORMAT "%8.3" ECU_ADDRESS 0x70003164 /end MEASUREMENT
/begin MEASUREMENT msdkahpg_w "Mass flow across throttle valve adapted to HFM(only background calculation)" UWORD m_q0p1 1 100 0.100 6553.500 FORMAT "%8.3" ECU_ADDRESS 0x6000118A /end MEASUREMENT
/begin MEASUREMENT msdkaphg_w "Mass flow across throttle valve adapted to DSS(only background calculation)" UWORD m_q0p1 1 100 0.100 6553.500 FORMAT "%8.3" ECU_ADDRESS 0x60001188 /end MEASUREMENT
/begin MEASUREMENT msdkdslocadpn_w "local copy for dfuelsan calculation" UWORD m_q0p1 1 100 0.00 6553.500 FORMAT "%8.3" ECU_ADDRESS 0x60000604 /end MEASUREMENT
/begin MEASUREMENT msdkds_w_msg "Mass flow at the DK calculated from the sensor signal of the DSS" UWORD m_q0p1 1 100 0.00 6553.500 FORMAT "%8.3" ECU_ADDRESS 0x600007F2 /end MEASUREMENT
/begin MEASUREMENT msdkhfmlocadpn_w "local copy for dfuelsan calculation" UWORD m_q0p1 1 100 0.00 6553.500 FORMAT "%8.3" ECU_ADDRESS 0x60000606 /end MEASUREMENT
/begin MEASUREMENT msdkhfs_w_msg "air mass flow main charge sensor" UWORD m_q0p1 1 100 0.00 6553.500 FORMAT "%8.3" ECU_ADDRESS 0x600015D4 /end MEASUREMENT
/begin MEASUREMENT msdkhmn_w_msg "Mass flow through throttle valve- minimum for HFM-diagnosis" UWORD m_q0p1 1 100 0.00 6553.500 FORMAT "%8.3" ECU_ADDRESS 0x500008F0 /end MEASUREMENT
/begin MEASUREMENT msdkhmx_w_msg "Mass flow through throttle valve- maximum for HFM-diagnosis" UWORD m_q0p1 1 100 0.00 6553.500 FORMAT "%8.3" ECU_ADDRESS 0x500008F2 /end MEASUREMENT
/begin MEASUREMENT msdklocadpn_w "local copy for dfuelsan calculation" UWORD m_q0p1 1 100 0.00 6553.500 FORMAT "%8.3" ECU_ADDRESS 0x60000608 /end MEASUREMENT
/begin MEASUREMENT msdkmxtx_w_msg "max. possible mass flow through DK at max. tolerances" UWORD m_uw_b6553p5 1 100 0.00 6553.500 FORMAT "%8.3" ECU_ADDRESS 0x60000CFA /end MEASUREMENT
/begin MEASUREMENT msdkmx_w_msg "max. possible air mass flow through throttle valve" UWORD m_uw_b6553p5 1 100 0.00 6553.500 FORMAT "%8.3" ECU_ADDRESS 0x600015D2 /end MEASUREMENT
/begin MEASUREMENT msdkoolocadpn_w "local copy for dfuelsan calculation" UWORD m_q0p1 1 100 0.00 6553.500 FORMAT "%8.3" ECU_ADDRESS 0x6000060A /end MEASUREMENT
/begin MEASUREMENT msdkosa_w_msg "air-mass flow through throttle valve without fast adjustment" UWORD m_q0p1 1 100 0.00 6553.500 FORMAT "%8.3" ECU_ADDRESS 0x500008F4 /end MEASUREMENT
/begin MEASUREMENT msdkoue_w "air-mass flow through throttle valve without ""überweg""" UWORD m_q0p1 1 100 0.00 6553.500 FORMAT "%8.3" ECU_ADDRESS 0x5000078A /end MEASUREMENT
/begin MEASUREMENT msdkpmn_w_msg "Mass flow through throttle valve for minimum intake manifold pressure" UWORD m_q0p1 1 100 0.00 6553.500 FORMAT "%8.3" ECU_ADDRESS 0x500008F6 /end MEASUREMENT
/begin MEASUREMENT msdkpmx_w_msg "Mass flow through throttle valve for max. intake manifold pressure" UWORD m_q0p1 1 100 0.00 6553.500 FORMAT "%8.3" ECU_ADDRESS 0x500008F8 /end MEASUREMENT
/begin MEASUREMENT msdksoir_w "set air mass flow through throttling valve without inert gas ratio governor part" UWORD m_uw_b6553p5 1 100 0.00 6553.500 FORMAT "%8.3" ECU_ADDRESS 0x60000CB2 /end MEASUREMENT
/begin MEASUREMENT msdks_w_msg "set air mass flow through throttling valve" UWORD m_uw_b6553p5 1 100 0.00 6553.500 FORMAT "%8.3" ECU_ADDRESS 0x600015D0 /end MEASUREMENT
/begin MEASUREMENT msdkugd_w_msg "air mass flow through throttle valve at ps/pvdk=0.95(unthrottled)" UWORD m_uw_b6553p5 1 100 0.00 6553.500 FORMAT "%8.3" ECU_ADDRESS 0x60000CFC /end MEASUREMENT
/begin MEASUREMENT msdkugpn_w_msg "min. air massflow opver throttle blade for MAP-diagnosis at UGD" UWORD m_uw_b6553p5 1 100 0.00 6553.500 FORMAT "%8.3" ECU_ADDRESS 0x60000CFE /end MEASUREMENT
/begin MEASUREMENT msdkugtn_w_msg "minimum mass flow due to tolerances through DK at ps/pvdk=0.95 (unthrottled)" UWORD m_uw_b6553p5 1 100 0.00 6553.500 FORMAT "%8.3" ECU_ADDRESS 0x60000D00 /end MEASUREMENT
/begin MEASUREMENT msdkugtx_w_msg "maximum mass flow due to tolerances through DK at ps/pvdk=0.95 (unthrottled)" UWORD m_uw_b6553p5 1 100 0.00 6553.500 FORMAT "%8.3" ECU_ADDRESS 0x600015CE /end MEASUREMENT
/begin MEASUREMENT msdk_w_msg "air-mass flow through throttle valve" UWORD m_q0p1 1 100 0.00 6553.500 FORMAT "%8.3" ECU_ADDRESS 0x600007EE /end MEASUREMENT
/begin MEASUREMENT msdouep_w "predicted air mass flow over throttle blade without overtravel" UWORD m_q0p1 1 100 0.00 6553.500 FORMAT "%8.3" ECU_ADDRESS 0x70003162 /end MEASUREMENT
/begin MEASUREMENT msdpmn_w "Mass flow through throttle valve for minimum intake manifold pressure" UWORD m_q0p1 1 100 0.00 6553.500 FORMAT "%8.3" ECU_ADDRESS 0x70003160 /end MEASUREMENT
/begin MEASUREMENT msdpvf_w "predicted air mass flow through throttle blade before filtering" UWORD m_q0p1 1 100 0.00 6553.500 FORMAT "%8.3" ECU_ADDRESS 0x7000315E /end MEASUREMENT
/begin MEASUREMENT msdp_w_msg "predicted air mass flow through throttle blade" UWORD m_q0p1 1 100 0.00 6553.500 FORMAT "%8.3" ECU_ADDRESS 0x500008FA /end MEASUREMENT
/begin MEASUREMENT msdstats_w_msg "desired air mass flow through throttling valve under stationary conditions" UWORD m_q0p1 1 100 0.00 6553.500 FORMAT "%8.3" ECU_ADDRESS 0x600015CC /end MEASUREMENT
/begin MEASUREMENT msdue_w "Mass flow via throttle valve for wide open throttle" UWORD m_q0p1 1 100 0.00 6553.500 FORMAT "%8.3" ECU_ADDRESS 0x7000315C /end MEASUREMENT
/begin MEASUREMENT msdvf_w "air mass flow through throttle blade without filter" UWORD m_q0p1 1 100 0.00 6553.500 FORMAT "%8.3" ECU_ADDRESS 0x7000315A /end MEASUREMENT
/begin MEASUREMENT msfabr_w_msg "Mass-flow charge flowing through the outlet valves from the combustion chamber" UWORD m_q0p1 1 100 0.00 6553.500 FORMAT "%8.3" ECU_ADDRESS 0x600007FA /end MEASUREMENT
/begin MEASUREMENT mshfmdk_w_msg "model. air mass flow based on throttle at installed position of MAF sensor" UWORD m_uw_b6553p5 1 100 0.00 6553.500 FORMAT "%8.3" ECU_ADDRESS 0x70003780 /end MEASUREMENT
/begin MEASUREMENT mshfmds_w_msg "model. air mass flow based on MAP sensor at installed position of MAFsensor" UWORD m_uw_b6553p5 1 100 0.00 6553.500 FORMAT "%8.3" ECU_ADDRESS 0x7000377E /end MEASUREMENT
/begin MEASUREMENT mshfmmod_w_msg "modelled air mass flow at MAF sensor based on throttle blade or MAP sensor" UWORD m_uw_b6553p5 1 100 0.00 6553.500 FORMAT "%8.3" ECU_ADDRESS 0x7000377C /end MEASUREMENT
/begin MEASUREMENT mshmdkmn_w_msg "Mass flow at MAF position based on throttle valve model - minimum for HFM-diagnosis" UWORD m_uw_b6553p5 1 100 0.00 6553.500 FORMAT "%8.3" ECU_ADDRESS 0x60000800 /end MEASUREMENT
/begin MEASUREMENT mshmdkmx_w_msg "Mass flow at MAF position based on throttle valve model - maximum for HFM-diagnosis" UWORD m_uw_b6553p5 1 100 0.00 6553.500 FORMAT "%8.3" ECU_ADDRESS 0x60000802 /end MEASUREMENT
/begin MEASUREMENT msndkoo_w_msg "Normalized mass flow over throttle without offset (word)" UWORD m_q0p1 1 100 0.00 6553.500 FORMAT "%8.3" ECU_ADDRESS 0x500008FE /end MEASUREMENT
/begin MEASUREMENT msndk_w_msg "standardised air mass flow through throttle valve" UWORD m_q0p1 1 100 0.00 6553.500 FORMAT "%8.3" ECU_ADDRESS 0x7000377A /end MEASUREMENT
/begin MEASUREMENT msrirsp_w "Mass flow of re-aspirated residue gas" UWORD m_q0p00625 1 100 0.00 409.5938 FORMAT "%8.4" ECU_ADDRESS 0x60001152 /end MEASUREMENT
/begin MEASUREMENT nmotsw_w "engine speed where syn. faster then 10ms" SWORD EngN 1 100 -16384.00 16383.50 FORMAT "%8.2" ECU_ADDRESS 0x60001150 /end MEASUREMENT
/begin MEASUREMENT nmottkor_w "Engine speed temperature corrected" SWORD EngN 1 100 -16384.00 16383.50 FORMAT "%8.2" ECU_ADDRESS 0x6000114E /end MEASUREMENT
/begin MEASUREMENT oafpsrr_w "offset adaption psrr_w" SWORD p_q0p078 1 100 -2560.000 2559.922 FORMAT "%8.3" ECU_ADDRESS 0x6000060C /end MEASUREMENT
/begin MEASUREMENT ofmsdap_w "Old value: Leakage air mass flow throttle valve(DSS-based) of interpolation between window 1 and window 2" SWORD m_q0p1 1 100 -3276.800 3276.700 FORMAT "%8.3" ECU_ADDRESS 0x60001178 /end MEASUREMENT
/begin MEASUREMENT ofmsdkh_w "Leakage air mass flow throttle adapted to HFM by interpolation between window 1 and window 2" SWORD m_q0p1 1 100 -3276.800 3276.700 FORMAT "%8.3" ECU_ADDRESS 0x60001186 /end MEASUREMENT
/begin MEASUREMENT ofmsdkp_w "Leakage air mass flow throttle adapted to DSS by interpolation between window 1 and window 2" SWORD m_q0p1 1 100 -3276.800 3276.700 FORMAT "%8.3" ECU_ADDRESS 0x60001184 /end MEASUREMENT
/begin MEASUREMENT ofmsndah1_w "Old value: Leakage air mass flow throttle valve(HFM-based) in mass flow adaptation window region 1" SWORD m_q0p1 1 100 -3276.800 3276.700 FORMAT "%8.3" ECU_ADDRESS 0x600394A0 /end MEASUREMENT
/begin MEASUREMENT ofmsndah2_w "Old value: Leakage air mass flow throttle valve(HFM-based) in mass flow adaptation window region 2" SWORD m_q0p1 1 100 -3276.800 3276.700 FORMAT "%8.3" ECU_ADDRESS 0x6003949E /end MEASUREMENT
/begin MEASUREMENT ofmsndap1_w "Old value: Leakage air mass flow throttle valve(DSS-based) in mass flow adaptation region 1" SWORD m_q0p1 1 100 -3276.800 3276.700 FORMAT "%8.3" ECU_ADDRESS 0x6003949C /end MEASUREMENT
/begin MEASUREMENT ofmsndap2_w "Old value: Leakage air mass flow throttle valve(DSS-based) in mass flow adaptation region 2" SWORD m_q0p1 1 100 -3276.800 3276.700 FORMAT "%8.3" ECU_ADDRESS 0x6003949A /end MEASUREMENT
/begin MEASUREMENT ofmsndap_w_msg "Old value: Leakage air mass flow throttle valve(DSS-based)" SWORD m_q0p1 1 100 -3276.800 3276.700 FORMAT "%8.3" ECU_ADDRESS 0x600395BA /end MEASUREMENT
/begin MEASUREMENT ofmsndkh1_w_msg "Leakage air mass flow throttle valve(HFM-based) in mass flow adaptation window region 1" SWORD m_q0p1 1 100 -3276.800 3276.700 FORMAT "%8.3" ECU_ADDRESS 0x600395B8 /end MEASUREMENT
/begin MEASUREMENT ofmsndkh2_w_msg "Leakage air mass flow throttle valve(HFM-based) in mass flow adaptation window region 2" SWORD m_q0p1 1 100 -3276.800 3276.700 FORMAT "%8.3" ECU_ADDRESS 0x600395B6 /end MEASUREMENT
/begin MEASUREMENT ofmsndkh_w_msg "Leakage air mass flow throttle valve(HFM-based)" SWORD m_q0p1 1 100 -3276.800 3276.700 FORMAT "%8.3" ECU_ADDRESS 0x600395B4 /end MEASUREMENT
/begin MEASUREMENT ofmsndkp1_w_msg "Leakage air mass flow throttle adapted to DSS (in window region 1)" SWORD m_q0p1 1 100 -3276.800 3276.700 FORMAT "%8.3" ECU_ADDRESS 0x600395B2 /end MEASUREMENT
/begin MEASUREMENT ofmsndkp2_w_msg "Leakage air mass flow throttle adapted to DSS (in window region 2)" SWORD m_q0p1 1 100 -3276.800 3276.700 FORMAT "%8.3" ECU_ADDRESS 0x600395B0 /end MEASUREMENT
/begin MEASUREMENT ofmsndkp_w_msg "Leakage air mass flow throttle adapted to DSS" SWORD m_q0p1 1 100 -3276.800 3276.700 FORMAT "%8.3" ECU_ADDRESS 0x600395AE /end MEASUREMENT
/begin MEASUREMENT ofmsndk_w_msg "offset norm air mass flow through throttle blade" SWORD m_q0p1 1 100 -3276.800 3276.700 FORMAT "%8.3" ECU_ADDRESS 0x50000F92 /end MEASUREMENT
/begin MEASUREMENT pabefrg_w "Effective exhaust gas backpressure for model of internal EGR" UWORD p_uw_q0p078 1 100 0.00 5119.922 FORMAT "%8.3" ECU_ADDRESS 0x6000114C /end MEASUREMENT
/begin MEASUREMENT pabnavfe_w_msg "Exhaust gas pressure in manifold (high dynamic)" UWORD p_uw_q0p078 1 100 0.00 5119.922 FORMAT "%8.3" ECU_ADDRESS 0x60000D0A /end MEASUREMENT
/begin MEASUREMENT pabnav_w_msg "Actual exhaust gas pressure downstream of exhaust valve" UWORD p_uw_q0p078 1 100 0.00 5119.922 FORMAT "%8.3" ECU_ADDRESS 0x600015C4 /end MEASUREMENT
/begin MEASUREMENT pbrihoms_w_msg "target partial pressure residual exhaust gas internal egr in hom. mode" UWORD p_uw_q0p039 1 100 0.00 2559.961 FORMAT "%8.3" ECU_ADDRESS 0x60001450 /end MEASUREMENT
/begin MEASUREMENT pbrihsps_w_msg "target partial pressure residual exhaust gas internal egr in HSP mode" UWORD p_uw_q0p039 1 100 0.00 2559.961 FORMAT "%8.3" ECU_ADDRESS 0x6000144E /end MEASUREMENT
/begin MEASUREMENT pbrintmx_w_msg "Partial pressure (inert gas + air) in combustion compart through internal EGR" UWORD p_uw_q0p039 1 100 0.00 2559.961 FORMAT "%8.3" ECU_ADDRESS 0x600015C2 /end MEASUREMENT
/begin MEASUREMENT pbrintro_w "unfilter value for partial pressure residual gas internal EGR" UWORD p_uw_q0p039 1 100 0.00 2559.961 FORMAT "%8.3" ECU_ADDRESS 0x6000114A /end MEASUREMENT
/begin MEASUREMENT pbrints_w_msg "Desired partial pressure (inert gas+air) in combustion compart through int. EGR" UWORD p_uw_q0p039 1 100 0.00 2559.961 FORMAT "%8.3" ECU_ADDRESS 0x50000F98 /end MEASUREMENT
/begin MEASUREMENT pbrinttn_w_msg "min. partial press. (inert gas+air) in the combustion chamber due to tolerances" UWORD p_uw_q0p039 1 100 0.00 2559.961 FORMAT "%8.3" ECU_ADDRESS 0x60000D10 /end MEASUREMENT
/begin MEASUREMENT pbrinttx_w_msg "max. partial press. (inert gas+air) in the combustion chamber due to tolerances" UWORD p_uw_q0p039 1 100 0.00 2559.961 FORMAT "%8.3" ECU_ADDRESS 0x60000D12 /end MEASUREMENT
/begin MEASUREMENT pbrintug_w_msg "Partial pressure (inert gas + air) in combustion compart through internal EGR" UWORD p_uw_q0p039 1 100 0.00 2559.961 FORMAT "%8.3" ECU_ADDRESS 0x600015C0 /end MEASUREMENT
/begin MEASUREMENT pbrintuk_w_msg "Partial press (inert gas + air) in comb. chamber thru inte. EGR, not corrected" UWORD p_uw_q0p039 1 100 0.00 2559.961 FORMAT "%8.3" ECU_ADDRESS 0x600015BE /end MEASUREMENT
/begin MEASUREMENT pbrint_w_msg "Partial pressure (inert gas + air) in combustion compart through internal EGR" UWORD p_uw_q0p039 1 100 0.00 2559.961 FORMAT "%8.3" ECU_ADDRESS 0x60000D0E /end MEASUREMENT
/begin MEASUREMENT pbrivheg_w_msg "target partial pressure residual exhaust gas internal egr in VHE mode" UWORD p_uw_q0p039 1 100 0.00 2559.961 FORMAT "%8.3" ECU_ADDRESS 0x6000144C /end MEASUREMENT
/begin MEASUREMENT pbrivhek_w_msg "target partial pressure residual exhaust gas internal egr in VHE mode small cam" UWORD p_uw_q0p039 1 100 0.00 2559.961 FORMAT "%8.3" ECU_ADDRESS 0x6000144A /end MEASUREMENT
/begin MEASUREMENT PIntkVUs_facNrmPEnv "Ratio: Intake manifold pressure upstream to ambient pressure" UWORD fak_uw_b8 1 100 0.00 7.999878 FORMAT "%8.6" ECU_ADDRESS 0x70003808 /end MEASUREMENT
/begin MEASUREMENT PIntkVUs_flgPMeasdVldTiBasdB1 "Validity measured manifold pressure time based 1. bank" UBYTE B_TRUE 1 100 0.00 1.00000000000 BIT_MASK 0x1 FORMAT "%13.11" ECU_ADDRESS 0x700007B3 /end MEASUREMENT
/begin MEASUREMENT PIntkVUs_flgPVldTiBasd "Validity of manifold pressure (timebased)" UBYTE B_TRUE 1 100 0.00 1.00000000000 BIT_MASK 0x1 FORMAT "%13.11" ECU_ADDRESS 0x700007B0 /end MEASUREMENT
/begin MEASUREMENT PIntkVUs_flgPVldTiBasdB1 "Validity of manifold pressure (timebased) 1. bank" UBYTE B_TRUE 1 100 0.00 1.00000000000 BIT_MASK 0x1 FORMAT "%13.11" ECU_ADDRESS 0x700007AF /end MEASUREMENT
/begin MEASUREMENT PIntkVUs_flgSwtFilPrm "status, if other filterparameter are used in case of change of the intake valve lift" UBYTE B_TRUE 1 100 0.00 1.00000000000 BIT_MASK 0x1 FORMAT "%13.11" ECU_ADDRESS 0x700007AE /end MEASUREMENT
/begin MEASUREMENT PIntkVUs_p "pressure value (best of) of the intake manifold" UWORD p_q0p078 1 100 0.00 5119.922 FORMAT "%8.3" ECU_ADDRESS 0x6000072A /end MEASUREMENT
/begin MEASUREMENT PIntkVUs_pB1 "pressure value (best of) of the intake manifold - bank 1" UWORD p_q0p078 1 100 0.00 5119.922 FORMAT "%8.3" ECU_ADDRESS 0x70003806 /end MEASUREMENT
/begin MEASUREMENT PIntkVUs_pMeasdTiBasdB1 "measured manifold pressure time based 1. bank" UWORD p_q0p078 1 100 0.00 5119.922 FORMAT "%8.3" ECU_ADDRESS 0x60013FA0 /end MEASUREMENT
/begin MEASUREMENT PIntkVUs_pTiBasd "intake manifold pressure (timebased)" UWORD p_q0p078 1 100 0.00 5119.922 FORMAT "%8.3" ECU_ADDRESS 0x60013FA2 /end MEASUREMENT
/begin MEASUREMENT PIntkVUs_pTiBasdB1 "intake manifold pressure (timebased) 1. bank" UWORD p_q0p078 1 100 0.00 5119.922 FORMAT "%8.3" ECU_ADDRESS 0x60013FA4 /end MEASUREMENT
/begin MEASUREMENT pndk_w_msg "pressure downstream throttle valve" UWORD p_q0p078 1 100 0.00 5119.922 FORMAT "%8.3" ECU_ADDRESS 0x60000804 /end MEASUREMENT
/begin MEASUREMENT psdkugdn_w_msg "minimum manifold pressure if ratio pressure = 0.95" UWORD p_uw_q0p078 1 100 0.00 5119.922 FORMAT "%8.3" ECU_ADDRESS 0x60000D14 /end MEASUREMENT
/begin MEASUREMENT psdkugdx_w_msg "maximum manifold pressure if ratio pressure = 0.95" UWORD p_uw_q0p078 1 100 0.00 5119.922 FORMAT "%8.3" ECU_ADDRESS 0x600015B2 /end MEASUREMENT
/begin MEASUREMENT psr1_w_msg "pressure value (best of) of the intake manifold - bank 1" UWORD p_q0p078 1 100 0.00 5119.922 FORMAT "%8.3" ECU_ADDRESS 0x70003772 /end MEASUREMENT
/begin MEASUREMENT psrdkugd_w_msg "Intake manifold pressure at the unthrottled point" UWORD p_uw_q0p078 1 100 0.00 5119.922 FORMAT "%8.3" ECU_ADDRESS 0x600015B0 /end MEASUREMENT
/begin MEASUREMENT psrfg_w_msg "intake manifold fresh air partial pressure" UWORD p_q0p078 1 100 0.00 5119.922 FORMAT "%8.3" ECU_ADDRESS 0x70003770 /end MEASUREMENT
/begin MEASUREMENT psrg1_w_msg "pressure value (sensor) of the intake manifold - bank 1" UWORD p_q0p078 1 100 0.00 5119.922 FORMAT "%8.3" ECU_ADDRESS 0x7000376E /end MEASUREMENT
/begin MEASUREMENT psrgsm_w_msg "sensor value after offset adaption" UWORD p_q0p078 1 100 0.00 5119.922 FORMAT "%8.3" ECU_ADDRESS 0x50000904 /end MEASUREMENT
/begin MEASUREMENT psrg_w_msg "pressure value (sensor) of the intake manifold" UWORD p_q0p078 1 100 0.00 5119.922 FORMAT "%8.3" ECU_ADDRESS 0x60000812 /end MEASUREMENT
/begin MEASUREMENT psrhmmn_w "min manifold pressure for HFM diagnosis" UWORD p_q0p078 1 100 0.00 5119.922 FORMAT "%8.3" ECU_ADDRESS 0x50000798 /end MEASUREMENT
/begin MEASUREMENT psrhmmx_w "max manifold pressure for HFM diagnosis" UWORD p_q0p078 1 100 0.00 5119.922 FORMAT "%8.3" ECU_ADDRESS 0x70003158 /end MEASUREMENT
/begin MEASUREMENT psrmxhsp_w_msg "maximum manifold pressure for operating mode HSP" UWORD p_uw_q0p078 1 100 0.00 5119.922 FORMAT "%8.3" ECU_ADDRESS 0x600015AC /end MEASUREMENT
/begin MEASUREMENT psrmxveg_w_msg "maximum manifold pressure for operating mode valve lift variation big cam" UWORD p_uw_q0p078 1 100 0.00 5119.922 FORMAT "%8.3" ECU_ADDRESS 0x600015AA /end MEASUREMENT
/begin MEASUREMENT psrmxvek_w_msg "maximum manifold pressure for operating mode valve lift variation small cam" UWORD p_uw_q0p078 1 100 0.00 5119.922 FORMAT "%8.3" ECU_ADDRESS 0x600015A8 /end MEASUREMENT
/begin MEASUREMENT psrrf_w_msg "Manifold pressure raw value filtered" UWORD p_q0p078 1 100 0.00 5119.922 FORMAT "%8.3" ECU_ADDRESS 0x5000090E /end MEASUREMENT
/begin MEASUREMENT psrrl_w_msg "manifold pressure for calculation of relative charge" UWORD p_q0p078 1 100 0.00 5119.922 FORMAT "%8.3" ECU_ADDRESS 0x50000910 /end MEASUREMENT
/begin MEASUREMENT psrugd_w_msg "manifold pressure if ratio pressure = PSPVDKUG" UWORD p_uw_q0p078 1 100 0.00 5119.922 FORMAT "%8.3" ECU_ADDRESS 0x60000D18 /end MEASUREMENT
/begin MEASUREMENT psrxs_w_msg "max. desired manifold pressure" UWORD p_uw_q0p078 1 100 0.00 5119.922 FORMAT "%8.3" ECU_ADDRESS 0x6000159E /end MEASUREMENT
/begin MEASUREMENT psr_w_msg "pressure value (best of) of the intake manifold" UWORD p_q0p078 1 100 0.00 5119.922 FORMAT "%8.3" ECU_ADDRESS 0x6000080A /end MEASUREMENT
/begin MEASUREMENT qtitimngdi "quotient ti TIMIN on direct injection path" UBYTE fak_ub_b4 1 100 0.00 3.984 FORMAT "%5.3" ECU_ADDRESS 0x6000E8E7 /end MEASUREMENT
/begin MEASUREMENT qtitimnh_msg "quotient ti / TIMIN (at homogeneous mode - for GDI)" UBYTE fak_ub_b4 1 100 0.00 3.984 FORMAT "%5.3" ECU_ADDRESS 0x6000F2DF /end MEASUREMENT
/begin MEASUREMENT rfges_w_msg "total relative charge (including EGR)" UWORD rel_q0p0234 1 100 0.00 1535.977 FORMAT "%8.3" ECU_ADDRESS 0x50000912 /end MEASUREMENT
/begin MEASUREMENT rfkrbrr_w "relative charge from exhaust manifold to combustion chamber(base value)" UWORD rel_uw_q0p0234 1 100 0.00 1535.977 FORMAT "%8.3" ECU_ADDRESS 0x60001148 /end MEASUREMENT
/begin MEASUREMENT rforgi_w_msg "Relative total charge, without internal residual gas" UWORD rel_q0p0234 1 100 0.00 1535.977 FORMAT "%8.3" ECU_ADDRESS 0x70003764 /end MEASUREMENT
/begin MEASUREMENT rfrihoms_w_msg "rel. charge (residual gas + air) about int. EGR" UWORD rel_uw_q0p0234 1 100 0.00 1535.977 FORMAT "%8.3" ECU_ADDRESS 0x60001442 /end MEASUREMENT
/begin MEASUREMENT rfrihsps_w_msg "rel.charge (residual gas + air) about int.AGR in HSP mode" UWORD rel_uw_q0p0234 1 100 0.00 1535.977 FORMAT "%8.3" ECU_ADDRESS 0x60001440 /end MEASUREMENT
/begin MEASUREMENT rfrimx_w "relative int. EGR charge with complete open throttle" UWORD rel_uw_q0p0234 1 100 0.00 1535.977 FORMAT "%8.3" ECU_ADDRESS 0x60001146 /end MEASUREMENT
/begin MEASUREMENT rfrintros_w "Relative charging (inert gas + air) over internal EGR raw value desired" UWORD rel_uw_q0p0234 1 100 0.00 1535.977 FORMAT "%8.3" ECU_ADDRESS 0x60001144 /end MEASUREMENT
/begin MEASUREMENT rfrintro_w "Relative charging (inert gas + air) over internal EGR raw value" UWORD rel_uw_q0p0234 1 100 0.00 1535.977 FORMAT "%8.3" ECU_ADDRESS 0x60001142 /end MEASUREMENT
/begin MEASUREMENT rfrints_w_msg "rel.desired charge (int.gas +air) about int.AGR" UWORD rel_uw_q0p0234 1 100 0.00 1535.977 FORMAT "%8.3" ECU_ADDRESS 0x6000158E /end MEASUREMENT
/begin MEASUREMENT rfrint_w_msg "Relative charging (inert gas + air) over internal EGR" UWORD rel_uw_q0p0234 1 100 0.00 1535.977 FORMAT "%8.3" ECU_ADDRESS 0x60000D2A /end MEASUREMENT
/begin MEASUREMENT rfriresr_w "Residual portion of the relative charge (inert gas + air) via internal EGR without savenging" UWORD rel_q0p02344 1 100 0.00 1535.977 FORMAT "%8.3" ECU_ADDRESS 0x60001140 /end MEASUREMENT
/begin MEASUREMENT rfrires_w_msg "Residual portion of the relative charge (inert gas + air) via internal EGR" UWORD rel_uw_q0p0234 1 100 0.00 1535.977 FORMAT "%8.3" ECU_ADDRESS 0x6000158C /end MEASUREMENT
/begin MEASUREMENT rfrirsp_w_msg "Re-aspirated portion of the relative charge (inert gas + air) via internal EGR" UWORD rel_uw_q0p0234 1 100 0.00 1535.977 FORMAT "%8.3" ECU_ADDRESS 0x6000158A /end MEASUREMENT
/begin MEASUREMENT rfrirssr_w "Residual portion of the relative charge flowing into intake manifold (inert gas + air) via internal EGR without savenging" UWORD rel_q0p02344 1 100 0.00 1535.977 FORMAT "%8.3" ECU_ADDRESS 0x6000113E /end MEASUREMENT
/begin MEASUREMENT rfriug_w "relative int. EGR charge at point UGD" UWORD rel_uw_q0p0234 1 100 0.00 1535.977 FORMAT "%8.3" ECU_ADDRESS 0x6000113C /end MEASUREMENT
/begin MEASUREMENT rfrivheg_w_msg "rel.charge (residual gas + air) about int.AGR in mode VHE" UWORD rel_uw_q0p0234 1 100 0.00 1535.977 FORMAT "%8.3" ECU_ADDRESS 0x6000143E /end MEASUREMENT
/begin MEASUREMENT rfrivhek_w_msg "rel.charge (residual gas + air) about int.AGR in mode VHE small cam" UWORD rel_uw_q0p0234 1 100 0.00 1535.977 FORMAT "%8.3" ECU_ADDRESS 0x6000143C /end MEASUREMENT
/begin MEASUREMENT ririhoms_w_msg "rel. residual gas charge about int.AGR in mode homogeneous" UWORD rel_uw_q0p0234 1 100 0.00 1535.977 FORMAT "%8.3" ECU_ADDRESS 0x60001438 /end MEASUREMENT
/begin MEASUREMENT ririntp_w_msg "desired relative residual gas about int. EGR pedricted" UWORD rel_uw_q0p0234 1 100 0.00 1535.977 FORMAT "%8.3" ECU_ADDRESS 0x70003762 /end MEASUREMENT
/begin MEASUREMENT rirints_w_msg "desired relative residual gas about int. EGR" UWORD rel_uw_q0p0234 1 100 0.00 1535.977 FORMAT "%8.3" ECU_ADDRESS 0x50000FA6 /end MEASUREMENT
/begin MEASUREMENT rirint_w_msg "Relative inert-gas from internal EGR" UWORD rel_uw_q0p0234 1 100 0.00 1535.977 FORMAT "%8.3" ECU_ADDRESS 0x5000091A /end MEASUREMENT
/begin MEASUREMENT rir_w_msg "relative inert gas charge from int. and ext. EGR" UWORD rel_q0p0234 1 100 0.00 1535.977 FORMAT "%8.3" ECU_ADDRESS 0x6000084C /end MEASUREMENT
/begin MEASUREMENT rklabbr_w "Relative fuel amount for computation of lambda setpoint for burning cylinders" UWORD rel_q0p046875 1 100 0.00 3071.953 FORMAT "%8.3" ECU_ADDRESS 0x60001174 /end MEASUREMENT
/begin MEASUREMENT rksumev_w "Integrated (over 100ms) part of rk_w, which is injected by the Inj. vlaves" UWORD rel_uw_b491520 1 100 0.00 491512.5 FORMAT "%8.1" ECU_ADDRESS 0x6000782C /end MEASUREMENT
/begin MEASUREMENT rksum_w "integrated rk_w" UWORD rel_uw_b491520 1 100 0.00 491512.5 FORMAT "%8.1" ECU_ADDRESS 0x6000782A /end MEASUREMENT
/begin MEASUREMENT rktesu_w "Integrated rkte_w (over 100ms)" SWORD rel_uw_b491520 1 100 -245760.0 245752.5 FORMAT "%8.1" ECU_ADDRESS 0x60007828 /end MEASUREMENT
/begin MEASUREMENT rlabs_w_msg "relative air charge (absolute load value) acc. to ISO 15031-5" UWORD rel_q0p0234 1 100 0.00 1535.977 FORMAT "%8.3" ECU_ADDRESS 0x60001436 /end MEASUREMENT
/begin MEASUREMENT rldpsds_w "Filtered value of the pressure ratio of fresh air partial pressure in intake manifold between two consecutive rasters to the intake manifold integrator factor" SWORD rel_q0p0234 1 100 -768.0000 767.9766 FORMAT "%8.4" ECU_ADDRESS 0x700039DA /end MEASUREMENT
/begin MEASUREMENT rlfgks_w_msg "Corrected rel. desired air charge (air from throttle and EEC)" UWORD rel_uw_q0p0234 1 100 0.00 1535.977 FORMAT "%8.3" ECU_ADDRESS 0x60001574 /end MEASUREMENT
/begin MEASUREMENT rlfg_w_msg "Relative fresh air (air flowing over throttle valve and canister purge valve)" UWORD rel_q0p0234 1 100 0.00 1535.977 FORMAT "%8.3" ECU_ADDRESS 0x50000922 /end MEASUREMENT
/begin MEASUREMENT rllabbr_w "Relative load for computation of lambda setpoint for burning cylinders" UWORD rel_q0p0234 1 100 0.00 1535.977 FORMAT "%8.3" ECU_ADDRESS 0x60001172 /end MEASUREMENT
/begin MEASUREMENT rlmxsoe_w_msg "maximum desired air charge without further reducing interventions" UWORD rel_q0p0234 1 100 0.00 1535.977 FORMAT "%8.3" ECU_ADDRESS 0x60001434 /end MEASUREMENT
/begin MEASUREMENT rlrintp_w_msg "Relative air charging internal EGR predicted" UWORD rel_uw_q0p0234 1 100 0.00 1535.977 FORMAT "%8.3" ECU_ADDRESS 0x70003758 /end MEASUREMENT
/begin MEASUREMENT rlrints_w_msg "desired air charge ratio int. egr" UWORD rel_uw_q0p0234 1 100 0.00 1535.977 FORMAT "%8.3" ECU_ADDRESS 0x50000FAA /end MEASUREMENT
/begin MEASUREMENT rlrint_w_msg "Relative air charging internal EGR" UWORD rel_uw_q0p0234 1 100 0.00 1535.977 FORMAT "%8.3" ECU_ADDRESS 0x60000876 /end MEASUREMENT
/begin MEASUREMENT rlr_w_msg "relative air-load over int. and ext. EGR" UWORD rel_q0p0234 1 100 0.00 1535.977 FORMAT "%8.3" ECU_ADDRESS 0x60000870 /end MEASUREMENT
/begin MEASUREMENT rl_msg "relative air charge" UBYTE rel_q0p75 1 100 0.00 191.3 FORMAT "%5.1" ECU_ADDRESS 0x600009A2 /end MEASUREMENT
/begin MEASUREMENT rl_w_msg "Relative air charge" UWORD rel_q0p0234 1 100 0.00 1535.977 FORMAT "%8.3" ECU_ADDRESS 0x5000091E /end MEASUREMENT
/begin MEASUREMENT rml_msg "relative air mass (calc. load value) acc. to SAE J1979" UBYTE rel_ub_b99p6 1 100 0.00 99.61 FORMAT "%5.2" ECU_ADDRESS 0x60001410 /end MEASUREMENT
/begin MEASUREMENT rri_w_msg "Residue gas/inert gas ratio by internal and external EGR" UWORD rel_uw_b100 1 100 0.00 99.99847 FORMAT "%8.5" ECU_ADDRESS 0x6000087A /end MEASUREMENT
/begin MEASUREMENT SnsrSlowClassB1.ratLamSp "Lambda set point calculation in case of slow lambda sensor, bank 1 / Lambda setpoint" UWORD fak_q0p000244 1 100 0.00 15.99976 FORMAT "%8.5" ECU_ADDRESS 0x60000C6A /end MEASUREMENT
/begin MEASUREMENT SnsrSlowClassB1.SnsrSlowDT_I.buffer "Lambda set point calculation in case of slow lambda sensor, bank 1 / Delay time element for sensor slow down / Time delay" UWORD fak_uw_b1 1 100 0.00 0.9999847 FORMAT "%9.7" ARRAY_SIZE 21 ECU_ADDRESS 0x60000C6C /end MEASUREMENT
/begin MEASUREMENT SnsrSlowClassB1.SnsrSlowDT_I.counter "Lambda set point calculation in case of slow lambda sensor, bank 1 / Delay time element for sensor slow down / Time delay" UWORD fak_uw_b2 1 100 0.00 1.000000 FORMAT "%8.6" ECU_ADDRESS 0x60000C96 /end MEASUREMENT
/begin MEASUREMENT SnsrSlowClassB1.SnsrSlowDT_I.ds "Lambda set point calculation in case of slow lambda sensor, bank 1 / Delay time element for sensor slow down / Time delay" UWORD fak_uw_b2 1 100 0.00 1.000000 FORMAT "%8.6" ECU_ADDRESS 0x60000C98 /end MEASUREMENT
/begin MEASUREMENT SnsrSlowClassB1.SnsrSlowDT_I.pointer "Lambda set point calculation in case of slow lambda sensor, bank 1 / Delay time element for sensor slow down / Time delay" UBYTE dez 1 100 0.00 255.0 FORMAT "%5.1" ECU_ADDRESS 0x60000C9A /end MEASUREMENT
/begin MEASUREMENT SnsrSlowClassB1.SnsrSlowLT_I.memory "Lambda set point calculation in case of slow lambda sensor, bank 1 / Lowpass for sensor slow down / current lowpass value" ULONG fak_q3p72529Em9 1 100 0.00 15.9999999963 FORMAT "%13.10" ECU_ADDRESS 0x60000C9C /end MEASUREMENT
/begin MEASUREMENT timinausggdi_w_msg "minimal injection time GDI(Gasoline Direct Injection) in dual system" UWORD t_q0p001_ms 1 100 0.00 65.53500 FORMAT "%8.5" ECU_ADDRESS 0x60008A60 /end MEASUREMENT
/begin MEASUREMENT timnausg_w_msg "Minimal injection time for the calculation of injection time increase because of fuel volatilisation in oil." UWORD t_q0p001_ms 1 100 0.00 65.53500 FORMAT "%8.5" ECU_ADDRESS 0x60008A5E /end MEASUREMENT
/begin MEASUREMENT tppsrifd_w "variable time constant lowpass-filter for psrif_w" UWORD fak_q3p0518Em5 1 100 0.00 1.999969 FORMAT "%8.6" ECU_ADDRESS 0x60000616 /end MEASUREMENT
/begin MEASUREMENT trfrints_w_msg "Temp. of int. residual gas at intake manif.press. level(desired mode)" UWORD temp_q0p0234_o273 1 100 -273.150 1262.827 FORMAT "%8.3" ECU_ADDRESS 0x60001540 /end MEASUREMENT
/begin MEASUREMENT trfrint_w_msg "Temp. of the internal residue gas at the pressure level of the intake manifold" UWORD temp_q0p0234_o273 1 100 -273.150 1262.827 FORMAT "%8.3" ECU_ADDRESS 0x60001542 /end MEASUREMENT
/begin MEASUREMENT triresp_w "Temp. of the residual gas that has flown into intake manifold at the pressure level of the intake manifold" UWORD temp_q0p0234 1 100 0.00 1535.977 FORMAT "%8.3" ECU_ADDRESS 0x6000113A /end MEASUREMENT
/begin MEASUREMENT triresr_w "Temp. of the internal residue gas at the pressure level of the intake manifold" UWORD temp_q0p0234 1 100 0.00 1535.977 FORMAT "%8.3" ECU_ADDRESS 0x60001138 /end MEASUREMENT
/begin MEASUREMENT trirsp_w_msg "Temp. of re-aspirated portion of the relative charge (inert gas + air) via internal EGR" UWORD temp_q0p0234_o273 1 100 -273.150 1262.827 FORMAT "%8.3" ECU_ADDRESS 0x6000153E /end MEASUREMENT
/begin MEASUREMENT trlrlsdk_w "time constant for time constant rl/rlsol-low-pass filter in suction area" UWORD t_q0p001 1 100 0.00 65.53500 FORMAT "%8.5" ECU_ADDRESS 0x60001118 /end MEASUREMENT
/begin MEASUREMENT trlrlsol_w_msg "time constant for settling period of rl/rlsol" UWORD t_q0p01 1 100 0.0100 655.3500 FORMAT "%8.4" ECU_ADDRESS 0x6000153C /end MEASUREMENT
/begin MEASUREMENT trlrls_w_msg "time constant for settling period of rlrlsol (more precise resolution than trlrlsol_w_msg)" UWORD zk1msxs_uw_b65p536 1 100 0.001000015 65.536000000 FORMAT "%12.9" ECU_ADDRESS 0x700050B8 /end MEASUREMENT
/begin MEASUREMENT tsaugr_w_msg "Time constant intake manifold" UWORD t_q0p01 1 100 0.0200 655.3500 FORMAT "%8.4" ECU_ADDRESS 0x700050BA /end MEASUREMENT
/begin MEASUREMENT tsaug_w_msg "Time constant intake manifold (more precise resolution than tsaugr_w_msg)" UWORD t_q0p001 1 100 0.01000 65.53500 FORMAT "%8.5" ECU_ADDRESS 0x6000153A /end MEASUREMENT
/begin MEASUREMENT ufmsfreg_w "Conversion, charge into mass flow of charge controller" UWORD m_q0p0005 1 100 0.00 32.76750 FORMAT "%8.5" ECU_ADDRESS 0x60001116 /end MEASUREMENT
/begin MEASUREMENT ummsnms1_w "Conversion of standardized mass flow into mass flow at throttle blade, bank1" UWORD fak_q1p22Em4 1 100 0.00 7.999878 FORMAT "%8.6" ECU_ADDRESS 0x70003156 /end MEASUREMENT
/begin MEASUREMENT ummsnmslocadpn_w "local copy for dfuelsan calculation" UWORD fak_uw_b8 1 100 0.00 7.999878 FORMAT "%8.6" ECU_ADDRESS 0x60000618 /end MEASUREMENT
/begin MEASUREMENT ummsnms_w_msg "Conversion of standardized mass flow into mass flow at throttle blade" UWORD fak_uw_b8 1 100 0.00 7.999878 FORMAT "%8.6" ECU_ADDRESS 0x60000890 /end MEASUREMENT
/begin MEASUREMENT umsnms1f_w "Conversion of standardized mass flow into mass flow at throttle blade, bank1 msdpvf_w" UWORD fak_q1p22Em4 1 100 0.00 7.999878 FORMAT "%8.6" ECU_ADDRESS 0x70003154 /end MEASUREMENT
/begin MEASUREMENT umsnms1n_w "Conversion of standardized mass flow into mass flow at throttle blade, bank1 msdkpmn_w" UWORD fak_q1p22Em4 1 100 0.00 7.999878 FORMAT "%8.6" ECU_ADDRESS 0x70003152 /end MEASUREMENT
/begin MEASUREMENT umsnms1x_w "Conversion of standardized mass flow into mass flow at throttle blade, bank1 msdkpmx_w" UWORD fak_q1p22Em4 1 100 0.00 7.999878 FORMAT "%8.6" ECU_ADDRESS 0x50000F6A /end MEASUREMENT
/begin MEASUREMENT umsnms2n_w "Conversion of standardized mass flow into mass flow at throttle blade, bank2 msdkpmn_w" UWORD fak_q1p22Em4 1 100 0.00 7.999878 FORMAT "%8.6" ECU_ADDRESS 0x6000061A /end MEASUREMENT
/begin MEASUREMENT umsnms2x_w "Conversion of standardized mass flow into mass flow at throttle blade, bank2 msdkpmx_w" UWORD fak_q1p22Em4 1 100 0.00 7.999878 FORMAT "%8.6" ECU_ADDRESS 0x6000111C /end MEASUREMENT
/begin MEASUREMENT umsnmsn1_w "Conversion of standardized mass flow into mass flow at throttle blade, bank1 msdkhmn_w" UWORD fak_q1p22Em4 1 100 0.00 7.999878 FORMAT "%8.6" ECU_ADDRESS 0x70003150 /end MEASUREMENT
/begin MEASUREMENT umsnmsx1_w "Conversion of standardized mass flow into mass flow at throttle blade, bank1 msdkhmx_w" UWORD fak_q1p22Em4 1 100 0.00 7.999878 FORMAT "%8.6" ECU_ADDRESS 0x7000314E /end MEASUREMENT
/begin MEASUREMENT umsrlnk_w_msg "umsrln_w_msg limited at low engine speed" UWORD m_q0p0005 1 100 0.00 32.76750 FORMAT "%8.5" ECU_ADDRESS 0x60000D3C /end MEASUREMENT
/begin MEASUREMENT uproml_w "constant for transformation from % into ml" UWORD ASCET_tmp4 1 100 0.00 0.01017237 FORMAT "%10.8" ECU_ADDRESS 0x60007826 /end MEASUREMENT
/begin MEASUREMENT vpexpkap_w "pressure ratio for adressing of curve ""exponent kappa""" UWORD fak_uw_b4 1 100 0.00 3.999939 FORMAT "%8.6" ECU_ADDRESS 0x60001136 /end MEASUREMENT
/begin MEASUREMENT vpsab_w "Pressure ratio of manifold pressure and exhaust gas backpressure for effective exhaust gas backpressure for charge models" UWORD fak_uw_b4 1 100 0.00 3.999939 FORMAT "%8.6" ECU_ADDRESS 0x60001134 /end MEASUREMENT
/begin MEASUREMENT vpsrabg_w "pressure ratio manifold pressure to exhaust gas back pressure" UWORD fak_uw_b2 1 100 0.00 1.999969 FORMAT "%8.6" ECU_ADDRESS 0x60001132 /end MEASUREMENT
/begin MEASUREMENT vpsrpuakt_w "pressure ratio psr to pu" UWORD fak_uw_b4 1 100 0.00 3.999939 FORMAT "%8.6" ECU_ADDRESS 0x60001130 /end MEASUREMENT
/begin MEASUREMENT vpsrvdb_w_msg "quotient: int.manif.press.divided by press.upstream of throttle valve limit" UWORD fak_uw_b2 1 100 0.00 1.999969 FORMAT "%8.6" ECU_ADDRESS 0x5000093E /end MEASUREMENT
/begin MEASUREMENT vpsrvdk_w_msg "quotient: intake manifold pressure divided by pressure upstream throttle" UWORD fak_uw_b2 1 100 0.00 1.999969 FORMAT "%8.6" ECU_ADDRESS 0x6000089E /end MEASUREMENT
/begin MEASUREMENT vpsrvd_w_msg "quotient manifold pressure/pressure before throttle plate" UWORD fak_uw_b2 1 100 0.00 1.999969 FORMAT "%8.6" ECU_ADDRESS 0x60001534 /end MEASUREMENT
/begin MEASUREMENT vvexpkap_w "volume ratio for adressing of curve ""exponent kappa""" UWORD fak_uw_b4 1 100 0.00 3.999939 FORMAT "%8.6" ECU_ADDRESS 0x6000112E /end MEASUREMENT
/begin MEASUREMENT wdkmsmx_w_msg "throttle balde angle for maximum air mass flow" UWORD rel_uw_b100 1 100 0.00 99.99847 FORMAT "%8.5" ECU_ADDRESS 0x60001528 /end MEASUREMENT
/begin MEASUREMENT wdkm_w "throttle angle with respect to lower mechanical stop (mean value 1 seg.)" UWORD rel_uw_b100 1 100 0.00 99.99847 FORMAT "%8.5" ECU_ADDRESS 0x6000061C /end MEASUREMENT
/begin MEASUREMENT wdktn_w "Throttle valve angle for minimum mass flow through throttle valve due to tolerances" UWORD rel_uw_b100 1 100 0.00 99.99847 FORMAT "%8.5" ECU_ADDRESS 0x6000061E /end MEASUREMENT
/begin MEASUREMENT wdktx_w "Throttle valve angle for maximum mass flow through throttle valve due to tolerances" UWORD rel_uw_b100 1 100 0.00 99.99847 FORMAT "%8.5" ECU_ADDRESS 0x500007B6 /end MEASUREMENT
/begin MEASUREMENT wgvokmne_w_msg "min. angle gas change valve opens intake for VHE small cam profile" SWORD kw_q0p0156 1 100 -512.0000 511.9844 FORMAT "%8.4" ECU_ADDRESS 0x600014B4 /end MEASUREMENT
/begin MEASUREMENT wgvokmxe_w_msg "max. angle gas change valve opens intake for VHE small cam profile" SWORD kw_q0p0156 1 100 -512.0000 511.9844 FORMAT "%8.4" ECU_ADDRESS 0x600014B2 /end MEASUREMENT
/begin MEASUREMENT wgvomne_w_msg "min. angle gas change valve opens intake" SWORD kw_q0p0156 1 100 -512.0000 511.9844 FORMAT "%8.4" ECU_ADDRESS 0x600014B0 /end MEASUREMENT
/begin MEASUREMENT wgvomxe_w_msg "max. angle gas change valve opens intake" SWORD kw_q0p0156 1 100 -512.0000 511.9844 FORMAT "%8.4" ECU_ADDRESS 0x600014AE /end MEASUREMENT
/begin MEASUREMENT wgvskmne_w_msg "min. angle gas change valve closes intake for VHE small cam profile" SWORD kw_q0p0156 1 100 -512.0000 511.9844 FORMAT "%8.4" ECU_ADDRESS 0x600014AC /end MEASUREMENT
/begin MEASUREMENT wgvskmxe_w_msg "max. angle gas change valve closes intake for VHE small cam profile" SWORD kw_q0p0156 1 100 -512.0000 511.9844 FORMAT "%8.4" ECU_ADDRESS 0x600014AA /end MEASUREMENT
/begin MEASUREMENT wgvsmne_w_msg "min. angle gas change valve closes intake" SWORD kw_q0p0156 1 100 -512.0000 511.9844 FORMAT "%8.4" ECU_ADDRESS 0x600014A8 /end MEASUREMENT
/begin MEASUREMENT wgvsmxe_w_msg "max. angle gas change valve closes intake" SWORD kw_q0p0156 1 100 -512.0000 511.9844 FORMAT "%8.4" ECU_ADDRESS 0x600014A6 /end MEASUREMENT
/begin MEASUREMENT wgvums_w "Av.value: overlap angle GWV f. re-aspir. residual gas(SCH-mode)" SWORD kw_q0p0156 1 100 -512.0000 511.9844 FORMAT "%8.4" ECU_ADDRESS 0x6000112C /end MEASUREMENT
/begin MEASUREMENT wgvum_w_msg "Center value overlap angle gas change valve for re-aspirated residue gas" SWORD kw_q0p0156 1 100 -512.0000 511.9844 FORMAT "%8.4" ECU_ADDRESS 0x60001624 /end MEASUREMENT
/begin FUNCTION BGFKMS "38.1.0    Calculated value correction factor air mass flow"
 /begin DEF_CHARACTERISTIC ChrCtl_tiMFlowAdpnConNeutVal_C ChrCtl_tiMFlowAdpnFastEngStop_C ChrCtl_tiMFlowAdpnFastNeutVal_C ChrCtl_tiMFlowAdpnFast_C ChrCtl_tiMFlowAdpnFast_T ChrCtl_tiMFlowAdpnSlowEol_C ChrCtl_tiMFlowAdpnSlow_T ChrCtl_tiMFlowFacFastAdjmtRst_C ChrCtl_tiMFlowLeakFltMaiLoadSnsr_C ChrCtl_tiThrVlvMFlowLeakAdpnEol_C ChrCtl_tiThrVlvMFlowLeakAdpnLeak_C ChrCtl_tiThrVlvMFlowLeakAdpnLrgDe_C ChrCtl_tiThrVlvMFlowLeakAdpn_C CWBGFKMS DFAFKPVDKE DFAOMSNDE DFEADKE DFHYSAOMSNDE DFKMSDKSMA DFKMSDSTZ DOFMSNDMSLL DTAFKPVDKE DTAOMSNDKE FKMSDKMN FKMSDKMX FKPVDKMN FKPVDKMSMN FKPVDKMX FKPVDKPMN FKPVDKPUGD KLVPSPVDMNFASA MTOLMSTE NMOTFADKMN NMOTFADKMX NMOTOFDKMN NMOTOFDKMN2 NMOTOFDKMX NMOTOFDKMX2 OFMSNDKINI OFMSNDKINI2 OFMSNDKMN OFMSNDKMN2 OFMSNDKMX OFMSNDKMX2 OFMSNDMSMN OFMSNDMSMN2 OFMSNDMSMX OFMSNDMSMX2 OFMSNDMSMX3 RRSEXTSABG TAFKPVDKE TAOFMSNDKE TDABGLST TDDTEVFGAB TDFGABOAGR TDFKMSDKMA TDSAFGABGL TDSAOFMNDP TDSDAGRSS TDWDKSUGD VPSPVDMNFA /end DEF_CHARACTERISTIC
 /begin IN_MEASUREMENT B_agron_msg B_agrsg_msg B_bkvmsisr_msg B_cdehfm_msg B_dagrss_msg B_dsshfs_msg B_dteaam_msg B_dtest_msg B_fafkmsla_msg B_falzsr_msg B_fedssb_msg B_fgdkabgs_msg B_hfmhfs_msg B_hos_msg B_ll_msg B_msddkg_msg B_msdkhfmg_msg B_psrgg_msg B_psrmozdg_msg B_rqttev_msg B_sa_msg B_stopeng_msg CoEOM_bSPC CoEOM_flgStrat dmsdkugd_w_msg dmsnte_w_msg Eep_EnvRamHist Eep_EnvRamInvld Epm_nEng msdkds_w_msg msdkhfm_w_msg msdk_w_msg msndkoo_w_msg msndks_w_msg mste_msg psr_w_msg pvd_w_msg rrsext_w_msg SyC_stSub ThrVlv_flgSngSensErrSuspcB1 tnst_w_msg ummsnms_w_msg /end IN_MEASUREMENT
 /begin OUT_MEASUREMENT B_adkhe_msg B_adkose_msg B_adkoshe_msg B_adkospe_msg B_adkpe_msg B_afkpvdhe_msg B_afkpvdke_msg B_afkpvdpe_msg B_agrinsr_msg B_ahfsnfsa_msg B_amsndkoe_msg B_aomsndhe_msg B_aomsndpe_msg B_dschlldk_msg B_fadkoap_msg B_fgabgla_msg B_fgabglp_msg B_fgabgl_msg B_fgsabglp_msg B_fkpvdkp_msg B_fkpvdk_msg B_fsabpagr_msg B_iniabga_msg B_inilabgp_msg B_ofmsndkh1_msg B_ofmsndkh2_msg B_ofmsndkh_msg B_ofmsndkp1_msg B_ofmsndkp2_msg B_ofmsndkp_msg B_ofmsndk_msg B_zwfdkah_msg B_zwfdkap_msg B_zwfdka_msg dfuelsan_w_msg dkpsrmh_w_msg fkmsdkh_w_msg fkmsdkp_w_msg fkmsdksp_w_msg fkmsdks_w_msg fkmsdk_w_msg fkpvdkp_w_msg fkpvdk_w_msg ofmsndap_w_msg ofmsndkh1_w_msg ofmsndkh2_w_msg ofmsndkh_w_msg ofmsndkp1_w_msg ofmsndkp2_w_msg ofmsndkp_w_msg ofmsndk_w_msg vpsrvd_w_msg /end OUT_MEASUREMENT
 /begin LOC_MEASUREMENT B_afkpvdei B_fabgagr B_fgabglh B_fgsabhm B_fkpvdkh B_inisabgh B_inisabgp B_ofmsndhb B_ofmsndhb1 B_ofmsndhb2 B_ofmsndkh B_vpspvd ChrCtl_flgRstDsmAdpnEtc100ms ChrCtl_flgRstDsmAdpnEtc10ms ChrCtl_flgRstDsmAdpnEtcGen ChrCtl_flgRstDsmAdpnEtcMAF ChrCtl_flgRstDsmAdpnEtcMAP ChrCtl_stInactvCpvAts ChrCtl_tiMFlowAdpnFastAfsBasd ChrCtl_tiMFlowAdpnFastBasdIntkMnfldSnsr ChrCtl_tiThrVlvMFlowLeakAdpnMAF ChrCtl_tiThrVlvMFlowLeakAdpnMAP dfkmsdsh_w dfkmsdsp_w dfmsdsp_w dfuelanh_w dfuelanp_w dofmsndmsll_w fkmsdksh_w fkpvdkah_w fkpvdkap_w fkpvdkh_w klvpspv_w msdkahpg_w msdkaphg_w msdkdslocadpn_w msdkhfmlocadpn_w msdklocadpn_w msdkoolocadpn_w ofmsdap_w ofmsdkh_w ofmsdkp_w ofmsndah1_w ofmsndah2_w ofmsndap1_w ofmsndap2_w ummsnmslocadpn_w /end LOC_MEASUREMENT
 FUNCTION_VERSION "38.1.0" /end FUNCTION
/begin FUNCTION BGKV "18.19.0   Calculation variable consumed fuel"
 /begin DEF_CHARACTERISTIC CWBGKV InjSys_facCorFuCons_M InjSys_facCorrnDensFuCns_T InjSys_facCorrnFuT_T InjSys_facFuCorrnEthnlCns_M KLMCO2L /end DEF_CHARACTERISTIC
 /begin IN_MEASUREMENT B_evzaush_msg EngStrt_mFuOil_msg EpmSeq_numInt Epm_nEng Epm_numCyl fethstoe_msg FfPrm_facEth ffudens_msg InjSys_facCnvnRatFuM InjSys_ratFuM InjSys_rhoFuStd rkme_w_msg rkte_w_msg SyC_stSub tfuelhpsq_msg /end IN_MEASUREMENT
 /begin OUT_MEASUREMENT InjSys_dmCo2 InjSys_dvolFu InjSys_dvolFuInjr InjSys_dvolFumL InjSys_mCo2PerLFu InjSys_mfEngFuRate InjSys_mfFuMCmbToOilDelta InjSys_mfVehFuRate InjSys_volEngFuCnsPerHr InjSys_volFuConsDrvCyc InjSys_volFuConsDrvCycCAN InjSys_volFuConsDrvgCycTstrSrv /end OUT_MEASUREMENT
 /begin LOC_MEASUREMENT cycbgkv_w InjSys_dvolFuPerHr InjSys_facCorrnFuT InjSys_mFuMIntgl InjSys_mFuMIT InjSys_mFuMPID5E InjSys_mFuMPID9D InjSys_mFuMSumPID5E InjSys_mFuMSumPID9D InjSys_mFuOilDiff InjSys_mFuOilOld InjSys_ratFuMIT InjSys_ratFuMPID5E InjSys_ratFuMPID9D InjSys_tFuSnsr InjSys_tiSynPerCyc InjSys_volEngFuCnsPerSec rksumev_w rksum_w rktesu_w uproml_w /end LOC_MEASUREMENT
 FUNCTION_VERSION "18.19.0" /end FUNCTION
/begin FUNCTION BGLASO "1.34.0    Calculation of desired lambda for lambda sensor"
 /begin DEF_CHARACTERISTIC CWBGLASO FRIRLABBR LamCtrl_flgFixdIninAftSpst_C LamCtrl_ratLamIninAftSpst_C LASTCMN LASTCMX VSONTL /end DEF_CHARACTERISTIC
 /begin IN_MEASUREMENT B_rkapp_msg B_stendes_msg B_stopz_msg CoEOM_bHOM dlaso_msg EGSDO2_tiDlyAdpnS1B1 EGSDO2_tiTranAdpnS1B1 EngStrt_bStrtEnd Epm_nEng ExhMod_mfExhB1 ExhMod_mfExhMnfB1 ExhMod_pExhCat1UsB1 ExhMod_tExhCat1UsB1 ExhMod_tExhMnfB1 InjSys_ratFuM InjSys_ratPrdcAirLamDes lamsbg_w_msg pabnav_w_msg redistb1_msg rir_w_msg SyC_stSub tlrslb_w_msg UEGO_rLamS1B1 zlrsb_w_msg /end IN_MEASUREMENT
 /begin OUT_MEASUREMENT B_lasostc_msg labbrm_w_msg labrgs_w_msg LamCtrl_ratLamSpNoDynS1B1 LamCtrl_ratLamSpS1B1 LamCtrl_tiDeadTiCorrdHomStratBnk1 LamCtrl_tiDeadTiSnsrToDsChrgrBnk1 lamsbrs_w_msg lamsobd_w_msg lamsons_w_msg laontlm_w_msg laonvkm_w_msg lassa_w_msg /end OUT_MEASUREMENT
 /begin LOC_MEASUREMENT B_totab evabkor_w LamCtrl_flgIninSpB1 rklabbr_w rllabbr_w SnsrSlowClassB1.ratLamSp SnsrSlowClassB1.SnsrSlowDT_I.buffer SnsrSlowClassB1.SnsrSlowDT_I.counter SnsrSlowClassB1.SnsrSlowDT_I.ds SnsrSlowClassB1.SnsrSlowDT_I.pointer SnsrSlowClassB1.SnsrSlowLT_I.memory /end LOC_MEASUREMENT
 FUNCTION_VERSION "1.34.0" /end FUNCTION
/begin FUNCTION BGLWM "37.0.0_2.0.0Calculation for charge exchange model"
 /begin DEF_CHARACTERISTIC AirMod_facDia_T AirMod_facFcoCorrnRampIn_C AirMod_facFcoCorrnRampOut_C AirMod_FacFilDmCyl2ExhMnfld_T AirMod_flgEnblRefPos_C AirMod_pExhDeltaDia_M AirMod_pOffsCorrnFcoLoLft_M AirMod_pOffsCorrnFco_M AirMod_stChrCorrGslSp_C AirMod_tiResetFkorCalc_C CWBGLWM CWBGLWM2 CWBGLWMNWK2A CWBGLWMNWK2E CWBGLWMNWK3 CWBGLWMNWK4 CWPABEF CWPBRKBG CWPIRGKL1 DFPBRK DFPBRKREF DNWREFABGLWM DNWREFEBGLWM DPABEFO DPABEFU DPBRINTTN DPBRINTTX DWGVLIMFE EXP1DKAPPA EXPKAPPA EXPTERMKAP FAFRSPVP FFUPSRLTN FFUPSRLTX FIMXFADK FIMXVP FIMXVPVHE FKDTRFRINT FKDTRFRINT2 FTMSDV FUPSRLMN FUPSRLMX FVBR KFDIPABERGVP KFDIPABERGVP1 KFDPBRMXWE KFDPBRMXWE1 KFDPBRMXWU1 KFDPBRWE KFDPBRWE1 KFDTRFRINT KFFPBRKSVN KFFPBRKSVN1 KFIPABERG KLFPBRGRVIVC KLFPBRGRVIVCVHE KLGRFVBRWVHE MSNRIRSP PBRINTMN PBRINTMX /end DEF_CHARACTERISTIC
 /begin REF_CHARACTERISTIC KLFEXPSL GEVCtl_agMaxIntk_C GEVCtl_agMinIntk_C GEVCtl_agOffsVlvOpenIntk_C GEVCtl_agOffsVlvOpenSpclLftIntk_C GEVCtl_agWidthCamProfIntk_C GEVCtl_agWidthCamProfSpclLftIntk_C GEVCtl_stPhaAdpr_C /end REF_CHARACTERISTIC
 /begin IN_MEASUREMENT B_wgvsvheg_msg CEngDsT_t Epm_nEng Epm_nEng10ms ExhMod_pExhCat1UsB1 ExhMod_tExhMnfB1 ExhMod_tExhMnfQstyB1 FfPrm_facEth fkfupsrl_w_msg ftahev_w_msg GEVCtl_agIntkClsd GEVCtl_agIntkOpen GEVCtl_agOutlClsd GEVCtl_agRefPosnIntkB1 GEVCtl_agRefPosnOutlB1 GEVCtl_agSpHomHiLftIntk GEVCtl_agSpHomHiLftOutl GEVCtl_agSpHomLoLftIntk GEVCtl_agSpHomLoLftOutl GEVCtl_agSpIntkB1 GEVCtl_agSpIntkClsd GEVCtl_agSpIntkOpen GEVCtl_agSpOutlB1 GEVCtl_agSpOutlClsd GEVCtl_flgActAgStdLftIntk GEVCtl_flgSpIdleIntk GEVCtl_flgSpIdleOutl GEVCtl_stGslSpIntk GEVCtl_stGslSpOutl GEVlv_agIntkB1 GEVlv_agOutlB1 Ign_iacalc_s8 Ign_iaPr_s8 IntkAirT_tIntkMnfld ofpbrint_w_msg pabnavfe_w_msg PEnv_p psrdkugd_w_msg psrhoms_w_msg psrmxhsp_w_msg psrmxveg_w_msg psrmxvek_w_msg psr_w_msg PthSet_bOvrRun pvd_w_msg quotntke_w_msg SyC_stSub taev_w_msg tahev_w_msg ThrVlv_bDblSensErrSuspcDeb_msg ThrVlv_ratActPosnB1 ThrVlv_ratLimpAirPosnB1 toch_msg umsrln_w_msg vpsrvdk_w_msg wdks_w_msg wdkugd_w_msg wgvohsme_w_msg wgvovgesme_w_msg wgvovkesme_w_msg wgvshsma_w_msg wgvshsme_w_msg wgvsvgesma_w_msg wgvsvgesme_w_msg wgvsvkesma_w_msg wgvsvkesme_w_msg /end IN_MEASUREMENT
 /begin OUT_MEASUREMENT B_fupivheg_msg fkor_w_msg fpbrps_w_msg fpbrsrs_w_msg fupshoms_w_msg fupshsps_w_msg fupsrlmx_w_msg fupsrls_w_msg fupsrltn_w_msg fupsrltx_w_msg fupsrlug_w_msg fupsrl_w_msg fupsvheg_w_msg fupsvhek_w_msg pbrihoms_w_msg pbrihsps_w_msg pbrintmx_w_msg pbrints_w_msg pbrinttn_w_msg pbrinttx_w_msg pbrintug_w_msg pbrintuk_w_msg pbrint_w_msg pbrivheg_w_msg pbrivhek_w_msg rfrihoms_w_msg rfrihsps_w_msg rfrints_w_msg rfrint_w_msg rfrires_w_msg rfrirsp_w_msg rfrivheg_w_msg rfrivhek_w_msg ririhoms_w_msg ririntp_w_msg rirints_w_msg rirint_w_msg rlrintp_w_msg rlrints_w_msg rlrint_w_msg trfrints_w_msg trfrint_w_msg trirsp_w_msg wgvokmne_w_msg wgvokmxe_w_msg wgvomne_w_msg wgvomxe_w_msg wgvskmne_w_msg wgvskmxe_w_msg wgvsmne_w_msg wgvsmxe_w_msg wgvum_w_msg /end OUT_MEASUREMENT
 /begin LOC_MEASUREMENT AirMod_dia AirMod_facDia AirMod_facFcoCorrnRamp AirMod_flgRstFkorCalc AirMod_flgRstFkorCalcAftDly AirMod_flgRstFkorCalcHomBg AirMod_flgRstFkorCalcVhegBg AirMod_flgRstFkorCalcVhekBg AirMod_pOffsCorrnFco AirMod_pOffsCorrnFcoDes AirMod_ratInertGasCylCorrnFco AirMod_ratInertGasCylCorrnFcoDes dpbreops_w fkl1_w fkl2_w fkorbgvheg_w fkorbgvhek_w fpbrpsg_w fpbrpsmx_w fpbrpsug_w fupsrlro_w grfvbr_w labbris_w msrirsp_w nmotsw_w nmottkor_w pabefrg_w pbrintro_w rfkrbrr_w rfrimx_w rfrintros_w rfrintro_w rfriresr_w rfrirssr_w rfriug_w triresp_w triresr_w vpexpkap_w vpsab_w vpsrabg_w vpsrpuakt_w vvexpkap_w wgvums_w /end LOC_MEASUREMENT
 FUNCTION_VERSION "37.0.0_2.0.0" /end FUNCTION
/begin FUNCTION BGMSDK "18.8.1    Calculation: mass flow through throttle valve"
 /begin DEF_CHARACTERISTIC ChrCtl_facMfUGD_C ChrCtl_facSuctnRefLoLft_T ChrCtl_facSuctnRef_T ChrCtl_mfAfsMax_C ChrCtl_pDifOpenThrRefLoLft_T ChrCtl_pDifOpenThrRef_T CWBGMSDK DANZSYN DWDKMXWDK FIUWMSDKVHEKXN FIUWMSDKXN FKVDVP FMSNDKTN FMSNDKTX FMSPULSMN FMSPULSMX KFMSNWDKVP KMSDK OFMSNDKTN OFMSNDKTX TUGDTX VPSRMHVDUG VPSRVDUGD /end DEF_CHARACTERISTIC
 /begin REF_CHARACTERISTIC DPTPSRMX /end REF_CHARACTERISTIC
 /begin IN_MEASUREMENT B_msdkhfmg_msg B_psrgg_msg B_psrmozdg_msg B_psrmozpnxg_msg B_pvdg_msg B_rlp_msg B_syn2fe_msg B_tavdkg_msg B_vheg_msg dkpsrmh_w_msg Epm_nEng Epm_stSpd fkmsdks_w_msg fkmsdk_w_msg fpvd_w_msg ftavdkmn_w_msg ftavdkmx_w_msg ftvdk_w_msg fupsrl_w_msg msdkmxtx_w_msg msdkmx_w_msg msdkugd_w_msg msdkugpn_w_msg msdkugtn_w_msg ofmsndk_w_msg pbrint_w_msg psrgsm_w_msg psrg_w_msg psrmhmi_w_msg psrmh_w_msg psrmmn_w_msg psrmmx_w_msg psrmp_w_msg pvdmn_w_msg pvdmx_w_msg pvd_w_msg SyC_stSub ThrVlv_flgReqFuCutOffB1 ThrVlv_flgSngSensErrSuspcB1 ThrVlv_ratActPosnB1 ThrVlv_ratActPosnMaxB1 ThrVlv_ratActPosnMinB1 ThrVlv_ratLimpAirPosnB1 wdkbap_w_msg wdkugd_w_msg wdkugtx_w_msg /end IN_MEASUREMENT
 /begin OUT_MEASUREMENT B_2synpmX_msg B_dugdtx_msg B_msddkg_msg B_msdkhnxg_msg B_msdkpnxg_msg B_msdpg_msg B_ugdtx_msg B_ugd_msg B_vpdkugd_msg ChrCtl_flgChrgCalcnTiBasd dmsdkugd_w_msg fiuewdk_w_msg fklafa_w_msg ftpavdn_w_msg ftpavdx_w_msg ftpavd_w_msg ftpvd_w_msg msdkhmn_w_msg msdkhmx_w_msg msdkosa_w_msg msdkpmn_w_msg msdkpmx_w_msg msdk_w_msg msdp_w_msg msndkoo_w_msg msndk_w_msg ummsnms_w_msg vpsrvdb_w_msg vpsrvdk_w_msg wdkmsmx_w_msg /end OUT_MEASUREMENT
 /begin LOC_MEASUREMENT B_dugdhtx B_pugd B_pugdp B_wugdp ChrCtl_facPCorrnOpenThr ChrCtl_facSuctnCorrnOpenThr ChrCtl_nEngCorrd dmsdkugp_w kmsdk_w msdhmn_w msdkoue_w msdouep_w msdpmn_w msdpvf_w msdue_w msdvf_w psrhmmn_w psrhmmx_w ummsnms1_w umsnms1f_w umsnms1n_w umsnms1x_w umsnms2n_w umsnms2x_w umsnmsn1_w umsnmsx1_w wdkm_w wdktn_w wdktx_w /end LOC_MEASUREMENT
 FUNCTION_VERSION "18.8.1" /end FUNCTION
/begin FUNCTION BGMSDKS "51.2.0    Calculation of set air mass flow through throttling valve"
 /begin DEF_CHARACTERISTIC ChrCtl_facCorrnChrgTn_T ChrCtl_nEngMinLoadMfCorrn_C ChrCtl_ratChrgMinOffs_C ChrCtl_tiCnvMfRatChrg_M ChrCtl_tiFcoEndDlyd_C CWBGMSDKS DRLFRMNTST DRLFRMXTST FMSPULSDKMN KFDRLFRMN KFDRLFRMNE KFDRLFRMX KFDRLFRMXE KFTEIRLRLSN KFTEIRLRLSZN KLIDRLETH NRLMN TRLRLSDKMN /end DEF_CHARACTERISTIC
 /begin REF_CHARACTERISTIC KUMSIRL MSNTEVO /end REF_CHARACTERISTIC
 /begin IN_MEASUREMENT B_sa_msg CEngDsT_t EngStrt_bStrtEnd Epm_dnEngFlt Epm_nEng Epm_nEng10ms FfPrm_facEth fupsrl_w_msg IntkAirT_tIntkMnfld msagrtn_w_msg msagrtx_w_msg msbkvsr_w_msg mste_msg rfzumxtx_w_msg rfzuugpn_w_msg rfzuugtn_w_msg rfzuugtx_w_msg rldkmx_w_msg rldkugd_w_msg rlfgs_w_msg rlrints_w_msg rlrint_w_msg rlsol_w_msg rl_w_msg SyC_stSub tnst_w_msg umsrln_w_msg vsaugr_w_msg /end IN_MEASUREMENT
 /begin OUT_MEASUREMENT drlm_w_msg msdkmxtx_w_msg msdkmx_w_msg msdks_w_msg msdkugd_w_msg msdkugpn_w_msg msdkugtn_w_msg msdkugtx_w_msg msdstats_w_msg rlfgks_w_msg trlrlsol_w_msg trlrls_w_msg tsaugr_w_msg tsaug_w_msg umsrlnk_w_msg /end OUT_MEASUREMENT
 /begin LOC_MEASUREMENT Chrctl_stAirChrgCtrlr dmsfue_w msdksoir_w trlrlsdk_w ufmsfreg_w /end LOC_MEASUREMENT
 FUNCTION_VERSION "51.2.0" /end FUNCTION
/begin FUNCTION BGMSDSS "12.1.0    calculation of air mass flow from intake manifold pressure sensor (DS-S signal)"
 /begin IN_MEASUREMENT B_psrgg_msg B_psrmozdg_msg ChrCtl_flgChrgCalcnTiBasd dpsrfgmp_w_msg fisrm_w_msg msbkvsr_w_msg mste_msg rlfgdssm_w_msg SyC_stSub umsrln_w_msg /end IN_MEASUREMENT
 /begin OUT_MEASUREMENT B_msdkdsg_msg msdkds_w_msg /end OUT_MEASUREMENT
 /begin LOC_MEASUREMENT rldpsds_w /end LOC_MEASUREMENT
 FUNCTION_VERSION "12.1.0" /end FUNCTION
/begin FUNCTION BGMSHMDK "2.4.0     calculation of air mass at MAF sensor based on throttle blade or MAP sensor" /begin DEF_CHARACTERISTIC CWBGMSHMDK /end DEF_CHARACTERISTIC
 /begin IN_MEASUREMENT B_msddkg_msg B_msdkdsg_msg B_msdkhnxg_msg ChrCtl_flgChrgCalcnTiBasd msdkds_w_msg msdkhmn_w_msg msdkhmx_w_msg msdk_w_msg SyC_stSub /end IN_MEASUREMENT
 /begin OUT_MEASUREMENT B_mshfmdkg_msg B_mshfmdsg_msg B_mshmdnxg_msg mshfmdk_w_msg mshfmds_w_msg mshfmmod_w_msg mshmdkmn_w_msg mshmdkmx_w_msg /end OUT_MEASUREMENT
 FUNCTION_VERSION "2.4.0" /end FUNCTION
/begin FUNCTION BGPABNAV "8.6.1     Calculation of pressure downstream exhaust valve" /begin DEF_CHARACTERISTIC CWPABNAV /end DEF_CHARACTERISTIC /begin IN_MEASUREMENT ExhMod_pEnvAppl ExhMod_pExhCat1UsB1 SyC_stSub /end IN_MEASUREMENT /begin OUT_MEASUREMENT fpabnav_w_msg pabnavfe_w_msg pabnav_w_msg /end OUT_MEASUREMENT FUNCTION_VERSION "8.6.1" /end FUNCTION
/begin FUNCTION BGPNDK "3.7.0     Output pressure downstream throttle valve" /begin DEF_CHARACTERISTIC NPNDKGMN /end DEF_CHARACTERISTIC /begin IN_MEASUREMENT B_psrg_msg Epm_nEng Epm_stSync psr_w_msg /end IN_MEASUREMENT /begin OUT_MEASUREMENT B_pndkg_msg fpndk_w_msg pndk_w_msg /end OUT_MEASUREMENT FUNCTION_VERSION "3.7.0" /end FUNCTION
/begin FUNCTION BGPSMAX "14.1.0    Calculated value for manifold pressure unthrottled und maximal" /begin DEF_CHARACTERISTIC MXVVVEKN /end DEF_CHARACTERISTIC /begin REF_CHARACTERISTIC VPSRVDUGD /end REF_CHARACTERISTIC
 /begin IN_MEASUREMENT BrkBst_pMaxIntkMnfldHiRng B_hspfes_msg B_wdkuehsp_msg Epm_nEng PEnv_p psagrugb_w_msg pvdmn_w_msg pvdmx_w_msg pvd_w_msg SyC_stSub /end IN_MEASUREMENT
 /begin OUT_MEASUREMENT psdkugdn_w_msg psdkugdx_w_msg psrdkugd_w_msg psrmxhsp_w_msg psrmxveg_w_msg psrmxvek_w_msg psrugd_w_msg psrxs_w_msg /end OUT_MEASUREMENT
 FUNCTION_VERSION "14.1.0" /end FUNCTION
/begin FUNCTION BGPSR "7.10.0    Calculated value manifold pressure"
 /begin DEF_CHARACTERISTIC KLREDOSP KLTPPSRIFD KLTPPSRIFH NPSRSEG NPULSMN PIntkVUs_tiSwtFilPrm_C SAPSRR /end DEF_CHARACTERISTIC
 /begin REF_CHARACTERISTIC PIntkVUs_stCfg_C /end REF_CHARACTERISTIC
 /begin IN_MEASUREMENT B_psrmhg_msg B_psrmw_msg B_psrpl_msg Epm_nEng Epm_stSync GEVCtl_flgStdLftSyncIntk ofpsr_w_msg PEnv_p PIntkVUs_flgPRawVldTiBasdB1 PIntkVUs_pRaw PIntkVUs_pRawTiBasdB1 PIntkVUs_stSRCVld psrmh_w_msg psrrldc_w_msg /end IN_MEASUREMENT
 /begin OUT_MEASUREMENT B_psrg1_msg B_psrgg1_msg B_psrgg_msg B_psrg_msg dpsrg1_w_msg dpsrg_w_msg PIntkVUs_facNrmPEnv PIntkVUs_flgPMeasdVldTiBasdB1 PIntkVUs_flgPVldTiBasd PIntkVUs_flgPVldTiBasdB1 PIntkVUs_p PIntkVUs_pB1 PIntkVUs_pMeasdTiBasdB1 PIntkVUs_pTiBasd PIntkVUs_pTiBasdB1 psr1_w_msg psrg1_w_msg psrgsm_w_msg psrg_w_msg psrrf_w_msg psr_w_msg /end OUT_MEASUREMENT
 /begin LOC_MEASUREMENT fapsrr_w fdpslma_w oafpsrr_w PIntkVUs_flgSwtFilPrm tppsrifd_w /end LOC_MEASUREMENT
 FUNCTION_VERSION "7.10.0" /end FUNCTION
/begin FUNCTION BGQTITIMN "6.9.0     Calculation of quotient ti - TIMIN"
 /begin DEF_CHARACTERISTIC InjSys_flgInjTiOpenActv_C InjSys_idxInjPlsQuoTiMin_T InjSys_tiMinRatCvoIdle_C InjSys_tiMinRatCvo_C /end DEF_CHARACTERISTIC
 /begin REF_CHARACTERISTIC InjSys_stInjMod_AX /end REF_CHARACTERISTIC
 /begin IN_MEASUREMENT B_ll_msg evz_austot_msg InjSys_idxMI InjSys_stInjTmng InjSys_tiInjOpenSyn0 InjSys_tiInjOpenSyn1 InjSys_tiInjSyn0 InjSys_tiInjSyn1 SyC_ctDrvEnter zzylh_msg zzyls_msg /end IN_MEASUREMENT
 /begin OUT_MEASUREMENT InjSys_tiMaiInj qtitimnh_msg timinausggdi_w_msg timnausg_w_msg /end OUT_MEASUREMENT
 /begin LOC_MEASUREMENT qtitimngdi /end LOC_MEASUREMENT
 FUNCTION_VERSION "6.9.0" /end FUNCTION
/begin FUNCTION BGRL "29.1.0    Calculation of fresh air in combustion chamber"
 /begin DEF_CHARACTERISTIC AirMod_nrSynAirChrgToIgnCalcn_C AirMod_tiThdpSysStrt_C CWBGRL FEETEPNUN FEETEPNVPX /end DEF_CHARACTERISTIC
 /begin IN_MEASUREMENT AirMod_idxCylAirChrgPred AirMod_nrSynAirChrgPred AirMod_nrSynAirChrgPredHom B_adkhe_msg B_adkpe_msg B_agrofkl_msg B_apslmdse_msg B_cdagr_msg B_cdehfm_msg B_fupivheg_msg B_msddkg_msg B_msdkhfmg_msg B_mszsdkb_msg B_psrgg_msg B_pvdg_msg B_vhefeps_msg B_vhegfe_msg B_vhegs_msg B_vheg_msg B_vheinst_msg ChrCtl_flgChrgCalcnTiBasd dpsrfgmh_w_msg dpsrfgmp_w_msg Eep_EnvRamHist Eep_EnvRamInvld Epm_ctCyl fupsrls_w_msg fupsrl_w_msg msdkds_w_msg msdkhfm_w_msg pbrints_w_msg pbrint_w_msg PEnv_p psrfgmh_w_msg psrfgmp_w_msg psrg_w_msg psrmh_w_msg psrsuvhe_w_msg psr_w_msg rfdsorgi_w_msg rflmorgi_w_msg rirext_w_msg rirints_w_msg rirint_w_msg rlfgds_w_msg rlfglm_w_msg rlp_w_msg rlrext_w_msg rlrints_w_msg rlrint_w_msg rriext_w_msg rrsiext_w_msg ThrVlv_flgIrrvFuCutOffB1 tnse_w_msg umsrln_w_msg wgvum_w_msg /end IN_MEASUREMENT
 /begin OUT_MEASUREMENT AirMod_idxCylAirChrg AirMod_mfAirCyl AirMod_nrSynAirChrgToIgnCalcn AirMod_ratChrgAirCyl AirMod_ratChrgAirCylAdv_a AirMod_ratChrgAirCylAftSwtPred AirMod_ratChrgAirCylLoResl AirMod_ratChrgAirEgrCyl AirMod_ratChrgInertCyl AirMod_ratInertCyl AirMod_ratInertCylAdv_a AirMod_ratInertCylPred AirMod_ratInertEgrExtCyl AirMod_ratInertEgrIntCyl B_dsshfs_msg B_fagrfe_msg B_fedkahb_msg B_fedkapb_msg B_fedkb_msg B_fedkoab_msg B_fedssb_msg B_feete_msg B_fehfmb_msg B_ferlnotb_msg B_hfmhfs_msg B_msdkhfsg_msg B_rlvheg_msg dpsrfg_w_msg drldvls_w_msg drlvhepsrs_w_msg drl_w_msg ml_msg ml_w_msg msdkhfs_w_msg msfabr_w_msg psrfg_w_msg psrrl_w_msg rfges_w_msg rforgi_w_msg rir_w_msg rlfg_w_msg rlr_w_msg rl_msg rl_w_msg rri_w_msg /end OUT_MEASUREMENT
 /begin LOC_MEASUREMENT AirMod_idxCylAirChrgPredHom AirMod_idxCylAirChrgPredOld AirMod_nrSynAirChrgPredOld /end LOC_MEASUREMENT
 FUNCTION_VERSION "29.1.0" /end FUNCTION
/begin FUNCTION BGRL2SV "8.1.0     Calculation rl-Reference-Values to Service" /begin IN_MEASUREMENT Epm_nEng rlmxvl_w_msg rl_w_msg SyC_stSub /end IN_MEASUREMENT /begin OUT_MEASUREMENT AirMod_ratRelAirM rlabs_w_msg rlmxsoe_w_msg rml_msg /end OUT_MEASUREMENT FUNCTION_VERSION "8.1.0" /end FUNCTION
/begin COMPU_METHOD ASCET_tmp4 "" RAT_FUNC "%9.8" "" COEFFS 0 65536 0 0 0 0.01017253 /end COMPU_METHOD
/begin COMPU_METHOD ASCET_tmp6 "" RAT_FUNC "%10.9" "g" COEFFS 0 21333333.3333333 0 0 0 1 /end COMPU_METHOD
/begin COMPU_METHOD ASCET_tmp7 "" RAT_FUNC "%11.10" "g" COEFFS 0 213333333.333333 0 0 0 1 /end COMPU_METHOD
/begin COMPU_METHOD B_TRUE "" TAB_VERB "%6.3" "" COMPU_TAB_REF B_TRUE /end COMPU_METHOD
/begin COMPU_VTAB B_TRUE "" TAB_VERB 2 0 "FALSE" 1 "TRUE" /end COMPU_VTAB
/begin COMPU_METHOD CMPRBYPVLV_AIRACTR_SC_Compu "" TAB_VERB "%6.3" "" COMPU_TAB_REF CMPRBYPVLV_AIRACTR_SC_Compu /end COMPU_METHOD
/begin COMPU_VTAB CMPRBYPVLV_AIRACTR_SC_Compu "" TAB_VERB 2 0 "INACTIVE" 1 "ACTIVE" /end COMPU_VTAB
/begin COMPU_METHOD CMPRHP2DST_TYPAVL_SC_Compu "" TAB_VERB "%6.3" "" COMPU_TAB_REF CMPRHP2DST_TYPAVL_SC_Compu /end COMPU_METHOD
/begin COMPU_VTAB CMPRHP2DST_TYPAVL_SC_Compu "" TAB_VERB 2 0 "False" 1 "True" /end COMPU_VTAB
/begin COMPU_METHOD Cnd_uS_DIV_Cm_q0p01_COMPU "" RAT_FUNC "%6.4" "µS/Cm" COEFFS 0 100 0 0 0 1 /end COMPU_METHOD
/begin COMPU_METHOD CNG_SY_Compu "" TAB_VERB "%6.3" "" COMPU_TAB_REF CNG_SY_Compu /end COMPU_METHOD
/begin COMPU_VTAB CNG_SY_Compu "" TAB_VERB 5 0 "Kein System mit CNG" 1 "System mit CNG" 2 "System mit CNG und EOBD" 3 "System mit CNG Fehlerpfade ASV1...5" 4 "System mit CNG Plattform" /end COMPU_VTAB
/begin COMPU_METHOD CnvtCoeffCatAir "" RAT_FUNC "%6.4" "J/K/s/m^2" COEFFS 0 50 0 0 0 1 /end COMPU_METHOD
/begin COMPU_METHOD CoeffA "" RAT_FUNC "%6.4" "1/(s*Nm)" COEFFS 0 204.8 0 0 0 1 /end COMPU_METHOD
/begin COMPU_METHOD COENG_APPLANDTESTSUPRTSPST_SC_Compu "" TAB_VERB "%6.3" "" COMPU_TAB_REF COENG_APPLANDTESTSUPRTSPST_SC_Compu /end COMPU_METHOD
/begin COMPU_VTAB COENG_APPLANDTESTSUPRTSPST_SC_Compu "" TAB_VERB 2 0 "False" 1 "True" /end COMPU_VTAB
/begin COMPU_METHOD COENG_BASCONLY_SC_Compu "" TAB_VERB "%6.3" "" COMPU_TAB_REF COENG_BASCONLY_SC_Compu /end COMPU_METHOD
/begin COMPU_VTAB COENG_BASCONLY_SC_Compu "" TAB_VERB 2 0 "False" 1 "True" /end COMPU_VTAB
/begin COMPU_METHOD COENG_DRGDESCDN_SC_Compu "" RAT_FUNC "%6.2" "" COEFFS 0 1 0 0 0 1 /end COMPU_METHOD
/begin COMPU_METHOD COENG_ENANTEPIDS_SC_Compu "" TAB_VERB "%6.3" "" COMPU_TAB_REF COENG_ENANTEPIDS_SC_Compu /end COMPU_METHOD
/begin COMPU_VTAB COENG_ENANTEPIDS_SC_Compu "" TAB_VERB 2 0 "NoNTE_PIDs" 1 "NTE_PIDs_Enabled" /end COMPU_VTAB
/begin COMPU_METHOD CoEng_StEngs_sm_VERB "" TAB_VERB "%6.3" "" COMPU_TAB_REF CoEng_StEngs_sm_VERB /end COMPU_METHOD
/begin COMPU_VTAB CoEng_StEngs_sm_VERB "" TAB_VERB 10 0 "A_STANDBY" 1 "A_AUTOSTOPPING" 2 "A_FINISH" 3 "A_READY" 4 "A_RUNNING" 5 "A_STARTING" 6 "A_STOPPING" 7 "H_DRIVE" 8 "H_POSTDRIVE" 9 "H_PREDRIVE" /end COMPU_VTAB
/begin COMPU_METHOD COENG_STOPENBLCOND1_SC_Compu "" RAT_FUNC "%6.2" "" COEFFS 0 1 0 0 0 1 /end COMPU_METHOD
/begin COMPU_METHOD COENG_STOPENBLCOND2_SC_Compu "" RAT_FUNC "%6.2" "" COEFFS 0 1 0 0 0 1 /end COMPU_METHOD
/begin COMPU_METHOD COENG_STOPENBLCONDIDL_SY_Compu "" RAT_FUNC "%6.2" "" COEFFS 0 1 0 0 0 1 /end COMPU_METHOD
/begin COMPU_METHOD COENG_STOPENBLCOND_SY_Compu "" RAT_FUNC "%6.2" "" COEFFS 0 1 0 0 0 1 /end COMPU_METHOD
/begin COMPU_METHOD COENG_STRTDESCOND1_SC_Compu "" RAT_FUNC "%6.2" "" COEFFS 0 1 0 0 0 1 /end COMPU_METHOD
/begin COMPU_METHOD COENG_STRTDESCOND2_SC_Compu "" RAT_FUNC "%6.2" "" COEFFS 0 1 0 0 0 1 /end COMPU_METHOD
/begin COMPU_METHOD COENG_STRTDESCOND_SC_Compu "" RAT_FUNC "%6.2" "" COEFFS 0 1 0 0 0 1 /end COMPU_METHOD
/begin COMPU_METHOD COENG_STRTENBLCOND_SY_Compu "" RAT_FUNC "%6.2" "" COEFFS 0 1 0 0 0 1 /end COMPU_METHOD
/begin COMPU_METHOD COENG_SWTVEHTYP_SC_Compu "" TAB_VERB "%6.3" "" COMPU_TAB_REF COENG_SWTVEHTYP_SC_Compu /end COMPU_METHOD
/begin COMPU_VTAB COENG_SWTVEHTYP_SC_Compu "" TAB_VERB 3 0 "PC" 5 "CV" 10 "OHW" /end COMPU_VTAB
/begin COMPU_METHOD CoEng_ti_VERB "" TAB_VERB "%6.3" "" COMPU_TAB_REF CoEng_ti_VERB /end COMPU_METHOD
/begin COMPU_VTAB CoEng_ti_VERB "" TAB_VERB 11 0 "COENG_TI_STANDBY" 1 "COENG_TI_READY" 2 "COENG_TI_STARTING" 3 "COENG_TI_AUTOSTOPPING" 4 "COENG_TI_RUNNING" 5 "COENG_TI_STOPPING" 6 "COENG_TI_FINISH" 7 "COENG_TI_START" 8 "COENG_TI_NORMAL" 9 "COENG_TI_AFTERRUN" 10 "COENG_TI_RUNNGSUM" /end COMPU_VTAB
/begin COMPU_METHOD COENG_TYPSTOPRELSHYB_SC_Compu "" TAB_VERB "%6.3" "" COMPU_TAB_REF COENG_TYPSTOPRELSHYB_SC_Compu /end COMPU_METHOD
/begin COMPU_VTAB COENG_TYPSTOPRELSHYB_SC_Compu "" TAB_VERB 2 0 "0" 1 "1" /end COMPU_VTAB
/begin COMPU_METHOD COENG_VAR_SY_Compu "" TAB_VERB "%6.3" "" COMPU_TAB_REF COENG_VAR_SY_Compu /end COMPU_METHOD
/begin COMPU_VTAB COENG_VAR_SY_Compu "" TAB_VERB 52 0 "kein Kundenbezug" 1 "DAI" 3 "VWW" 4 "POR" 5 "AUD" 6 "OPE" 9 "FIA" 11 "BMW" 14 "PSA" 15 "REN" 17 "ALF" 18 "SAB" 19 "VOL" 20 "NIS" 21 "GMU" 22 "FOR" 26 "IMJ" 36 "MAN" 51 "SEA" 53 "CHR" 54 "JAG" 55 "ROL" 69 "FER" 72 "TOY" 123 "MIT" 147 "HYU" 159 "HON" 160 "MAZ" 183 "CU" 190 "LRG" 204 "VVW" 214 "AVT" 242 "Iveco" 243 "DMC" 248 "SUZ" 267 "SSANGYONG" 270 "KEF" 289 "AMG" 308 "TAT" 319 "MVM" 328 "MM" 385 "UAES" 578 "AL" 590 "Scania" 760 "WEICHAI" 828 "RBCD" 898 "MFTBC" 966 "International" 999 "ALL" 2887 "NONOX" 9454 "Fuso" 9546 "CAT" /end COMPU_VTAB
/begin COMPU_METHOD COENG_VLVLFTSPINTKTYP_SC_Compu "" TAB_VERB "%6.3" "" COMPU_TAB_REF COENG_VLVLFTSPINTKTYP_SC_Compu /end COMPU_METHOD
/begin COMPU_VTAB COENG_VLVLFTSPINTKTYP_SC_Compu "" TAB_VERB 3 0 "0" 1 "1" 2 "2" /end COMPU_VTAB
/begin COMPU_METHOD COENG_WPDMDHYBCFG_SC_Compu "" TAB_VERB "%6.3" "" COMPU_TAB_REF COENG_WPDMDHYBCFG_SC_Compu /end COMPU_METHOD
/begin COMPU_VTAB COENG_WPDMDHYBCFG_SC_Compu "" TAB_VERB 3 0 "0" 1 "1" 2 "2" /end COMPU_VTAB
/begin COMPU_METHOD COENG_WPDMDHYBSTC_SC_Compu "" TAB_VERB "%6.3" "" COMPU_TAB_REF COENG_WPDMDHYBSTC_SC_Compu /end COMPU_METHOD
/begin COMPU_VTAB COENG_WPDMDHYBSTC_SC_Compu "" TAB_VERB 2 0 "False" 1 "True" /end COMPU_VTAB
/begin COMPU_METHOD CoEOMSwt "" RAT_FUNC "%10.9" "-" COEFFS 0 16384000 0 0 0 1 /end COMPU_METHOD
/begin COMPU_METHOD CoEOMSwt_S16 "" RAT_FUNC "%7.6" "-" COEFFS 0 16384 0 0 0 1 /end COMPU_METHOD
/begin COMPU_METHOD COEOM_APPLSUPRT_SC_Compu "" RAT_FUNC "%6.2" "" COEFFS 0 1 0 0 0 1 /end COMPU_METHOD
/begin COMPU_METHOD COEOM_INHOUSE_SC_Compu "" TAB_VERB "%6.3" "" COMPU_TAB_REF COEOM_INHOUSE_SC_Compu /end COMPU_METHOD
/begin COMPU_VTAB COEOM_INHOUSE_SC_Compu "" TAB_VERB 3 0 "BOSCH" 1 "OEM" 2 "OEM_and_BOSCH" /end COMPU_VTAB
/begin COMPU_METHOD COEOM_INJCRVMI1NUMMAP_SY_Compu "" RAT_FUNC "%6.2" "" COEFFS 0 1 0 0 0 1 /end COMPU_METHOD
/begin COMPU_METHOD COEOM_INJCRVMI1NUMSWTDES_SY_Compu "" RAT_FUNC "%6.2" "" COEFFS 0 1 0 0 0 1 /end COMPU_METHOD
/begin COMPU_METHOD COEOM_INJCRVPII1NUMMAP_SY_Compu "" RAT_FUNC "%6.2" "" COEFFS 0 1 0 0 0 1 /end COMPU_METHOD
/begin COMPU_METHOD COEOM_INJCRVPII1NUMSWTDES_SY_Compu "" RAT_FUNC "%6.2" "" COEFFS 0 1 0 0 0 1 /end COMPU_METHOD
/begin COMPU_METHOD COEOM_INJCRVPII2NUMMAP_SY_Compu "" RAT_FUNC "%6.2" "" COEFFS 0 1 0 0 0 1 /end COMPU_METHOD
/begin COMPU_METHOD COEOM_INJCRVPII2NUMSWTDES_SY_Compu "" RAT_FUNC "%6.2" "" COEFFS 0 1 0 0 0 1 /end COMPU_METHOD
/begin COMPU_METHOD COEOM_INJCRVPOI1NUMMAP_SY_Compu "" RAT_FUNC "%6.2" "" COEFFS 0 1 0 0 0 1 /end COMPU_METHOD
/begin COMPU_METHOD COEOM_INJCRVPOI1NUMSWTDES_SY_Compu "" RAT_FUNC "%6.2" "" COEFFS 0 1 0 0 0 1 /end COMPU_METHOD
/begin COMPU_METHOD dez "" RAT_FUNC "%6.2" "" COEFFS 0 1 0 0 0 1 /end COMPU_METHOD
/begin COMPU_METHOD EngN "" RAT_FUNC "%6.3" "rpm" COEFFS 0 2 0 0 0 1 /end COMPU_METHOD
/begin COMPU_METHOD EngNGrd "" RAT_FUNC "%6.3" "rpm/s" COEFFS 0 2 0 0 0 1 /end COMPU_METHOD
/begin COMPU_METHOD fak_q0p000244 "" RAT_FUNC "%6.5" "-" COEFFS 0 65536 0 0 0 16 /end COMPU_METHOD
/begin COMPU_METHOD fak_q1p22Em4 "" RAT_FUNC "%6.5" "-" COEFFS 0 8192 0 0 0 1 /end COMPU_METHOD
/begin COMPU_METHOD fak_q1p526Em5 "" RAT_FUNC "%7.6" "-" COEFFS 0 65536 0 0 0 1 /end COMPU_METHOD
/begin COMPU_METHOD fak_q3p0518Em5 "" RAT_FUNC "%7.6" "" COEFFS 0 32768 0 0 0 1 /end COMPU_METHOD
/begin COMPU_METHOD fak_q3p72529Em9 "" RAT_FUNC "%11.10" "" COEFFS 0 268435456 0 0 0 1 /end COMPU_METHOD
/begin COMPU_METHOD fak_q4p883Em4 "" RAT_FUNC "%6.5" "-" COEFFS 0 65536 0 0 0 32 /end COMPU_METHOD
/begin COMPU_METHOD fak_q6p1035Em5 "" RAT_FUNC "%7.6" "-" COEFFS 0 65536 0 0 0 4 /end COMPU_METHOD
/begin COMPU_METHOD fak_sw_b1 "" RAT_FUNC "%7.6" "-" COEFFS 0 65536 0 0 0 2 /end COMPU_METHOD
/begin COMPU_METHOD fak_sw_b2 "" RAT_FUNC "%7.6" "-" COEFFS 0 65536 0 0 0 4 /end COMPU_METHOD
/begin COMPU_METHOD fak_sw_q64 "" RAT_FUNC "%6.4" "-" COEFFS 0 64 0 0 0 1 /end COMPU_METHOD
/begin COMPU_METHOD fak_ub_b1 "" RAT_FUNC "%6.4" "-" COEFFS 0 256 0 0 0 1 /end COMPU_METHOD
/begin COMPU_METHOD fak_ub_b2 "" RAT_FUNC "%8.5" "-" COEFFS 0 256 0 0 0 2 /end COMPU_METHOD
/begin COMPU_METHOD fak_ub_b4 "" RAT_FUNC "%6.4" "-" COEFFS 0 256 0 0 0 4 /end COMPU_METHOD
/begin COMPU_METHOD fak_uw_b1 "" RAT_FUNC "%7.6" "-" COEFFS 0 65536 0 0 0 1 /end COMPU_METHOD
/begin COMPU_METHOD fak_uw_b16 "" RAT_FUNC "%6.5" "-" COEFFS 0 65536 0 0 0 16 /end COMPU_METHOD
/begin COMPU_METHOD fak_uw_b2 "" RAT_FUNC "%7.6" "-" COEFFS 0 65536 0 0 0 2 /end COMPU_METHOD
/begin COMPU_METHOD fak_uw_b4 "" RAT_FUNC "%7.6" "-" COEFFS 0 65536 0 0 0 4 /end COMPU_METHOD
/begin COMPU_METHOD fak_uw_b8 "" RAT_FUNC "%6.5" "-" COEFFS 0 65536 0 0 0 8 /end COMPU_METHOD
/begin COMPU_METHOD InjSys_InjMode_Set_COMPU_VERB "" TAB_VERB "%6.3" "-" COMPU_TAB_REF InjSys_InjMode_Set_COMPU_VERB /end COMPU_METHOD
/begin COMPU_VTAB InjSys_InjMode_Set_COMPU_VERB "" TAB_VERB 20 0 "GDIOff" 1 "HO1" 2 "HO2" 3 "HO3" 4 "HO1_WU" 5 "HO2_WU" 6 "HO3_WU" 7 "HP2" 8 "HP3" 9 "HP2_CH" 10 "HP3_CH" 11 "HP2Z" 12 "HP3Z" 13 "SHO1" 14 "SHO2" 15 "SHO3" 16 "SHP3" 17 "SH1" 18 "SH2" 19 "SH3" /end COMPU_VTAB
/begin COMPU_METHOD kw_q0p0156 "" RAT_FUNC "%6.4" "Grad KW" COEFFS 0 64 0 0 0 1 /end COMPU_METHOD
/begin COMPU_METHOD kw_q0p75 "" RAT_FUNC "%6.3" "Grad KW" COEFFS 0 4 0 0 0 3 /end COMPU_METHOD
/begin COMPU_METHOD kw_sw_q0p0156 "" RAT_FUNC "%9.5" "deg KW" COEFFS 0 64 0 0 0 1 /end COMPU_METHOD
/begin COMPU_METHOD m_q0p0005 "" RAT_FUNC "%6.5" "kg/(h*%)" COEFFS 0 1 0 0 0 0.0005 /end COMPU_METHOD
/begin COMPU_METHOD m_q0p0031 "" RAT_FUNC "%6.4" "kg/h" COEFFS 0 320 0 0 0 1 /end COMPU_METHOD
/begin COMPU_METHOD m_q0p00625 "" RAT_FUNC "%6.4" "kg/h" COEFFS 0 160 0 0 0 1 /end COMPU_METHOD
/begin COMPU_METHOD m_q0p032_g "" RAT_FUNC "%6.4" "g" COEFFS 0 1 0 0 0 0.032 /end COMPU_METHOD
/begin COMPU_METHOD m_q0p1 "" RAT_FUNC "%6.3" "kg/h" COEFFS 0 10 0 0 0 1 /end COMPU_METHOD
/begin COMPU_METHOD m_q0p1_g_DIV_L "" RAT_FUNC "%6.3" "g/l" COEFFS 0 10 0 0 0 1 /end COMPU_METHOD
/begin COMPU_METHOD m_q4_kg_DIV_h "" RAT_FUNC "%6.2" "kg/h" COEFFS 0 1 0 0 0 4 /end COMPU_METHOD
/begin COMPU_METHOD m_ub_b25p6 "" RAT_FUNC "%6.3" "kg/h" COEFFS 0 256 0 0 0 25.6 /end COMPU_METHOD
/begin COMPU_METHOD m_uw_b1536 "" RAT_FUNC "%6.4" "kg/h" COEFFS 0 65536 0 0 0 1536 /end COMPU_METHOD
/begin COMPU_METHOD m_uw_b6553p5 "" RAT_FUNC "%6.3" "kg/h" COEFFS 0 1 0 0 0 0.1 /end COMPU_METHOD
/begin COMPU_METHOD nmot_q0p25 "" RAT_FUNC "%6.3" "1/min" COEFFS 0 4 0 0 0 1 /end COMPU_METHOD
/begin COMPU_METHOD OneToOne "" RAT_FUNC "%6.2" "-" COEFFS 0 1 0 0 0 1 /end COMPU_METHOD
/begin COMPU_METHOD p_q0p078 "" RAT_FUNC "%6.4" "hPa" COEFFS 0 64 0 0 0 5 /end COMPU_METHOD
/begin COMPU_METHOD p_sw_q0p039 "" RAT_FUNC "%6.4" "hPa" COEFFS 0 256 0 0 0 10 /end COMPU_METHOD
/begin COMPU_METHOD p_sw_q0p078 "" RAT_FUNC "%6.4" "hPa" COEFFS 0 65536 0 0 0 5120 /end COMPU_METHOD
/begin COMPU_METHOD p_uw_q0p039 "" RAT_FUNC "%6.4" "hPa" COEFFS 0 256 0 0 0 10 /end COMPU_METHOD
/begin COMPU_METHOD p_uw_q0p078 "" RAT_FUNC "%6.4" "hPa" COEFFS 0 256 0 0 0 20 /end COMPU_METHOD
/begin COMPU_METHOD q0p00390625_s_h_DIV_kg "" RAT_FUNC "%6.4" "sh/kg" COEFFS 0 256 0 0 0 1 /end COMPU_METHOD
/begin COMPU_METHOD q1p1921Em3_mL_DIV_s "" RAT_FUNC "%6.4" "ml/s" COEFFS 0 65536 0 0 0 78.125 /end COMPU_METHOD
/begin COMPU_METHOD q1p1921Em6_L_DIV_s "" RAT_FUNC "%8.7" "l/s" COEFFS 0 65536 0 0 0 0.078125 /end COMPU_METHOD
/begin COMPU_METHOD RBPtCel_mf_0p02_1 "" RAT_FUNC "%6.4" "g/s" COEFFS 0 50 0 0 0 1 /end COMPU_METHOD
/begin COMPU_METHOD rel_q0p0078125 "" RAT_FUNC "%6.4" "%" COEFFS 0 128 0 0 0 1 /end COMPU_METHOD
/begin COMPU_METHOD rel_q0p0234 "" RAT_FUNC "%6.4" "%" COEFFS 0 128 0 0 0 3 /end COMPU_METHOD
/begin COMPU_METHOD rel_q0p02344 "" RAT_FUNC "%6.4" "%" COEFFS 0 32 0 0 0 0.75 /end COMPU_METHOD
/begin COMPU_METHOD rel_q0p046875 "" RAT_FUNC "%6.4" "%" COEFFS 0 65536 0 0 0 3072 /end COMPU_METHOD
/begin COMPU_METHOD rel_q0p392 "" RAT_FUNC "%6.3" "%" COEFFS 0 255 0 0 0 100 /end COMPU_METHOD
/begin COMPU_METHOD rel_q0p75 "" RAT_FUNC "%6.3" "%" COEFFS 0 4 0 0 0 3 /end COMPU_METHOD
/begin COMPU_METHOD rel_ub_b99p6 "" RAT_FUNC "%6.3" "%" COEFFS 0 256 0 0 0 100 /end COMPU_METHOD
/begin COMPU_METHOD rel_uw_b0p3 "" RAT_FUNC "%8.7" "%/hPa" COEFFS 0 65536 0 0 0 0.3 /end COMPU_METHOD
/begin COMPU_METHOD rel_uw_b100 "" RAT_FUNC "%6.4" "%" COEFFS 0 65536 0 0 0 100 /end COMPU_METHOD
/begin COMPU_METHOD rel_uw_b3072 "" RAT_FUNC "%6.4" "%" COEFFS 0 65536 0 0 0 3072 /end COMPU_METHOD
/begin COMPU_METHOD rel_uw_b491520 "" RAT_FUNC "%6.2" "%/s" COEFFS 0 65536 0 0 0 491520 /end COMPU_METHOD
/begin COMPU_METHOD rel_uw_q0p0234 "" RAT_FUNC "%6.4" "%" COEFFS 0 32 0 0 0 0.75 /end COMPU_METHOD
/begin COMPU_METHOD Temp_Cels "" RAT_FUNC "%6.1" "deg C" COEFFS 0 10 2731.4 0 0 1 /end COMPU_METHOD
/begin COMPU_METHOD temp_q0p0234 "" RAT_FUNC "%6.4" "K" COEFFS 0 256 0 0 0 6 /end COMPU_METHOD
/begin COMPU_METHOD temp_q0p0234_o273 "" RAT_FUNC "%6.1" "Grad C" COEFFS 0 1 273.15 0 0 0.0234375 /end COMPU_METHOD
/begin COMPU_METHOD temp_ub_q0p75_o48 "" RAT_FUNC "%6.2" "Grad C" COEFFS 0 1 48 0 0 0.75 /end COMPU_METHOD
/begin COMPU_METHOD Time_Dt "" RAT_FUNC "%9.8" "s" COEFFS 0 1000000 0 0 0 1 /end COMPU_METHOD
/begin COMPU_METHOD t_q0p0004_ms "" RAT_FUNC "%6.5" "ms" COEFFS 0 10000 0 0 0 4 /end COMPU_METHOD
/begin COMPU_METHOD t_q0p001 "" RAT_FUNC "%6.5" "s" COEFFS 0 1000 0 0 0 1 /end COMPU_METHOD
/begin COMPU_METHOD t_q0p001_ms "" RAT_FUNC "%6.5" "ms" COEFFS 0 1 0 0 0 0.001 /end COMPU_METHOD
/begin COMPU_METHOD t_q0p01 "" RAT_FUNC "%6.4" "s" COEFFS 0 100 0 0 0 1 /end COMPU_METHOD
/begin COMPU_METHOD t_q0p1 "" RAT_FUNC "%6.3" "s" COEFFS 0 10 0 0 0 1 /end COMPU_METHOD
/begin COMPU_METHOD Vol "" RAT_FUNC "%6.4" "l" COEFFS 0 100 0 0 0 1 /end COMPU_METHOD
/begin COMPU_METHOD volgrd_q0p05_L_DIV_h "" RAT_FUNC "%6.4" "l/h" COEFFS 0 20 0 0 0 1 /end COMPU_METHOD
/begin COMPU_METHOD vol_q0p1_cm3 "" RAT_FUNC "%6.3" "cm^3" COEFFS 0 10 0 0 0 1 /end COMPU_METHOD
/begin COMPU_METHOD vol_q0p306_cme3 "" RAT_FUNC "%6.3" "cm^3" COEFFS 0 6.5536 0 0 0 2 /end COMPU_METHOD
/begin COMPU_METHOD vol_q6p1035Em7 "" RAT_FUNC "%9.8" "L" COEFFS 0 65536 0 0 0 0.04 /end COMPU_METHOD
/begin COMPU_METHOD vol_q8p583Em3 "" RAT_FUNC "%6.4" "l/h" COEFFS 0 131072 0 0 0 1125 /end COMPU_METHOD
/begin COMPU_METHOD vol_q9p766Em4_L "" RAT_FUNC "%6.5" "L" COEFFS 0 65536 0 0 0 64 /end COMPU_METHOD
/begin COMPU_METHOD zk10msxs_uw_b655 "" RAT_FUNC "%6.2" "s" COEFFS 0 0 65536 0 100 0 /end COMPU_METHOD
/begin COMPU_METHOD zk1msxs_uw_b65p536 "" RAT_FUNC "%6.3" "s" COEFFS 0 0 65536 0 1000 0 /end COMPU_METHOD
/begin RECORD_LAYOUT RB_Axis_U8 NO_AXIS_PTS_X 1 UBYTE AXIS_PTS_X 2 UBYTE INDEX_INCR DIRECT /end RECORD_LAYOUT
/begin RECORD_LAYOUT RB_CurveGroup_U8 FNC_VALUES 1 UBYTE COLUMN_DIR DIRECT /end RECORD_LAYOUT
/begin RECORD_LAYOUT RB_Curve_S16_S16 NO_AXIS_PTS_X 1 SWORD AXIS_PTS_X 2 SWORD INDEX_INCR DIRECT FNC_VALUES 3 SWORD COLUMN_DIR DIRECT /end RECORD_LAYOUT
/begin RECORD_LAYOUT RB_Curve_S16_U16_Static NO_AXIS_PTS_X 1 SWORD AXIS_PTS_X 2 SWORD INDEX_INCR DIRECT FNC_VALUES 3 UWORD COLUMN_DIR DIRECT STATIC_RECORD_LAYOUT /end RECORD_LAYOUT
/begin RECORD_LAYOUT RB_Curve_S8_U16_Static NO_AXIS_PTS_X 1 SBYTE AXIS_PTS_X 2 SBYTE INDEX_INCR DIRECT FNC_VALUES 3 UWORD COLUMN_DIR DIRECT STATIC_RECORD_LAYOUT /end RECORD_LAYOUT
/begin RECORD_LAYOUT RB_Curve_U16_S16_Static NO_AXIS_PTS_X 1 UWORD AXIS_PTS_X 2 UWORD INDEX_INCR DIRECT FNC_VALUES 3 SWORD COLUMN_DIR DIRECT STATIC_RECORD_LAYOUT /end RECORD_LAYOUT
/begin RECORD_LAYOUT RB_Curve_U16_U16 NO_AXIS_PTS_X 1 UWORD AXIS_PTS_X 2 UWORD INDEX_INCR DIRECT FNC_VALUES 3 UWORD COLUMN_DIR DIRECT /end RECORD_LAYOUT
/begin RECORD_LAYOUT RB_Curve_U16_U8_Static NO_AXIS_PTS_X 1 UWORD AXIS_PTS_X 2 UWORD INDEX_INCR DIRECT FNC_VALUES 3 UBYTE COLUMN_DIR DIRECT STATIC_RECORD_LAYOUT /end RECORD_LAYOUT
/begin RECORD_LAYOUT RB_Curve_U8_U8 NO_AXIS_PTS_X 1 UBYTE AXIS_PTS_X 2 UBYTE INDEX_INCR DIRECT FNC_VALUES 3 UBYTE COLUMN_DIR DIRECT /end RECORD_LAYOUT
/begin RECORD_LAYOUT RB_FixCurve_U16_U16 FNC_VALUES 1 UWORD COLUMN_DIR DIRECT /end RECORD_LAYOUT
/begin RECORD_LAYOUT RB_Map_S16S16_S16 NO_AXIS_PTS_X 1 SWORD NO_AXIS_PTS_Y 2 SWORD AXIS_PTS_X 3 SWORD INDEX_INCR DIRECT AXIS_PTS_Y 4 SWORD INDEX_INCR DIRECT FNC_VALUES 5 SWORD COLUMN_DIR DIRECT /end RECORD_LAYOUT
/begin RECORD_LAYOUT RB_Map_S16S16_U16 NO_AXIS_PTS_X 1 SWORD NO_AXIS_PTS_Y 2 SWORD AXIS_PTS_X 3 SWORD INDEX_INCR DIRECT AXIS_PTS_Y 4 SWORD INDEX_INCR DIRECT FNC_VALUES 5 UWORD COLUMN_DIR DIRECT /end RECORD_LAYOUT
/begin RECORD_LAYOUT RB_Map_S16U16_S16 NO_AXIS_PTS_X 1 SWORD NO_AXIS_PTS_Y 2 SWORD AXIS_PTS_X 3 SWORD INDEX_INCR DIRECT AXIS_PTS_Y 4 UWORD INDEX_INCR DIRECT FNC_VALUES 5 SWORD ROW_DIR DIRECT /end RECORD_LAYOUT
/begin RECORD_LAYOUT RB_Map_S16U16_U16 NO_AXIS_PTS_X 1 SWORD NO_AXIS_PTS_Y 2 SWORD AXIS_PTS_X 3 SWORD INDEX_INCR DIRECT AXIS_PTS_Y 4 UWORD INDEX_INCR DIRECT FNC_VALUES 5 UWORD ROW_DIR DIRECT /end RECORD_LAYOUT
/begin RECORD_LAYOUT RB_Map_U16S16_S16 NO_AXIS_PTS_X 1 UWORD NO_AXIS_PTS_Y 2 UWORD AXIS_PTS_X 3 UWORD INDEX_INCR DIRECT AXIS_PTS_Y 4 SWORD INDEX_INCR DIRECT FNC_VALUES 5 SWORD COLUMN_DIR DIRECT /end RECORD_LAYOUT
/begin RECORD_LAYOUT RB_Map_U16S16_U16 NO_AXIS_PTS_X 1 UWORD NO_AXIS_PTS_Y 2 UWORD AXIS_PTS_X 3 UWORD INDEX_INCR DIRECT AXIS_PTS_Y 4 SWORD INDEX_INCR DIRECT FNC_VALUES 5 UWORD COLUMN_DIR DIRECT /end RECORD_LAYOUT
/begin RECORD_LAYOUT RB_Map_U16U16_U16 NO_AXIS_PTS_X 1 UWORD NO_AXIS_PTS_Y 2 UWORD AXIS_PTS_X 3 UWORD INDEX_INCR DIRECT AXIS_PTS_Y 4 UWORD INDEX_INCR DIRECT FNC_VALUES 5 UWORD COLUMN_DIR DIRECT /end RECORD_LAYOUT
/begin RECORD_LAYOUT RB_Val_Wboolean FNC_VALUES 1 UBYTE COLUMN_DIR DIRECT /end RECORD_LAYOUT
/begin RECORD_LAYOUT RB_Val_Ws16 FNC_VALUES 1 SWORD COLUMN_DIR DIRECT /end RECORD_LAYOUT
/begin RECORD_LAYOUT RB_Val_Wu16 FNC_VALUES 1 UWORD COLUMN_DIR DIRECT /end RECORD_LAYOUT
/begin RECORD_LAYOUT RB_Val_Wu32 FNC_VALUES 1 ULONG COLUMN_DIR DIRECT /end RECORD_LAYOUT
/begin RECORD_LAYOUT RB_Val_Wu8 FNC_VALUES 1 UBYTE COLUMN_DIR DIRECT /end RECORD_LAYOUT
/end MODULE
/end PROJECT
