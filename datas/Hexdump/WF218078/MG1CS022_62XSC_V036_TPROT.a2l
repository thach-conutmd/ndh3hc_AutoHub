ASAP2_VERSION 1 60
/begin PROJECT MG1CS022 "MG1CS022"
/begin HEADER "" VERSION "MG1CS022_62XSC_V036_TPROT" PROJECT_NO MG1CS022 /end HEADER
/begin MODULE DIM ""
/begin MOD_COMMON "" BYTE_ORDER MSB_LAST ALIGNMENT_BYTE 1 ALIGNMENT_WORD 2 ALIGNMENT_LONG 4 ALIGNMENT_INT64 4 ALIGNMENT_FLOAT32_IEEE 4 ALIGNMENT_FLOAT64_IEEE 4 DATA_SIZE 32 /end MOD_COMMON
/begin CHARACTERISTIC Com_dENG18SigSel_C "Signal selection data for ENG18 frame" VALUE 0x805427BA RB_Val_Wu8 255.0 OneToOne 0.00 255.0 FORMAT "%5.1" /end CHARACTERISTIC
/begin CHARACTERISTIC Com_nEngHi_C "Hysteris upper limit of engine speed for Engine stall information." VALUE 0x805427B4 RB_Val_Ws16 32767.50 EngN -16384.00 16383.50 FORMAT "%8.2" /end CHARACTERISTIC
/begin CHARACTERISTIC Com_nEngLo_C "Hysteris lower limit of engine speed for Engine stall information." VALUE 0x805427B6 RB_Val_Ws16 32767.50 EngN -16384.00 16383.50 FORMAT "%8.2" /end CHARACTERISTIC
/begin CHARACTERISTIC Com_rThrVlvActAdj_C "Calibration adjust for Actual throttle Aperture" VALUE 0x805427A8 RB_Val_Wu16 159.9976 reldeg_q0p002441 0.00 159.9976 FORMAT "%8.4" /end CHARACTERISTIC
/begin CHARACTERISTIC Com_stIdleNeutMsk_C "Calibration for Engine Idle Neutral Judgment" VALUE 0x805427AC RB_Val_Wu32 4294967295.00 OneToOne 0.00 4294967295.00 FORMAT "%13.2" /end CHARACTERISTIC
/begin CHARACTERISTIC Com_swtNEng_C "switch for selection of engine speed" VALUE 0x805427B8 RB_Val_Wu8 255.0 OneToOne 0.00 255.0 FORMAT "%5.1" /end CHARACTERISTIC
/begin CHARACTERISTIC Com_swtTqRvsnEnaFlg_C "Switch for Torque adjustment permission flag" VALUE 0x805427B0 RB_Val_Wu8 1.000 OneToOne 0.00 1.000 FORMAT "%5.3" EXTENDED_LIMITS 0.00 255.0 /end CHARACTERISTIC
/begin CHARACTERISTIC Com_tiHACCut_C "calibration infomration for Timet AC Cut Infomation" VALUE 0x805427B2 RB_Val_Ws16 65535.00 t_q1_ms -32768.00 32767.00 FORMAT "%8.2" /end CHARACTERISTIC
/begin CHARACTERISTIC EGSDU_duMinRateTran_C "Minimum change of sensor voltage for calculatrion of time constant for single step" VALUE 0x8053EB88 RB_Val_Wu16 4.998779 spg_q1p221Em3_V 0.00 4.998779 FORMAT "%8.6" EXTENDED_LIMITS 0.00 79.99878 /end CHARACTERISTIC
/begin CHARACTERISTIC EGSDU_facBndErrEvln_C "Limitation of values: 1.5" VALUE 0x8053EAE0 RB_Val_Wu16 3.999939 fak_uw_b4 0.00 3.999939 FORMAT "%8.6" READ_ONLY /end CHARACTERISTIC
/begin CHARACTERISTIC EGSDU_flgLimMaxPsblTran_C "Limitation of the transition time by plausibilisation with the delay diagnosis activated" VALUE 0x8053EB8A RB_Val_Wu8 1.00000000000 B_TRUE 0.00 1.00000000000 FORMAT "%13.11" /end CHARACTERISTIC
/begin CHARACTERISTIC EGSDU_flgS2LtrDlyArthEvln_CW "Codeword (Binary): Apply arithmetic filter for delay time of sensor voltage at transition lean-rich, sensor 2" VALUE 0x8053EAE2 RB_Val_Wu8 1.00000000000 B_TRUE 0.00 1.00000000000 FORMAT "%13.11" /end CHARACTERISTIC
/begin CHARACTERISTIC EGSDU_flgS2LtrTranArthEvln_CW "Codeword (Binary): Apply arithmetic filter for transition time of sensor voltage at transition lean-rich, sensor 2" VALUE 0x8053EAE3 RB_Val_Wu8 1.00000000000 B_TRUE 0.00 1.00000000000 FORMAT "%13.11" /end CHARACTERISTIC
/begin CHARACTERISTIC EGSDU_flgS2RtlDlyArthEvln_CW "Codeword (Binary): Apply arithmetic filter for delay time of sensor voltage at transition rich-lean, sensor 2" VALUE 0x8053EAE4 RB_Val_Wu8 1.00000000000 B_TRUE 0.00 1.00000000000 FORMAT "%13.11" /end CHARACTERISTIC
/begin CHARACTERISTIC EGSDU_flgS2RtlTranArthEvln_CW "Codeword (Binary):Apply arithmetic filter for transition time of sensor voltage at transition rich-lean, sensor 2" VALUE 0x8053EAE5 RB_Val_Wu8 1.00000000000 B_TRUE 0.00 1.00000000000 FORMAT "%13.11" /end CHARACTERISTIC
/begin CHARACTERISTIC EGSDU_S2B1LtrFilDlyEvln_I.facEwmaCodClr_C "Class instance: filter delay time of sensor voltage at transition lean-rich, sensor 2, bank 1 / Filter coefficient for EWMA filter during Code clear mode" VALUE 0x8053EB14 RB_Val_Wu8 0.9961 fak_ub_b1 0.00 0.9961 /end CHARACTERISTIC
/begin CHARACTERISTIC EGSDU_S2B1LtrFilDlyEvln_I.facEwmaNorm_C "Class instance: filter delay time of sensor voltage at transition lean-rich, sensor 2, bank 1 / Filter coefficient for EWMA filter during normal mode" VALUE 0x8053EB15 RB_Val_Wu8 0.9961 fak_ub_b1 0.00 0.9961 /end CHARACTERISTIC
/begin CHARACTERISTIC EGSDU_S2B1LtrFilDlyEvln_I.facEwmaStepChg_C "Class instance: filter delay time of sensor voltage at transition lean-rich, sensor 2, bank 1 / Filter coefficient for EWMA filter during Step Change mode" VALUE 0x8053EB16 RB_Val_Wu8 0.9961 fak_ub_b1 0.00 0.9961 /end CHARACTERISTIC
/begin CHARACTERISTIC EGSDU_S2B1LtrFilDlyEvln_I.nrMeasCodClrTrip_C "Class instance: filter delay time of sensor voltage at transition lean-rich, sensor 2, bank 1 / Number of measurements needed for the EWMA filter in the current driving cycle during Code clear mode" VALUE 0x8053EB17 RB_Val_Wu8 255.0 dez 0.00 255.0 FORMAT "%5.1" /end CHARACTERISTIC
/begin CHARACTERISTIC EGSDU_S2B1LtrFilDlyEvln_I.nrMeasCodClr_C "Class instance: filter delay time of sensor voltage at transition lean-rich, sensor 2, bank 1 / Number of measurements needed for the EWMA filter for result evaluation during Code clear mode" VALUE 0x8053EB18 RB_Val_Wu8 255.0 dez 0.00 255.0 FORMAT "%5.1" /end CHARACTERISTIC
/begin CHARACTERISTIC EGSDU_S2B1LtrFilDlyEvln_I.nrMeasStepChgTrip_C "Class instance: filter delay time of sensor voltage at transition lean-rich, sensor 2, bank 1 / Number of measurements needed for the EWMA filter in the current driving cycle during Step Change Mode" VALUE 0x8053EB19 RB_Val_Wu8 255.0 dez 0.00 255.0 FORMAT "%5.1" /end CHARACTERISTIC
/begin CHARACTERISTIC EGSDU_S2B1LtrFilDlyEvln_I.nrMeasStepChg_C "Class instance: filter delay time of sensor voltage at transition lean-rich, sensor 2, bank 1 / Number of measurements needed for the EWMA filter for result evaluation during Step Change mode" VALUE 0x8053EB1A RB_Val_Wu8 255.0 dez 0.00 255.0 FORMAT "%5.1" /end CHARACTERISTIC
/begin CHARACTERISTIC EGSDU_S2B1LtrFilDlyEvln_I.numMeasShtrp_C "Class instance: filter delay time of sensor voltage at transition lean-rich, sensor 2, bank 1 / number of necessary measurements for short trip" VALUE 0x8053EB1B RB_Val_Wu8 255.0 dez 0.00 255.0 FORMAT "%5.1" /end CHARACTERISTIC
/begin CHARACTERISTIC EGSDU_S2B1LtrFilDlyEvln_I.numMeas_C "Class instance: filter delay time of sensor voltage at transition lean-rich, sensor 2, bank 1 / Minimum number of Tests for Fast Initial Response and Step Change for EWMA-Filter" VALUE 0x8053EB1C RB_Val_Wu8 255.0 dez 0.00 255.0 FORMAT "%5.1" /end CHARACTERISTIC
/begin CHARACTERISTIC EGSDU_S2B1LtrFilDlyEvln_I.tiBndErrEvlnOffs_C "Class instance: filter delay time of sensor voltage at transition lean-rich, sensor 2, bank 1 / Offset correciont for the filtering Diagnosis incase of the vehicle in production Mode" VALUE 0x8053EB1E RB_Val_Ws16 655.3500 t_q0p01 -327.6800 327.6700 FORMAT "%8.4" /end CHARACTERISTIC
/begin CHARACTERISTIC EGSDU_S2B1LtrFilDlyEvln_I.tiIni_C "Class instance: filter delay time of sensor voltage at transition lean-rich, sensor 2, bank 1 / Initial value of dynamic time" VALUE 0x8053EB20 RB_Val_Ws16 655.3500 t_q0p01 -327.6800 327.6700 FORMAT "%8.4" /end CHARACTERISTIC
/begin CHARACTERISTIC EGSDU_S2B1LtrFilDlyEvln_I.tiStepChgCnf_C "Class instance: filter delay time of sensor voltage at transition lean-rich, sensor 2, bank 1 / Threshold (absolute) to confirm Step Change for EWMA-Filter" VALUE 0x8053EB22 RB_Val_Wu16 655.3500 t_q0p01 0.00 655.3500 FORMAT "%8.4" /end CHARACTERISTIC
/begin CHARACTERISTIC EGSDU_S2B1LtrFilDlyEvln_I.tiStepChgSus_C "Class instance: filter delay time of sensor voltage at transition lean-rich, sensor 2, bank 1 / Threshold (absolut) to trigger Step Change logic for EWMA-Filter" VALUE 0x8053EB24 RB_Val_Wu16 655.3500 t_q0p01 0.00 655.3500 FORMAT "%8.4" /end CHARACTERISTIC
/begin CHARACTERISTIC EGSDU_S2B1LtrFilTranEvln_I.facEwmaCodClr_C "Class instance: filter transition time of sensor voltage at transition lean-rich, sensor 2, bank 1 / Filter coefficient for EWMA filter during Code clear mode" VALUE 0x8053EB34 RB_Val_Wu8 0.9961 fak_ub_b1 0.00 0.9961 /end CHARACTERISTIC
/begin CHARACTERISTIC EGSDU_S2B1LtrFilTranEvln_I.facEwmaNorm_C "Class instance: filter transition time of sensor voltage at transition lean-rich, sensor 2, bank 1 / Filter coefficient for EWMA filter during normal mode" VALUE 0x8053EB35 RB_Val_Wu8 0.9961 fak_ub_b1 0.00 0.9961 /end CHARACTERISTIC
/begin CHARACTERISTIC EGSDU_S2B1LtrFilTranEvln_I.facEwmaStepChg_C "Class instance: filter transition time of sensor voltage at transition lean-rich, sensor 2, bank 1 / Filter coefficient for EWMA filter during Step Change mode" VALUE 0x8053EB36 RB_Val_Wu8 0.9961 fak_ub_b1 0.00 0.9961 /end CHARACTERISTIC
/begin CHARACTERISTIC EGSDU_S2B1LtrFilTranEvln_I.nrMeasCodClrTrip_C "Class instance: filter transition time of sensor voltage at transition lean-rich, sensor 2, bank 1 / Number of measurements needed for the EWMA filter in the current driving cycle during Code clear mode" VALUE 0x8053EB37 RB_Val_Wu8 255.0 dez 0.00 255.0 FORMAT "%5.1" /end CHARACTERISTIC
/begin CHARACTERISTIC EGSDU_S2B1LtrFilTranEvln_I.nrMeasCodClr_C "Class instance: filter transition time of sensor voltage at transition lean-rich, sensor 2, bank 1 / Number of measurements needed for the EWMA filter for result evaluation during Code clear mode" VALUE 0x8053EB38 RB_Val_Wu8 255.0 dez 0.00 255.0 FORMAT "%5.1" /end CHARACTERISTIC
/begin CHARACTERISTIC EGSDU_S2B1LtrFilTranEvln_I.nrMeasStepChgTrip_C "Class instance: filter transition time of sensor voltage at transition lean-rich, sensor 2, bank 1 / Number of measurements needed for the EWMA filter in the current driving cycle during Step Change Mode" VALUE 0x8053EB39 RB_Val_Wu8 255.0 dez 0.00 255.0 FORMAT "%5.1" /end CHARACTERISTIC
/begin CHARACTERISTIC EGSDU_S2B1LtrFilTranEvln_I.nrMeasStepChg_C "Class instance: filter transition time of sensor voltage at transition lean-rich, sensor 2, bank 1 / Number of measurements needed for the EWMA filter for result evaluation during Step Change mode" VALUE 0x8053EB3A RB_Val_Wu8 255.0 dez 0.00 255.0 FORMAT "%5.1" /end CHARACTERISTIC
/begin CHARACTERISTIC EGSDU_S2B1LtrFilTranEvln_I.numMeasShtrp_C "Class instance: filter transition time of sensor voltage at transition lean-rich, sensor 2, bank 1 / number of necessary measurements for short trip" VALUE 0x8053EB3B RB_Val_Wu8 255.0 dez 0.00 255.0 FORMAT "%5.1" /end CHARACTERISTIC
/begin CHARACTERISTIC EGSDU_S2B1LtrFilTranEvln_I.numMeas_C "Class instance: filter transition time of sensor voltage at transition lean-rich, sensor 2, bank 1 / Minimum number of Tests for Fast Initial Response and Step Change for EWMA-Filter" VALUE 0x8053EB3C RB_Val_Wu8 255.0 dez 0.00 255.0 FORMAT "%5.1" /end CHARACTERISTIC
/begin CHARACTERISTIC EGSDU_S2B1LtrFilTranEvln_I.tiBndErrEvlnOffs_C "Class instance: filter transition time of sensor voltage at transition lean-rich, sensor 2, bank 1 / Offset correciont for the filtering Diagnosis incase of the vehicle in production Mode" VALUE 0x8053EB3E RB_Val_Ws16 655.3500 t_q0p01 -327.6800 327.6700 FORMAT "%8.4" /end CHARACTERISTIC
/begin CHARACTERISTIC EGSDU_S2B1LtrFilTranEvln_I.tiIni_C "Class instance: filter transition time of sensor voltage at transition lean-rich, sensor 2, bank 1 / Initial value of dynamic time" VALUE 0x8053EB40 RB_Val_Ws16 655.3500 t_q0p01 -327.6800 327.6700 FORMAT "%8.4" /end CHARACTERISTIC
/begin CHARACTERISTIC EGSDU_S2B1LtrFilTranEvln_I.tiStepChgCnf_C "Class instance: filter transition time of sensor voltage at transition lean-rich, sensor 2, bank 1 / Threshold (absolute) to confirm Step Change for EWMA-Filter" VALUE 0x8053EB42 RB_Val_Wu16 655.3500 t_q0p01 0.00 655.3500 FORMAT "%8.4" /end CHARACTERISTIC
/begin CHARACTERISTIC EGSDU_S2B1LtrFilTranEvln_I.tiStepChgSus_C "Class instance: filter transition time of sensor voltage at transition lean-rich, sensor 2, bank 1 / Threshold (absolut) to trigger Step Change logic for EWMA-Filter" VALUE 0x8053EB44 RB_Val_Wu16 655.3500 t_q0p01 0.00 655.3500 FORMAT "%8.4" /end CHARACTERISTIC
/begin CHARACTERISTIC EGSDU_S2B1MinTiLtrTran_I.uDstTarTran_C "Class instance: measurement of transition time of sensor voltage lean to rich, sensor 2, bank 1 / Delta voltage between end of transition time check to target sensor voltage of PT1 model caculation" VALUE 0x8053EC74 RB_Val_Wu16 4.998779 spg_q1p221Em3_V 0.00 4.998779 FORMAT "%8.6" EXTENDED_LIMITS 0.00 79.99878 /end CHARACTERISTIC
/begin CHARACTERISTIC EGSDU_S2B1MinTiRtlTran_I.uDstTarTran_C "Class instance: measurement of transition time of sensor voltage rich to lean, sensor 2, bank 1 / Delta voltage between end of transition time check to target sensor voltage of PT1 model caculation" VALUE 0x8053EC7C RB_Val_Wu16 4.998779 spg_q1p221Em3_V 0.00 4.998779 FORMAT "%8.6" EXTENDED_LIMITS 0.00 79.99878 /end CHARACTERISTIC
/begin CHARACTERISTIC EGSDU_S2B1RtlFilDlyEvln_I.facEwmaCodClr_C "Class instance: filter delay time of sensor voltage at transition rich-lean, sensor 2, bank 1 / Filter coefficient for EWMA filter during Code clear mode" VALUE 0x8053EB54 RB_Val_Wu8 0.9961 fak_ub_b1 0.00 0.9961 /end CHARACTERISTIC
/begin CHARACTERISTIC EGSDU_S2B1RtlFilDlyEvln_I.facEwmaNorm_C "Class instance: filter delay time of sensor voltage at transition rich-lean, sensor 2, bank 1 / Filter coefficient for EWMA filter during normal mode" VALUE 0x8053EB55 RB_Val_Wu8 0.9961 fak_ub_b1 0.00 0.9961 /end CHARACTERISTIC
/begin CHARACTERISTIC EGSDU_S2B1RtlFilDlyEvln_I.facEwmaStepChg_C "Class instance: filter delay time of sensor voltage at transition rich-lean, sensor 2, bank 1 / Filter coefficient for EWMA filter during Step Change mode" VALUE 0x8053EB56 RB_Val_Wu8 0.9961 fak_ub_b1 0.00 0.9961 /end CHARACTERISTIC
/begin CHARACTERISTIC EGSDU_S2B1RtlFilDlyEvln_I.nrMeasCodClrTrip_C "Class instance: filter delay time of sensor voltage at transition rich-lean, sensor 2, bank 1 / Number of measurements needed for the EWMA filter in the current driving cycle during Code clear mode" VALUE 0x8053EB57 RB_Val_Wu8 255.0 dez 0.00 255.0 FORMAT "%5.1" /end CHARACTERISTIC
/begin CHARACTERISTIC EGSDU_S2B1RtlFilDlyEvln_I.nrMeasCodClr_C "Class instance: filter delay time of sensor voltage at transition rich-lean, sensor 2, bank 1 / Number of measurements needed for the EWMA filter for result evaluation during Code clear mode" VALUE 0x8053EB58 RB_Val_Wu8 255.0 dez 0.00 255.0 FORMAT "%5.1" /end CHARACTERISTIC
/begin CHARACTERISTIC EGSDU_S2B1RtlFilDlyEvln_I.nrMeasStepChgTrip_C "Class instance: filter delay time of sensor voltage at transition rich-lean, sensor 2, bank 1 / Number of measurements needed for the EWMA filter in the current driving cycle during Step Change Mode" VALUE 0x8053EB59 RB_Val_Wu8 255.0 dez 0.00 255.0 FORMAT "%5.1" /end CHARACTERISTIC
/begin CHARACTERISTIC EGSDU_S2B1RtlFilDlyEvln_I.nrMeasStepChg_C "Class instance: filter delay time of sensor voltage at transition rich-lean, sensor 2, bank 1 / Number of measurements needed for the EWMA filter for result evaluation during Step Change mode" VALUE 0x8053EB5A RB_Val_Wu8 255.0 dez 0.00 255.0 FORMAT "%5.1" /end CHARACTERISTIC
/begin CHARACTERISTIC EGSDU_S2B1RtlFilDlyEvln_I.numMeasShtrp_C "Class instance: filter delay time of sensor voltage at transition rich-lean, sensor 2, bank 1 / number of necessary measurements for short trip" VALUE 0x8053EB5B RB_Val_Wu8 255.0 dez 0.00 255.0 FORMAT "%5.1" /end CHARACTERISTIC
/begin CHARACTERISTIC EGSDU_S2B1RtlFilDlyEvln_I.numMeas_C "Class instance: filter delay time of sensor voltage at transition rich-lean, sensor 2, bank 1 / Minimum number of Tests for Fast Initial Response and Step Change for EWMA-Filter" VALUE 0x8053EB5C RB_Val_Wu8 255.0 dez 0.00 255.0 FORMAT "%5.1" /end CHARACTERISTIC
/begin CHARACTERISTIC EGSDU_S2B1RtlFilDlyEvln_I.tiBndErrEvlnOffs_C "Class instance: filter delay time of sensor voltage at transition rich-lean, sensor 2, bank 1 / Offset correciont for the filtering Diagnosis incase of the vehicle in production Mode" VALUE 0x8053EB5E RB_Val_Ws16 655.3500 t_q0p01 -327.6800 327.6700 FORMAT "%8.4" /end CHARACTERISTIC
/begin CHARACTERISTIC EGSDU_S2B1RtlFilDlyEvln_I.tiIni_C "Class instance: filter delay time of sensor voltage at transition rich-lean, sensor 2, bank 1 / Initial value of dynamic time" VALUE 0x8053EB60 RB_Val_Ws16 655.3500 t_q0p01 -327.6800 327.6700 FORMAT "%8.4" /end CHARACTERISTIC
/begin CHARACTERISTIC EGSDU_S2B1RtlFilDlyEvln_I.tiStepChgCnf_C "Class instance: filter delay time of sensor voltage at transition rich-lean, sensor 2, bank 1 / Threshold (absolute) to confirm Step Change for EWMA-Filter" VALUE 0x8053EB62 RB_Val_Wu16 655.3500 t_q0p01 0.00 655.3500 FORMAT "%8.4" /end CHARACTERISTIC
/begin CHARACTERISTIC EGSDU_S2B1RtlFilDlyEvln_I.tiStepChgSus_C "Class instance: filter delay time of sensor voltage at transition rich-lean, sensor 2, bank 1 / Threshold (absolut) to trigger Step Change logic for EWMA-Filter" VALUE 0x8053EB64 RB_Val_Wu16 655.3500 t_q0p01 0.00 655.3500 FORMAT "%8.4" /end CHARACTERISTIC
/begin CHARACTERISTIC EGSDU_S2B1RtlFilTranEvln_I.facEwmaCodClr_C "Class instance: filter transition time of sensor voltage at transition rich-lean, sensor 2, bank 1 / Filter coefficient for EWMA filter during Code clear mode" VALUE 0x8053EB74 RB_Val_Wu8 0.9961 fak_ub_b1 0.00 0.9961 /end CHARACTERISTIC
/begin CHARACTERISTIC EGSDU_S2B1RtlFilTranEvln_I.facEwmaNorm_C "Class instance: filter transition time of sensor voltage at transition rich-lean, sensor 2, bank 1 / Filter coefficient for EWMA filter during normal mode" VALUE 0x8053EB75 RB_Val_Wu8 0.9961 fak_ub_b1 0.00 0.9961 /end CHARACTERISTIC
/begin CHARACTERISTIC EGSDU_S2B1RtlFilTranEvln_I.facEwmaStepChg_C "Class instance: filter transition time of sensor voltage at transition rich-lean, sensor 2, bank 1 / Filter coefficient for EWMA filter during Step Change mode" VALUE 0x8053EB76 RB_Val_Wu8 0.9961 fak_ub_b1 0.00 0.9961 /end CHARACTERISTIC
/begin CHARACTERISTIC EGSDU_S2B1RtlFilTranEvln_I.nrMeasCodClrTrip_C "Class instance: filter transition time of sensor voltage at transition rich-lean, sensor 2, bank 1 / Number of measurements needed for the EWMA filter in the current driving cycle during Code clear mode" VALUE 0x8053EB77 RB_Val_Wu8 255.0 dez 0.00 255.0 FORMAT "%5.1" /end CHARACTERISTIC
/begin CHARACTERISTIC EGSDU_S2B1RtlFilTranEvln_I.nrMeasCodClr_C "Class instance: filter transition time of sensor voltage at transition rich-lean, sensor 2, bank 1 / Number of measurements needed for the EWMA filter for result evaluation during Code clear mode" VALUE 0x8053EB78 RB_Val_Wu8 255.0 dez 0.00 255.0 FORMAT "%5.1" /end CHARACTERISTIC
/begin CHARACTERISTIC EGSDU_S2B1RtlFilTranEvln_I.nrMeasStepChgTrip_C "Class instance: filter transition time of sensor voltage at transition rich-lean, sensor 2, bank 1 / Number of measurements needed for the EWMA filter in the current driving cycle during Step Change Mode" VALUE 0x8053EB79 RB_Val_Wu8 255.0 dez 0.00 255.0 FORMAT "%5.1" /end CHARACTERISTIC
/begin CHARACTERISTIC EGSDU_S2B1RtlFilTranEvln_I.nrMeasStepChg_C "Class instance: filter transition time of sensor voltage at transition rich-lean, sensor 2, bank 1 / Number of measurements needed for the EWMA filter for result evaluation during Step Change mode" VALUE 0x8053EB7A RB_Val_Wu8 255.0 dez 0.00 255.0 FORMAT "%5.1" /end CHARACTERISTIC
/begin CHARACTERISTIC EGSDU_S2B1RtlFilTranEvln_I.numMeasShtrp_C "Class instance: filter transition time of sensor voltage at transition rich-lean, sensor 2, bank 1 / number of necessary measurements for short trip" VALUE 0x8053EB7B RB_Val_Wu8 255.0 dez 0.00 255.0 FORMAT "%5.1" /end CHARACTERISTIC
/begin CHARACTERISTIC EGSDU_S2B1RtlFilTranEvln_I.numMeas_C "Class instance: filter transition time of sensor voltage at transition rich-lean, sensor 2, bank 1 / Minimum number of Tests for Fast Initial Response and Step Change for EWMA-Filter" VALUE 0x8053EB7C RB_Val_Wu8 255.0 dez 0.00 255.0 FORMAT "%5.1" /end CHARACTERISTIC
/begin CHARACTERISTIC EGSDU_S2B1RtlFilTranEvln_I.tiBndErrEvlnOffs_C "Class instance: filter transition time of sensor voltage at transition rich-lean, sensor 2, bank 1 / Offset correciont for the filtering Diagnosis incase of the vehicle in production Mode" VALUE 0x8053EB7E RB_Val_Ws16 655.3500 t_q0p01 -327.6800 327.6700 FORMAT "%8.4" /end CHARACTERISTIC
/begin CHARACTERISTIC EGSDU_S2B1RtlFilTranEvln_I.tiIni_C "Class instance: filter transition time of sensor voltage at transition rich-lean, sensor 2, bank 1 / Initial value of dynamic time" VALUE 0x8053EB80 RB_Val_Ws16 655.3500 t_q0p01 -327.6800 327.6700 FORMAT "%8.4" /end CHARACTERISTIC
/begin CHARACTERISTIC EGSDU_S2B1RtlFilTranEvln_I.tiStepChgCnf_C "Class instance: filter transition time of sensor voltage at transition rich-lean, sensor 2, bank 1 / Threshold (absolute) to confirm Step Change for EWMA-Filter" VALUE 0x8053EB82 RB_Val_Wu16 655.3500 t_q0p01 0.00 655.3500 FORMAT "%8.4" /end CHARACTERISTIC
/begin CHARACTERISTIC EGSDU_S2B1RtlFilTranEvln_I.tiStepChgSus_C "Class instance: filter transition time of sensor voltage at transition rich-lean, sensor 2, bank 1 / Threshold (absolut) to trigger Step Change logic for EWMA-Filter" VALUE 0x8053EB84 RB_Val_Wu16 655.3500 t_q0p01 0.00 655.3500 FORMAT "%8.4" /end CHARACTERISTIC
/begin CHARACTERISTIC EGSDU_tiBgnRiInhbTran_C "Minimum time constant to activate the inhibit of binary sensor internal resistance measurement during transition time check" VALUE 0x8053EB8C RB_Val_Wu16 655.3500 t_q0p01 0.00 655.3500 FORMAT "%8.4" /end CHARACTERISTIC
/begin CHARACTERISTIC EGSDU_tiMaxPsblTran_M "Charakteristic map of the maximim transition time that is still plausible when taking onto account the results of the delay diagnosis" MAP 0x8053EB8E RB_Map_U16S16_U16 327.6700 t_q0p01 0.00 327.6700 FORMAT "%8.4" EXTENDED_LIMITS 0.00 655.3500
 /begin AXIS_DESCR STD_AXIS EGSDU_mfAvrgS2B1MeasRtlDly m_q0p1 8 0.00 6553.500 FORMAT "%8.3" DEPOSIT ABSOLUTE /end AXIS_DESCR
 /begin AXIS_DESCR STD_AXIS EGSDU_tiS2B1RtlNrmDly t_q0p01 8 -327.6800 327.6700 FORMAT "%8.4" DEPOSIT ABSOLUTE /end AXIS_DESCR
/end CHARACTERISTIC
/begin CHARACTERISTIC EGSDU_tiS2CoorrLtrTran_T "Characteristic Line for normalization of transition time lean-rich" CURVE 0x8053EC32 RB_Curve_U16_U16 655.3500 t_q0p01 0.00 655.3500 FORMAT "%8.4"
 /begin AXIS_DESCR STD_AXIS EGSDCmn_mfEgCat1B1Parl m_q0p1 6 0.00 6553.500 FORMAT "%8.3" DEPOSIT ABSOLUTE /end AXIS_DESCR
/end CHARACTERISTIC
/begin CHARACTERISTIC EGSDU_tiS2CoorrRtlTran_T "Characteristic Line for normalization of transition time rich-lean" CURVE 0x8053EC4C RB_Curve_U16_U16 655.3500 t_q0p01 0.00 655.3500 FORMAT "%8.4"
 /begin AXIS_DESCR STD_AXIS EGSDCmn_mfEgCat1B1Parl m_q0p1 6 0.00 6553.500 FORMAT "%8.3" DEPOSIT ABSOLUTE /end AXIS_DESCR
/end CHARACTERISTIC
/begin CHARACTERISTIC EGSDU_tiS2DlyAsymcThdEvln "Threshold to detect asymmetric transition time" VALUE 0x8053EAE6 RB_Val_Wu16 655.3500 t_q0p01 0.00 655.3500 FORMAT "%8.4" /end CHARACTERISTIC
/begin CHARACTERISTIC EGSDU_tiS2LtrBPUDlyEvln_C "threshold ""best performing unacceptable"" of delay time of sensor voltage for transition lean to rich, sensor 2" VALUE 0x8053EAE8 RB_Val_Wu16 655.3500 t_q0p01 0.00 655.3500 FORMAT "%8.4" /end CHARACTERISTIC
/begin CHARACTERISTIC EGSDU_tiS2LtrBPUTranEvln_C "threshold ""best performing unacceptable"" of transition time of sensor voltage for transition lean to rich, sensor 2" VALUE 0x8053EAEA RB_Val_Wu16 655.3500 t_q0p01 0.00 655.3500 FORMAT "%8.4" /end CHARACTERISTIC
/begin CHARACTERISTIC EGSDU_tiS2LtrErrDlyEvln_C "fault threshold of delay time of sensor voltage for transition lean to rich, sensor 2" VALUE 0x8053EAEC RB_Val_Wu16 655.3500 t_q0p01 0.00 655.3500 FORMAT "%8.4" /end CHARACTERISTIC
/begin CHARACTERISTIC EGSDU_tiS2LtrErrShtrpDlyEvln_C "threshold best performing unacceptable of transition time of sensor voltage for transition lean to rich in short trip, sensor 2" VALUE 0x8053EAEE RB_Val_Wu16 655.3500 t_q0p01 0.00 655.3500 FORMAT "%8.4" /end CHARACTERISTIC
/begin CHARACTERISTIC EGSDU_tiS2LtrErrShtrpTranEvln_C "fault threshold of transition time of sensor voltage during crossing lean to rich in short trip, sensor 2" VALUE 0x8053EAF0 RB_Val_Wu16 655.3500 t_q0p01 0.00 655.3500 FORMAT "%8.4" /end CHARACTERISTIC
/begin CHARACTERISTIC EGSDU_tiS2LtrErrTranEvln_C "fault threshold of transition time of sensor voltage during crossing lean to rich, sensor 2" VALUE 0x8053EAF2 RB_Val_Wu16 655.3500 t_q0p01 0.00 655.3500 FORMAT "%8.4" /end CHARACTERISTIC
/begin CHARACTERISTIC EGSDU_tiS2LtrInflDlyTran_C "Threshold for the correction of the cross-influence of the lean to rich transition time on the following rich to lean delay diagnosis, sensor 2" VALUE 0x8053EC66 RB_Val_Ws16 655.3500 t_q0p01 -327.6800 327.6700 FORMAT "%8.4" /end CHARACTERISTIC
/begin CHARACTERISTIC EGSDU_tiS2LtrSusTranEvln_C "threshold: transition time of sensor voltage for transition lean to rich has impact on measured delay, sensor 2" VALUE 0x8053EAF4 RB_Val_Wu16 655.3500 t_q0p01 0.00 655.3500 FORMAT "%8.4" /end CHARACTERISTIC
/begin CHARACTERISTIC EGSDU_tiS2RtlBPUDlyEvln_C "threshold ""best performing unacceptable"" of delay time of sensor voltage for transition rich to lean, sensor 2" VALUE 0x8053EAF6 RB_Val_Wu16 655.3500 t_q0p01 0.00 655.3500 FORMAT "%8.4" /end CHARACTERISTIC
/begin CHARACTERISTIC EGSDU_tiS2RtlBPUTranEvln_C "threshold ""best performing unacceptable"" of transition time of sensor voltage for transition rich to lean, sensor 2" VALUE 0x8053EAF8 RB_Val_Wu16 655.3500 t_q0p01 0.00 655.3500 FORMAT "%8.4" /end CHARACTERISTIC
/begin CHARACTERISTIC EGSDU_tiS2RtlErrDlyEvln_C "fault threshold of delay time of sensor voltage for transition rich to lean, sensor 2" VALUE 0x8053EAFA RB_Val_Wu16 655.3500 t_q0p01 0.00 655.3500 FORMAT "%8.4" /end CHARACTERISTIC
/begin CHARACTERISTIC EGSDU_tiS2RtlErrShtrpDlyEvln_C "fault threshold of delay time of sensor voltage for transition rich to lean in short trip, sensor 2" VALUE 0x8053EAFC RB_Val_Wu16 655.3500 t_q0p01 0.00 655.3500 FORMAT "%8.4" /end CHARACTERISTIC
/begin CHARACTERISTIC EGSDU_tiS2RtlErrShtrpTranEvln_C "fault threshold of transition time of sensor voltage during crossing rich to lean in short trip, sensor 2" VALUE 0x8053EAFE RB_Val_Wu16 655.3500 t_q0p01 0.00 655.3500 FORMAT "%8.4" /end CHARACTERISTIC
/begin CHARACTERISTIC EGSDU_tiS2RtlErrTranEvln_C "fault threshold of transition time of sensor voltage during crossing rich to lean, sensor 2" VALUE 0x8053EB00 RB_Val_Wu16 655.3500 t_q0p01 0.00 655.3500 FORMAT "%8.4" /end CHARACTERISTIC
/begin CHARACTERISTIC EGSDU_tiS2RtlInflDlyTran_C "Threshold for the correction of the cross-influence of the rich to lean transition time on the following lean to rich delay diagnosis, sensor 2" VALUE 0x8053EC68 RB_Val_Ws16 655.3500 t_q0p01 -327.6800 327.6700 FORMAT "%8.4" /end CHARACTERISTIC
/begin CHARACTERISTIC EGSDU_tiS2RtlSusTranEvln_C "threshold: transition time of sensor voltage for transition rich to lean has impact on measured delay, sensor 2" VALUE 0x8053EB02 RB_Val_Wu16 655.3500 t_q0p01 0.00 655.3500 FORMAT "%8.4" /end CHARACTERISTIC
/begin CHARACTERISTIC EGSDU_tiS2TranAsymcThdEvln "Threshold to detect asymmetric delay time" VALUE 0x8053EB04 RB_Val_Wu16 655.3500 t_q0p01 0.00 655.3500 FORMAT "%8.4" /end CHARACTERISTIC
/begin CHARACTERISTIC EGSDU_uEndLtrTran_C "sensor voltage to determinate the end of transition time check rich-lean" VALUE 0x8053EC6A RB_Val_Wu16 4.998779 spg_q1p221Em3_V 0.00 4.998779 FORMAT "%8.6" EXTENDED_LIMITS 0.00 79.99878 /end CHARACTERISTIC
/begin CHARACTERISTIC EGSDU_uEndRtlTran_C "Destination voltage to determinate the end of transition time check lean-rich" VALUE 0x8053EC6C RB_Val_Wu16 4.998779 spg_q1p221Em3_V 0.00 4.998779 FORMAT "%8.6" EXTENDED_LIMITS 0.00 79.99878 /end CHARACTERISTIC
/begin CHARACTERISTIC EGSPrepn_idxDmEgFlowArySnsr1Bnk1_C "ndex of exhaust-gas mass flow for sensor 1 bank 1 in the field of the exhaust-gas mass flows for Gasoline" VALUE 0x8053EC80 RB_Val_Wu8 255.0 OneToOne 0.00 255.0 FORMAT "%5.1" /end CHARACTERISTIC
/begin CHARACTERISTIC EGSSig_IntfrCorrn_T "" CURVE 0x8053F19C RB_Curve_U16_U8_Static 1.992188 fak_ub_b2 0.00 1.992188 FORMAT "%8.6"
 /begin AXIS_DESCR STD_AXIS NO_INPUT_QUANTITY fak_uw_b16 5 0.00 15.99976 FORMAT "%8.5" DEPOSIT ABSOLUTE /end AXIS_DESCR
/end CHARACTERISTIC
/begin CHARACTERISTIC EGSSig_LamCorrnDeIO2ChartcCrv_T "Lambda correction dependent on lambda for project-specific deviations from TCI characteristic curves" CURVE 0x8053F1AE RB_Curve_U16_S16_Static 15.99976 fak_q0p000244 -8.000000 7.999756 FORMAT "%8.6"
 /begin AXIS_DESCR STD_AXIS NO_INPUT_QUANTITY fak_q0p000244 16 0.00 15.99976 FORMAT "%8.5" DEPOSIT ABSOLUTE /end AXIS_DESCR
/end CHARACTERISTIC
/begin CHARACTERISTIC EGSSig_O2SigS1B1_I.LamCorrnDeIO2ChartcCrv_T "Class for calculation of oxygen signals and whose signal quality for sensor 1 bank 1 / Lambda correction dependent on lambda for project-specific deviations from TCI characteristic curves" CURVE 0x8053F1F8 RB_Curve_U16_S16_Static 15.99976 fak_q0p000244 -8.000000 7.999756 FORMAT "%8.6"
 /begin AXIS_DESCR STD_AXIS NO_INPUT_QUANTITY q4p88281Em4 16 0.00 31.99951 FORMAT "%8.5" DEPOSIT ABSOLUTE /end AXIS_DESCR
/end CHARACTERISTIC
/begin CHARACTERISTIC EGSSig_O2SigS1B1_I.LamCorrnDeIO2ChartcFlexfuelCrv_T "Class for calculation of oxygen signals and whose signal quality for sensor 1 bank 1 / Lambda correction dependent on lambda for project-specific deviations from TCI characteristic curves for flex fuel vehicle" CURVE 0x8053F23A RB_Curve_U16_S16_Static 15.99976 fak_q0p000244 -8.000000 7.999756 FORMAT "%8.6"
 /begin AXIS_DESCR STD_AXIS NO_INPUT_QUANTITY q4p88281Em4 16 0.00 31.99951 FORMAT "%8.5" DEPOSIT ABSOLUTE /end AXIS_DESCR
/end CHARACTERISTIC
/begin CHARACTERISTIC EGSSig_ratIntfrCorrnFlexfuMod_M "Map cross sensitivity correction in Lambda for FlexFuel" MAP 0x8053EC82 RB_Map_U8U16_S16 15.99976 fak_sw_b8 -8.000000 7.999756 FORMAT "%8.6"
 /begin AXIS_DESCR STD_AXIS Epm_nEngLRes nmot_q40 12 0.00 10200. FORMAT "%5.0" DEPOSIT ABSOLUTE /end AXIS_DESCR
 /begin AXIS_DESCR STD_AXIS rl_w_msg rel_uw_q0p0234 12 0.00 1535.977 FORMAT "%8.3" DEPOSIT ABSOLUTE /end AXIS_DESCR
/end CHARACTERISTIC
/begin CHARACTERISTIC EGSSig_ratIntfrCorrnFlexfuVHEMod_M "Map cross sensitivity correction in Lambda for FlexFuel at condition: high valve lift for timing of air charge determination" MAP 0x8053EDC8 RB_Map_U8U16_S16 15.99976 fak_sw_b8 -8.000000 7.999756 FORMAT "%8.6"
 /begin AXIS_DESCR STD_AXIS Epm_nEngLRes nmot_q40 12 0.00 10200. FORMAT "%5.0" DEPOSIT ABSOLUTE /end AXIS_DESCR
 /begin AXIS_DESCR STD_AXIS rl_w_msg rel_uw_q0p0234 12 0.00 1535.977 FORMAT "%8.3" DEPOSIT ABSOLUTE /end AXIS_DESCR
/end CHARACTERISTIC
/begin CHARACTERISTIC EGSSig_ratIntfrCorrnHomMod_M "Map cross sensitivity correction in Lambda for Homogeneous operation mode" MAP 0x8053EF0E RB_Map_U8U16_S16 15.99976 fak_sw_b8 -8.000000 7.999756 FORMAT "%8.6"
 /begin AXIS_DESCR STD_AXIS Epm_nEngLRes nmot_q40 12 0.00 10200. FORMAT "%5.0" DEPOSIT ABSOLUTE /end AXIS_DESCR
 /begin AXIS_DESCR STD_AXIS rl_w_msg rel_uw_q0p0234 12 0.00 1535.977 FORMAT "%8.3" DEPOSIT ABSOLUTE /end AXIS_DESCR
/end CHARACTERISTIC
/begin CHARACTERISTIC EGSSig_ratIntfrCorrnVHEMod_M "Map cross sensitivity correction in lambda for inlet valve lift" MAP 0x8053F054 RB_Map_U8U16_S16 15.99976 fak_sw_b8 -8.000000 7.999756 FORMAT "%8.6"
 /begin AXIS_DESCR STD_AXIS Epm_nEngLRes nmot_q40 12 0.00 10200. FORMAT "%5.0" DEPOSIT ABSOLUTE /end AXIS_DESCR
 /begin AXIS_DESCR STD_AXIS rl_w_msg rel_uw_q0p0234 12 0.00 1535.977 FORMAT "%8.3" DEPOSIT ABSOLUTE /end AXIS_DESCR
/end CHARACTERISTIC
/begin CHARACTERISTIC EGSSig_swtPSeln_C "Switch for selection of the pressure signal for pressure correction" VALUE 0x8053F1F0 RB_Val_Wboolean 1.00000000000 B_TRUE 0.00 1.00000000000 FORMAT "%13.11" /end CHARACTERISTIC
/begin CHARACTERISTIC EGSSig_tiConTrigFil_C "lowpass time constant for smoothing of original signal" VALUE 0x8053F19A RB_Val_Wu16 655.34999985 zk10msxs_uw_b655p36 0.01000015 655.36000000 FORMAT "%12.8" EXTENDED_LIMITS 0.010000152590 655.36000000 /end CHARACTERISTIC
/begin CHARACTERISTIC ElecLd_facEPSLd_C "factor for Electric load current" VALUE 0x805425DC Val_Ws16 1.000000 Fact 0.00 1.000000 FORMAT "%8.6" EXTENDED_LIMITS -4.000000 3.999878 /end CHARACTERISTIC
/begin CHARACTERISTIC ElecLd_iAirCmprGsl_C "Electric load current for Air Compressor switch ON mode in Gasoline engine" VALUE 0x805425DE RB_Val_Ws16 655.3500 Curr_A -327.6800 327.6700 FORMAT "%8.4" /end CHARACTERISTIC
/begin CHARACTERISTIC ElecLd_iBlowrFanAutoAC_CUR "Curve for Blower fan voltage level (Auto AC)" CURVE 0x805425E0 RB_Curve_S16_S16 655.3500 Curr_A -327.6800 327.6700 FORMAT "%8.4"
 /begin AXIS_DESCR STD_AXIS NO_INPUT_QUANTITY Volt_q1 16 0.00 100.0000 FORMAT "%8.4" EXTENDED_LIMITS -32768.00 32767.00 DEPOSIT ABSOLUTE /end AXIS_DESCR
/end CHARACTERISTIC
/begin CHARACTERISTIC ElecLd_iBlowrFanManAC_CUR "Curve for Blower fan voltage level (Manual AC)" CURVE 0x80542622 RB_Curve_S16_S16 100.0000 Curr_A 0.00 100.0000 FORMAT "%8.4" EXTENDED_LIMITS -327.6800 327.6700
 /begin AXIS_DESCR STD_AXIS ElecLd_uHeatrMot Volt_Batt 16 -655360.0 655340.0 FORMAT "%8.1" DEPOSIT ABSOLUTE /end AXIS_DESCR
/end CHARACTERISTIC
/begin CHARACTERISTIC ElecLd_iComBase_C "Additional Load Current" VALUE 0x80542664 RB_Val_Ws16 655.3500 Curr_A -327.6800 327.6700 FORMAT "%8.4" /end CHARACTERISTIC
/begin CHARACTERISTIC ElecLd_iComElecLoadReplcmt_C "EPS load current replacement value in case of communication error" VALUE 0x80542666 Val_Ws16 655.3500 Curr_A -327.6800 327.6700 FORMAT "%8.4" /end CHARACTERISTIC
/begin CHARACTERISTIC ElecLd_iComErrDftValGslAutAC_C "Default Auto AC Electric current for Com error in GS" VALUE 0x80542668 RB_Val_Ws16 655.3500 Curr_A -327.6800 327.6700 FORMAT "%8.4" /end CHARACTERISTIC
/begin CHARACTERISTIC ElecLd_iComErrDftValGslManAC_C "Default Auto AC Electric current for Com error in GS" VALUE 0x8054266A RB_Val_Ws16 655.3500 Curr_A -327.6800 327.6700 FORMAT "%8.4" /end CHARACTERISTIC
/begin CHARACTERISTIC ElecLd_iFan0_C "Electric load current value for fan off condition" VALUE 0x8054266C RB_Val_Ws16 655.3500 Curr_A -327.6800 327.6700 FORMAT "%8.4" /end CHARACTERISTIC
/begin CHARACTERISTIC ElecLd_iFan1_C "Electric load current value for fan low condition" VALUE 0x8054266E RB_Val_Ws16 655.3500 Curr_A -327.6800 327.6700 FORMAT "%8.4" /end CHARACTERISTIC
/begin CHARACTERISTIC ElecLd_iFan2_C "Electric load current value for fan high condition" VALUE 0x80542670 RB_Val_Ws16 655.3500 Curr_A -327.6800 327.6700 FORMAT "%8.4" /end CHARACTERISTIC
/begin CHARACTERISTIC ElecLd_iFanExt_C "Default value of electric load current for fan" VALUE 0x80542672 RB_Val_Ws16 655.3500 Curr_A -327.6800 327.6700 FORMAT "%8.4" /end CHARACTERISTIC
/begin CHARACTERISTIC ElecLd_iFrntDeicer1_C "Electric load current for Front de-icer switch ON mode" VALUE 0x80542674 RB_Val_Ws16 655.3500 Curr_A -327.6800 327.6700 FORMAT "%8.4" /end CHARACTERISTIC
/begin CHARACTERISTIC ElecLd_iFrntDeicerSwt_C "Electric load current for Front de-icer switch OFF mode" VALUE 0x80542676 RB_Val_Ws16 655.3500 Curr_A -327.6800 327.6700 FORMAT "%8.4" /end CHARACTERISTIC
/begin CHARACTERISTIC ElecLd_iFrntFog1_C "Electric load current for Front-fog lamp switch ON mode" VALUE 0x80542678 RB_Val_Ws16 655.3500 Curr_A -327.6800 327.6700 FORMAT "%8.4" /end CHARACTERISTIC
/begin CHARACTERISTIC ElecLd_iFrntFogSwt_C "Electric load current for Front-fog lamp switch OFF mode" VALUE 0x8054267A RB_Val_Ws16 655.3500 Curr_A -327.6800 327.6700 FORMAT "%8.4" /end CHARACTERISTIC
/begin CHARACTERISTIC ElecLd_iLiSwt0_C "Electric load current for light switch off condition" VALUE 0x8054267C RB_Val_Ws16 655.3500 Curr_A -327.6800 327.6700 FORMAT "%8.4" /end CHARACTERISTIC
/begin CHARACTERISTIC ElecLd_iLiSwt1_C "Electric load current for small light on condition" VALUE 0x8054267E RB_Val_Ws16 655.3500 Curr_A -327.6800 327.6700 FORMAT "%8.4" /end CHARACTERISTIC
/begin CHARACTERISTIC ElecLd_iLiSwt2_C "Electric load current for low beam" VALUE 0x80542680 RB_Val_Ws16 655.3500 Curr_A -327.6800 327.6700 FORMAT "%8.4" /end CHARACTERISTIC
/begin CHARACTERISTIC ElecLd_iLiSwt3_C "Electric load current for high beam" VALUE 0x80542682 RB_Val_Ws16 655.3500 Curr_A -327.6800 327.6700 FORMAT "%8.4" /end CHARACTERISTIC
/begin CHARACTERISTIC ElecLd_iReDeFoggerAutoAC1_C "Electric load current for Rear de-fogger (Auto AC) switch ON mode" VALUE 0x80542684 RB_Val_Ws16 655.3500 Curr_A -327.6800 327.6700 FORMAT "%8.4" /end CHARACTERISTIC
/begin CHARACTERISTIC ElecLd_iReDeFoggerAutoACSwt_C "Electric load current for Rear de-fogger (Auto AC) switch OFF mode" VALUE 0x80542686 RB_Val_Ws16 655.3500 Curr_A -327.6800 327.6700 FORMAT "%8.4" /end CHARACTERISTIC
/begin CHARACTERISTIC ElecLd_iReDeFoggerManAC1_C "Electric load current for Rear de-fogger (Manual AC) switch ON mode" VALUE 0x80542688 RB_Val_Ws16 655.3500 Curr_A -327.6800 327.6700 FORMAT "%8.4" /end CHARACTERISTIC
/begin CHARACTERISTIC ElecLd_iReDeFoggerManACSwt_C "Electric load current for Rear de-fogger (Manual AC) switch OFF mode" VALUE 0x8054268A RB_Val_Ws16 655.3500 Curr_A -327.6800 327.6700 FORMAT "%8.4" /end CHARACTERISTIC
/begin CHARACTERISTIC ElecLd_iReFog1_C "Electric load current for Rear-fog lamp switch ON mode" VALUE 0x8054268C RB_Val_Ws16 655.3500 Curr_A -327.6800 327.6700 FORMAT "%8.4" /end CHARACTERISTIC
/begin CHARACTERISTIC ElecLd_iReFogSwt_C "Electric load current for Rear-fog lamp switch OFF mode" VALUE 0x8054268E RB_Val_Ws16 655.3500 Curr_A -327.6800 327.6700 FORMAT "%8.4" /end CHARACTERISTIC
/begin CHARACTERISTIC ElecLd_iWiprHi_C "Electric load current for Wiper switch High mode" VALUE 0x80542690 RB_Val_Ws16 655.3500 Curr_A -327.6800 327.6700 FORMAT "%8.4" /end CHARACTERISTIC
/begin CHARACTERISTIC ElecLd_iWiprLo_C "Wiper low calibration" VALUE 0x80542692 RB_Val_Ws16 655.3500 Curr_A -327.6800 327.6700 FORMAT "%8.4" /end CHARACTERISTIC
/begin CHARACTERISTIC ElecLd_iWiprOffErr_C "Wiper off error calibration current" VALUE 0x80542694 RB_Val_Ws16 655.3500 Curr_A -327.6800 327.6700 FORMAT "%8.4" /end CHARACTERISTIC
/begin CHARACTERISTIC ElecLd_RmpSlp.Pos_C "Structure containing ramp slopes for response in case of errors in the analog signal read from the Electric load / Slope if the ramp has to be increased" VALUE 0x80590CAC Kw_Ws32 327679.499817 RmpCurr_A 0.500031 327679.999847 FORMAT "%13.6" EXTENDED_LIMITS -327680.000000 327679.999847 /end CHARACTERISTIC
/begin CHARACTERISTIC ElecLd_RmpSlp.Neg_C "Structure containing ramp slopes for response in case of errors in the analog signal read from the Electric load / negative ramp slope" VALUE 0x80590CB0 Kw_Ws32 327679.499817 RmpCurr_A 0.500031 327679.999847 FORMAT "%13.6" EXTENDED_LIMITS -327680.000000 327679.999847 /end CHARACTERISTIC
/begin CHARACTERISTIC ElecLd_stSwtHdLiInfoSeln_C "Head light information selection switch status" VALUE 0x80542696 RB_Val_Wu8 1.000 OneToOne 0.00 1.000 FORMAT "%5.3" EXTENDED_LIMITS 0.00 255.0 /end CHARACTERISTIC
/begin CHARACTERISTIC ElecLd_swtCurrMdl_C "Electric Load current value Model switch" VALUE 0x80542697 RB_Val_Wu8 1.000 OneToOne 0.00 1.000 FORMAT "%5.3" EXTENDED_LIMITS 0.00 255.0 /end CHARACTERISTIC
/begin CHARACTERISTIC ElecLd_swtEPSLd_C "switch to select Electric load current" VALUE 0x80542698 RB_Val_Wu8 1.000 OneToOne 0.00 1.000 FORMAT "%5.3" EXTENDED_LIMITS 0.00 255.0 /end CHARACTERISTIC
/begin CHARACTERISTIC ElecLd_tiAirCdnLrng_C "Timer for AC learning" VALUE 0x8054269A RB_Val_Ws16 655.3400 t_q0p02 0.00 655.3400 FORMAT "%8.4" EXTENDED_LIMITS -655.3600 655.3400 /end CHARACTERISTIC
/begin CHARACTERISTIC ElecLd_tiLdFltPT1_C "Time constant of the PT1 filter for Electric load current" VALUE 0x8054269C RB_Val_Ws32 4294.9672940000000 TimeDelay_s 0.0000020000000 4294.9672959999998 FORMAT "%19.14" EXTENDED_LIMITS 0.000002000000001 4294.9672959999998 /end CHARACTERISTIC
/begin CHARACTERISTIC ElecLd_tiMdlLoadCalc_C "Time constant of the PT1 filter for the modelled load current" VALUE 0x805426A0 RB_Val_Ws32 4294.9672940000000 TimeDelay_s 0.0000020000000 4294.9672959999998 FORMAT "%19.14" EXTENDED_LIMITS 0.000002000000001 4294.9672959999998 /end CHARACTERISTIC
/begin CHARACTERISTIC ElecLd_tiPT1FltEPSLd_C "Time constant of the PT1 filter for the EPS load current" VALUE 0x805426A4 RB_Val_Ws32 4294.9672940000000 TimeDelay_s 0.0000020000000 4294.9672959999998 FORMAT "%19.14" EXTENDED_LIMITS 0.000002000000001 4294.9672959999998 /end CHARACTERISTIC
/begin CHARACTERISTIC ElecLd_TransStg.Dfl_C "Structure containing fixed replacement values and the status word to decide the response in case of errors in the analog signal read from the Electric load sensor loa / Fixed replacement value" VALUE 0x80590CB4 Kw_Ws16 327.6700 Curr_A 0.00 327.6700 FORMAT "%8.4" EXTENDED_LIMITS -327.6800 327.6700 /end CHARACTERISTIC
/begin CHARACTERISTIC ElecLd_TransStg.stSensId_C "Structure containing fixed replacement values and the status word to decide the response in case of errors in the analog signal read from the Electric load sensor loa / Sensor Id word" VALUE 0x80590CB6 Kw_Wu8 255.0 OneToOne 0.00 255.0 FORMAT "%5.1" /end CHARACTERISTIC
/begin CHARACTERISTIC EngDa_pwrCrksftMax_C "Engine reference power at crankshaft level" VALUE 0x805426A8 RB_Val_Wr32 16777215.99000 RBPtCel_pwr_kw_1p0_1 0.01000 16777216.00000 FORMAT "%20.5" EXTENDED_LIMITS -3.40282E+038 3.40282E+038 /end CHARACTERISTIC
/begin CHARACTERISTIC EngDa_tqCrksftMax_C "Engine reference torque torque at crankshaft level" VALUE 0x805426AC RB_Val_Wr32 16777215.90000 RBPtCel_tq_1p0_1 0.10000 16777216.00000 FORMAT "%16.5" EXTENDED_LIMITS -3.40282E+038 3.40282E+038 /end CHARACTERISTIC
/begin CHARACTERISTIC EngDa_tqInnrMax_C "Maximum indicated Engine torque torque" VALUE 0x805426B0 RB_Val_Wr32 16777215.90000 RBPtCel_tq_1p0_1 0.10000 16777216.00000 FORMAT "%16.5" EXTENDED_LIMITS -3.40282E+038 3.40282E+038 /end CHARACTERISTIC
/begin CHARACTERISTIC EngDa_volDispl_C "Engine displacement" VALUE 0x805426B4 RB_Val_Wr32 16777215.99000 RBPtCel_vol_1p0_1 0.01000 16777216.00000 FORMAT "%16.5" EXTENDED_LIMITS -3.40282E+038 3.40282E+038 /end CHARACTERISTIC
/begin CHARACTERISTIC EngDem_dTqSlpLimnNeg_T "Negative slopes for the torque limitation ramp for individual error entries" VAL_BLK 0x805426B8 RB_ValA_Ws32 3276799.99847 RmpTrq 0.00 3276799.99847 FORMAT "%13.5" EXTENDED_LIMITS -3276800.00000 3276799.99847 NUMBER 4 /end CHARACTERISTIC
/begin CHARACTERISTIC EngDem_dTqSlpLimnPos_T "Positive slopes for the torque limitation ramp for individual error entries" VAL_BLK 0x805426C8 RB_ValA_Ws32 3276799.99847 RmpTrq 0.00 3276799.99847 FORMAT "%13.5" EXTENDED_LIMITS -3276800.00000 3276799.99847 NUMBER 4 /end CHARACTERISTIC
/begin CHARACTERISTIC EngDem_flgFcoEna_C "Fuel cut-off enable flag" VALUE 0x805426D8 RB_Val_Wu8 1.00000000000 B_TRUE 0.00 1.00000000000 FORMAT "%13.11" /end CHARACTERISTIC
/begin CHARACTERISTIC EngDem_idxMapTqLimnInjMod_CA "Choice of injection modes for the activation of torque limitaton" CURVE 0x805426D9 RB_FixCurve_U8_U8 1.000 OneToOne 0.00 1.000 FORMAT "%5.3" EXTENDED_LIMITS 0.00 255.0
 /begin AXIS_DESCR FIX_AXIS InjSys_stInjMod InjSys_InjMode_Set_COMPU_VERB 20 0.00 19.0000000000 FORMAT "%13.10" FIX_AXIS_PAR 0 0 20 /end AXIS_DESCR
/end CHARACTERISTIC
/begin CHARACTERISTIC EngDem_nrRampSlpCfg_T "Configuration index for positive and negative ramping slopes" VAL_BLK 0x805426ED RB_ValA_Wu8 3.000 OneToOne 0.00 3.000 FORMAT "%5.3" EXTENDED_LIMITS 0.00 255.0 NUMBER 23 /end CHARACTERISTIC
/begin CHARACTERISTIC EngDem_swtTqLimnCfg_C "Configuration of the error cases for ramping switch-off at condition target reached" VALUE 0x80542704 RB_Val_Wu32 4294967295.00 OneToOne 0.00 4294967295.00 FORMAT "%13.2" /end CHARACTERISTIC
/begin CHARACTERISTIC EngDem_swtTqLimnRmpReIni_C "Configuration of the re-initialisation of the ramp when current torque leis bellow ramping value" VALUE 0x80542708 RB_Val_Wu32 4294967295.00 OneToOne 0.00 4294967295.00 FORMAT "%13.2" /end CHARACTERISTIC
/begin CHARACTERISTIC EngDem_tiRampIniRst_C "Ramp initialisation time after engine start" VALUE 0x8054270C RB_Val_Wu8 2.550 Time_s 0.00 2.550 FORMAT "%5.3" /end CHARACTERISTIC
/begin CHARACTERISTIC EngDem_tqLimnCamsftErr_T "Torque limitation due to camshaft errors" CURVE 0x8054270E RB_Curve_S16_S16 1000.000 Trq 0.00 1000.000 FORMAT "%8.3" EXTENDED_LIMITS -3276.800 3276.700
 /begin AXIS_DESCR STD_AXIS Epm_nEng EngN 6 -16384.00 16383.50 FORMAT "%8.2" DEPOSIT ABSOLUTE /end AXIS_DESCR
/end CHARACTERISTIC
/begin CHARACTERISTIC EngDem_tqLimnInjMod_T "Torque limitation at choice of injection modes" CURVE 0x80542728 RB_Curve_S16_S16 1000.000 Trq 0.00 1000.000 FORMAT "%8.3" EXTENDED_LIMITS -3276.800 3276.700
 /begin AXIS_DESCR STD_AXIS Epm_nEng EngN 7 -16384.00 16383.50 FORMAT "%8.2" DEPOSIT ABSOLUTE /end AXIS_DESCR
/end CHARACTERISTIC
/begin CHARACTERISTIC EngDem_tqLimnOilPmp_T "Curve torque limitation due to error in the oil pump" CURVE 0x80542746 RB_Curve_S16_S16 1000.000 Trq 0.00 1000.000 FORMAT "%8.3" EXTENDED_LIMITS -3276.800 3276.700
 /begin AXIS_DESCR STD_AXIS Epm_nEng EngN 7 -16384.00 16383.50 FORMAT "%8.2" DEPOSIT ABSOLUTE /end AXIS_DESCR
/end CHARACTERISTIC
/begin CHARACTERISTIC EngDem_tqLimnThmstHeatCtrlCirc_T "Torque limitation in the case of failure due to condition of thermostat heater circuit open" CURVE 0x80542764 RB_Curve_S16_S16 1000.000 Trq 0.00 1000.000 FORMAT "%8.3" EXTENDED_LIMITS -3276.800 3276.700
 /begin AXIS_DESCR STD_AXIS Epm_nEng EngN 8 -16384.00 16383.50 FORMAT "%8.2" DEPOSIT ABSOLUTE /end AXIS_DESCR
/end CHARACTERISTIC
/begin CHARACTERISTIC EngDem_trqLimErrAPP_CUR "Torque limitation in case of DK/PWR failure" CURVE 0x80542786 RB_Curve_S16_S16 1000.000 Trq 0.00 1000.000 FORMAT "%8.3" EXTENDED_LIMITS -3276.800 3276.700
 /begin AXIS_DESCR STD_AXIS Epm_nEng EngN 8 -16384.00 16383.50 FORMAT "%8.2" DEPOSIT ABSOLUTE /end AXIS_DESCR
/end CHARACTERISTIC
/begin MEASUREMENT B_elsxbb_msg "error LS upstream catalyst resetting operational readiness" UBYTE B_TRUE 1 100 0.00 1.00000000000 BIT_MASK 0x1 FORMAT "%13.11" ECU_ADDRESS 0x6000F26A /end MEASUREMENT
/begin MEASUREMENT B_sbblsu_msg "condition for sensor LSU upstream cat ready for operation f(lamsons_w)" UBYTE B_TRUE 1 100 0.00 1.00000000000 BIT_MASK 0x1 FORMAT "%13.11" ECU_ADDRESS 0x6000F228 /end MEASUREMENT
/begin MEASUREMENT B_sbbvk_msg "condition for lambda sensor upstream cat ready for operation" UBYTE B_TRUE 1 100 0.00 1.00000000000 BIT_MASK 0x1 FORMAT "%13.11" ECU_ADDRESS 0x6000F227 /end MEASUREMENT
/begin MEASUREMENT Com_bCVTIdleStop "Status of idle stop request" UBYTE B_TRUE 1 100 0.00 1.00000000000 BIT_MASK 0x1 FORMAT "%13.11" ECU_ADDRESS 0x6000F184 /end MEASUREMENT
/begin MEASUREMENT Com_bCVTStopEna "Status of Preparation for Idle Stop" UBYTE B_TRUE 1 100 0.00 1.00000000000 BIT_MASK 0x1 FORMAT "%13.11" ECU_ADDRESS 0x6000F183 /end MEASUREMENT
/begin MEASUREMENT Com_ctCRingENG1 "Message counter for ENG1 frame ( message counter)" UBYTE OneToOne 1 100 0.00 3.000 FORMAT "%5.3" ECU_ADDRESS 0x6000F6CD /end MEASUREMENT
/begin MEASUREMENT Com_ctCRingENG10 "Ring counter for ENG10 frame" UBYTE OneToOne 1 100 0.00 255.0 FORMAT "%5.1" ECU_ADDRESS 0x6000F019 /end MEASUREMENT
/begin MEASUREMENT Com_ctCRingENG11 "Ring counter for ENG11 frame" UBYTE OneToOne 1 100 0.00 255.0 FORMAT "%5.1" ECU_ADDRESS 0x6000F018 /end MEASUREMENT
/begin MEASUREMENT Com_ctCRingENG15 "CAN RingCounter for ENG15 Frame" UBYTE OneToOne 1 100 0.00 255.0 FORMAT "%5.1" ECU_ADDRESS 0x6000F6D1 /end MEASUREMENT
/begin MEASUREMENT Com_ctCRingENG16 "Message counter for Eng16 frame" UBYTE OneToOne 1 100 0.00 255.0 FORMAT "%5.1" ECU_ADDRESS 0x6000F6D0 /end MEASUREMENT
/begin MEASUREMENT Com_ctCRingENG17 "the message Counter for ENG17 frame" UBYTE OneToOne 1 100 0.00 255.0 FORMAT "%5.1" ECU_ADDRESS 0x6000F6CF /end MEASUREMENT
/begin MEASUREMENT Com_ctCRingENG18 "Message counter for Eng18 frame" UBYTE OneToOne 1 100 0.00 3.000 FORMAT "%5.3" ECU_ADDRESS 0x6000F6CE /end MEASUREMENT
/begin MEASUREMENT Com_flgACReq "A/C Clutch Connection Status" UBYTE OneToOne 1 100 0.00 255.0 FORMAT "%5.1" ECU_ADDRESS 0x6000F697 /end MEASUREMENT
/begin MEASUREMENT Com_flgCylIndFcoStrtd "Condition: overrun fuel cut-off" UBYTE OneToOne 1 100 0.00 255.0 FORMAT "%5.1" ECU_ADDRESS 0x6000F693 /end MEASUREMENT
/begin MEASUREMENT Com_flgFcoRdy "Fuel Cut ready state" UBYTE OneToOne 1 100 0.00 255.0 FORMAT "%5.1" ECU_ADDRESS 0x6000F690 /end MEASUREMENT
/begin MEASUREMENT Com_flgVirtApp "ENG_APOPEN virtual gas pedal status" UBYTE OneToOne 1 100 0.00 255.0 FORMAT "%5.1" ECU_ADDRESS 0x6000F68C /end MEASUREMENT
/begin MEASUREMENT Com_nEngSpd "current engine speed" SWORD EngN 1 100 -16384.00 16383.50 FORMAT "%8.2" ECU_ADDRESS 0x600092AC /end MEASUREMENT
/begin MEASUREMENT Com_nrCsumENG15 "Checksum for ENG15 frame." UBYTE OneToOne 1 100 0.00 255.0 FORMAT "%5.1" ECU_ADDRESS 0x6000F688 /end MEASUREMENT
/begin MEASUREMENT Com_nSetPLo "Low Idle SetPoint Speed" SWORD EngN 1 100 -16384.00 16383.50 FORMAT "%8.2" ECU_ADDRESS 0x600092A4 /end MEASUREMENT
/begin MEASUREMENT Com_numCsumENG1 "Checksum message for frame ENG1" UBYTE OneToOne 1 100 0.00 15.00 FORMAT "%5.2" ECU_ADDRESS 0x6000F671 /end MEASUREMENT
/begin MEASUREMENT Com_numCsumENG10 "Checksum for ENG10 frame" UBYTE OneToOne 1 100 0.00 255.0 FORMAT "%5.1" ECU_ADDRESS 0x6000EFEF /end MEASUREMENT
/begin MEASUREMENT Com_numCsumENG11 "Checksum for ENG11 frame" UBYTE OneToOne 1 100 0.00 255.0 FORMAT "%5.1" ECU_ADDRESS 0x6000EFEE /end MEASUREMENT
/begin MEASUREMENT Com_numCsumENG16 "Checksum message for Eng16 frame" UBYTE OneToOne 1 100 0.00 255.0 FORMAT "%5.1" ECU_ADDRESS 0x6000F674 /end MEASUREMENT
/begin MEASUREMENT Com_numCsumENG17 "The Checksum for ENG17 frame" UBYTE OneToOne 1 100 0.00 255.0 FORMAT "%5.1" ECU_ADDRESS 0x6000F673 /end MEASUREMENT
/begin MEASUREMENT Com_numCsumENG18 "Checksum message for Eng18 frame" UBYTE OneToOne 1 100 0.00 15.00 FORMAT "%5.2" ECU_ADDRESS 0x6000F672 /end MEASUREMENT
/begin MEASUREMENT Com_pEnvPRaw "Raw value for Ambient pressure value transmitted on the CAN" UWORD Pres_1_kPa 1 100 0.00 65535.00 FORMAT "%8.2" ECU_ADDRESS 0x60008D10 /end MEASUREMENT
/begin MEASUREMENT Com_rDrvAccrPedlPosn "Com message of Accelerator Pedal opening for IUPR message" UWORD q0p005_Perc 1 100 0.00 327.6750 FORMAT "%8.4" ECU_ADDRESS 0x60008D08 /end MEASUREMENT
/begin MEASUREMENT Com_rThrVlvAct "Throttle valve angle" SWORD Com_deg_q0p02441 1 100 -800.0000 799.9756 FORMAT "%8.4" ECU_ADDRESS 0x6000927E /end MEASUREMENT
/begin MEASUREMENT Com_stAltFail "Fail information for Alternator" UBYTE OneToOne 1 100 0.00 255.0 FORMAT "%5.1" ECU_ADDRESS 0x6000F61F /end MEASUREMENT
/begin MEASUREMENT Com_stEngCooltTFail "Fail information for Engine coolant temperature" UBYTE OneToOne 1 100 0.00 255.0 FORMAT "%5.1" ECU_ADDRESS 0x6000F5C9 /end MEASUREMENT
/begin MEASUREMENT Com_stEngIntkAirFail "Fail information for Engine intake air temperature" UBYTE OneToOne 1 100 0.00 255.0 FORMAT "%5.1" ECU_ADDRESS 0x6000F5C7 /end MEASUREMENT
/begin MEASUREMENT Com_stEngSpd30DegFail "Fail information of engine speed 30deg" UBYTE OneToOne 1 100 0.00 255.0 FORMAT "%5.1" ECU_ADDRESS 0x6000F5C1 /end MEASUREMENT
/begin MEASUREMENT Com_stEngStop "Engine Stop status" UBYTE OneToOne 1 100 0.00 255.0 FORMAT "%5.1" ECU_ADDRESS 0x6000F5C0 /end MEASUREMENT
/begin MEASUREMENT Com_stPBSensFail "Fail information for manifold pressure by TDC" UBYTE OneToOne 1 100 0.00 255.0 FORMAT "%5.1" ECU_ADDRESS 0x6000F565 /end MEASUREMENT
/begin MEASUREMENT Com_stThrPosnFail "Fail information relating to DBW" UBYTE OneToOne 1 100 0.00 255.0 FORMAT "%5.1" ECU_ADDRESS 0x6000F526 /end MEASUREMENT
/begin MEASUREMENT Com_stTqRvsnEnaFlg "Status of Torque slippage breakdown existence flag" UBYTE OneToOne 1 100 0.00 1.000 FORMAT "%5.3" ECU_ADDRESS 0x6000F524 /end MEASUREMENT
/begin MEASUREMENT Com_stTrqAccuracySlow "Slow torque required accuracy deterioration" UBYTE OneToOne 1 100 0.00 255.0 FORMAT "%5.1" ECU_ADDRESS 0x6000F523 /end MEASUREMENT
/begin MEASUREMENT Com_stTrqReqFast "Prohibition of fast torque requests" UBYTE OneToOne 1 100 0.00 255.0 FORMAT "%5.1" ECU_ADDRESS 0x6000F522 /end MEASUREMENT
/begin MEASUREMENT Com_stTrqReqSlow "Prohibition of slow torque requests" UBYTE OneToOne 1 100 0.00 255.0 FORMAT "%5.1" ECU_ADDRESS 0x6000F521 /end MEASUREMENT
/begin MEASUREMENT Com_swtDrvMod "Control state of ECON transmitted on CAN" UBYTE OneToOne 1 100 0.00 255.0 FORMAT "%5.1" ECU_ADDRESS 0x6000F4FD /end MEASUREMENT
/begin MEASUREMENT Com_tiExptFcoStrt "Timer till FC starts Down Counter" ULONG Time_ms_to_us 1 100 0.00 4294967.29500 FORMAT "%13.5" ECU_ADDRESS 0x50004DB8 /end MEASUREMENT
/begin MEASUREMENT Com_tiHACCut "Timer information for AC cut" UWORD t_q1_ms 1 100 0.00 65535.00 FORMAT "%8.2" ECU_ADDRESS 0x60008CFC /end MEASUREMENT
/begin MEASUREMENT EGSDU_ctReIni100msEvlnDs "Reini counter" UBYTE OneToOne 1 100 0.00 255.0 FORMAT "%5.1" ECU_ADDRESS 0x6000B1ED /end MEASUREMENT
/begin MEASUREMENT EGSDU_ctReIni100msTranDs "ReIni counter" UBYTE OneToOne 1 100 0.00 255.0 FORMAT "%5.1" ECU_ADDRESS 0x600140AE /end MEASUREMENT
/begin MEASUREMENT EGSDU_ctReIni10msEvlnDs "ReIni counter" UBYTE OneToOne 1 100 0.00 255.0 FORMAT "%5.1" ECU_ADDRESS 0x6000F455 /end MEASUREMENT
/begin MEASUREMENT EGSDU_ctReIni10msTranDs "ReIni counter" UBYTE OneToOne 1 100 0.00 255.0 FORMAT "%5.1" ECU_ADDRESS 0x6000B1EC /end MEASUREMENT
/begin MEASUREMENT EGSDU_flgDSMClrTranDs "DSM Clr STatus Msg for TranDs" UBYTE B_TRUE 1 100 0.00 1.00000000000 BIT_MASK 0x1 FORMAT "%13.11" ECU_ADDRESS 0x700002E3 /end MEASUREMENT
/begin MEASUREMENT EGSDU_flgRstEvlnParl "Reset of internal variables for Feature Multiple Parallelization executions" UBYTE B_TRUE 1 100 0.00 1.00000000000 BIT_MASK 0x1 FORMAT "%13.11" ECU_ADDRESS 0x700002E4 /end MEASUREMENT
/begin MEASUREMENT EGSDU_flgS2B1AsymcFltEvln "asymmetric dynamic behavior detected in sensor 2 bank 1" UBYTE B_TRUE 1 100 0.00 1.00000000000 BIT_MASK 0x1 FORMAT "%13.11" ECU_ADDRESS 0x700009D3 /end MEASUREMENT
/begin MEASUREMENT EGSDU_flgS2B1InhbRiEvln "Inhibit RI measurement for dynamic of sensor voltage, sensor 2, bank 1" UBYTE B_TRUE 1 100 0.00 1.00000000000 BIT_MASK 0x1 FORMAT "%13.11" ECU_ADDRESS 0x700009D1 /end MEASUREMENT
/begin MEASUREMENT EGSDU_flgS2B1InhbRiTran "Inhibit RI measurement for transition time measurement of sensor voltage, sensor 2, bank 1" UBYTE B_TRUE 1 100 0.00 1.00000000000 BIT_MASK 0x1 FORMAT "%13.11" ECU_ADDRESS 0x700009D0 /end MEASUREMENT
/begin MEASUREMENT EGSDU_flgS2B1LtrInflDlyTran "Lean to rich transition influences rich to lean delay diagnosis, sensor 2 bank 1" UBYTE B_TRUE 1 100 0.00 1.00000000000 BIT_MASK 0x1 FORMAT "%13.11" ECU_ADDRESS 0x700009CF /end MEASUREMENT
/begin MEASUREMENT EGSDU_flgS2B1LtrMeasTran "Measurement of transition time of sensor voltage at transition lean-rich is running, sensor 2, bank 1" UBYTE B_TRUE 1 100 0.00 1.00000000000 BIT_MASK 0x1 FORMAT "%13.11" ECU_ADDRESS 0x700002E2 /end MEASUREMENT
/begin MEASUREMENT EGSDU_flgS2B1QPFaildDynEvln "Quick pass failed at evaluation dynamic diagnosis for sensor voltage of lambda sensors downstream catalyst, sensor 2, bank 1" UBYTE B_TRUE 1 100 0.00 1.00000000000 BIT_MASK 0x1 FORMAT "%13.11" ECU_ADDRESS 0x700009CE /end MEASUREMENT
/begin MEASUREMENT EGSDU_flgS2B1ResLtrDlyEvln "fault check delay time of sensor voltage at transition lean to rich is finished, sensor 2, bank 1" UBYTE B_TRUE 1 100 0.00 1.00000000000 BIT_MASK 0x1 FORMAT "%13.11" ECU_ADDRESS 0x700009CC /end MEASUREMENT
/begin MEASUREMENT EGSDU_flgS2B1ResLtrTran "Single measurement transition time of sensor voltage at transition lean-rich is finished, sensor 2, bank 1" UBYTE B_TRUE 1 100 0.00 1.00000000000 BIT_MASK 0x1 FORMAT "%13.11" ECU_ADDRESS 0x700009CB /end MEASUREMENT
/begin MEASUREMENT EGSDU_flgS2B1ResLtrTranEvln "fault check transition time of sensor voltage at transition lean to rich is finished, sensor 2, bank 1" UBYTE B_TRUE 1 100 0.00 1.00000000000 BIT_MASK 0x1 FORMAT "%13.11" ECU_ADDRESS 0x700009CA /end MEASUREMENT
/begin MEASUREMENT EGSDU_flgS2B1ResRtlDlyEvln "fault check delay time of sensor voltage at transition rich to lean is finished, sensor 2, bank 1" UBYTE B_TRUE 1 100 0.00 1.00000000000 BIT_MASK 0x1 FORMAT "%13.11" ECU_ADDRESS 0x700009C8 /end MEASUREMENT
/begin MEASUREMENT EGSDU_flgS2B1ResRtlTran "Single measurement transition time of sensor voltage at transition rich-lean is finished, sensor 2, bank 1" UBYTE B_TRUE 1 100 0.00 1.00000000000 BIT_MASK 0x1 FORMAT "%13.11" ECU_ADDRESS 0x700009C7 /end MEASUREMENT
/begin MEASUREMENT EGSDU_flgS2B1ResRtlTranEvln "fault check transition time of sensor voltage at transition rich to lean is finished, sensor 2, bank 1" UBYTE B_TRUE 1 100 0.00 1.00000000000 BIT_MASK 0x1 FORMAT "%13.11" ECU_ADDRESS 0x700009C6 /end MEASUREMENT
/begin MEASUREMENT EGSDU_flgS2B1ResVirtLtrDlyEvln "IUMPR simulation of delay time of sensor voltage at transition lean to rich is finished, sensor 2, bank 1" UBYTE B_TRUE 1 100 0.00 1.00000000000 BIT_MASK 0x1 FORMAT "%13.11" ECU_ADDRESS 0x700009C4 /end MEASUREMENT
/begin MEASUREMENT EGSDU_flgS2B1ResVirtLtrTran "IUMPR simulation of single measurement transition time of sensor voltage at transition lean-rich is finished, sensor 2, bank 1" UBYTE B_TRUE 1 100 0.00 1.00000000000 BIT_MASK 0x1 FORMAT "%13.11" ECU_ADDRESS 0x700009C3 /end MEASUREMENT
/begin MEASUREMENT EGSDU_flgS2B1ResVirtLtrTranEvln "IUMPR simulation of transition time of sensor voltage at transition lean to rich is finished, sensor 2, bank 1" UBYTE B_TRUE 1 100 0.00 1.00000000000 BIT_MASK 0x1 FORMAT "%13.11" ECU_ADDRESS 0x700009C2 /end MEASUREMENT
/begin MEASUREMENT EGSDU_flgS2B1ResVirtRtlActvTran "Condition: Virtual (IUMPR) for transition time measurement O2-sensor in active procedure executed (Sensor 2, Bank 1)" UBYTE B_TRUE 1 100 0.00 1.00000000000 BIT_MASK 0x1 FORMAT "%13.11" ECU_ADDRESS 0x700002E1 /end MEASUREMENT
/begin MEASUREMENT EGSDU_flgS2B1ResVirtRtlDlyEvln "IUMPR simulation of delay time of sensor voltage at transition rich to lean is finished, sensor 2, bank 1" UBYTE B_TRUE 1 100 0.00 1.00000000000 BIT_MASK 0x1 FORMAT "%13.11" ECU_ADDRESS 0x700009C0 /end MEASUREMENT
/begin MEASUREMENT EGSDU_flgS2B1ResVirtRtlTran "IUMPR simulation of single measurement transition time of sensor voltage at transition rich-lean is finished, sensor 2, bank 1" UBYTE B_TRUE 1 100 0.00 1.00000000000 BIT_MASK 0x1 FORMAT "%13.11" ECU_ADDRESS 0x700009BF /end MEASUREMENT
/begin MEASUREMENT EGSDU_flgS2B1ResVirtRtlTranEvln "IUMPR simulation of transition time of sensor voltage at transition rich to lean is finished, sensor 2, bank 1" UBYTE B_TRUE 1 100 0.00 1.00000000000 BIT_MASK 0x1 FORMAT "%13.11" ECU_ADDRESS 0x700009BE /end MEASUREMENT
/begin MEASUREMENT EGSDU_flgS2B1RtlInflDlyTran "Rich to lean transition influences lean to rich delay diagnosis, sensor 2 bank 1" UBYTE B_TRUE 1 100 0.00 1.00000000000 BIT_MASK 0x1 FORMAT "%13.11" ECU_ADDRESS 0x700009BD /end MEASUREMENT
/begin MEASUREMENT EGSDU_flgS2B1RtlMeasTran "Measurement of transition time of sensor voltage at transition rich-lean is running, sensor 2, bank 1" UBYTE B_TRUE 1 100 0.00 1.00000000000 BIT_MASK 0x1 FORMAT "%13.11" ECU_ADDRESS 0x700002E0 /end MEASUREMENT
/begin MEASUREMENT EGSDU_flgS2B1TarLeanResEvln "range check of lean target sensor voltage is completed and evaluated, sensor 2, bank 1" UBYTE B_TRUE 1 100 0.00 1.00000000000 BIT_MASK 0x1 FORMAT "%13.11" ECU_ADDRESS 0x700009BC /end MEASUREMENT
/begin MEASUREMENT EGSDU_flgS2B1TarLeanResVirtEvln "IUMPR simulation of range check of lean target sensor voltage is completed and evaluated" UBYTE B_TRUE 1 100 0.00 1.00000000000 BIT_MASK 0x1 FORMAT "%13.11" ECU_ADDRESS 0x700009BB /end MEASUREMENT
/begin MEASUREMENT EGSDU_flgS2B1TarRichResEvln "range check of rich target sensor voltage is completed and evaluated, sensor 2, bank 1" UBYTE B_TRUE 1 100 0.00 1.00000000000 BIT_MASK 0x1 FORMAT "%13.11" ECU_ADDRESS 0x700009BA /end MEASUREMENT
/begin MEASUREMENT EGSDU_flgS2B1TarRichResVirtEvln "IUMPR simulation of range check of rich target sensor voltage is completed and evaluated" UBYTE B_TRUE 1 100 0.00 1.00000000000 BIT_MASK 0x1 FORMAT "%13.11" ECU_ADDRESS 0x700009B9 /end MEASUREMENT
/begin MEASUREMENT EGSDU_flgS2B1TripLtrDlyEvln "fault check delay time of sensor voltage at transition lean to rich is for this driving cycle finished, sensor 2, bank 1" UBYTE B_TRUE 1 100 0.00 1.00000000000 BIT_MASK 0x1 FORMAT "%13.11" ECU_ADDRESS 0x700009B8 /end MEASUREMENT
/begin MEASUREMENT EGSDU_flgS2B1TripLtrTranEvln "fault check delay time of sensor voltage at transition lean to rich is for this driving cycle finished, sensor 2, bank 1" UBYTE B_TRUE 1 100 0.00 1.00000000000 BIT_MASK 0x1 FORMAT "%13.11" ECU_ADDRESS 0x700009B7 /end MEASUREMENT
/begin MEASUREMENT EGSDU_flgS2B1TripRtlDlyEvln "fault check delay time of sensor voltage at transition rich to lean is for this driving cycle finished, sensor 2, bank 1" UBYTE B_TRUE 1 100 0.00 1.00000000000 BIT_MASK 0x1 FORMAT "%13.11" ECU_ADDRESS 0x700009B6 /end MEASUREMENT
/begin MEASUREMENT EGSDU_flgS2B1TripRtlTranEvln "fault check delay time of sensor voltage at transition rich to lean is for this driving cycle finished, sensor 2, bank 1" UBYTE B_TRUE 1 100 0.00 1.00000000000 BIT_MASK 0x1 FORMAT "%13.11" ECU_ADDRESS 0x700009B5 /end MEASUREMENT
/begin MEASUREMENT EGSDU_flgS2B1TripVirtLtrDlyEvln "IUMPR simulation of delay time of sensor voltage at transition lean to rich is for this driving cycle finished, sensor 2, bank 1" UBYTE B_TRUE 1 100 0.00 1.00000000000 BIT_MASK 0x1 FORMAT "%13.11" ECU_ADDRESS 0x700009B4 /end MEASUREMENT
/begin MEASUREMENT EGSDU_flgS2B1TripVirtLtrTranEvln "IUMPR simulation of transition time of sensor voltage at transition lean to rich is for this driving cycle finished, sensor 2, bank 1" UBYTE B_TRUE 1 100 0.00 1.00000000000 BIT_MASK 0x1 FORMAT "%13.11" ECU_ADDRESS 0x700009B3 /end MEASUREMENT
/begin MEASUREMENT EGSDU_flgS2B1TripVirtRtlDlyEvln "IUMPR simulation of delay time of sensor voltage at transition rich to lean is for this driving cycle finished, sensor 2, bank 1" UBYTE B_TRUE 1 100 0.00 1.00000000000 BIT_MASK 0x1 FORMAT "%13.11" ECU_ADDRESS 0x700009B2 /end MEASUREMENT
/begin MEASUREMENT EGSDU_flgS2B1TripVirtRtlTranEvln "IUMPR simulation of transition time of sensor voltage at transition rich to lean is for this driving cycle finished, sensor 2, bank 1" UBYTE B_TRUE 1 100 0.00 1.00000000000 BIT_MASK 0x1 FORMAT "%13.11" ECU_ADDRESS 0x700009B1 /end MEASUREMENT
/begin MEASUREMENT EGSDU_flgS2B1VirtQPFaildDynEvln "virtual Quick pass failed at evaluation dynamic diagnosis for sensor voltage of lambda sensors downstream catalyst, sensor 2, bank 1" UBYTE B_TRUE 1 100 0.00 1.00000000000 BIT_MASK 0x1 FORMAT "%13.11" ECU_ADDRESS 0x700009B0 /end MEASUREMENT
/begin MEASUREMENT EGSDU_S2B1LtrFilDlyEvln_I.flgErrEwmaQckFail "Class instance: filter delay time of sensor voltage at transition lean-rich, sensor 2, bank 1 / Quick fail detection logic flag for EWMA filtering" UBYTE B_TRUE 1 100 0.00 1.00000000000 BIT_MASK 0x1 FORMAT "%13.11" ECU_ADDRESS 0x60002C94 /end MEASUREMENT
/begin MEASUREMENT EGSDU_S2B1LtrFilDlyEvln_I.flgFCMClrReqdCL100ms "Class instance: filter delay time of sensor voltage at transition lean-rich, sensor 2, bank 1 / FCM clear status flag" UBYTE B_TRUE 1 100 0.00 1.00000000000 BIT_MASK 0x1 FORMAT "%13.11" ECU_ADDRESS 0x60002C95 /end MEASUREMENT
/begin MEASUREMENT EGSDU_S2B1LtrFilDlyEvln_I.flgFCMClrReqdCL10ms "Class instance: filter delay time of sensor voltage at transition lean-rich, sensor 2, bank 1 / FCM clear status flag" UBYTE B_TRUE 1 100 0.00 1.00000000000 BIT_MASK 0x1 FORMAT "%13.11" ECU_ADDRESS 0x60007286 /end MEASUREMENT
/begin MEASUREMENT EGSDU_S2B1LtrFilDlyEvln_I.flgQckPassd "Class instance: filter delay time of sensor voltage at transition lean-rich, sensor 2, bank 1 / Condition: the diagnosis has quick pass" UBYTE B_TRUE 1 100 0.00 1.00000000000 BIT_MASK 0x1 FORMAT "%13.11" ECU_ADDRESS 0x60002C96 /end MEASUREMENT
/begin MEASUREMENT EGSDU_S2B1LtrFilDlyEvln_I.flgQckPassdFaild "Class instance: filter delay time of sensor voltage at transition lean-rich, sensor 2, bank 1 / Condition: the diagnosis doesnt have quick pass" UBYTE B_TRUE 1 100 0.00 1.00000000000 BIT_MASK 0x1 FORMAT "%13.11" ECU_ADDRESS 0x60002C97 /end MEASUREMENT
/begin MEASUREMENT EGSDU_S2B1LtrFilDlyEvln_I.flgRes "Class instance: filter delay time of sensor voltage at transition lean-rich, sensor 2, bank 1 / Condition: result available (single measurement)" UBYTE B_TRUE 1 100 0.00 1.00000000000 BIT_MASK 0x1 FORMAT "%13.11" ECU_ADDRESS 0x60002C98 /end MEASUREMENT
/begin MEASUREMENT EGSDU_S2B1LtrFilDlyEvln_I.flgResFil "Class instance: filter delay time of sensor voltage at transition lean-rich, sensor 2, bank 1 / Condition: filtered result available" UBYTE B_TRUE 1 100 0.00 1.00000000000 BIT_MASK 0x1 FORMAT "%13.11" ECU_ADDRESS 0x60002C99 /end MEASUREMENT
/begin MEASUREMENT EGSDU_S2B1LtrFilDlyEvln_I.flgResVirt "Class instance: filter delay time of sensor voltage at transition lean-rich, sensor 2, bank 1 / single measurement for IUMPR is finished" UBYTE B_TRUE 1 100 0.00 1.00000000000 BIT_MASK 0x1 FORMAT "%13.11" ECU_ADDRESS 0x60002C9A /end MEASUREMENT
/begin MEASUREMENT EGSDU_S2B1LtrFilDlyEvln_I.flgResVirtFil "Class instance: filter delay time of sensor voltage at transition lean-rich, sensor 2, bank 1 / Condition: Numerator Complete (internal)" UBYTE B_TRUE 1 100 0.00 1.00000000000 BIT_MASK 0x1 FORMAT "%13.11" ECU_ADDRESS 0x60002C9B /end MEASUREMENT
/begin MEASUREMENT EGSDU_S2B1LtrFilDlyEvln_I.flgResVirtTmp "Class instance: filter delay time of sensor voltage at transition lean-rich, sensor 2, bank 1 / IUMPR simulation is finished for the fault check" UBYTE B_TRUE 1 100 0.00 1.00000000000 BIT_MASK 0x1 FORMAT "%13.11" ECU_ADDRESS 0x60002C9C /end MEASUREMENT
/begin MEASUREMENT EGSDU_S2B1LtrFilDlyEvln_I.flgTrip "Class instance: filter delay time of sensor voltage at transition lean-rich, sensor 2, bank 1 / fault check is for this driving clycle finished" UBYTE B_TRUE 1 100 0.00 1.00000000000 BIT_MASK 0x1 FORMAT "%13.11" ECU_ADDRESS 0x60002C9D /end MEASUREMENT
/begin MEASUREMENT EGSDU_S2B1LtrFilDlyEvln_I.flgTripVirt "Class instance: filter delay time of sensor voltage at transition lean-rich, sensor 2, bank 1 / IUMPR simulation is for this driving cycle finished" UBYTE B_TRUE 1 100 0.00 1.00000000000 BIT_MASK 0x1 FORMAT "%13.11" ECU_ADDRESS 0x60002C9E /end MEASUREMENT
/begin MEASUREMENT EGSDU_S2B1LtrFilDlyEvln_I.flgVirtQckFaild "Class instance: filter delay time of sensor voltage at transition lean-rich, sensor 2, bank 1 / Condition: virtual Quickpass failed is set" UBYTE B_TRUE 1 100 0.00 1.00000000000 BIT_MASK 0x1 FORMAT "%13.11" ECU_ADDRESS 0x60002C9F /end MEASUREMENT
/begin MEASUREMENT EGSDU_S2B1LtrFilDlyEvln_I.numMeas "Class instance: filter delay time of sensor voltage at transition lean-rich, sensor 2, bank 1 / Number of measurements" UBYTE dez 1 100 0.00 255.0 FORMAT "%5.1" ECU_ADDRESS 0x600390F2 /end MEASUREMENT
/begin MEASUREMENT EGSDU_S2B1LtrFilDlyEvln_I.numMeasShtrp "Class instance: filter delay time of sensor voltage at transition lean-rich, sensor 2, bank 1 / number of measurements for short trip" UBYTE dez 1 100 0.00 255.0 FORMAT "%5.1" ECU_ADDRESS 0x60002CA0 /end MEASUREMENT
/begin MEASUREMENT EGSDU_S2B1LtrFilDlyEvln_I.numMeasTrip "Class instance: filter delay time of sensor voltage at transition lean-rich, sensor 2, bank 1 / number of measurement in this driving clycle" UBYTE dez 1 100 0.00 255.0 FORMAT "%5.1" ECU_ADDRESS 0x60002CA1 /end MEASUREMENT
/begin MEASUREMENT EGSDU_S2B1LtrFilDlyEvln_I.numVirtMeas "Class instance: filter delay time of sensor voltage at transition lean-rich, sensor 2, bank 1 / Number of virtual measurements (IUMPR)" UBYTE dez 1 100 0.00 255.0 FORMAT "%5.1" ECU_ADDRESS 0x600390F3 /end MEASUREMENT
/begin MEASUREMENT EGSDU_S2B1LtrFilDlyEvln_I.numVirtMeasTrip "Class instance: filter delay time of sensor voltage at transition lean-rich, sensor 2, bank 1 / Number of virtual measurements (IUMPR) in this driving clycle in case of step change" UBYTE dez 1 100 0.00 255.0 FORMAT "%5.1" ECU_ADDRESS 0x60002CA2 /end MEASUREMENT
/begin MEASUREMENT EGSDU_S2B1LtrFilDlyEvln_I.stEwmaMod "Class instance: filter delay time of sensor voltage at transition lean-rich, sensor 2, bank 1 / Current mode of EWMA filter" UBYTE OneToOne 1 100 0.00 2.000 FORMAT "%5.3" ECU_ADDRESS 0x600390F4 /end MEASUREMENT
/begin MEASUREMENT EGSDU_S2B1LtrFilDlyEvln_I.stEwmaVirtMod "Class instance: filter delay time of sensor voltage at transition lean-rich, sensor 2, bank 1 / Current mode of EWMA filter for IUMPR Simulation" UBYTE OneToOne 1 100 0.00 2.000 FORMAT "%5.3" ECU_ADDRESS 0x600390F5 /end MEASUREMENT
/begin MEASUREMENT EGSDU_S2B1LtrFilDlyEvln_I.ti "Class instance: filter delay time of sensor voltage at transition lean-rich, sensor 2, bank 1 / result of dynamic measurement" SWORD t_q0p01 1 100 -327.6800 327.6700 FORMAT "%8.4" ECU_ADDRESS 0x60007288 /end MEASUREMENT
/begin MEASUREMENT EGSDU_S2B1LtrFilDlyEvln_I.tiArth "Class instance: filter delay time of sensor voltage at transition lean-rich, sensor 2, bank 1 / value of aritmetic-filter" SWORD t_q0p01 1 100 -327.6800 327.6700 FORMAT "%8.4" ECU_ADDRESS 0x600390F6 /end MEASUREMENT
/begin MEASUREMENT EGSDU_S2B1LtrFilDlyEvln_I.tiEwma "Class instance: filter delay time of sensor voltage at transition lean-rich, sensor 2, bank 1 / Value of EWMA-Filter (word)" SWORD t_q0p01 1 100 -327.6800 327.6700 FORMAT "%8.4" ECU_ADDRESS 0x600390F8 /end MEASUREMENT
/begin MEASUREMENT EGSDU_S2B1LtrFilDlyEvln_I.tiFil "Class instance: filter delay time of sensor voltage at transition lean-rich, sensor 2, bank 1 / filtered result of dynamic measurement" UWORD t_q0p01 1 100 0.00 655.3500 FORMAT "%8.4" ECU_ADDRESS 0x600390FA /end MEASUREMENT
/begin MEASUREMENT EGSDU_S2B1LtrFilDlyEvln_I.tiQuickPass "Class instance: filter delay time of sensor voltage at transition lean-rich, sensor 2, bank 1 / Threshold for quick pass" SWORD t_q0p01 1 100 -327.6800 327.6700 FORMAT "%8.4" ECU_ADDRESS 0x60002CA4 /end MEASUREMENT
/begin MEASUREMENT EGSDU_S2B1LtrFilDlyEvln_I.ResFF_I.status "Class instance: filter delay time of sensor voltage at transition lean-rich, sensor 2, bank 1 / FlipFlop: result available (single measurement) / current value of RS-FF" UBYTE B_TRUE 1 100 0.00 1.00000000000 BIT_MASK 0x1 FORMAT "%13.11" ECU_ADDRESS 0x6000728A /end MEASUREMENT
/begin MEASUREMENT EGSDU_S2B1LtrFilDlyEvln_I.tiArithShtrpDL_I.memory "Class instance: filter delay time of sensor voltage at transition lean-rich, sensor 2, bank 1 / aritmetic filter for short trip / current lowpass value" SLONG q1p5259Em7_s 1 100 -327.680000000 327.679999847 FORMAT "%13.9" ECU_ADDRESS 0x60002CA8 /end MEASUREMENT
/begin MEASUREMENT EGSDU_S2B1LtrFilDlyEvln_I.tiArthDL_I.memory "Class instance: filter delay time of sensor voltage at transition lean-rich, sensor 2, bank 1 / aritmetic filter / current lowpass value" SLONG q1p5259Em7_s 1 100 -327.680000000 327.679999847 FORMAT "%13.9" ECU_ADDRESS 0x60002CAC /end MEASUREMENT
/begin MEASUREMENT EGSDU_S2B1LtrFilDlyEvln_I.tiEwmaDL_I.memory "Class instance: filter delay time of sensor voltage at transition lean-rich, sensor 2, bank 1 / Value of EWMA-Filter (Digital Low Pass) / current lowpass value" SLONG q1p5259Em7_s 1 100 -327.680000000 327.679999847 FORMAT "%13.9" ECU_ADDRESS 0x60002CB0 /end MEASUREMENT
/begin MEASUREMENT EGSDU_S2B1LtrFilTranEvln_I.flgErrEwmaQckFail "Class instance: filter transition time of sensor voltage at transition lean-rich, sensor 2, bank 1 / Quick fail detection logic flag for EWMA filtering" UBYTE B_TRUE 1 100 0.00 1.00000000000 BIT_MASK 0x1 FORMAT "%13.11" ECU_ADDRESS 0x60002C74 /end MEASUREMENT
/begin MEASUREMENT EGSDU_S2B1LtrFilTranEvln_I.flgFCMClrReqdCL100ms "Class instance: filter transition time of sensor voltage at transition lean-rich, sensor 2, bank 1 / FCM clear status flag" UBYTE B_TRUE 1 100 0.00 1.00000000000 BIT_MASK 0x1 FORMAT "%13.11" ECU_ADDRESS 0x60002C75 /end MEASUREMENT
/begin MEASUREMENT EGSDU_S2B1LtrFilTranEvln_I.flgFCMClrReqdCL10ms "Class instance: filter transition time of sensor voltage at transition lean-rich, sensor 2, bank 1 / FCM clear status flag" UBYTE B_TRUE 1 100 0.00 1.00000000000 BIT_MASK 0x1 FORMAT "%13.11" ECU_ADDRESS 0x60007280 /end MEASUREMENT
/begin MEASUREMENT EGSDU_S2B1LtrFilTranEvln_I.flgQckPassd "Class instance: filter transition time of sensor voltage at transition lean-rich, sensor 2, bank 1 / Condition: the diagnosis has quick pass" UBYTE B_TRUE 1 100 0.00 1.00000000000 BIT_MASK 0x1 FORMAT "%13.11" ECU_ADDRESS 0x60002C76 /end MEASUREMENT
/begin MEASUREMENT EGSDU_S2B1LtrFilTranEvln_I.flgQckPassdFaild "Class instance: filter transition time of sensor voltage at transition lean-rich, sensor 2, bank 1 / Condition: the diagnosis doesnt have quick pass" UBYTE B_TRUE 1 100 0.00 1.00000000000 BIT_MASK 0x1 FORMAT "%13.11" ECU_ADDRESS 0x60002C77 /end MEASUREMENT
/begin MEASUREMENT EGSDU_S2B1LtrFilTranEvln_I.flgRes "Class instance: filter transition time of sensor voltage at transition lean-rich, sensor 2, bank 1 / Condition: result available (single measurement)" UBYTE B_TRUE 1 100 0.00 1.00000000000 BIT_MASK 0x1 FORMAT "%13.11" ECU_ADDRESS 0x60002C78 /end MEASUREMENT
/begin MEASUREMENT EGSDU_S2B1LtrFilTranEvln_I.flgResFil "Class instance: filter transition time of sensor voltage at transition lean-rich, sensor 2, bank 1 / Condition: filtered result available" UBYTE B_TRUE 1 100 0.00 1.00000000000 BIT_MASK 0x1 FORMAT "%13.11" ECU_ADDRESS 0x60002C79 /end MEASUREMENT
/begin MEASUREMENT EGSDU_S2B1LtrFilTranEvln_I.flgResVirt "Class instance: filter transition time of sensor voltage at transition lean-rich, sensor 2, bank 1 / single measurement for IUMPR is finished" UBYTE B_TRUE 1 100 0.00 1.00000000000 BIT_MASK 0x1 FORMAT "%13.11" ECU_ADDRESS 0x60002C7A /end MEASUREMENT
/begin MEASUREMENT EGSDU_S2B1LtrFilTranEvln_I.flgResVirtFil "Class instance: filter transition time of sensor voltage at transition lean-rich, sensor 2, bank 1 / Condition: Numerator Complete (internal)" UBYTE B_TRUE 1 100 0.00 1.00000000000 BIT_MASK 0x1 FORMAT "%13.11" ECU_ADDRESS 0x60002C7B /end MEASUREMENT
/begin MEASUREMENT EGSDU_S2B1LtrFilTranEvln_I.flgResVirtTmp "Class instance: filter transition time of sensor voltage at transition lean-rich, sensor 2, bank 1 / IUMPR simulation is finished for the fault check" UBYTE B_TRUE 1 100 0.00 1.00000000000 BIT_MASK 0x1 FORMAT "%13.11" ECU_ADDRESS 0x60002C7C /end MEASUREMENT
/begin MEASUREMENT EGSDU_S2B1LtrFilTranEvln_I.flgTrip "Class instance: filter transition time of sensor voltage at transition lean-rich, sensor 2, bank 1 / fault check is for this driving clycle finished" UBYTE B_TRUE 1 100 0.00 1.00000000000 BIT_MASK 0x1 FORMAT "%13.11" ECU_ADDRESS 0x60002C7D /end MEASUREMENT
/begin MEASUREMENT EGSDU_S2B1LtrFilTranEvln_I.flgTripVirt "Class instance: filter transition time of sensor voltage at transition lean-rich, sensor 2, bank 1 / IUMPR simulation is for this driving cycle finished" UBYTE B_TRUE 1 100 0.00 1.00000000000 BIT_MASK 0x1 FORMAT "%13.11" ECU_ADDRESS 0x60002C7E /end MEASUREMENT
/begin MEASUREMENT EGSDU_S2B1LtrFilTranEvln_I.flgVirtQckFaild "Class instance: filter transition time of sensor voltage at transition lean-rich, sensor 2, bank 1 / Condition: virtual Quickpass failed is set" UBYTE B_TRUE 1 100 0.00 1.00000000000 BIT_MASK 0x1 FORMAT "%13.11" ECU_ADDRESS 0x60002C7F /end MEASUREMENT
/begin MEASUREMENT EGSDU_S2B1LtrFilTranEvln_I.numMeas "Class instance: filter transition time of sensor voltage at transition lean-rich, sensor 2, bank 1 / Number of measurements" UBYTE dez 1 100 0.00 255.0 FORMAT "%5.1" ECU_ADDRESS 0x600390E8 /end MEASUREMENT
/begin MEASUREMENT EGSDU_S2B1LtrFilTranEvln_I.numMeasShtrp "Class instance: filter transition time of sensor voltage at transition lean-rich, sensor 2, bank 1 / number of measurements for short trip" UBYTE dez 1 100 0.00 255.0 FORMAT "%5.1" ECU_ADDRESS 0x60002C80 /end MEASUREMENT
/begin MEASUREMENT EGSDU_S2B1LtrFilTranEvln_I.numMeasTrip "Class instance: filter transition time of sensor voltage at transition lean-rich, sensor 2, bank 1 / number of measurement in this driving clycle" UBYTE dez 1 100 0.00 255.0 FORMAT "%5.1" ECU_ADDRESS 0x60002C81 /end MEASUREMENT
/begin MEASUREMENT EGSDU_S2B1LtrFilTranEvln_I.numVirtMeas "Class instance: filter transition time of sensor voltage at transition lean-rich, sensor 2, bank 1 / Number of virtual measurements (IUMPR)" UBYTE dez 1 100 0.00 255.0 FORMAT "%5.1" ECU_ADDRESS 0x600390E9 /end MEASUREMENT
/begin MEASUREMENT EGSDU_S2B1LtrFilTranEvln_I.numVirtMeasTrip "Class instance: filter transition time of sensor voltage at transition lean-rich, sensor 2, bank 1 / Number of virtual measurements (IUMPR) in this driving clycle in case of step change" UBYTE dez 1 100 0.00 255.0 FORMAT "%5.1" ECU_ADDRESS 0x60002C82 /end MEASUREMENT
/begin MEASUREMENT EGSDU_S2B1LtrFilTranEvln_I.stEwmaMod "Class instance: filter transition time of sensor voltage at transition lean-rich, sensor 2, bank 1 / Current mode of EWMA filter" UBYTE OneToOne 1 100 0.00 2.000 FORMAT "%5.3" ECU_ADDRESS 0x600390EA /end MEASUREMENT
/begin MEASUREMENT EGSDU_S2B1LtrFilTranEvln_I.stEwmaVirtMod "Class instance: filter transition time of sensor voltage at transition lean-rich, sensor 2, bank 1 / Current mode of EWMA filter for IUMPR Simulation" UBYTE OneToOne 1 100 0.00 2.000 FORMAT "%5.3" ECU_ADDRESS 0x600390EB /end MEASUREMENT
/begin MEASUREMENT EGSDU_S2B1LtrFilTranEvln_I.ti "Class instance: filter transition time of sensor voltage at transition lean-rich, sensor 2, bank 1 / result of dynamic measurement" SWORD t_q0p01 1 100 -327.6800 327.6700 FORMAT "%8.4" ECU_ADDRESS 0x60007282 /end MEASUREMENT
/begin MEASUREMENT EGSDU_S2B1LtrFilTranEvln_I.tiArth "Class instance: filter transition time of sensor voltage at transition lean-rich, sensor 2, bank 1 / value of aritmetic-filter" SWORD t_q0p01 1 100 -327.6800 327.6700 FORMAT "%8.4" ECU_ADDRESS 0x600390EC /end MEASUREMENT
/begin MEASUREMENT EGSDU_S2B1LtrFilTranEvln_I.tiEwma "Class instance: filter transition time of sensor voltage at transition lean-rich, sensor 2, bank 1 / Value of EWMA-Filter (word)" SWORD t_q0p01 1 100 -327.6800 327.6700 FORMAT "%8.4" ECU_ADDRESS 0x600390EE /end MEASUREMENT
/begin MEASUREMENT EGSDU_S2B1LtrFilTranEvln_I.tiFil "Class instance: filter transition time of sensor voltage at transition lean-rich, sensor 2, bank 1 / filtered result of dynamic measurement" UWORD t_q0p01 1 100 0.00 655.3500 FORMAT "%8.4" ECU_ADDRESS 0x600390F0 /end MEASUREMENT
/begin MEASUREMENT EGSDU_S2B1LtrFilTranEvln_I.tiQuickPass "Class instance: filter transition time of sensor voltage at transition lean-rich, sensor 2, bank 1 / Threshold for quick pass" SWORD t_q0p01 1 100 -327.6800 327.6700 FORMAT "%8.4" ECU_ADDRESS 0x60002C84 /end MEASUREMENT
/begin MEASUREMENT EGSDU_S2B1LtrFilTranEvln_I.ResFF_I.status "Class instance: filter transition time of sensor voltage at transition lean-rich, sensor 2, bank 1 / FlipFlop: result available (single measurement) / current value of RS-FF" UBYTE B_TRUE 1 100 0.00 1.00000000000 BIT_MASK 0x1 FORMAT "%13.11" ECU_ADDRESS 0x60007284 /end MEASUREMENT
/begin MEASUREMENT EGSDU_S2B1LtrFilTranEvln_I.tiArithShtrpDL_I.memory "Class instance: filter transition time of sensor voltage at transition lean-rich, sensor 2, bank 1 / aritmetic filter for short trip / current lowpass value" SLONG q1p5259Em7_s 1 100 -327.680000000 327.679999847 FORMAT "%13.9" ECU_ADDRESS 0x60002C88 /end MEASUREMENT
/begin MEASUREMENT EGSDU_S2B1LtrFilTranEvln_I.tiArthDL_I.memory "Class instance: filter transition time of sensor voltage at transition lean-rich, sensor 2, bank 1 / aritmetic filter / current lowpass value" SLONG q1p5259Em7_s 1 100 -327.680000000 327.679999847 FORMAT "%13.9" ECU_ADDRESS 0x60002C8C /end MEASUREMENT
/begin MEASUREMENT EGSDU_S2B1LtrFilTranEvln_I.tiEwmaDL_I.memory "Class instance: filter transition time of sensor voltage at transition lean-rich, sensor 2, bank 1 / Value of EWMA-Filter (Digital Low Pass) / current lowpass value" SLONG q1p5259Em7_s 1 100 -327.680000000 327.679999847 FORMAT "%13.9" ECU_ADDRESS 0x60002C90 /end MEASUREMENT
/begin MEASUREMENT EGSDU_S2B1LtrMeasActvDur_I.flgMeasRprtTran "Class instance denoting active transition measurement for lean to rich transition measurement for Sensor 2 Bank 1 / ." UBYTE B_TRUE 1 100 0.00 1.00000000000 BIT_MASK 0x1 FORMAT "%13.11" ECU_ADDRESS 0x60007242 /end MEASUREMENT
/begin MEASUREMENT EGSDU_S2B1LtrMeasActvDur_I.flgPlausRdy "Class instance denoting active transition measurement for lean to rich transition measurement for Sensor 2 Bank 1 / plausibilization concluded" UBYTE B_TRUE 1 100 0.00 1.00000000000 BIT_MASK 0x1 FORMAT "%13.11" ECU_ADDRESS 0x60007243 /end MEASUREMENT
/begin MEASUREMENT EGSDU_S2B1LtrMeasActvDur_I.stParlOld "Class instance denoting active transition measurement for lean to rich transition measurement for Sensor 2 Bank 1 / Value of last calculation step: status of state machine of lambda shifting from coordinator function of parallelization" UBYTE dez 1 100 0.00 255.0 FORMAT "%5.1" ECU_ADDRESS 0x60007244 /end MEASUREMENT
/begin MEASUREMENT EGSDU_S2B1LtrMeasActvDur_I.flgActvMeasTranFF_I.status "Class instance denoting active transition measurement for lean to rich transition measurement for Sensor 2 Bank 1 / Lean to rich transition measurement active / current value of RS-FF" UBYTE B_TRUE 1 100 0.00 1.00000000000 BIT_MASK 0x1 FORMAT "%13.11" ECU_ADDRESS 0x60007245 /end MEASUREMENT
/begin MEASUREMENT EGSDU_S2B1LtrMeasActvDur_I.flgWaitDlyFinshdFF_I.status "Class instance denoting active transition measurement for lean to rich transition measurement for Sensor 2 Bank 1 / wait for delay diagnosis / current value of RS-FF" UBYTE B_TRUE 1 100 0.00 1.00000000000 BIT_MASK 0x1 FORMAT "%13.11" ECU_ADDRESS 0x60007246 /end MEASUREMENT
/begin MEASUREMENT EGSDU_S2B1LtrSrvDlyEvln_I.flgDisbl "Class instance: interface to fault code memory and scan tool services delay time of sensor voltage at transition lean-rich, sensor 2, bank 1 / DFC is disabled by disable mask" UBYTE B_TRUE 1 100 0.00 1.00000000000 BIT_MASK 0x1 FORMAT "%13.11" ECU_ADDRESS 0x60007278 /end MEASUREMENT
/begin MEASUREMENT EGSDU_S2B1LtrSrvDlyEvln_I.flgErrSuspc "Class instance: interface to fault code memory and scan tool services delay time of sensor voltage at transition lean-rich, sensor 2, bank 1 / condition: Results go beyond the fault threshold" UBYTE B_TRUE 1 100 0.00 1.00000000000 BIT_MASK 0x1 FORMAT "%13.11" ECU_ADDRESS 0x60007279 /end MEASUREMENT
/begin MEASUREMENT EGSDU_S2B1LtrSrvDlyEvln_I.flgInhbn "Class instance: interface to fault code memory and scan tool services delay time of sensor voltage at transition lean-rich, sensor 2, bank 1 / DFC is inhibited" UBYTE B_TRUE 1 100 0.00 1.00000000000 BIT_MASK 0x1 FORMAT "%13.11" ECU_ADDRESS 0x6000727A /end MEASUREMENT
/begin MEASUREMENT EGSDU_S2B1LtrSrvDlyEvln_I.flgResEvln "Class instance: interface to fault code memory and scan tool services delay time of sensor voltage at transition lean-rich, sensor 2, bank 1 / Condition: result available" UBYTE B_TRUE 1 100 0.00 1.00000000000 BIT_MASK 0x1 FORMAT "%13.11" ECU_ADDRESS 0x6000727B /end MEASUREMENT
/begin MEASUREMENT EGSDU_S2B1LtrSrvDlyEvln_I.flgResVirtEvln "Class instance: interface to fault code memory and scan tool services delay time of sensor voltage at transition lean-rich, sensor 2, bank 1 / measurement for IUMPR is finished" UBYTE B_TRUE 1 100 0.00 1.00000000000 BIT_MASK 0x1 FORMAT "%13.11" ECU_ADDRESS 0x6000727C /end MEASUREMENT
/begin MEASUREMENT EGSDU_S2B1LtrSrvDlyEvln_I.flgFrzFrmER_I.buffer "Class instance: interface to fault code memory and scan tool services delay time of sensor voltage at transition lean-rich, sensor 2, bank 1 / Edge Rising: FreezeFrame request / rising edge detected" UBYTE B_TRUE 1 100 0.00 1.00000000000 BIT_MASK 0x1 FORMAT "%13.11" ECU_ADDRESS 0x6000727E /end MEASUREMENT
/begin MEASUREMENT EGSDU_S2B1LtrSrvDlyEvln_I.flgFrzFrmER_I.oldSignal "Class instance: interface to fault code memory and scan tool services delay time of sensor voltage at transition lean-rich, sensor 2, bank 1 / Edge Rising: FreezeFrame request / flag rising edge" UBYTE B_TRUE 1 100 0.00 1.00000000000 BIT_MASK 0x1 FORMAT "%13.11" ECU_ADDRESS 0x6000727F /end MEASUREMENT
/begin MEASUREMENT EGSDU_S2B1LtrSrvTranEvln_I.flgDisbl "Class instance: interface to fault code memory and scan tool services transition time of sensor voltage at transition rich-lean, sensor 2, bank 1 / DFC is disabled by disable mask" UBYTE B_TRUE 1 100 0.00 1.00000000000 BIT_MASK 0x1 FORMAT "%13.11" ECU_ADDRESS 0x60007270 /end MEASUREMENT
/begin MEASUREMENT EGSDU_S2B1LtrSrvTranEvln_I.flgErrSuspc "Class instance: interface to fault code memory and scan tool services transition time of sensor voltage at transition rich-lean, sensor 2, bank 1 / condition: Results go beyond the fault threshold" UBYTE B_TRUE 1 100 0.00 1.00000000000 BIT_MASK 0x1 FORMAT "%13.11" ECU_ADDRESS 0x60007271 /end MEASUREMENT
/begin MEASUREMENT EGSDU_S2B1LtrSrvTranEvln_I.flgInhbn "Class instance: interface to fault code memory and scan tool services transition time of sensor voltage at transition rich-lean, sensor 2, bank 1 / DFC is inhibited" UBYTE B_TRUE 1 100 0.00 1.00000000000 BIT_MASK 0x1 FORMAT "%13.11" ECU_ADDRESS 0x60007272 /end MEASUREMENT
/begin MEASUREMENT EGSDU_S2B1LtrSrvTranEvln_I.flgResEvln "Class instance: interface to fault code memory and scan tool services transition time of sensor voltage at transition rich-lean, sensor 2, bank 1 / Condition: result available" UBYTE B_TRUE 1 100 0.00 1.00000000000 BIT_MASK 0x1 FORMAT "%13.11" ECU_ADDRESS 0x60007273 /end MEASUREMENT
/begin MEASUREMENT EGSDU_S2B1LtrSrvTranEvln_I.flgResVirtEvln "Class instance: interface to fault code memory and scan tool services transition time of sensor voltage at transition rich-lean, sensor 2, bank 1 / measurement for IUMPR is finished" UBYTE B_TRUE 1 100 0.00 1.00000000000 BIT_MASK 0x1 FORMAT "%13.11" ECU_ADDRESS 0x60007274 /end MEASUREMENT
/begin MEASUREMENT EGSDU_S2B1LtrSrvTranEvln_I.flgFrzFrmER_I.buffer "Class instance: interface to fault code memory and scan tool services transition time of sensor voltage at transition rich-lean, sensor 2, bank 1 / Edge Rising: FreezeFrame request / rising edge detected" UBYTE B_TRUE 1 100 0.00 1.00000000000 BIT_MASK 0x1 FORMAT "%13.11" ECU_ADDRESS 0x60007276 /end MEASUREMENT
/begin MEASUREMENT EGSDU_S2B1LtrSrvTranEvln_I.flgFrzFrmER_I.oldSignal "Class instance: interface to fault code memory and scan tool services transition time of sensor voltage at transition rich-lean, sensor 2, bank 1 / Edge Rising: FreezeFrame request / flag rising edge" UBYTE B_TRUE 1 100 0.00 1.00000000000 BIT_MASK 0x1 FORMAT "%13.11" ECU_ADDRESS 0x60007277 /end MEASUREMENT
/begin MEASUREMENT EGSDU_S2B1LtrVirtMeasDurDs_I.flgResVirtTran "class instance: IUMPR of the transition time lean to rich, sensor 2, bank 1 / IUMPR lean to rich concluded" UBYTE B_TRUE 1 100 0.00 1.00000000000 BIT_MASK 0x1 FORMAT "%13.11" ECU_ADDRESS 0x6000723E /end MEASUREMENT
/begin MEASUREMENT EGSDU_S2B1LtrVirtMeasDurDs_I.flgLtrMeasDoneFF_I.status "class instance: IUMPR of the transition time lean to rich, sensor 2, bank 1 / virtual transition measurement done, waiting for virtual delay measurement / current value of RS-FF" UBYTE B_TRUE 1 100 0.00 1.00000000000 BIT_MASK 0x1 FORMAT "%13.11" ECU_ADDRESS 0x6000723F /end MEASUREMENT
/begin MEASUREMENT EGSDU_S2B1LtrVirtMeasDurDs_I.flgVirtRtlDlyEndER_I.buffer "class instance: IUMPR of the transition time lean to rich, sensor 2, bank 1 / virtual delay measurement concluded / rising edge detected" UBYTE B_TRUE 1 100 0.00 1.00000000000 BIT_MASK 0x1 FORMAT "%13.11" ECU_ADDRESS 0x60007240 /end MEASUREMENT
/begin MEASUREMENT EGSDU_S2B1LtrVirtMeasDurDs_I.flgVirtRtlDlyEndER_I.oldSignal "class instance: IUMPR of the transition time lean to rich, sensor 2, bank 1 / virtual delay measurement concluded / flag rising edge" UBYTE B_TRUE 1 100 0.00 1.00000000000 BIT_MASK 0x1 FORMAT "%13.11" ECU_ADDRESS 0x60007241 /end MEASUREMENT
/begin MEASUREMENT EGSDU_S2B1MinTiLtrTran_I.du "Class instance: measurement of transition time of sensor voltage lean to rich, sensor 2, bank 1 / Voltage change during measurement of Transition Time of O2Sensor" SWORD spg_q1p221Em3_V 1 100 -4.998779 4.998779 FORMAT "%8.6" ECU_ADDRESS 0x6000722A /end MEASUREMENT
/begin MEASUREMENT EGSDU_S2B1MinTiLtrTran_I.flgInhbRi "Class instance: measurement of transition time of sensor voltage lean to rich, sensor 2, bank 1 / Condition: Ri-measurement inhibit during the dynamic diagnosis transition time" UBYTE B_TRUE 1 100 0.00 1.00000000000 BIT_MASK 0x1 FORMAT "%13.11" ECU_ADDRESS 0x6000722C /end MEASUREMENT
/begin MEASUREMENT EGSDU_S2B1MinTiLtrTran_I.flgMeasFinshd "Class instance: measurement of transition time of sensor voltage lean to rich, sensor 2, bank 1 / Condition: result available (single measurement) for measurement Transition Time O2Sensor" UBYTE B_TRUE 1 100 0.00 1.00000000000 BIT_MASK 0x1 FORMAT "%13.11" ECU_ADDRESS 0x6000722D /end MEASUREMENT
/begin MEASUREMENT EGSDU_S2B1MinTiLtrTran_I.flgO2Extd "Class instance: measurement of transition time of sensor voltage lean to rich, sensor 2, bank 1 / Condition: IUMPR-Condition fulfilled (single measurement) for measurement Transition Time O2Sensor" UBYTE B_TRUE 1 100 0.00 1.00000000000 BIT_MASK 0x1 FORMAT "%13.11" ECU_ADDRESS 0x6000722E /end MEASUREMENT
/begin MEASUREMENT EGSDU_S2B1MinTiLtrTran_I.flgResTran "Class instance: measurement of transition time of sensor voltage lean to rich, sensor 2, bank 1 / transition diagnosis result ready" UBYTE B_TRUE 1 100 0.00 1.00000000000 BIT_MASK 0x1 FORMAT "%13.11" ECU_ADDRESS 0x6000722F /end MEASUREMENT
/begin MEASUREMENT EGSDU_S2B1MinTiLtrTran_I.tiTran "Class instance: measurement of transition time of sensor voltage lean to rich, sensor 2, bank 1 / Transition Time O2 Sensor" UWORD t_q0p01 1 100 0.00 655.3500 FORMAT "%8.4" ECU_ADDRESS 0x60007230 /end MEASUREMENT
/begin MEASUREMENT EGSDU_S2B1MinTiLtrTran_I.tiTranRaw "Class instance: measurement of transition time of sensor voltage lean to rich, sensor 2, bank 1 / measured transition time without correction" UWORD t_q0p01 1 100 0.00 655.3500 FORMAT "%8.4" ECU_ADDRESS 0x60007232 /end MEASUREMENT
/begin MEASUREMENT EGSDU_S2B1MinTiLtrTran_I.tiTranSeg "Class instance: measurement of transition time of sensor voltage lean to rich, sensor 2, bank 1 / Transition Time O2 Sensor by one caculation step" UWORD t_q0p01 1 100 0.00 655.3500 FORMAT "%8.4" ECU_ADDRESS 0x60007234 /end MEASUREMENT
/begin MEASUREMENT EGSDU_S2B1MinTiLtrTran_I.tiUStop "Class instance: measurement of transition time of sensor voltage lean to rich, sensor 2, bank 1 / hold time of the sensor voltage" UWORD t_q0p01 1 100 0.00 655.3500 FORMAT "%8.4" ECU_ADDRESS 0x60007236 /end MEASUREMENT
/begin MEASUREMENT EGSDU_S2B1MinTiLtrTran_I.ticorr "Class instance: measurement of transition time of sensor voltage lean to rich, sensor 2, bank 1 / mass flow dependent correction time" UWORD t_q0p01 1 100 0.00 655.3500 FORMAT "%8.4" ECU_ADDRESS 0x60007238 /end MEASUREMENT
/begin MEASUREMENT EGSDU_S2B1MinTiLtrTran_I.uOld "Class instance: measurement of transition time of sensor voltage lean to rich, sensor 2, bank 1 / O2 Sensor Voltage Old Value" UWORD spg_q1p221Em3_V 1 100 0.00 4.998779 FORMAT "%8.6" ECU_ADDRESS 0x6000723A /end MEASUREMENT
/begin MEASUREMENT EGSDU_S2B1MinTiRtlTran_I.du "Class instance: measurement of transition time of sensor voltage rich to lean, sensor 2, bank 1 / Voltage change during measurement of Transition Time of O2Sensor" SWORD spg_q1p221Em3_V 1 100 -4.998779 4.998779 FORMAT "%8.6" ECU_ADDRESS 0x5000550A /end MEASUREMENT
/begin MEASUREMENT EGSDU_S2B1MinTiRtlTran_I.flgInhbRi "Class instance: measurement of transition time of sensor voltage rich to lean, sensor 2, bank 1 / Condition: Ri-measurement inhibit during the dynamic diagnosis transition time" UBYTE B_TRUE 1 100 0.00 1.00000000000 BIT_MASK 0x1 FORMAT "%13.11" ECU_ADDRESS 0x5000550C /end MEASUREMENT
/begin MEASUREMENT EGSDU_S2B1MinTiRtlTran_I.flgMeasFinshd "Class instance: measurement of transition time of sensor voltage rich to lean, sensor 2, bank 1 / Condition: result available (single measurement) for measurement Transition Time O2Sensor" UBYTE B_TRUE 1 100 0.00 1.00000000000 BIT_MASK 0x1 FORMAT "%13.11" ECU_ADDRESS 0x5000550D /end MEASUREMENT
/begin MEASUREMENT EGSDU_S2B1MinTiRtlTran_I.flgO2Extd "Class instance: measurement of transition time of sensor voltage rich to lean, sensor 2, bank 1 / Condition: IUMPR-Condition fulfilled (single measurement) for measurement Transition Time O2Sensor" UBYTE B_TRUE 1 100 0.00 1.00000000000 BIT_MASK 0x1 FORMAT "%13.11" ECU_ADDRESS 0x5000550E /end MEASUREMENT
/begin MEASUREMENT EGSDU_S2B1MinTiRtlTran_I.flgResTran "Class instance: measurement of transition time of sensor voltage rich to lean, sensor 2, bank 1 / transition diagnosis result ready" UBYTE B_TRUE 1 100 0.00 1.00000000000 BIT_MASK 0x1 FORMAT "%13.11" ECU_ADDRESS 0x5000550F /end MEASUREMENT
/begin MEASUREMENT EGSDU_S2B1MinTiRtlTran_I.tiTran "Class instance: measurement of transition time of sensor voltage rich to lean, sensor 2, bank 1 / Transition Time O2 Sensor" UWORD t_q0p01 1 100 0.00 655.3500 FORMAT "%8.4" ECU_ADDRESS 0x50005510 /end MEASUREMENT
/begin MEASUREMENT EGSDU_S2B1MinTiRtlTran_I.tiTranRaw "Class instance: measurement of transition time of sensor voltage rich to lean, sensor 2, bank 1 / measured transition time without correction" UWORD t_q0p01 1 100 0.00 655.3500 FORMAT "%8.4" ECU_ADDRESS 0x50005512 /end MEASUREMENT
/begin MEASUREMENT EGSDU_S2B1MinTiRtlTran_I.tiTranSeg "Class instance: measurement of transition time of sensor voltage rich to lean, sensor 2, bank 1 / Transition Time O2 Sensor by one caculation step" UWORD t_q0p01 1 100 0.00 655.3500 FORMAT "%8.4" ECU_ADDRESS 0x50005514 /end MEASUREMENT
/begin MEASUREMENT EGSDU_S2B1MinTiRtlTran_I.tiUStop "Class instance: measurement of transition time of sensor voltage rich to lean, sensor 2, bank 1 / hold time of the sensor voltage" UWORD t_q0p01 1 100 0.00 655.3500 FORMAT "%8.4" ECU_ADDRESS 0x50005516 /end MEASUREMENT
/begin MEASUREMENT EGSDU_S2B1MinTiRtlTran_I.ticorr "Class instance: measurement of transition time of sensor voltage rich to lean, sensor 2, bank 1 / mass flow dependent correction time" UWORD t_q0p01 1 100 0.00 655.3500 FORMAT "%8.4" ECU_ADDRESS 0x50005518 /end MEASUREMENT
/begin MEASUREMENT EGSDU_S2B1MinTiRtlTran_I.uOld "Class instance: measurement of transition time of sensor voltage rich to lean, sensor 2, bank 1 / O2 Sensor Voltage Old Value" UWORD spg_q1p221Em3_V 1 100 0.00 4.998779 FORMAT "%8.6" ECU_ADDRESS 0x5000551A /end MEASUREMENT
/begin MEASUREMENT EGSDU_S2B1RtlFilDlyEvln_I.flgErrEwmaQckFail "Class instance: filter delay time of sensor voltage at transition rich-lean, sensor 2, bank 1 / Quick fail detection logic flag for EWMA filtering" UBYTE B_TRUE 1 100 0.00 1.00000000000 BIT_MASK 0x1 FORMAT "%13.11" ECU_ADDRESS 0x60002C54 /end MEASUREMENT
/begin MEASUREMENT EGSDU_S2B1RtlFilDlyEvln_I.flgFCMClrReqdCL100ms "Class instance: filter delay time of sensor voltage at transition rich-lean, sensor 2, bank 1 / FCM clear status flag" UBYTE B_TRUE 1 100 0.00 1.00000000000 BIT_MASK 0x1 FORMAT "%13.11" ECU_ADDRESS 0x60002C55 /end MEASUREMENT
/begin MEASUREMENT EGSDU_S2B1RtlFilDlyEvln_I.flgFCMClrReqdCL10ms "Class instance: filter delay time of sensor voltage at transition rich-lean, sensor 2, bank 1 / FCM clear status flag" UBYTE B_TRUE 1 100 0.00 1.00000000000 BIT_MASK 0x1 FORMAT "%13.11" ECU_ADDRESS 0x6000726A /end MEASUREMENT
/begin MEASUREMENT EGSDU_S2B1RtlFilDlyEvln_I.flgQckPassd "Class instance: filter delay time of sensor voltage at transition rich-lean, sensor 2, bank 1 / Condition: the diagnosis has quick pass" UBYTE B_TRUE 1 100 0.00 1.00000000000 BIT_MASK 0x1 FORMAT "%13.11" ECU_ADDRESS 0x60002C56 /end MEASUREMENT
/begin MEASUREMENT EGSDU_S2B1RtlFilDlyEvln_I.flgQckPassdFaild "Class instance: filter delay time of sensor voltage at transition rich-lean, sensor 2, bank 1 / Condition: the diagnosis doesnt have quick pass" UBYTE B_TRUE 1 100 0.00 1.00000000000 BIT_MASK 0x1 FORMAT "%13.11" ECU_ADDRESS 0x60002C57 /end MEASUREMENT
/begin MEASUREMENT EGSDU_S2B1RtlFilDlyEvln_I.flgRes "Class instance: filter delay time of sensor voltage at transition rich-lean, sensor 2, bank 1 / Condition: result available (single measurement)" UBYTE B_TRUE 1 100 0.00 1.00000000000 BIT_MASK 0x1 FORMAT "%13.11" ECU_ADDRESS 0x60002C58 /end MEASUREMENT
/begin MEASUREMENT EGSDU_S2B1RtlFilDlyEvln_I.flgResFil "Class instance: filter delay time of sensor voltage at transition rich-lean, sensor 2, bank 1 / Condition: filtered result available" UBYTE B_TRUE 1 100 0.00 1.00000000000 BIT_MASK 0x1 FORMAT "%13.11" ECU_ADDRESS 0x60002C59 /end MEASUREMENT
/begin MEASUREMENT EGSDU_S2B1RtlFilDlyEvln_I.flgResVirt "Class instance: filter delay time of sensor voltage at transition rich-lean, sensor 2, bank 1 / single measurement for IUMPR is finished" UBYTE B_TRUE 1 100 0.00 1.00000000000 BIT_MASK 0x1 FORMAT "%13.11" ECU_ADDRESS 0x60002C5A /end MEASUREMENT
/begin MEASUREMENT EGSDU_S2B1RtlFilDlyEvln_I.flgResVirtFil "Class instance: filter delay time of sensor voltage at transition rich-lean, sensor 2, bank 1 / Condition: Numerator Complete (internal)" UBYTE B_TRUE 1 100 0.00 1.00000000000 BIT_MASK 0x1 FORMAT "%13.11" ECU_ADDRESS 0x60002C5B /end MEASUREMENT
/begin MEASUREMENT EGSDU_S2B1RtlFilDlyEvln_I.flgResVirtTmp "Class instance: filter delay time of sensor voltage at transition rich-lean, sensor 2, bank 1 / IUMPR simulation is finished for the fault check" UBYTE B_TRUE 1 100 0.00 1.00000000000 BIT_MASK 0x1 FORMAT "%13.11" ECU_ADDRESS 0x60002C5C /end MEASUREMENT
/begin MEASUREMENT EGSDU_S2B1RtlFilDlyEvln_I.flgTrip "Class instance: filter delay time of sensor voltage at transition rich-lean, sensor 2, bank 1 / fault check is for this driving clycle finished" UBYTE B_TRUE 1 100 0.00 1.00000000000 BIT_MASK 0x1 FORMAT "%13.11" ECU_ADDRESS 0x60002C5D /end MEASUREMENT
/begin MEASUREMENT EGSDU_S2B1RtlFilDlyEvln_I.flgTripVirt "Class instance: filter delay time of sensor voltage at transition rich-lean, sensor 2, bank 1 / IUMPR simulation is for this driving cycle finished" UBYTE B_TRUE 1 100 0.00 1.00000000000 BIT_MASK 0x1 FORMAT "%13.11" ECU_ADDRESS 0x60002C5E /end MEASUREMENT
/begin MEASUREMENT EGSDU_S2B1RtlFilDlyEvln_I.flgVirtQckFaild "Class instance: filter delay time of sensor voltage at transition rich-lean, sensor 2, bank 1 / Condition: virtual Quickpass failed is set" UBYTE B_TRUE 1 100 0.00 1.00000000000 BIT_MASK 0x1 FORMAT "%13.11" ECU_ADDRESS 0x60002C5F /end MEASUREMENT
/begin MEASUREMENT EGSDU_S2B1RtlFilDlyEvln_I.numMeas "Class instance: filter delay time of sensor voltage at transition rich-lean, sensor 2, bank 1 / Number of measurements" UBYTE dez 1 100 0.00 255.0 FORMAT "%5.1" ECU_ADDRESS 0x600390DE /end MEASUREMENT
/begin MEASUREMENT EGSDU_S2B1RtlFilDlyEvln_I.numMeasShtrp "Class instance: filter delay time of sensor voltage at transition rich-lean, sensor 2, bank 1 / number of measurements for short trip" UBYTE dez 1 100 0.00 255.0 FORMAT "%5.1" ECU_ADDRESS 0x60002C60 /end MEASUREMENT
/begin MEASUREMENT EGSDU_S2B1RtlFilDlyEvln_I.numMeasTrip "Class instance: filter delay time of sensor voltage at transition rich-lean, sensor 2, bank 1 / number of measurement in this driving clycle" UBYTE dez 1 100 0.00 255.0 FORMAT "%5.1" ECU_ADDRESS 0x60002C61 /end MEASUREMENT
/begin MEASUREMENT EGSDU_S2B1RtlFilDlyEvln_I.numVirtMeas "Class instance: filter delay time of sensor voltage at transition rich-lean, sensor 2, bank 1 / Number of virtual measurements (IUMPR)" UBYTE dez 1 100 0.00 255.0 FORMAT "%5.1" ECU_ADDRESS 0x600390DF /end MEASUREMENT
/begin MEASUREMENT EGSDU_S2B1RtlFilDlyEvln_I.numVirtMeasTrip "Class instance: filter delay time of sensor voltage at transition rich-lean, sensor 2, bank 1 / Number of virtual measurements (IUMPR) in this driving clycle in case of step change" UBYTE dez 1 100 0.00 255.0 FORMAT "%5.1" ECU_ADDRESS 0x60002C62 /end MEASUREMENT
/begin MEASUREMENT EGSDU_S2B1RtlFilDlyEvln_I.stEwmaMod "Class instance: filter delay time of sensor voltage at transition rich-lean, sensor 2, bank 1 / Current mode of EWMA filter" UBYTE OneToOne 1 100 0.00 2.000 FORMAT "%5.3" ECU_ADDRESS 0x600390E0 /end MEASUREMENT
/begin MEASUREMENT EGSDU_S2B1RtlFilDlyEvln_I.stEwmaVirtMod "Class instance: filter delay time of sensor voltage at transition rich-lean, sensor 2, bank 1 / Current mode of EWMA filter for IUMPR Simulation" UBYTE OneToOne 1 100 0.00 2.000 FORMAT "%5.3" ECU_ADDRESS 0x600390E1 /end MEASUREMENT
/begin MEASUREMENT EGSDU_S2B1RtlFilDlyEvln_I.ti "Class instance: filter delay time of sensor voltage at transition rich-lean, sensor 2, bank 1 / result of dynamic measurement" SWORD t_q0p01 1 100 -327.6800 327.6700 FORMAT "%8.4" ECU_ADDRESS 0x6000726C /end MEASUREMENT
/begin MEASUREMENT EGSDU_S2B1RtlFilDlyEvln_I.tiArth "Class instance: filter delay time of sensor voltage at transition rich-lean, sensor 2, bank 1 / value of aritmetic-filter" SWORD t_q0p01 1 100 -327.6800 327.6700 FORMAT "%8.4" ECU_ADDRESS 0x600390E2 /end MEASUREMENT
/begin MEASUREMENT EGSDU_S2B1RtlFilDlyEvln_I.tiEwma "Class instance: filter delay time of sensor voltage at transition rich-lean, sensor 2, bank 1 / Value of EWMA-Filter (word)" SWORD t_q0p01 1 100 -327.6800 327.6700 FORMAT "%8.4" ECU_ADDRESS 0x600390E4 /end MEASUREMENT
/begin MEASUREMENT EGSDU_S2B1RtlFilDlyEvln_I.tiFil "Class instance: filter delay time of sensor voltage at transition rich-lean, sensor 2, bank 1 / filtered result of dynamic measurement" UWORD t_q0p01 1 100 0.00 655.3500 FORMAT "%8.4" ECU_ADDRESS 0x600390E6 /end MEASUREMENT
/begin MEASUREMENT EGSDU_S2B1RtlFilDlyEvln_I.tiQuickPass "Class instance: filter delay time of sensor voltage at transition rich-lean, sensor 2, bank 1 / Threshold for quick pass" SWORD t_q0p01 1 100 -327.6800 327.6700 FORMAT "%8.4" ECU_ADDRESS 0x60002C64 /end MEASUREMENT
/begin MEASUREMENT EGSDU_S2B1RtlFilDlyEvln_I.ResFF_I.status "Class instance: filter delay time of sensor voltage at transition rich-lean, sensor 2, bank 1 / FlipFlop: result available (single measurement) / current value of RS-FF" UBYTE B_TRUE 1 100 0.00 1.00000000000 BIT_MASK 0x1 FORMAT "%13.11" ECU_ADDRESS 0x6000726E /end MEASUREMENT
/begin MEASUREMENT EGSDU_S2B1RtlFilDlyEvln_I.tiArithShtrpDL_I.memory "Class instance: filter delay time of sensor voltage at transition rich-lean, sensor 2, bank 1 / aritmetic filter for short trip / current lowpass value" SLONG q1p5259Em7_s 1 100 -327.680000000 327.679999847 FORMAT "%13.9" ECU_ADDRESS 0x60002C68 /end MEASUREMENT
/begin MEASUREMENT EGSDU_S2B1RtlFilDlyEvln_I.tiArthDL_I.memory "Class instance: filter delay time of sensor voltage at transition rich-lean, sensor 2, bank 1 / aritmetic filter / current lowpass value" SLONG q1p5259Em7_s 1 100 -327.680000000 327.679999847 FORMAT "%13.9" ECU_ADDRESS 0x60002C6C /end MEASUREMENT
/begin MEASUREMENT EGSDU_S2B1RtlFilDlyEvln_I.tiEwmaDL_I.memory "Class instance: filter delay time of sensor voltage at transition rich-lean, sensor 2, bank 1 / Value of EWMA-Filter (Digital Low Pass) / current lowpass value" SLONG q1p5259Em7_s 1 100 -327.680000000 327.679999847 FORMAT "%13.9" ECU_ADDRESS 0x60002C70 /end MEASUREMENT
/begin MEASUREMENT EGSDU_S2B1RtlFilTranEvln_I.flgErrEwmaQckFail "Class instance: filter transition time of sensor voltage at transition rich-lean, sensor 2, bank 1 / Quick fail detection logic flag for EWMA filtering" UBYTE B_TRUE 1 100 0.00 1.00000000000 BIT_MASK 0x1 FORMAT "%13.11" ECU_ADDRESS 0x60002C34 /end MEASUREMENT
/begin MEASUREMENT EGSDU_S2B1RtlFilTranEvln_I.flgFCMClrReqdCL100ms "Class instance: filter transition time of sensor voltage at transition rich-lean, sensor 2, bank 1 / FCM clear status flag" UBYTE B_TRUE 1 100 0.00 1.00000000000 BIT_MASK 0x1 FORMAT "%13.11" ECU_ADDRESS 0x60002C35 /end MEASUREMENT
/begin MEASUREMENT EGSDU_S2B1RtlFilTranEvln_I.flgFCMClrReqdCL10ms "Class instance: filter transition time of sensor voltage at transition rich-lean, sensor 2, bank 1 / FCM clear status flag" UBYTE B_TRUE 1 100 0.00 1.00000000000 BIT_MASK 0x1 FORMAT "%13.11" ECU_ADDRESS 0x60013360 /end MEASUREMENT
/begin MEASUREMENT EGSDU_S2B1RtlFilTranEvln_I.flgQckPassd "Class instance: filter transition time of sensor voltage at transition rich-lean, sensor 2, bank 1 / Condition: the diagnosis has quick pass" UBYTE B_TRUE 1 100 0.00 1.00000000000 BIT_MASK 0x1 FORMAT "%13.11" ECU_ADDRESS 0x60002C36 /end MEASUREMENT
/begin MEASUREMENT EGSDU_S2B1RtlFilTranEvln_I.flgQckPassdFaild "Class instance: filter transition time of sensor voltage at transition rich-lean, sensor 2, bank 1 / Condition: the diagnosis doesnt have quick pass" UBYTE B_TRUE 1 100 0.00 1.00000000000 BIT_MASK 0x1 FORMAT "%13.11" ECU_ADDRESS 0x60002C37 /end MEASUREMENT
/begin MEASUREMENT EGSDU_S2B1RtlFilTranEvln_I.flgRes "Class instance: filter transition time of sensor voltage at transition rich-lean, sensor 2, bank 1 / Condition: result available (single measurement)" UBYTE B_TRUE 1 100 0.00 1.00000000000 BIT_MASK 0x1 FORMAT "%13.11" ECU_ADDRESS 0x60002C38 /end MEASUREMENT
/begin MEASUREMENT EGSDU_S2B1RtlFilTranEvln_I.flgResFil "Class instance: filter transition time of sensor voltage at transition rich-lean, sensor 2, bank 1 / Condition: filtered result available" UBYTE B_TRUE 1 100 0.00 1.00000000000 BIT_MASK 0x1 FORMAT "%13.11" ECU_ADDRESS 0x60002C39 /end MEASUREMENT
/begin MEASUREMENT EGSDU_S2B1RtlFilTranEvln_I.flgResVirt "Class instance: filter transition time of sensor voltage at transition rich-lean, sensor 2, bank 1 / single measurement for IUMPR is finished" UBYTE B_TRUE 1 100 0.00 1.00000000000 BIT_MASK 0x1 FORMAT "%13.11" ECU_ADDRESS 0x60002C3A /end MEASUREMENT
/begin MEASUREMENT EGSDU_S2B1RtlFilTranEvln_I.flgResVirtFil "Class instance: filter transition time of sensor voltage at transition rich-lean, sensor 2, bank 1 / Condition: Numerator Complete (internal)" UBYTE B_TRUE 1 100 0.00 1.00000000000 BIT_MASK 0x1 FORMAT "%13.11" ECU_ADDRESS 0x60002C3B /end MEASUREMENT
/begin MEASUREMENT EGSDU_S2B1RtlFilTranEvln_I.flgResVirtTmp "Class instance: filter transition time of sensor voltage at transition rich-lean, sensor 2, bank 1 / IUMPR simulation is finished for the fault check" UBYTE B_TRUE 1 100 0.00 1.00000000000 BIT_MASK 0x1 FORMAT "%13.11" ECU_ADDRESS 0x60002C3C /end MEASUREMENT
/begin MEASUREMENT EGSDU_S2B1RtlFilTranEvln_I.flgTrip "Class instance: filter transition time of sensor voltage at transition rich-lean, sensor 2, bank 1 / fault check is for this driving clycle finished" UBYTE B_TRUE 1 100 0.00 1.00000000000 BIT_MASK 0x1 FORMAT "%13.11" ECU_ADDRESS 0x60002C3D /end MEASUREMENT
/begin MEASUREMENT EGSDU_S2B1RtlFilTranEvln_I.flgTripVirt "Class instance: filter transition time of sensor voltage at transition rich-lean, sensor 2, bank 1 / IUMPR simulation is for this driving cycle finished" UBYTE B_TRUE 1 100 0.00 1.00000000000 BIT_MASK 0x1 FORMAT "%13.11" ECU_ADDRESS 0x60002C3E /end MEASUREMENT
/begin MEASUREMENT EGSDU_S2B1RtlFilTranEvln_I.flgVirtQckFaild "Class instance: filter transition time of sensor voltage at transition rich-lean, sensor 2, bank 1 / Condition: virtual Quickpass failed is set" UBYTE B_TRUE 1 100 0.00 1.00000000000 BIT_MASK 0x1 FORMAT "%13.11" ECU_ADDRESS 0x60002C3F /end MEASUREMENT
/begin MEASUREMENT EGSDU_S2B1RtlFilTranEvln_I.numMeas "Class instance: filter transition time of sensor voltage at transition rich-lean, sensor 2, bank 1 / Number of measurements" UBYTE dez 1 100 0.00 255.0 FORMAT "%5.1" ECU_ADDRESS 0x600390D4 /end MEASUREMENT
/begin MEASUREMENT EGSDU_S2B1RtlFilTranEvln_I.numMeasShtrp "Class instance: filter transition time of sensor voltage at transition rich-lean, sensor 2, bank 1 / number of measurements for short trip" UBYTE dez 1 100 0.00 255.0 FORMAT "%5.1" ECU_ADDRESS 0x60002C40 /end MEASUREMENT
/begin MEASUREMENT EGSDU_S2B1RtlFilTranEvln_I.numMeasTrip "Class instance: filter transition time of sensor voltage at transition rich-lean, sensor 2, bank 1 / number of measurement in this driving clycle" UBYTE dez 1 100 0.00 255.0 FORMAT "%5.1" ECU_ADDRESS 0x60002C41 /end MEASUREMENT
/begin MEASUREMENT EGSDU_S2B1RtlFilTranEvln_I.numVirtMeas "Class instance: filter transition time of sensor voltage at transition rich-lean, sensor 2, bank 1 / Number of virtual measurements (IUMPR)" UBYTE dez 1 100 0.00 255.0 FORMAT "%5.1" ECU_ADDRESS 0x600390D5 /end MEASUREMENT
/begin MEASUREMENT EGSDU_S2B1RtlFilTranEvln_I.numVirtMeasTrip "Class instance: filter transition time of sensor voltage at transition rich-lean, sensor 2, bank 1 / Number of virtual measurements (IUMPR) in this driving clycle in case of step change" UBYTE dez 1 100 0.00 255.0 FORMAT "%5.1" ECU_ADDRESS 0x60002C42 /end MEASUREMENT
/begin MEASUREMENT EGSDU_S2B1RtlFilTranEvln_I.stEwmaMod "Class instance: filter transition time of sensor voltage at transition rich-lean, sensor 2, bank 1 / Current mode of EWMA filter" UBYTE OneToOne 1 100 0.00 2.000 FORMAT "%5.3" ECU_ADDRESS 0x600390D6 /end MEASUREMENT
/begin MEASUREMENT EGSDU_S2B1RtlFilTranEvln_I.stEwmaVirtMod "Class instance: filter transition time of sensor voltage at transition rich-lean, sensor 2, bank 1 / Current mode of EWMA filter for IUMPR Simulation" UBYTE OneToOne 1 100 0.00 2.000 FORMAT "%5.3" ECU_ADDRESS 0x600390D7 /end MEASUREMENT
/begin MEASUREMENT EGSDU_S2B1RtlFilTranEvln_I.ti "Class instance: filter transition time of sensor voltage at transition rich-lean, sensor 2, bank 1 / result of dynamic measurement" SWORD t_q0p01 1 100 -327.6800 327.6700 FORMAT "%8.4" ECU_ADDRESS 0x60013362 /end MEASUREMENT
/begin MEASUREMENT EGSDU_S2B1RtlFilTranEvln_I.tiArth "Class instance: filter transition time of sensor voltage at transition rich-lean, sensor 2, bank 1 / value of aritmetic-filter" SWORD t_q0p01 1 100 -327.6800 327.6700 FORMAT "%8.4" ECU_ADDRESS 0x600390D8 /end MEASUREMENT
/begin MEASUREMENT EGSDU_S2B1RtlFilTranEvln_I.tiEwma "Class instance: filter transition time of sensor voltage at transition rich-lean, sensor 2, bank 1 / Value of EWMA-Filter (word)" SWORD t_q0p01 1 100 -327.6800 327.6700 FORMAT "%8.4" ECU_ADDRESS 0x600390DA /end MEASUREMENT
/begin MEASUREMENT EGSDU_S2B1RtlFilTranEvln_I.tiFil "Class instance: filter transition time of sensor voltage at transition rich-lean, sensor 2, bank 1 / filtered result of dynamic measurement" UWORD t_q0p01 1 100 0.00 655.3500 FORMAT "%8.4" ECU_ADDRESS 0x600390DC /end MEASUREMENT
/begin MEASUREMENT EGSDU_S2B1RtlFilTranEvln_I.tiQuickPass "Class instance: filter transition time of sensor voltage at transition rich-lean, sensor 2, bank 1 / Threshold for quick pass" SWORD t_q0p01 1 100 -327.6800 327.6700 FORMAT "%8.4" ECU_ADDRESS 0x60002C44 /end MEASUREMENT
/begin MEASUREMENT EGSDU_S2B1RtlFilTranEvln_I.ResFF_I.status "Class instance: filter transition time of sensor voltage at transition rich-lean, sensor 2, bank 1 / FlipFlop: result available (single measurement) / current value of RS-FF" UBYTE B_TRUE 1 100 0.00 1.00000000000 BIT_MASK 0x1 FORMAT "%13.11" ECU_ADDRESS 0x60013364 /end MEASUREMENT
/begin MEASUREMENT EGSDU_S2B1RtlFilTranEvln_I.tiArithShtrpDL_I.memory "Class instance: filter transition time of sensor voltage at transition rich-lean, sensor 2, bank 1 / aritmetic filter for short trip / current lowpass value" SLONG q1p5259Em7_s 1 100 -327.680000000 327.679999847 FORMAT "%13.9" ECU_ADDRESS 0x60002C48 /end MEASUREMENT
/begin MEASUREMENT EGSDU_S2B1RtlFilTranEvln_I.tiArthDL_I.memory "Class instance: filter transition time of sensor voltage at transition rich-lean, sensor 2, bank 1 / aritmetic filter / current lowpass value" SLONG q1p5259Em7_s 1 100 -327.680000000 327.679999847 FORMAT "%13.9" ECU_ADDRESS 0x60002C4C /end MEASUREMENT
/begin MEASUREMENT EGSDU_S2B1RtlFilTranEvln_I.tiEwmaDL_I.memory "Class instance: filter transition time of sensor voltage at transition rich-lean, sensor 2, bank 1 / Value of EWMA-Filter (Digital Low Pass) / current lowpass value" SLONG q1p5259Em7_s 1 100 -327.680000000 327.679999847 FORMAT "%13.9" ECU_ADDRESS 0x60002C50 /end MEASUREMENT
/begin MEASUREMENT EGSDU_S2B1RtlMeasActvDur_I.flgMeasTran "Class instance denoting active transition measurement for rich to lean tansition measurement for Sensor 2 Bank 1 / Full transition diagnosis active" UBYTE B_TRUE 1 100 0.00 1.00000000000 BIT_MASK 0x1 FORMAT "%13.11" ECU_ADDRESS 0x60007226 /end MEASUREMENT
/begin MEASUREMENT EGSDU_S2B1RtlMeasActvDur_I.flgRprtTran "Class instance denoting active transition measurement for rich to lean tansition measurement for Sensor 2 Bank 1 / ." UBYTE B_TRUE 1 100 0.00 1.00000000000 BIT_MASK 0x1 FORMAT "%13.11" ECU_ADDRESS 0x60007227 /end MEASUREMENT
/begin MEASUREMENT EGSDU_S2B1RtlMeasActvDur_I.stParlOld "Class instance denoting active transition measurement for rich to lean tansition measurement for Sensor 2 Bank 1 / Value of last calculation step: status of state machine of lambda shifting from coordinator function of parallelization" UBYTE dez 1 100 0.00 255.0 FORMAT "%5.1" ECU_ADDRESS 0x60007228 /end MEASUREMENT
/begin MEASUREMENT EGSDU_S2B1RtlMeasActvDur_I.flgActvMeasTranFF_I.status "Class instance denoting active transition measurement for rich to lean tansition measurement for Sensor 2 Bank 1 / Richj to lean transition measurement active / current value of RS-FF" UBYTE B_TRUE 1 100 0.00 1.00000000000 BIT_MASK 0x1 FORMAT "%13.11" ECU_ADDRESS 0x60007229 /end MEASUREMENT
/begin MEASUREMENT EGSDU_S2B1RtlSrvDlyEvln_I.flgDisbl "Class instance: interface to fault code memory and scan tool services transition time of sensor voltage at transition rich-lean, sensor 2, bank 1 / DFC is disabled by disable mask" UBYTE B_TRUE 1 100 0.00 1.00000000000 BIT_MASK 0x1 FORMAT "%13.11" ECU_ADDRESS 0x60007262 /end MEASUREMENT
/begin MEASUREMENT EGSDU_S2B1RtlSrvDlyEvln_I.flgErrSuspc "Class instance: interface to fault code memory and scan tool services transition time of sensor voltage at transition rich-lean, sensor 2, bank 1 / condition: Results go beyond the fault threshold" UBYTE B_TRUE 1 100 0.00 1.00000000000 BIT_MASK 0x1 FORMAT "%13.11" ECU_ADDRESS 0x60007263 /end MEASUREMENT
/begin MEASUREMENT EGSDU_S2B1RtlSrvDlyEvln_I.flgInhbn "Class instance: interface to fault code memory and scan tool services transition time of sensor voltage at transition rich-lean, sensor 2, bank 1 / DFC is inhibited" UBYTE B_TRUE 1 100 0.00 1.00000000000 BIT_MASK 0x1 FORMAT "%13.11" ECU_ADDRESS 0x60007264 /end MEASUREMENT
/begin MEASUREMENT EGSDU_S2B1RtlSrvDlyEvln_I.flgResEvln "Class instance: interface to fault code memory and scan tool services transition time of sensor voltage at transition rich-lean, sensor 2, bank 1 / Condition: result available" UBYTE B_TRUE 1 100 0.00 1.00000000000 BIT_MASK 0x1 FORMAT "%13.11" ECU_ADDRESS 0x60007265 /end MEASUREMENT
/begin MEASUREMENT EGSDU_S2B1RtlSrvDlyEvln_I.flgResVirtEvln "Class instance: interface to fault code memory and scan tool services transition time of sensor voltage at transition rich-lean, sensor 2, bank 1 / measurement for IUMPR is finished" UBYTE B_TRUE 1 100 0.00 1.00000000000 BIT_MASK 0x1 FORMAT "%13.11" ECU_ADDRESS 0x60007266 /end MEASUREMENT
/begin MEASUREMENT EGSDU_S2B1RtlSrvDlyEvln_I.flgFrzFrmER_I.buffer "Class instance: interface to fault code memory and scan tool services transition time of sensor voltage at transition rich-lean, sensor 2, bank 1 / Edge Rising: FreezeFrame request / rising edge detected" UBYTE B_TRUE 1 100 0.00 1.00000000000 BIT_MASK 0x1 FORMAT "%13.11" ECU_ADDRESS 0x60007268 /end MEASUREMENT
/begin MEASUREMENT EGSDU_S2B1RtlSrvDlyEvln_I.flgFrzFrmER_I.oldSignal "Class instance: interface to fault code memory and scan tool services transition time of sensor voltage at transition rich-lean, sensor 2, bank 1 / Edge Rising: FreezeFrame request / flag rising edge" UBYTE B_TRUE 1 100 0.00 1.00000000000 BIT_MASK 0x1 FORMAT "%13.11" ECU_ADDRESS 0x60007269 /end MEASUREMENT
/begin MEASUREMENT EGSDU_S2B1RtlSrvTranEvln_I.flgDisbl "Class instance: interface to fault code memory and scan tool services delay time of sensor voltage at transition rich-lean, sensor 2, bank 1 / DFC is disabled by disable mask" UBYTE B_TRUE 1 100 0.00 1.00000000000 BIT_MASK 0x1 FORMAT "%13.11" ECU_ADDRESS 0x6000725A /end MEASUREMENT
/begin MEASUREMENT EGSDU_S2B1RtlSrvTranEvln_I.flgErrSuspc "Class instance: interface to fault code memory and scan tool services delay time of sensor voltage at transition rich-lean, sensor 2, bank 1 / condition: Results go beyond the fault threshold" UBYTE B_TRUE 1 100 0.00 1.00000000000 BIT_MASK 0x1 FORMAT "%13.11" ECU_ADDRESS 0x6000725B /end MEASUREMENT
/begin MEASUREMENT EGSDU_S2B1RtlSrvTranEvln_I.flgInhbn "Class instance: interface to fault code memory and scan tool services delay time of sensor voltage at transition rich-lean, sensor 2, bank 1 / DFC is inhibited" UBYTE B_TRUE 1 100 0.00 1.00000000000 BIT_MASK 0x1 FORMAT "%13.11" ECU_ADDRESS 0x6000725C /end MEASUREMENT
/begin MEASUREMENT EGSDU_S2B1RtlSrvTranEvln_I.flgResEvln "Class instance: interface to fault code memory and scan tool services delay time of sensor voltage at transition rich-lean, sensor 2, bank 1 / Condition: result available" UBYTE B_TRUE 1 100 0.00 1.00000000000 BIT_MASK 0x1 FORMAT "%13.11" ECU_ADDRESS 0x6000725D /end MEASUREMENT
/begin MEASUREMENT EGSDU_S2B1RtlSrvTranEvln_I.flgResVirtEvln "Class instance: interface to fault code memory and scan tool services delay time of sensor voltage at transition rich-lean, sensor 2, bank 1 / measurement for IUMPR is finished" UBYTE B_TRUE 1 100 0.00 1.00000000000 BIT_MASK 0x1 FORMAT "%13.11" ECU_ADDRESS 0x6000725E /end MEASUREMENT
/begin MEASUREMENT EGSDU_S2B1RtlSrvTranEvln_I.flgFrzFrmER_I.buffer "Class instance: interface to fault code memory and scan tool services delay time of sensor voltage at transition rich-lean, sensor 2, bank 1 / Edge Rising: FreezeFrame request / rising edge detected" UBYTE B_TRUE 1 100 0.00 1.00000000000 BIT_MASK 0x1 FORMAT "%13.11" ECU_ADDRESS 0x60007260 /end MEASUREMENT
/begin MEASUREMENT EGSDU_S2B1RtlSrvTranEvln_I.flgFrzFrmER_I.oldSignal "Class instance: interface to fault code memory and scan tool services delay time of sensor voltage at transition rich-lean, sensor 2, bank 1 / Edge Rising: FreezeFrame request / flag rising edge" UBYTE B_TRUE 1 100 0.00 1.00000000000 BIT_MASK 0x1 FORMAT "%13.11" ECU_ADDRESS 0x60007261 /end MEASUREMENT
/begin MEASUREMENT EGSDU_S2B1TarLeanEvlnDs_I.flgFCMClrReqdCL10ms "class instance:supply diagnosis result of range check of target lean sensor voltage, sensor 2, bank 1 / FCM clear status flag" UBYTE B_TRUE 1 100 0.00 1.00000000000 BIT_MASK 0x1 FORMAT "%13.11" ECU_ADDRESS 0x60013366 /end MEASUREMENT
/begin MEASUREMENT EGSDU_S2B1TarLeanEvlnDs_I.flgRes "class instance:supply diagnosis result of range check of target lean sensor voltage, sensor 2, bank 1 / Condition: result available" UBYTE B_TRUE 1 100 0.00 1.00000000000 BIT_MASK 0x1 FORMAT "%13.11" ECU_ADDRESS 0x60013367 /end MEASUREMENT
/begin MEASUREMENT EGSDU_S2B1TarLeanEvlnDs_I.flgResVirt "class instance:supply diagnosis result of range check of target lean sensor voltage, sensor 2, bank 1 / measurement for IUMPR is finished" UBYTE B_TRUE 1 100 0.00 1.00000000000 BIT_MASK 0x1 FORMAT "%13.11" ECU_ADDRESS 0x60013368 /end MEASUREMENT
/begin MEASUREMENT EGSDU_S2B1TarLeanEvlnDs_I.u "class instance:supply diagnosis result of range check of target lean sensor voltage, sensor 2, bank 1 / Sensor voltage" UWORD spg_q1p221Em3_V 1 100 0.00 4.998779 FORMAT "%8.6" ECU_ADDRESS 0x6001336A /end MEASUREMENT
/begin MEASUREMENT EGSDU_S2B1TarLeanEvlnDs_I.u_Err_C "class instance:supply diagnosis result of range check of target lean sensor voltage, sensor 2, bank 1 / Threshold to detect sensor voltage fault" UWORD spg_q1p221Em3_V 1 100 0.00 4.998779 FORMAT "%8.6" ECU_ADDRESS 0x6001336C /end MEASUREMENT
/begin MEASUREMENT EGSDU_S2B1TarLeanSrvEvln_I.flgDisbl "Class instance: interface to fault code memory and scan tool services range check of lean target sensor voltage, sensor 2, bank 1 / DFC is disabled by disable mask" UBYTE B_TRUE 1 100 0.00 1.00000000000 BIT_MASK 0x1 FORMAT "%13.11" ECU_ADDRESS 0x60007252 /end MEASUREMENT
/begin MEASUREMENT EGSDU_S2B1TarLeanSrvEvln_I.flgErrSuspc "Class instance: interface to fault code memory and scan tool services range check of lean target sensor voltage, sensor 2, bank 1 / condition: Results go beyond the fault threshold" UBYTE B_TRUE 1 100 0.00 1.00000000000 BIT_MASK 0x1 FORMAT "%13.11" ECU_ADDRESS 0x60007253 /end MEASUREMENT
/begin MEASUREMENT EGSDU_S2B1TarLeanSrvEvln_I.flgInhbn "Class instance: interface to fault code memory and scan tool services range check of lean target sensor voltage, sensor 2, bank 1 / DFC is inhibited" UBYTE B_TRUE 1 100 0.00 1.00000000000 BIT_MASK 0x1 FORMAT "%13.11" ECU_ADDRESS 0x60007254 /end MEASUREMENT
/begin MEASUREMENT EGSDU_S2B1TarLeanSrvEvln_I.flgOkOnceEvln "Class instance: interface to fault code memory and scan tool services range check of lean target sensor voltage, sensor 2, bank 1 / at least one target OK check in the current driving cycle" UBYTE B_TRUE 1 100 0.00 1.00000000000 BIT_MASK 0x1 FORMAT "%13.11" ECU_ADDRESS 0x60007255 /end MEASUREMENT
/begin MEASUREMENT EGSDU_S2B1TarLeanSrvEvln_I.flgResEvln "Class instance: interface to fault code memory and scan tool services range check of lean target sensor voltage, sensor 2, bank 1 / Condition: result available" UBYTE B_TRUE 1 100 0.00 1.00000000000 BIT_MASK 0x1 FORMAT "%13.11" ECU_ADDRESS 0x60007256 /end MEASUREMENT
/begin MEASUREMENT EGSDU_S2B1TarLeanSrvEvln_I.flgResVirtEvln "Class instance: interface to fault code memory and scan tool services range check of lean target sensor voltage, sensor 2, bank 1 / measurement for IUMPR is finished" UBYTE B_TRUE 1 100 0.00 1.00000000000 BIT_MASK 0x1 FORMAT "%13.11" ECU_ADDRESS 0x60007257 /end MEASUREMENT
/begin MEASUREMENT EGSDU_S2B1TarLeanSrvEvln_I.flgFrzFrmER_I.buffer "Class instance: interface to fault code memory and scan tool services range check of lean target sensor voltage, sensor 2, bank 1 / EdgeRising:FreezeFrame is placed. / rising edge detected" UBYTE B_TRUE 1 100 0.00 1.00000000000 BIT_MASK 0x1 FORMAT "%13.11" ECU_ADDRESS 0x60007258 /end MEASUREMENT
/begin MEASUREMENT EGSDU_S2B1TarLeanSrvEvln_I.flgFrzFrmER_I.oldSignal "Class instance: interface to fault code memory and scan tool services range check of lean target sensor voltage, sensor 2, bank 1 / EdgeRising:FreezeFrame is placed. / flag rising edge" UBYTE B_TRUE 1 100 0.00 1.00000000000 BIT_MASK 0x1 FORMAT "%13.11" ECU_ADDRESS 0x60007259 /end MEASUREMENT
/begin MEASUREMENT EGSDU_S2B1TarRichEvlnDs_I.flgFCMClrReqdCL10ms "class instance:supply diagnosis result of range check of target rich sensor voltage, sensor 2, bank 1 / FCM clear status flag" UBYTE B_TRUE 1 100 0.00 1.00000000000 BIT_MASK 0x1 FORMAT "%13.11" ECU_ADDRESS 0x6001336E /end MEASUREMENT
/begin MEASUREMENT EGSDU_S2B1TarRichEvlnDs_I.flgRes "class instance:supply diagnosis result of range check of target rich sensor voltage, sensor 2, bank 1 / Condition: result available" UBYTE B_TRUE 1 100 0.00 1.00000000000 BIT_MASK 0x1 FORMAT "%13.11" ECU_ADDRESS 0x6001336F /end MEASUREMENT
/begin MEASUREMENT EGSDU_S2B1TarRichEvlnDs_I.flgResVirt "class instance:supply diagnosis result of range check of target rich sensor voltage, sensor 2, bank 1 / measurement for IUMPR is finished" UBYTE B_TRUE 1 100 0.00 1.00000000000 BIT_MASK 0x1 FORMAT "%13.11" ECU_ADDRESS 0x60013370 /end MEASUREMENT
/begin MEASUREMENT EGSDU_S2B1TarRichEvlnDs_I.u "class instance:supply diagnosis result of range check of target rich sensor voltage, sensor 2, bank 1 / Sensor voltage" UWORD spg_q1p221Em3_V 1 100 0.00 4.998779 FORMAT "%8.6" ECU_ADDRESS 0x60013372 /end MEASUREMENT
/begin MEASUREMENT EGSDU_S2B1TarRichEvlnDs_I.u_Err_C "class instance:supply diagnosis result of range check of target rich sensor voltage, sensor 2, bank 1 / Threshold to detect sensor voltage fault" UWORD spg_q1p221Em3_V 1 100 0.00 4.998779 FORMAT "%8.6" ECU_ADDRESS 0x60013374 /end MEASUREMENT
/begin MEASUREMENT EGSDU_S2B1TarRichSrvEvln_I.flgDisbl "Class instance: interface to fault code memory and scan tool services range check of rich target sensor voltage, sensor 2, bank 1 / DFC is disabled by disable mask" UBYTE B_TRUE 1 100 0.00 1.00000000000 BIT_MASK 0x1 FORMAT "%13.11" ECU_ADDRESS 0x6000724A /end MEASUREMENT
/begin MEASUREMENT EGSDU_S2B1TarRichSrvEvln_I.flgErrSuspc "Class instance: interface to fault code memory and scan tool services range check of rich target sensor voltage, sensor 2, bank 1 / condition: Results go beyond the fault threshold" UBYTE B_TRUE 1 100 0.00 1.00000000000 BIT_MASK 0x1 FORMAT "%13.11" ECU_ADDRESS 0x6000724B /end MEASUREMENT
/begin MEASUREMENT EGSDU_S2B1TarRichSrvEvln_I.flgInhbn "Class instance: interface to fault code memory and scan tool services range check of rich target sensor voltage, sensor 2, bank 1 / DFC is inhibited" UBYTE B_TRUE 1 100 0.00 1.00000000000 BIT_MASK 0x1 FORMAT "%13.11" ECU_ADDRESS 0x6000724C /end MEASUREMENT
/begin MEASUREMENT EGSDU_S2B1TarRichSrvEvln_I.flgOkOnceEvln "Class instance: interface to fault code memory and scan tool services range check of rich target sensor voltage, sensor 2, bank 1 / at least one target OK check in the current driving cycle" UBYTE B_TRUE 1 100 0.00 1.00000000000 BIT_MASK 0x1 FORMAT "%13.11" ECU_ADDRESS 0x6000724D /end MEASUREMENT
/begin MEASUREMENT EGSDU_S2B1TarRichSrvEvln_I.flgResEvln "Class instance: interface to fault code memory and scan tool services range check of rich target sensor voltage, sensor 2, bank 1 / Condition: result available" UBYTE B_TRUE 1 100 0.00 1.00000000000 BIT_MASK 0x1 FORMAT "%13.11" ECU_ADDRESS 0x6000724E /end MEASUREMENT
/begin MEASUREMENT EGSDU_S2B1TarRichSrvEvln_I.flgResVirtEvln "Class instance: interface to fault code memory and scan tool services range check of rich target sensor voltage, sensor 2, bank 1 / measurement for IUMPR is finished" UBYTE B_TRUE 1 100 0.00 1.00000000000 BIT_MASK 0x1 FORMAT "%13.11" ECU_ADDRESS 0x6000724F /end MEASUREMENT
/begin MEASUREMENT EGSDU_S2B1TarRichSrvEvln_I.flgFrzFrmER_I.buffer "Class instance: interface to fault code memory and scan tool services range check of rich target sensor voltage, sensor 2, bank 1 / EdgeRising:FreezeFrame is placed. / rising edge detected" UBYTE B_TRUE 1 100 0.00 1.00000000000 BIT_MASK 0x1 FORMAT "%13.11" ECU_ADDRESS 0x60007250 /end MEASUREMENT
/begin MEASUREMENT EGSDU_S2B1TarRichSrvEvln_I.flgFrzFrmER_I.oldSignal "Class instance: interface to fault code memory and scan tool services range check of rich target sensor voltage, sensor 2, bank 1 / EdgeRising:FreezeFrame is placed. / flag rising edge" UBYTE B_TRUE 1 100 0.00 1.00000000000 BIT_MASK 0x1 FORMAT "%13.11" ECU_ADDRESS 0x60007251 /end MEASUREMENT
/begin MEASUREMENT EGSDU_shtrp_100ms_I.buffer "Trigger shorttrip after flgtrip is set / rising edge detected" UBYTE B_TRUE 1 100 0.00 1.00000000000 BIT_MASK 0x1 FORMAT "%13.11" ECU_ADDRESS 0x60007248 /end MEASUREMENT
/begin MEASUREMENT EGSDU_shtrp_100ms_I.oldSignal "Trigger shorttrip after flgtrip is set / flag rising edge" UBYTE B_TRUE 1 100 0.00 1.00000000000 BIT_MASK 0x1 FORMAT "%13.11" ECU_ADDRESS 0x60007249 /end MEASUREMENT
/begin MEASUREMENT EGSDU_stS2B1VirtParlOld "Value of last calculation step: status of state machine of lambda shifting from coordinator function of parallelization, bank 2" UBYTE dez 1 100 0.00 255.0 FORMAT "%5.1" ECU_ADDRESS 0x600140AF /end MEASUREMENT
/begin MEASUREMENT EGSDU_tiS2B1LtrDlyEvln "evaluated delay time of sensor voltage during crossing lean to rich , sensor 2, bank 1" UWORD t_q0p01 1 100 0.00 655.3500 FORMAT "%8.4" ECU_ADDRESS 0x6000872A /end MEASUREMENT
/begin MEASUREMENT EGSDU_tiS2B1LtrDlySymcEvln "evaluated delay time of sensor voltage during asymmetric crossing lean to rich , sensor 2, bank 1" UWORD t_q0p01 1 100 0.00 655.3500 FORMAT "%8.4" ECU_ADDRESS 0x60008728 /end MEASUREMENT
/begin MEASUREMENT EGSDU_tiS2B1LtrDlyUnfildEvln "evaluated unfiltered delay time of sensor voltage during crossing lean to rich , sensor 2, bank 1" SWORD t_q0p01 1 100 -327.6800 327.6700 FORMAT "%8.4" ECU_ADDRESS 0x600091D4 /end MEASUREMENT
/begin MEASUREMENT EGSDU_tiS2B1LtrTran "transition time (single measurement) of sensor voltage at transition lean to rich, sensor 2, bank 1" SWORD t_q0p01 1 100 -327.6800 327.6700 FORMAT "%8.4" ECU_ADDRESS 0x600091D0 /end MEASUREMENT
/begin MEASUREMENT EGSDU_tiS2B1LtrTranEvln "evaluated transition time of sensor voltage during crossing lean to rich , sensor 2, bank 1" UWORD t_q0p01 1 100 0.00 655.3500 FORMAT "%8.4" ECU_ADDRESS 0x60013EA6 /end MEASUREMENT
/begin MEASUREMENT EGSDU_tiS2B1LtrTranSymcEvln "evaluated transition time of sensor voltage during asymmetric crossing lean to rich , sensor 2, bank 1" UWORD t_q0p01 1 100 0.00 655.3500 FORMAT "%8.4" ECU_ADDRESS 0x60008726 /end MEASUREMENT
/begin MEASUREMENT EGSDU_tiS2B1LtrTranUnfildEvln "evaluated unfiltered transition time of sensor voltage during crossing lean to rich , sensor 2, bank 1" SWORD t_q0p01 1 100 -327.6800 327.6700 FORMAT "%8.4" ECU_ADDRESS 0x600091CE /end MEASUREMENT
/begin MEASUREMENT EGSDU_tiS2B1RtlDlyEvln "evaluated delay time of sensor voltage during crossing rich to lean , sensor 2, bank 1" UWORD t_q0p01 1 100 0.00 655.3500 FORMAT "%8.4" ECU_ADDRESS 0x60008724 /end MEASUREMENT
/begin MEASUREMENT EGSDU_tiS2B1RtlDlySymcEvln "Maximum delay time of sensor voltage during asymmetric crossing rich to lean , sensor 2, bank 1" UWORD t_q0p01 1 100 0.00 655.3500 FORMAT "%8.4" ECU_ADDRESS 0x60008722 /end MEASUREMENT
/begin MEASUREMENT EGSDU_tiS2B1RtlDlyUnfildEvln "evaluated unfiltered delay time of sensor voltage during crossing rich to lean , sensor 2, bank 1" SWORD t_q0p01 1 100 -327.6800 327.6700 FORMAT "%8.4" ECU_ADDRESS 0x600091CC /end MEASUREMENT
/begin MEASUREMENT EGSDU_tiS2B1RtlTran "transition time (single measurement) of sensor voltage at transition rich to lean, sensor 2, bank 1" SWORD t_q0p01 1 100 -327.6800 327.6700 FORMAT "%8.4" ECU_ADDRESS 0x600091C8 /end MEASUREMENT
/begin MEASUREMENT EGSDU_tiS2B1RtlTranEvln "evaluated transition time of sensor voltage during crossing rich to lean , sensor 2, bank 1" UWORD t_q0p01 1 100 0.00 655.3500 FORMAT "%8.4" ECU_ADDRESS 0x60013EA8 /end MEASUREMENT
/begin MEASUREMENT EGSDU_tiS2B1RtlTranSymcEvln "evaluated transition time of sensor voltage during asymmetric crossing rich to lean , sensor 2, bank 1" UWORD t_q0p01 1 100 0.00 655.3500 FORMAT "%8.4" ECU_ADDRESS 0x60008720 /end MEASUREMENT
/begin MEASUREMENT EGSDU_tiS2B1RtlTranUnfildEvln "evaluated unfiltered transition time of sensor voltage during crossing rich to lean , sensor 2, bank 1" SWORD t_q0p01 1 100 -327.6800 327.6700 FORMAT "%8.4" ECU_ADDRESS 0x600091C6 /end MEASUREMENT
/begin MEASUREMENT EGSPrepn_dmEgFlowSnsr1Bnk1 "Exhaust-gas mass flow at sensor 1 bank 1" SWORD AirMassPerTime 1 100 -3276.800 3276.700 FORMAT "%8.3" ECU_ADDRESS 0x600091C4 /end MEASUREMENT
/begin MEASUREMENT EGSPrepn_dmExhAry "Array for mass flow exhaust gas sensor 1" SWORD m_q0p1 1 100 -3276.800 3276.700 FORMAT "%8.3" ARRAY_SIZE 4 ECU_ADDRESS 0x6000721E /end MEASUREMENT
/begin MEASUREMENT EGSPrepn_flgEgSnsrPrsntSnsr1Bnk1 "Exhaust gas sensor 1, bank 1 is present" UBYTE B_TRUE 1 100 0.00 1.00000000000 BIT_MASK 0x1 FORMAT "%13.11" ECU_ADDRESS 0x6000F144 /end MEASUREMENT
/begin MEASUREMENT EGSSig_AirQntyCmb "Constant for lambda calculation depending on the required air for fuel combustion" SWORD Fact1 1 100 -256.0000 255.9922 FORMAT "%8.4" ECU_ADDRESS 0x6000721C /end MEASUREMENT
/begin MEASUREMENT EGSSig_flgHomOperMod "Homogeneous operation mode" UBYTE B_TRUE 1 100 0.00 1.00000000000 BIT_MASK 0x1 FORMAT "%13.11" ECU_ADDRESS 0x700009AF /end MEASUREMENT
/begin MEASUREMENT EGSSig_flgO2NoErrS1B1 "No errors for oxygen signals resp. lambda for sensor 1 bank 1" UBYTE B_TRUE 1 100 0.00 1.00000000000 BIT_MASK 0x1 FORMAT "%13.11" ECU_ADDRESS 0x6000F143 /end MEASUREMENT
/begin MEASUREMENT EGSSig_flgO2PhyRelsS1B1 "Physical release of the O2 signal (sensor 1 bank 1)" UBYTE B_TRUE 1 100 0.00 1.00000000000 BIT_MASK 0x1 FORMAT "%13.11" ECU_ADDRESS 0x6000F142 /end MEASUREMENT
/begin MEASUREMENT EGSSig_flgO2RelsS1B1 "Release of oxygen signal of sensor 1 bank 1 for application SW (low precision)" UBYTE B_TRUE 1 100 0.00 1.00000000000 BIT_MASK 0x1 FORMAT "%13.11" ECU_ADDRESS 0x6000F141 /end MEASUREMENT
/begin MEASUREMENT EGSSig_LamSymcS1B1_I.flgAdpnFil "Instance of class which calculates symmetrized lambda for sensor 1 bank 1 / Flag dynamics symmetrization filter effective" UBYTE B_TRUE 1 100 0.00 1.00000000000 BIT_MASK 0x4 FORMAT "%13.11" ECU_ADDRESS 0x60002BD4 /end MEASUREMENT
/begin MEASUREMENT EGSSig_LamSymcS1B1_I.ratLam "Instance of class which calculates symmetrized lambda for sensor 1 bank 1 / Temporary variable for lambda" UWORD fak_q0p000244 1 100 0.00 15.99976 FORMAT "%8.5" ECU_ADDRESS 0x60002BD6 /end MEASUREMENT
/begin MEASUREMENT EGSSig_LamSymcS1B1_I.ratLamAdpnDir "Instance of class which calculates symmetrized lambda for sensor 1 bank 1 / Filtered lambda value for determination of direction" UWORD fak_q0p000244 1 100 0.00 15.99976 FORMAT "%8.5" ECU_ADDRESS 0x60002BD8 /end MEASUREMENT
/begin MEASUREMENT EGSSig_LamSymcS1B1_I.ratLamAdpn_LT_I.memory "Instance of class which calculates symmetrized lambda for sensor 1 bank 1 / Low pass for filtering of lambda, if the lambda signal is asymmetrical / current lowpass value" ULONG fak_q3p72529Em9 1 100 0.00 15.9999999963 FORMAT "%13.10" ECU_ADDRESS 0x60002BDC /end MEASUREMENT
/begin MEASUREMENT EGSSig_LamSymcS1B1_I.tiAdpnDTTtOpt_I.buffer "Instance of class which calculates symmetrized lambda for sensor 1 bank 1 / Delay element of symmetrization function / buffer element of delay time class" UWORD fak_q0p000244 1 100 0.00 15.99976 FORMAT "%8.5" ARRAY_SIZE 21 ECU_ADDRESS 0x60002BE0 /end MEASUREMENT
/begin MEASUREMENT EGSSig_LamSymcS1B1_I.tiAdpnDTTtOpt_I.counter "Instance of class which calculates symmetrized lambda for sensor 1 bank 1 / Delay element of symmetrization function / counter element of delay time class" UWORD fak_uw_b2 1 100 0.00 1.000000 FORMAT "%8.6" ECU_ADDRESS 0x60002C0A /end MEASUREMENT
/begin MEASUREMENT EGSSig_LamSymcS1B1_I.tiAdpnDTTtOpt_I.pointer "Instance of class which calculates symmetrized lambda for sensor 1 bank 1 / Delay element of symmetrization function / pointer element of delay time class" UBYTE dez 1 100 0.00 255.0 FORMAT "%5.1" ECU_ADDRESS 0x60002C0C /end MEASUREMENT
/begin MEASUREMENT EGSSig_LamSymcS1B1_I.tiConAdpn_LT_I.memory "Instance of class which calculates symmetrized lambda for sensor 1 bank 1 / Low pass for smooting of lambda signal / current lowpass value" ULONG fak_q3p72529Em9 1 100 0.00 15.9999999963 FORMAT "%13.10" ECU_ADDRESS 0x60002C10 /end MEASUREMENT
/begin MEASUREMENT EGSSig_LamTCorrdCalcnS1B1.DenomLamCalc "Class for the calculation of temperatue corrected lambda from rate of oxygen for sensor 1 bank 1 / Denominator of Pischinger formula" SLONG fak_q1Em5 1 100 0.0000100 21474.8364700 FORMAT "%13.7" ECU_ADDRESS 0x60002BCC /end MEASUREMENT
/begin MEASUREMENT EGSSig_LamTCorrdCalcnS1B1.NumrLamCalc "Class for the calculation of temperatue corrected lambda from rate of oxygen for sensor 1 bank 1 / Numerator of Pischinger formula" ULONG fak_q1Em6 1 100 0.00 4.00000000000 FORMAT "%13.11" ECU_ADDRESS 0x60002BD0 /end MEASUREMENT
/begin MEASUREMENT EGSSig_O2CrvtCompS1B1.facPAct "Class for compensation of the curvature at the oxygen signal for sensor 1 bank 1 / Dependency of the pressure correction factor on actual pressure" UWORD fak_uw_b16 1 100 0.00 15.99976 FORMAT "%8.5" ECU_ADDRESS 0x60007212 /end MEASUREMENT
/begin MEASUREMENT EGSSig_O2CrvtCompS1B1.facPCorrn "Class for compensation of the curvature at the oxygen signal for sensor 1 bank 1 / Dependency of the pressure correction factor on nominal pressure" UWORD fak_uw_b16 1 100 0.00 15.99976 FORMAT "%8.5" ECU_ADDRESS 0x60007214 /end MEASUREMENT
/begin MEASUREMENT EGSSig_O2CrvtCompS1B1.facPNorm "Class for compensation of the curvature at the oxygen signal for sensor 1 bank 1 / Pressure correction factor" UWORD fak_uw_b16 1 100 0.00 15.99976 FORMAT "%8.5" ECU_ADDRESS 0x60007216 /end MEASUREMENT
/begin MEASUREMENT EGSSig_O2CrvtCompS1B1.ratO2LnrPCorrd "Class for compensation of the curvature at the oxygen signal for sensor 1 bank 1 / Pressure corrected linearized oxygen ration" SWORD O2 1 100 -0.3276800 0.3276700 FORMAT "%9.7" ECU_ADDRESS 0x60007218 /end MEASUREMENT
/begin MEASUREMENT EGSSig_O2PCrvtCompS1B1_I.facPAct "Class for compensation of the curvature and pressure influence at the oxygen signal for sensor 1 bank 1 / Dependency of the pressure correction factor on actual pressure" UWORD fak_uw_b16 1 100 0.00 15.99976 FORMAT "%8.5" ECU_ADDRESS 0x6000720A /end MEASUREMENT
/begin MEASUREMENT EGSSig_O2PCrvtCompS1B1_I.facPCorrn "Class for compensation of the curvature and pressure influence at the oxygen signal for sensor 1 bank 1 / Dependency of the pressure correction factor on nominal pressure" UWORD fak_uw_b16 1 100 0.00 15.99976 FORMAT "%8.5" ECU_ADDRESS 0x6000720C /end MEASUREMENT
/begin MEASUREMENT EGSSig_O2PCrvtCompS1B1_I.facPNorm "Class for compensation of the curvature and pressure influence at the oxygen signal for sensor 1 bank 1 / Pressure correction factor" UWORD fak_uw_b16 1 100 0.00 15.99976 FORMAT "%8.5" ECU_ADDRESS 0x6000720E /end MEASUREMENT
/begin MEASUREMENT EGSSig_O2PCrvtCompS1B1_I.ratO2LnrPCorrd "Class for compensation of the curvature and pressure influence at the oxygen signal for sensor 1 bank 1 / Pressure corrected linearized oxygen ration" SWORD O2 1 100 -0.3276800 0.3276700 FORMAT "%9.7" ECU_ADDRESS 0x60007210 /end MEASUREMENT
/begin MEASUREMENT EGSSig_O2SigS1B1_I.flgffv "Class for calculation of oxygen signals and whose signal quality for sensor 1 bank 1 / flag status for flexible fuel vehicle" UBYTE B_TRUE 1 100 0.00 1.00000000000 BIT_MASK 0x1 FORMAT "%13.11" ECU_ADDRESS 0x60002BB0 /end MEASUREMENT
/begin MEASUREMENT EGSSig_O2SigS1B1_I.ratLam "Class for calculation of oxygen signals and whose signal quality for sensor 1 bank 1 / Lambda with all O2 corrections" ULONG fak_q0p000244 1 100 0.00 1048575.99976 FORMAT "%13.5" ECU_ADDRESS 0x60002BB4 /end MEASUREMENT
/begin MEASUREMENT EGSSig_O2SigS1B1_I.ratLamCorrd "Class for calculation of oxygen signals and whose signal quality for sensor 1 bank 1 / Corrected lambda" UWORD fak_q0p000244 1 100 0.00 15.99976 FORMAT "%8.5" ECU_ADDRESS 0x60002BB8 /end MEASUREMENT
/begin MEASUREMENT EGSSig_O2SigS1B1_I.ratLamOffsCorrd "Class for calculation of oxygen signals and whose signal quality for sensor 1 bank 1 / Lambda with corrected offset" UWORD fak_q0p000244 1 100 0.00 15.99976 FORMAT "%8.5" ECU_ADDRESS 0x60002BBA /end MEASUREMENT
/begin MEASUREMENT EGSSig_O2SigS1B1_I.ratLamPhy "Class for calculation of oxygen signals and whose signal quality for sensor 1 bank 1 / Physical lambda without lambda corrections" ULONG fak_q0p000244 1 100 0.00 1048575.99976 FORMAT "%13.5" ECU_ADDRESS 0x60002BBC /end MEASUREMENT
/begin MEASUREMENT EGSSig_O2SigS1B1_I.ratO2Srv1 "Class for calculation of oxygen signals and whose signal quality for sensor 1 bank 1 / Measured oxygen ratio for displaying of tester mode 01" SWORD O2 1 100 -0.3276800 0.3276700 FORMAT "%9.7" ECU_ADDRESS 0x60002BC0 /end MEASUREMENT
/begin MEASUREMENT EGSSig_O2SigS1B1_I.LamCalc_I.DenomLamCalc "Class for calculation of oxygen signals and whose signal quality for sensor 1 bank 1 / Class for the calculation of lambda and reciprocal lambda from rate of oxygen / Denominator of Pischinger formula" SLONG fak_q1Em5 1 100 0.0000100 21474.8364700 FORMAT "%13.7" ECU_ADDRESS 0x60002BC4 /end MEASUREMENT
/begin MEASUREMENT EGSSig_O2SigS1B1_I.LamCalc_I.NumrLamCalc "Class for calculation of oxygen signals and whose signal quality for sensor 1 bank 1 / Class for the calculation of lambda and reciprocal lambda from rate of oxygen / Numerator of Pischinger formula" ULONG fak_q1Em6 1 100 0.00 4.00000000000 FORMAT "%13.11" ECU_ADDRESS 0x60002BC8 /end MEASUREMENT
/begin MEASUREMENT EGSSig_ratLamCorrdS1B1 "Corrected lambda (without error simulation and without symmetrization) at sensor 1 bank 1" UWORD fak_q0p000244 1 100 0.00 15.99976 FORMAT "%8.5" ECU_ADDRESS 0x60008C5C /end MEASUREMENT
/begin MEASUREMENT EGSSig_ratLamDeltaIntfrS1B1 "lambda shift regarding sensor cross sensitivity in H2,CO,HC (sensor 1 bank 1)" SWORD fak_sw_b8 1 100 -8.000000 7.999756 FORMAT "%8.6" ECU_ADDRESS 0x600091C2 /end MEASUREMENT
/begin MEASUREMENT EGSSig_ratLamDeltaScavS1B1 "lambda shift regarding scavenging (sensor 1 bank 1)" SWORD fak_sw_b1 1 100 -1.000000 0.999969 FORMAT "%8.6" ECU_ADDRESS 0x600091C0 /end MEASUREMENT
/begin MEASUREMENT EGSSig_ratLamPTCorrdS1B1 "Pressure and temperature corrected lambda at sensor 1 bank 1" UWORD fak_q0p000244 1 100 0.00 15.99976 FORMAT "%8.5" ECU_ADDRESS 0x60008C5A /end MEASUREMENT
/begin MEASUREMENT EGSSig_ratLamS1B1 "Lambda of sensor 1 bank 1" UWORD fak_q0p000244 1 100 0.00 15.99976 FORMAT "%8.5" ECU_ADDRESS 0x60008C58 /end MEASUREMENT
/begin MEASUREMENT EGSSig_ratLamSrv1S1B1 "Actual value of lambda for service 01 (sensor 1 bank 1)" SWORD lambda 1 100 -32.76800 32.76700 FORMAT "%8.5" ECU_ADDRESS 0x600091BE /end MEASUREMENT
/begin MEASUREMENT EGSSig_ratLamSymcS1B1 "Actual lambda after symmetrization (sensor 1, bank 1)" UWORD fak_q0p000244 1 100 0.00 15.99976 FORMAT "%8.5" ECU_ADDRESS 0x60008C56 /end MEASUREMENT
/begin MEASUREMENT EGSSig_ratLamTCorrdS1B1 "Temperature corrected lambda of sensor 1 bank 1" UWORD fak_q0p000244 1 100 0.00 15.99976 FORMAT "%8.5" ECU_ADDRESS 0x60008C54 /end MEASUREMENT
/begin MEASUREMENT EGSSig_ratO2TCorrdS1B1 "Temperature corrected physical oxygen singal of sensor 1 bank 1" SWORD O2 1 100 -0.3276800 0.3276700 FORMAT "%9.7" ECU_ADDRESS 0x6000721A /end MEASUREMENT
/begin MEASUREMENT ElecLd_cntrReIni "ReIni counter variable" UBYTE OneToOne 1 100 0.00 255.0 FORMAT "%5.1" ECU_ADDRESS 0x6000B1EB /end MEASUREMENT
/begin MEASUREMENT ElecLd_iAirCmpr "Electric load current from Air Compressor" SWORD Curr_A 1 100 -327.6800 327.6700 FORMAT "%8.4" ECU_ADDRESS 0x600091A0 /end MEASUREMENT
/begin MEASUREMENT ElecLd_iBlowrFanAC "Blower Fan AC current" SWORD Curr_A 1 100 -327.6800 327.6700 FORMAT "%8.4" ECU_ADDRESS 0x6000919E /end MEASUREMENT
/begin MEASUREMENT ElecLd_iEPSLd "Electric load current output value" SWORD Curr_A 1 100 -327.6800 327.6700 FORMAT "%8.4" ECU_ADDRESS 0x6000919C /end MEASUREMENT
/begin MEASUREMENT ElecLd_iEPSLoadOnly "Electric load current from EPS ECU only." SWORD Curr_A 1 100 -327.6800 327.6700 FORMAT "%8.4" ECU_ADDRESS 0x6000919A /end MEASUREMENT
/begin MEASUREMENT ElecLd_iFan "Electric load current from fan" SWORD Curr_A 1 100 -327.6800 327.6700 FORMAT "%8.4" ECU_ADDRESS 0x60009198 /end MEASUREMENT
/begin MEASUREMENT ElecLd_iFild1EPSLoad "ElecLd_iFild1EPSLoad normalised value of filtered load current" SWORD Curr_A 1 100 -327.6800 327.6700 FORMAT "%8.4" ECU_ADDRESS 0x60007208 /end MEASUREMENT
/begin MEASUREMENT ElecLd_iFildElecLoad "Filtered value of Sensed Load current" SWORD Curr_A 1 100 -327.6800 327.6700 FORMAT "%8.4" ECU_ADDRESS 0x60007206 /end MEASUREMENT
/begin MEASUREMENT ElecLd_iFildEPSLoad "ElecLd_iFildEPSLoad filtered value of the load current" SWORD Curr_A 1 100 -327.6800 327.6700 FORMAT "%8.4" ECU_ADDRESS 0x60007204 /end MEASUREMENT
/begin MEASUREMENT ElecLd_iFrntDeicer "Electric load current from Front de-icer switch" SWORD Curr_A 1 100 -327.6800 327.6700 FORMAT "%8.4" ECU_ADDRESS 0x60009196 /end MEASUREMENT
/begin MEASUREMENT ElecLd_iFrntFog "Electric load current from Front-fog lamp switch" SWORD Curr_A 1 100 -327.6800 327.6700 FORMAT "%8.4" ECU_ADDRESS 0x60009194 /end MEASUREMENT
/begin MEASUREMENT ElecLd_iLd "Electric load current from the hardware" SWORD Curr_A 1 100 -327.6800 327.6700 FORMAT "%8.4" ECU_ADDRESS 0x6000918E /end MEASUREMENT
/begin MEASUREMENT ElecLd_iLd1 "Electric loads from Head Light, Front Fog, Rear Fog, Wiper, Front De-icer, Rear de-fogger (Manual AC), Rear de-fogger (Auto AC) and Blower Fan(Auto AC and Manual AC)" SWORD Curr_A 1 100 -327.6800 327.6700 FORMAT "%8.4" ECU_ADDRESS 0x60009192 /end MEASUREMENT
/begin MEASUREMENT ElecLd_iLd2 "Electric Load from calibration when Communication Error occurs" SWORD Curr_A 1 100 -327.6800 327.6700 FORMAT "%8.4" ECU_ADDRESS 0x60009190 /end MEASUREMENT
/begin MEASUREMENT ElecLd_iLiSwt "Electric load current from light switch" SWORD Curr_A 1 100 -327.6800 327.6700 FORMAT "%8.4" ECU_ADDRESS 0x6000918C /end MEASUREMENT
/begin MEASUREMENT ElecLd_iLoadMdlUnFild "Unfiltered value of the modelled load current" SWORD Curr_A 1 100 -327.6800 327.6700 FORMAT "%8.4" ECU_ADDRESS 0x6000918A /end MEASUREMENT
/begin MEASUREMENT ElecLd_iReDeFoggerAutoAC "Electric load current from Rear de-fogger (Auto AC) switch" SWORD Curr_A 1 100 -327.6800 327.6700 FORMAT "%8.4" ECU_ADDRESS 0x60009188 /end MEASUREMENT
/begin MEASUREMENT ElecLd_iReDeFoggerManAC "Electric load current from Rear de-fogger (Manual AC) switch" SWORD Curr_A 1 100 -327.6800 327.6700 FORMAT "%8.4" ECU_ADDRESS 0x60009186 /end MEASUREMENT
/begin MEASUREMENT ElecLd_iReFog "Electric load current from Rear-fog lamp switch" SWORD Curr_A 1 100 -327.6800 327.6700 FORMAT "%8.4" ECU_ADDRESS 0x60009184 /end MEASUREMENT
/begin MEASUREMENT ElecLd_iUnfildLoad "Unfiltered value of the load current" SWORD Curr_A 1 100 -327.6800 327.6700 FORMAT "%8.4" ECU_ADDRESS 0x60007202 /end MEASUREMENT
/begin MEASUREMENT ElecLd_iWipr "Electric load current from wiper" SWORD Curr_A 1 100 -327.6800 327.6700 FORMAT "%8.4" ECU_ADDRESS 0x60009180 /end MEASUREMENT
/begin MEASUREMENT ElecLd_stAutoAC "AC learning status" UBYTE OneToOne 1 100 0.00 1.000 FORMAT "%5.3" ECU_ADDRESS 0x600390D2 /end MEASUREMENT
/begin MEASUREMENT ElecLd_stHdLiInfo "Head Light Information status" UBYTE OneToOne 1 100 0.00 255.0 FORMAT "%5.1" ECU_ADDRESS 0x6000F453 /end MEASUREMENT
/begin MEASUREMENT ElecLd_swtCurrMdl "Electric Load current value Model switch" UBYTE OneToOne 1 100 0.00 1.000 FORMAT "%5.3" ECU_ADDRESS 0x6000F451 /end MEASUREMENT
/begin MEASUREMENT ElecLd_uHeatrMot "Value of Heater Motor Voltage" SWORD Volt_Batt 1 100 -655360.0 655340.0 FORMAT "%8.1" ECU_ADDRESS 0x60007200 /end MEASUREMENT
/begin MEASUREMENT EngDa_pwrCrksftMax "Maximum engine power at crankshaft level" SLONG Pwr_kW 1 100 0.00000 16777216.00000 FORMAT "%20.5" ECU_ADDRESS 0x60003790 /end MEASUREMENT
/begin MEASUREMENT EngDa_pwrCrksftMax_f "Engine reference power at crankshaft level" FLOAT32_IEEE RBPtCel_pwr_kw_1p0_1 1 100 0.00000 16777216.00000 FORMAT "%20.5" ECU_ADDRESS 0x50004EA8 /end MEASUREMENT
/begin MEASUREMENT EngDa_tqCrksftMax "Maximun Engine torque at crankshaft level" SLONG Trq 1 100 0.00 65535.0000000 FORMAT "%13.7" ECU_ADDRESS 0x60003788 /end MEASUREMENT
/begin MEASUREMENT EngDa_tqCrksftMax_f "Engine reference torque torque at crankshaft level" FLOAT32_IEEE RBPtCel_tq_1p0_1 1 100 0.00000 16777216.00000 FORMAT "%16.5" ECU_ADDRESS 0x60003874 /end MEASUREMENT
/begin MEASUREMENT EngDa_tqInnrMax "Maximum indicated Engine torque torque" SLONG Trq 1 100 0.00 65535.0000000 FORMAT "%13.7" ECU_ADDRESS 0x50004EAC /end MEASUREMENT
/begin MEASUREMENT EngDa_tqInnrMax_f "Maximum indicated Engine torque torque" FLOAT32_IEEE RBPtCel_tq_1p0_1 1 100 0.00000 16777216.00000 FORMAT "%16.5" ECU_ADDRESS 0x60003870 /end MEASUREMENT
/begin MEASUREMENT EngDa_volDispl "Engine displacement" UWORD Vol 1 100 0.00 655.3400 FORMAT "%8.4" ECU_ADDRESS 0x6000871A /end MEASUREMENT
/begin MEASUREMENT EngDa_volDispl_f "Engine displacement" FLOAT32_IEEE RBPtCel_vol_1p0_1 1 100 0.00000 16777216.00000 FORMAT "%16.5" ECU_ADDRESS 0x6000386C /end MEASUREMENT
/begin MEASUREMENT EngDem_dTqSlpLimnNeg "Selected negative ramp slope for torque limitation" SLONG RmpTrq 1 100 0.00 3276799.99847 FORMAT "%13.5" ECU_ADDRESS 0x600004C0 /end MEASUREMENT
/begin MEASUREMENT EngDem_dTqSlpLimnPos "Selected positive ramp slope for torque limitation" SLONG RmpTrq 1 100 0.00 3276799.99847 FORMAT "%13.5" ECU_ADDRESS 0x600004C8 /end MEASUREMENT
/begin MEASUREMENT EngDem_flgRampIni "Condition ramp initialisation" UBYTE B_TRUE 1 100 0.00 1.00000000000 BIT_MASK 0x1 FORMAT "%13.11" ECU_ADDRESS 0x6000095A /end MEASUREMENT
/begin MEASUREMENT EngDem_flgRampLeadReInit "Condition ramp initialisation on the Lead Path" UBYTE B_TRUE 1 100 0.00 1.00000000000 BIT_MASK 0x1 FORMAT "%13.11" ECU_ADDRESS 0x70003045 /end MEASUREMENT
/begin MEASUREMENT EngDem_flgRampTgtRea "Condition target reached in the ramping of the torque limitation" UBYTE B_TRUE 1 100 0.00 1.00000000000 BIT_MASK 0x1 FORMAT "%13.11" ECU_ADDRESS 0x70003044 /end MEASUREMENT
/begin MEASUREMENT EngDem_flgTqLimnErr "Condition system errors replacement value active in torque limitation" UBYTE B_TRUE 1 100 0.00 1.00000000000 BIT_MASK 0x1 FORMAT "%13.11" ECU_ADDRESS 0x7000361F /end MEASUREMENT
/begin MEASUREMENT EngDem_RampTgHldFF_I.status "Target-hold condition evaluated / current value of RS-FF" UBYTE B_TRUE 1 100 0.00 1.00000000000 BIT_MASK 0x1 FORMAT "%13.11" ECU_ADDRESS 0x600008B4 /end MEASUREMENT
/begin MEASUREMENT EngDem_ReInitCurrTqLeadERNM_I.oldSignal "Edge-rising condition for re-initialisation of torque limitation ramp on the Lead Path to current torque / value of input signal last calculation" UBYTE B_TRUE 1 100 0.00 1.00000000000 BIT_MASK 0x1 FORMAT "%13.11" ECU_ADDRESS 0x600008B5 /end MEASUREMENT
/begin MEASUREMENT EngDem_ReInitErrTqLeadERNM_I.oldSignal "Edge-rising condition for re-initialisation of torque limitation ramp on the Lead Path to error torque / value of input signal last calculation" UBYTE B_TRUE 1 100 0.00 1.00000000000 BIT_MASK 0x1 FORMAT "%13.11" ECU_ADDRESS 0x600008B6 /end MEASUREMENT
/begin MEASUREMENT EngDem_stLimErr "Status of the limitation FIds (1 Bit for each limitation)" ULONG OneToOne 1 100 0.00 4294967295.00 FORMAT "%13.2" ECU_ADDRESS 0x60013188 /end MEASUREMENT
/begin MEASUREMENT EngDem_stLimErrMn "Selected lowest system error torque limitations" ULONG OneToOne 1 100 0.00 4294967295.00 FORMAT "%13.2" ECU_ADDRESS 0x600004D0 /end MEASUREMENT
/begin MEASUREMENT EngDem_TqLimnLeadRMP_I.Dir "Ramp for torque limitation in the lead path / Direction element" SWORD OneToOne 1 100 -32768.00 32767.00 FORMAT "%8.2" ECU_ADDRESS 0x60000378 /end MEASUREMENT
/begin MEASUREMENT EngDem_TqLimnLeadRMP_I.State "Ramp for torque limitation in the lead path / Store state value" SLONG TrqHigh 1 100 -2147483.64800 2147483.64700 FORMAT "%13.5" ECU_ADDRESS 0x6000037C /end MEASUREMENT
/begin MEASUREMENT EngDem_TqLimnLeadRMP_I.Target "Ramp for torque limitation in the lead path / variable to recognize change of target" SLONG TrqHigh 1 100 -2147483.64800 2147483.64700 FORMAT "%13.5" ECU_ADDRESS 0x60000380 /end MEASUREMENT
/begin MEASUREMENT EngDem_tqLimnRampLead "Torque limitation on the Lead Path ramped" SWORD Trq 1 100 -3276.800 3276.700 FORMAT "%8.3" ECU_ADDRESS 0x600006AC /end MEASUREMENT
/begin MEASUREMENT EngDem_trqInrLim "Torque limitation" SWORD Trq 1 100 0.00 3276.700 FORMAT "%8.3" ECU_ADDRESS 0x500007D8 /end MEASUREMENT
/begin MEASUREMENT EngDem_trqInrLimCtOff "Torque limitation cut-off path (cylinder deactivation)" SWORD Trq 1 100 0.00 3276.700 FORMAT "%8.3" ECU_ADDRESS 0x70003BD0 /end MEASUREMENT
/begin MEASUREMENT EngDem_trqInrLimLead "Torque limitation (air path)" SWORD Trq 1 100 0.00 3276.700 FORMAT "%8.3" ECU_ADDRESS 0x500007DA /end MEASUREMENT
/begin MEASUREMENT EngDem_trqLimErr "Substitute limiting torque in the event of an error" SWORD Trq 1 100 0.00 3276.700 FORMAT "%8.3" ECU_ADDRESS 0x600006B2 /end MEASUREMENT
/begin MEASUREMENT EngDem_trqLimLeadRslt "Resulting limiting torque before ramp" SWORD Trq 1 100 -3276.800 3276.700 FORMAT "%8.3" ECU_ADDRESS 0x600006B6 /end MEASUREMENT
/begin MEASUREMENT flgactlskh "Flag validity of condition lambda split by cylinder variation is active" UBYTE B_TRUE 1 100 0.00 1.00000000000 BIT_MASK 0x1 FORMAT "%13.11" ECU_ADDRESS 0x6000F05D /end MEASUREMENT
/begin MEASUREMENT flghomopermod "Flag validity for the Homogeneous operation mode" UBYTE B_TRUE 1 100 0.00 1.00000000000 BIT_MASK 0x1 FORMAT "%13.11" ECU_ADDRESS 0x6000F05C /end MEASUREMENT
/begin MEASUREMENT IF_MinTiLtrTranS2_I.flgLtr "interface class for the transition diagnosis, direction lean to rich, sensor 2 / switch for direction rich to lean" UBYTE B_TRUE 1 100 0.00 1.00000000000 BIT_MASK 0x1 FORMAT "%13.11" ECU_ADDRESS 0x60002C24 /end MEASUREMENT
/begin MEASUREMENT IF_MinTiLtrTranS2_I.flgTOut "interface class for the transition diagnosis, direction lean to rich, sensor 2 / external timeout" UBYTE B_TRUE 1 100 0.00 1.00000000000 BIT_MASK 0x1 FORMAT "%13.11" ECU_ADDRESS 0x60002C25 /end MEASUREMENT
/begin MEASUREMENT IF_MinTiLtrTranS2_I.mO2TOut_C "interface class for the transition diagnosis, direction lean to rich, sensor 2 / Exhaust mass for calculation of time out criteria for transition time measurement during fuel cut off" FLOAT32_IEEE m_q1_mg 1 100 -1.00000000E+037 1.00000000E+037 FORMAT "%13.3" ECU_ADDRESS 0x60002C28 /end MEASUREMENT
/begin MEASUREMENT IF_MinTiLtrTranS2_I.swtO2Extd "interface class for the transition diagnosis, direction lean to rich, sensor 2 / switch of the timeout mode" UBYTE dez 1 100 0.00 127.0 FORMAT "%5.1" ECU_ADDRESS 0x60002C2C /end MEASUREMENT
/begin MEASUREMENT IF_MinTiLtrTranS2_I.tiTout_C "interface class for the transition diagnosis, direction lean to rich, sensor 2 / time out criterion for the sensor" UWORD t_q0p01 1 100 0.00 655.3500 FORMAT "%8.4" ECU_ADDRESS 0x60002C2E /end MEASUREMENT
/begin MEASUREMENT IF_MinTiLtrTranS2_I.uEndRtlTran_C "interface class for the transition diagnosis, direction lean to rich, sensor 2 / Destination voltage to determinate the end of transition time check lean-rich" UWORD spg_q1p221Em3_V 1 100 0.00 4.998779 FORMAT "%8.6" ECU_ADDRESS 0x60002C30 /end MEASUREMENT
/begin MEASUREMENT IF_MinTiRtlTranS2_I.flgLtr "interface class for the transition diagnosis, direction rich to lean, sensor 2 / switch for direction rich to lean" UBYTE B_TRUE 1 100 0.00 1.00000000000 BIT_MASK 0x1 FORMAT "%13.11" ECU_ADDRESS 0x60002C14 /end MEASUREMENT
/begin MEASUREMENT IF_MinTiRtlTranS2_I.flgTOut "interface class for the transition diagnosis, direction rich to lean, sensor 2 / external timeout" UBYTE B_TRUE 1 100 0.00 1.00000000000 BIT_MASK 0x1 FORMAT "%13.11" ECU_ADDRESS 0x60002C15 /end MEASUREMENT
/begin MEASUREMENT IF_MinTiRtlTranS2_I.mO2TOut_C "interface class for the transition diagnosis, direction rich to lean, sensor 2 / Exhaust mass for calculation of time out criteria for transition time measurement during fuel cut off" FLOAT32_IEEE m_q1_mg 1 100 -1.00000000E+037 1.00000000E+037 FORMAT "%13.3" ECU_ADDRESS 0x60002C18 /end MEASUREMENT
/begin MEASUREMENT IF_MinTiRtlTranS2_I.swtO2Extd "interface class for the transition diagnosis, direction rich to lean, sensor 2 / switch of the timeout mode" UBYTE dez 1 100 0.00 127.0 FORMAT "%5.1" ECU_ADDRESS 0x60002C1C /end MEASUREMENT
/begin MEASUREMENT IF_MinTiRtlTranS2_I.tiTout_C "interface class for the transition diagnosis, direction rich to lean, sensor 2 / time out criterion for the sensor" UWORD t_q0p01 1 100 0.00 655.3500 FORMAT "%8.4" ECU_ADDRESS 0x60002C1E /end MEASUREMENT
/begin MEASUREMENT IF_MinTiRtlTranS2_I.uEndRtlTran_C "interface class for the transition diagnosis, direction rich to lean, sensor 2 / Destination voltage to determinate the end of transition time check lean-rich" UWORD spg_q1p221Em3_V 1 100 0.00 4.998779 FORMAT "%8.6" ECU_ADDRESS 0x60002C20 /end MEASUREMENT
/begin MEASUREMENT lamsonb_w_msg "base lambda actual value" UWORD fak_uw_b16 1 100 0.00 15.99976 FORMAT "%8.5" ECU_ADDRESS 0x700053F4 /end MEASUREMENT
/begin MEASUREMENT UEGO_ratLamSrv1S1B1 "Lambda actual value for service 01 sensor 1 bank 1" UWORD fak_uw_b16 1 100 0.00 15.99976 FORMAT "%8.5" ECU_ADDRESS 0x700053EE /end MEASUREMENT
/begin MEASUREMENT UEGO_ratLamSymS1B1 "Actual lambda after symmetrization (sensor 1, bank 1)" UWORD fak_uw_b16 1 100 0.00 15.99976 FORMAT "%8.5" ECU_ADDRESS 0x60013FE6 /end MEASUREMENT
/begin MEASUREMENT UEGO_rLamEquivElecCorrdS1B1 "Lambda equivalent based on electrically corrected pump current sensor 1 bank 1" UWORD fak_uw_b16 1 100 0.00 15.99976 FORMAT "%8.5" ECU_ADDRESS 0x700053EC /end MEASUREMENT
/begin MEASUREMENT UEGO_rLamS1B1 "Lambda actual value sensor 1 bank 1" UWORD fak_uw_b16 1 100 0.00 15.99976 FORMAT "%8.5" ECU_ADDRESS 0x50005DEC /end MEASUREMENT
/begin FUNCTION EGSDU_EvlnDs "1.41.1    Dynamic diagnosis binary oxygen sensor downstream - evaluation"
 /begin DEF_CHARACTERISTIC EGSDU_facBndErrEvln_C EGSDU_flgS2LtrDlyArthEvln_CW EGSDU_flgS2LtrTranArthEvln_CW EGSDU_flgS2RtlDlyArthEvln_CW EGSDU_flgS2RtlTranArthEvln_CW EGSDU_S2B1LtrFilDlyEvln_I.facEwmaCodClr_C EGSDU_S2B1LtrFilDlyEvln_I.facEwmaNorm_C EGSDU_S2B1LtrFilDlyEvln_I.facEwmaStepChg_C EGSDU_S2B1LtrFilDlyEvln_I.nrMeasCodClrTrip_C EGSDU_S2B1LtrFilDlyEvln_I.nrMeasCodClr_C EGSDU_S2B1LtrFilDlyEvln_I.nrMeasStepChgTrip_C EGSDU_S2B1LtrFilDlyEvln_I.nrMeasStepChg_C EGSDU_S2B1LtrFilDlyEvln_I.numMeasShtrp_C EGSDU_S2B1LtrFilDlyEvln_I.numMeas_C EGSDU_S2B1LtrFilDlyEvln_I.tiBndErrEvlnOffs_C EGSDU_S2B1LtrFilDlyEvln_I.tiIni_C EGSDU_S2B1LtrFilDlyEvln_I.tiStepChgCnf_C EGSDU_S2B1LtrFilDlyEvln_I.tiStepChgSus_C EGSDU_S2B1LtrFilTranEvln_I.facEwmaCodClr_C EGSDU_S2B1LtrFilTranEvln_I.facEwmaNorm_C EGSDU_S2B1LtrFilTranEvln_I.facEwmaStepChg_C EGSDU_S2B1LtrFilTranEvln_I.nrMeasCodClrTrip_C EGSDU_S2B1LtrFilTranEvln_I.nrMeasCodClr_C EGSDU_S2B1LtrFilTranEvln_I.nrMeasStepChgTrip_C EGSDU_S2B1LtrFilTranEvln_I.nrMeasStepChg_C EGSDU_S2B1LtrFilTranEvln_I.numMeasShtrp_C EGSDU_S2B1LtrFilTranEvln_I.numMeas_C EGSDU_S2B1LtrFilTranEvln_I.tiBndErrEvlnOffs_C EGSDU_S2B1LtrFilTranEvln_I.tiIni_C EGSDU_S2B1LtrFilTranEvln_I.tiStepChgCnf_C EGSDU_S2B1LtrFilTranEvln_I.tiStepChgSus_C EGSDU_S2B1RtlFilDlyEvln_I.facEwmaCodClr_C EGSDU_S2B1RtlFilDlyEvln_I.facEwmaNorm_C EGSDU_S2B1RtlFilDlyEvln_I.facEwmaStepChg_C EGSDU_S2B1RtlFilDlyEvln_I.nrMeasCodClrTrip_C EGSDU_S2B1RtlFilDlyEvln_I.nrMeasCodClr_C EGSDU_S2B1RtlFilDlyEvln_I.nrMeasStepChgTrip_C EGSDU_S2B1RtlFilDlyEvln_I.nrMeasStepChg_C EGSDU_S2B1RtlFilDlyEvln_I.numMeasShtrp_C EGSDU_S2B1RtlFilDlyEvln_I.numMeas_C EGSDU_S2B1RtlFilDlyEvln_I.tiBndErrEvlnOffs_C EGSDU_S2B1RtlFilDlyEvln_I.tiIni_C EGSDU_S2B1RtlFilDlyEvln_I.tiStepChgCnf_C EGSDU_S2B1RtlFilDlyEvln_I.tiStepChgSus_C EGSDU_S2B1RtlFilTranEvln_I.facEwmaCodClr_C EGSDU_S2B1RtlFilTranEvln_I.facEwmaNorm_C EGSDU_S2B1RtlFilTranEvln_I.facEwmaStepChg_C EGSDU_S2B1RtlFilTranEvln_I.nrMeasCodClrTrip_C EGSDU_S2B1RtlFilTranEvln_I.nrMeasCodClr_C EGSDU_S2B1RtlFilTranEvln_I.nrMeasStepChgTrip_C EGSDU_S2B1RtlFilTranEvln_I.nrMeasStepChg_C EGSDU_S2B1RtlFilTranEvln_I.numMeasShtrp_C EGSDU_S2B1RtlFilTranEvln_I.numMeas_C EGSDU_S2B1RtlFilTranEvln_I.tiBndErrEvlnOffs_C EGSDU_S2B1RtlFilTranEvln_I.tiIni_C EGSDU_S2B1RtlFilTranEvln_I.tiStepChgCnf_C EGSDU_S2B1RtlFilTranEvln_I.tiStepChgSus_C EGSDU_tiS2DlyAsymcThdEvln EGSDU_tiS2LtrBPUDlyEvln_C EGSDU_tiS2LtrBPUTranEvln_C EGSDU_tiS2LtrErrDlyEvln_C EGSDU_tiS2LtrErrShtrpDlyEvln_C EGSDU_tiS2LtrErrShtrpTranEvln_C EGSDU_tiS2LtrErrTranEvln_C EGSDU_tiS2LtrSusTranEvln_C EGSDU_tiS2RtlBPUDlyEvln_C EGSDU_tiS2RtlBPUTranEvln_C EGSDU_tiS2RtlErrDlyEvln_C EGSDU_tiS2RtlErrShtrpDlyEvln_C EGSDU_tiS2RtlErrShtrpTranEvln_C EGSDU_tiS2RtlErrTranEvln_C EGSDU_tiS2RtlSusTranEvln_C EGSDU_tiS2TranAsymcThdEvln /end DEF_CHARACTERISTIC
 /begin REF_CHARACTERISTIC EGSDCmn_flgSymTranOnly_CW EGSDCmn_uCatEmptyGrdtParl_C EGSDCmn_uCatFullGrdtParl_C HEGO_flgS2B1Prsnt_C /end REF_CHARACTERISTIC
 /begin IN_MEASUREMENT Eep_EnvRamInvld EGSDCmn_cntrRstEvlnParl EGSDCmn_flgEnvtlDiPID41Parl EGSDCmn_flgProdModParl EGSDCmn_flgRmnProdModParl EGSDCmn_flgS2B1TarLeanResParl EGSDCmn_flgS2B1TarLeanResVirtParl EGSDCmn_flgS2B1TarRichResParl EGSDCmn_flgS2B1TarRichResVirtParl EGSDCmn_flgShtrpParl EGSDCmn_uS2B1CatEmptMaxParl EGSDCmn_uS2B1CatFullMinParl EGSDU_flgS2B1InhbRiDly EGSDU_flgS2B1InhbRiTran EGSDU_flgS2B1ResLtrDly EGSDU_flgS2B1ResLtrTran EGSDU_flgS2B1ResRtlDly EGSDU_flgS2B1ResRtlTran EGSDU_flgS2B1ResVirtLtrDly EGSDU_flgS2B1ResVirtLtrTran EGSDU_flgS2B1ResVirtRtlDly EGSDU_flgS2B1ResVirtRtlTran EGSDU_tiS2B1LtrNrmDly EGSDU_tiS2B1LtrTran EGSDU_tiS2B1RtlNrmDly EGSDU_tiS2B1RtlTran SyC_ctPostDrvLeave /end IN_MEASUREMENT
 /begin OUT_MEASUREMENT EGSDU_flgS2B1AsymcFltEvln EGSDU_flgS2B1InhbRiEvln EGSDU_flgS2B1QPFaildDynEvln EGSDU_flgS2B1ResLtrDlyEvln EGSDU_flgS2B1ResLtrTranEvln EGSDU_flgS2B1ResRtlDlyEvln EGSDU_flgS2B1ResRtlTranEvln EGSDU_flgS2B1ResVirtLtrDlyEvln EGSDU_flgS2B1ResVirtLtrTranEvln EGSDU_flgS2B1ResVirtRtlDlyEvln EGSDU_flgS2B1ResVirtRtlTranEvln EGSDU_flgS2B1TarLeanResEvln EGSDU_flgS2B1TarLeanResVirtEvln EGSDU_flgS2B1TarRichResEvln EGSDU_flgS2B1TarRichResVirtEvln EGSDU_flgS2B1TripLtrDlyEvln EGSDU_flgS2B1TripLtrTranEvln EGSDU_flgS2B1TripRtlDlyEvln EGSDU_flgS2B1TripRtlTranEvln EGSDU_flgS2B1TripVirtLtrDlyEvln EGSDU_flgS2B1TripVirtLtrTranEvln EGSDU_flgS2B1TripVirtRtlDlyEvln EGSDU_flgS2B1TripVirtRtlTranEvln EGSDU_flgS2B1VirtQPFaildDynEvln EGSDU_tiS2B1LtrDlyEvln EGSDU_tiS2B1LtrDlySymcEvln EGSDU_tiS2B1LtrDlyUnfildEvln EGSDU_tiS2B1LtrTranEvln EGSDU_tiS2B1LtrTranSymcEvln EGSDU_tiS2B1LtrTranUnfildEvln EGSDU_tiS2B1RtlDlyEvln EGSDU_tiS2B1RtlDlySymcEvln EGSDU_tiS2B1RtlDlyUnfildEvln EGSDU_tiS2B1RtlTranEvln EGSDU_tiS2B1RtlTranSymcEvln EGSDU_tiS2B1RtlTranUnfildEvln /end OUT_MEASUREMENT
 /begin LOC_MEASUREMENT EGSDU_ctReIni100msEvlnDs EGSDU_ctReIni10msEvlnDs EGSDU_flgRstEvlnParl EGSDU_S2B1LtrFilDlyEvln_I.flgErrEwmaQckFail EGSDU_S2B1LtrFilDlyEvln_I.flgFCMClrReqdCL100ms EGSDU_S2B1LtrFilDlyEvln_I.flgFCMClrReqdCL10ms EGSDU_S2B1LtrFilDlyEvln_I.flgQckPassd EGSDU_S2B1LtrFilDlyEvln_I.flgQckPassdFaild EGSDU_S2B1LtrFilDlyEvln_I.flgRes EGSDU_S2B1LtrFilDlyEvln_I.flgResFil EGSDU_S2B1LtrFilDlyEvln_I.flgResVirt EGSDU_S2B1LtrFilDlyEvln_I.flgResVirtFil EGSDU_S2B1LtrFilDlyEvln_I.flgResVirtTmp EGSDU_S2B1LtrFilDlyEvln_I.flgTrip EGSDU_S2B1LtrFilDlyEvln_I.flgTripVirt EGSDU_S2B1LtrFilDlyEvln_I.flgVirtQckFaild EGSDU_S2B1LtrFilDlyEvln_I.numMeas EGSDU_S2B1LtrFilDlyEvln_I.numMeasShtrp EGSDU_S2B1LtrFilDlyEvln_I.numMeasTrip EGSDU_S2B1LtrFilDlyEvln_I.numVirtMeas EGSDU_S2B1LtrFilDlyEvln_I.numVirtMeasTrip EGSDU_S2B1LtrFilDlyEvln_I.stEwmaMod EGSDU_S2B1LtrFilDlyEvln_I.stEwmaVirtMod EGSDU_S2B1LtrFilDlyEvln_I.ti EGSDU_S2B1LtrFilDlyEvln_I.tiArth EGSDU_S2B1LtrFilDlyEvln_I.tiEwma EGSDU_S2B1LtrFilDlyEvln_I.tiFil EGSDU_S2B1LtrFilDlyEvln_I.tiQuickPass EGSDU_S2B1LtrFilDlyEvln_I.ResFF_I.status EGSDU_S2B1LtrFilDlyEvln_I.tiArithShtrpDL_I.memory EGSDU_S2B1LtrFilDlyEvln_I.tiArthDL_I.memory EGSDU_S2B1LtrFilDlyEvln_I.tiEwmaDL_I.memory EGSDU_S2B1LtrFilTranEvln_I.flgErrEwmaQckFail EGSDU_S2B1LtrFilTranEvln_I.flgFCMClrReqdCL100ms EGSDU_S2B1LtrFilTranEvln_I.flgFCMClrReqdCL10ms EGSDU_S2B1LtrFilTranEvln_I.flgQckPassd EGSDU_S2B1LtrFilTranEvln_I.flgQckPassdFaild EGSDU_S2B1LtrFilTranEvln_I.flgRes EGSDU_S2B1LtrFilTranEvln_I.flgResFil EGSDU_S2B1LtrFilTranEvln_I.flgResVirt EGSDU_S2B1LtrFilTranEvln_I.flgResVirtFil EGSDU_S2B1LtrFilTranEvln_I.flgResVirtTmp EGSDU_S2B1LtrFilTranEvln_I.flgTrip EGSDU_S2B1LtrFilTranEvln_I.flgTripVirt EGSDU_S2B1LtrFilTranEvln_I.flgVirtQckFaild EGSDU_S2B1LtrFilTranEvln_I.numMeas EGSDU_S2B1LtrFilTranEvln_I.numMeasShtrp EGSDU_S2B1LtrFilTranEvln_I.numMeasTrip EGSDU_S2B1LtrFilTranEvln_I.numVirtMeas EGSDU_S2B1LtrFilTranEvln_I.numVirtMeasTrip EGSDU_S2B1LtrFilTranEvln_I.stEwmaMod EGSDU_S2B1LtrFilTranEvln_I.stEwmaVirtMod EGSDU_S2B1LtrFilTranEvln_I.ti EGSDU_S2B1LtrFilTranEvln_I.tiArth EGSDU_S2B1LtrFilTranEvln_I.tiEwma EGSDU_S2B1LtrFilTranEvln_I.tiFil EGSDU_S2B1LtrFilTranEvln_I.tiQuickPass EGSDU_S2B1LtrFilTranEvln_I.ResFF_I.status EGSDU_S2B1LtrFilTranEvln_I.tiArithShtrpDL_I.memory EGSDU_S2B1LtrFilTranEvln_I.tiArthDL_I.memory EGSDU_S2B1LtrFilTranEvln_I.tiEwmaDL_I.memory EGSDU_S2B1LtrSrvDlyEvln_I.flgDisbl EGSDU_S2B1LtrSrvDlyEvln_I.flgErrSuspc EGSDU_S2B1LtrSrvDlyEvln_I.flgInhbn EGSDU_S2B1LtrSrvDlyEvln_I.flgResEvln EGSDU_S2B1LtrSrvDlyEvln_I.flgResVirtEvln EGSDU_S2B1LtrSrvDlyEvln_I.flgFrzFrmER_I.buffer EGSDU_S2B1LtrSrvDlyEvln_I.flgFrzFrmER_I.oldSignal EGSDU_S2B1LtrSrvTranEvln_I.flgDisbl EGSDU_S2B1LtrSrvTranEvln_I.flgErrSuspc EGSDU_S2B1LtrSrvTranEvln_I.flgInhbn EGSDU_S2B1LtrSrvTranEvln_I.flgResEvln EGSDU_S2B1LtrSrvTranEvln_I.flgResVirtEvln EGSDU_S2B1LtrSrvTranEvln_I.flgFrzFrmER_I.buffer EGSDU_S2B1LtrSrvTranEvln_I.flgFrzFrmER_I.oldSignal EGSDU_S2B1RtlFilDlyEvln_I.flgErrEwmaQckFail EGSDU_S2B1RtlFilDlyEvln_I.flgFCMClrReqdCL100ms EGSDU_S2B1RtlFilDlyEvln_I.flgFCMClrReqdCL10ms EGSDU_S2B1RtlFilDlyEvln_I.flgQckPassd EGSDU_S2B1RtlFilDlyEvln_I.flgQckPassdFaild EGSDU_S2B1RtlFilDlyEvln_I.flgRes EGSDU_S2B1RtlFilDlyEvln_I.flgResFil EGSDU_S2B1RtlFilDlyEvln_I.flgResVirt EGSDU_S2B1RtlFilDlyEvln_I.flgResVirtFil EGSDU_S2B1RtlFilDlyEvln_I.flgResVirtTmp EGSDU_S2B1RtlFilDlyEvln_I.flgTrip EGSDU_S2B1RtlFilDlyEvln_I.flgTripVirt EGSDU_S2B1RtlFilDlyEvln_I.flgVirtQckFaild EGSDU_S2B1RtlFilDlyEvln_I.numMeas EGSDU_S2B1RtlFilDlyEvln_I.numMeasShtrp EGSDU_S2B1RtlFilDlyEvln_I.numMeasTrip EGSDU_S2B1RtlFilDlyEvln_I.numVirtMeas EGSDU_S2B1RtlFilDlyEvln_I.numVirtMeasTrip EGSDU_S2B1RtlFilDlyEvln_I.stEwmaMod EGSDU_S2B1RtlFilDlyEvln_I.stEwmaVirtMod EGSDU_S2B1RtlFilDlyEvln_I.ti EGSDU_S2B1RtlFilDlyEvln_I.tiArth EGSDU_S2B1RtlFilDlyEvln_I.tiEwma EGSDU_S2B1RtlFilDlyEvln_I.tiFil EGSDU_S2B1RtlFilDlyEvln_I.tiQuickPass EGSDU_S2B1RtlFilDlyEvln_I.ResFF_I.status EGSDU_S2B1RtlFilDlyEvln_I.tiArithShtrpDL_I.memory EGSDU_S2B1RtlFilDlyEvln_I.tiArthDL_I.memory EGSDU_S2B1RtlFilDlyEvln_I.tiEwmaDL_I.memory EGSDU_S2B1RtlFilTranEvln_I.flgErrEwmaQckFail EGSDU_S2B1RtlFilTranEvln_I.flgFCMClrReqdCL100ms EGSDU_S2B1RtlFilTranEvln_I.flgFCMClrReqdCL10ms EGSDU_S2B1RtlFilTranEvln_I.flgQckPassd EGSDU_S2B1RtlFilTranEvln_I.flgQckPassdFaild EGSDU_S2B1RtlFilTranEvln_I.flgRes EGSDU_S2B1RtlFilTranEvln_I.flgResFil EGSDU_S2B1RtlFilTranEvln_I.flgResVirt EGSDU_S2B1RtlFilTranEvln_I.flgResVirtFil EGSDU_S2B1RtlFilTranEvln_I.flgResVirtTmp EGSDU_S2B1RtlFilTranEvln_I.flgTrip EGSDU_S2B1RtlFilTranEvln_I.flgTripVirt EGSDU_S2B1RtlFilTranEvln_I.flgVirtQckFaild EGSDU_S2B1RtlFilTranEvln_I.numMeas EGSDU_S2B1RtlFilTranEvln_I.numMeasShtrp EGSDU_S2B1RtlFilTranEvln_I.numMeasTrip EGSDU_S2B1RtlFilTranEvln_I.numVirtMeas EGSDU_S2B1RtlFilTranEvln_I.numVirtMeasTrip EGSDU_S2B1RtlFilTranEvln_I.stEwmaMod EGSDU_S2B1RtlFilTranEvln_I.stEwmaVirtMod EGSDU_S2B1RtlFilTranEvln_I.ti EGSDU_S2B1RtlFilTranEvln_I.tiArth EGSDU_S2B1RtlFilTranEvln_I.tiEwma EGSDU_S2B1RtlFilTranEvln_I.tiFil EGSDU_S2B1RtlFilTranEvln_I.tiQuickPass EGSDU_S2B1RtlFilTranEvln_I.ResFF_I.status EGSDU_S2B1RtlFilTranEvln_I.tiArithShtrpDL_I.memory EGSDU_S2B1RtlFilTranEvln_I.tiArthDL_I.memory EGSDU_S2B1RtlFilTranEvln_I.tiEwmaDL_I.memory EGSDU_S2B1RtlSrvDlyEvln_I.flgDisbl EGSDU_S2B1RtlSrvDlyEvln_I.flgErrSuspc EGSDU_S2B1RtlSrvDlyEvln_I.flgInhbn EGSDU_S2B1RtlSrvDlyEvln_I.flgResEvln EGSDU_S2B1RtlSrvDlyEvln_I.flgResVirtEvln EGSDU_S2B1RtlSrvDlyEvln_I.flgFrzFrmER_I.buffer EGSDU_S2B1RtlSrvDlyEvln_I.flgFrzFrmER_I.oldSignal EGSDU_S2B1RtlSrvTranEvln_I.flgDisbl EGSDU_S2B1RtlSrvTranEvln_I.flgErrSuspc EGSDU_S2B1RtlSrvTranEvln_I.flgInhbn EGSDU_S2B1RtlSrvTranEvln_I.flgResEvln EGSDU_S2B1RtlSrvTranEvln_I.flgResVirtEvln EGSDU_S2B1RtlSrvTranEvln_I.flgFrzFrmER_I.buffer EGSDU_S2B1RtlSrvTranEvln_I.flgFrzFrmER_I.oldSignal EGSDU_S2B1TarLeanEvlnDs_I.flgFCMClrReqdCL10ms EGSDU_S2B1TarLeanEvlnDs_I.flgRes EGSDU_S2B1TarLeanEvlnDs_I.flgResVirt EGSDU_S2B1TarLeanEvlnDs_I.u EGSDU_S2B1TarLeanEvlnDs_I.u_Err_C EGSDU_S2B1TarLeanSrvEvln_I.flgDisbl EGSDU_S2B1TarLeanSrvEvln_I.flgErrSuspc EGSDU_S2B1TarLeanSrvEvln_I.flgInhbn EGSDU_S2B1TarLeanSrvEvln_I.flgOkOnceEvln EGSDU_S2B1TarLeanSrvEvln_I.flgResEvln EGSDU_S2B1TarLeanSrvEvln_I.flgResVirtEvln EGSDU_S2B1TarLeanSrvEvln_I.flgFrzFrmER_I.buffer EGSDU_S2B1TarLeanSrvEvln_I.flgFrzFrmER_I.oldSignal EGSDU_S2B1TarRichEvlnDs_I.flgFCMClrReqdCL10ms EGSDU_S2B1TarRichEvlnDs_I.flgRes EGSDU_S2B1TarRichEvlnDs_I.flgResVirt EGSDU_S2B1TarRichEvlnDs_I.u EGSDU_S2B1TarRichEvlnDs_I.u_Err_C EGSDU_S2B1TarRichSrvEvln_I.flgDisbl EGSDU_S2B1TarRichSrvEvln_I.flgErrSuspc EGSDU_S2B1TarRichSrvEvln_I.flgInhbn EGSDU_S2B1TarRichSrvEvln_I.flgOkOnceEvln EGSDU_S2B1TarRichSrvEvln_I.flgResEvln EGSDU_S2B1TarRichSrvEvln_I.flgResVirtEvln EGSDU_S2B1TarRichSrvEvln_I.flgFrzFrmER_I.buffer EGSDU_S2B1TarRichSrvEvln_I.flgFrzFrmER_I.oldSignal EGSDU_shtrp_100ms_I.buffer EGSDU_shtrp_100ms_I.oldSignal /end LOC_MEASUREMENT
 FUNCTION_VERSION "1.41.1" /end FUNCTION
/begin FUNCTION EGSDU_TranDs "1.25.0    Dynamic diagnosis binary oxygen sensor downstream - slow transition"
 /begin DEF_CHARACTERISTIC EGSDU_duMinRateTran_C EGSDU_flgLimMaxPsblTran_C EGSDU_S2B1MinTiLtrTran_I.uDstTarTran_C EGSDU_S2B1MinTiRtlTran_I.uDstTarTran_C EGSDU_tiBgnRiInhbTran_C EGSDU_tiMaxPsblTran_M EGSDU_tiS2CoorrLtrTran_T EGSDU_tiS2CoorrRtlTran_T EGSDU_tiS2LtrInflDlyTran_C EGSDU_tiS2RtlInflDlyTran_C EGSDU_uEndLtrTran_C EGSDU_uEndRtlTran_C /end DEF_CHARACTERISTIC
 /begin REF_CHARACTERISTIC EGSDCmn_flgSymTranOnly_CW /end REF_CHARACTERISTIC
 /begin IN_MEASUREMENT EGSDCmn_mfEgCat1B1Parl EGSDCmn_mfSeg1B1O2Parl EGSDCmn_mfSeg1B1RichParl EGSDCmn_stLamGenrParlB1 EGSDCmn_stVirtUTranParlB1 EGSDCmn_uS2B1FildParl EGSDU_flgS2B1ResRtlDly EGSDU_mfAvrgS2B1MeasRtlDly EGSDU_tiS2B1RtlNrmDly SyC_ctPostDrvLeave /end IN_MEASUREMENT
 /begin OUT_MEASUREMENT EGSDU_flgS2B1InhbRiTran EGSDU_flgS2B1LtrInflDlyTran EGSDU_flgS2B1ResLtrTran EGSDU_flgS2B1ResRtlTran EGSDU_flgS2B1ResVirtLtrTran EGSDU_flgS2B1ResVirtRtlTran EGSDU_flgS2B1RtlInflDlyTran EGSDU_tiS2B1LtrTran EGSDU_tiS2B1RtlTran /end OUT_MEASUREMENT
 /begin LOC_MEASUREMENT EGSDU_ctReIni100msTranDs EGSDU_ctReIni10msTranDs EGSDU_flgDSMClrTranDs EGSDU_flgS2B1LtrMeasTran EGSDU_flgS2B1ResVirtRtlActvTran EGSDU_flgS2B1RtlMeasTran EGSDU_S2B1LtrMeasActvDur_I.flgMeasRprtTran EGSDU_S2B1LtrMeasActvDur_I.flgPlausRdy EGSDU_S2B1LtrMeasActvDur_I.stParlOld EGSDU_S2B1LtrMeasActvDur_I.flgActvMeasTranFF_I.status EGSDU_S2B1LtrMeasActvDur_I.flgWaitDlyFinshdFF_I.status EGSDU_S2B1LtrVirtMeasDurDs_I.flgResVirtTran EGSDU_S2B1LtrVirtMeasDurDs_I.flgLtrMeasDoneFF_I.status EGSDU_S2B1LtrVirtMeasDurDs_I.flgVirtRtlDlyEndER_I.buffer EGSDU_S2B1LtrVirtMeasDurDs_I.flgVirtRtlDlyEndER_I.oldSignal EGSDU_S2B1MinTiLtrTran_I.du EGSDU_S2B1MinTiLtrTran_I.flgInhbRi EGSDU_S2B1MinTiLtrTran_I.flgMeasFinshd EGSDU_S2B1MinTiLtrTran_I.flgO2Extd EGSDU_S2B1MinTiLtrTran_I.flgResTran EGSDU_S2B1MinTiLtrTran_I.tiTran EGSDU_S2B1MinTiLtrTran_I.tiTranRaw EGSDU_S2B1MinTiLtrTran_I.tiTranSeg EGSDU_S2B1MinTiLtrTran_I.tiUStop EGSDU_S2B1MinTiLtrTran_I.ticorr EGSDU_S2B1MinTiLtrTran_I.uOld EGSDU_S2B1MinTiRtlTran_I.du EGSDU_S2B1MinTiRtlTran_I.flgInhbRi EGSDU_S2B1MinTiRtlTran_I.flgMeasFinshd EGSDU_S2B1MinTiRtlTran_I.flgO2Extd EGSDU_S2B1MinTiRtlTran_I.flgResTran EGSDU_S2B1MinTiRtlTran_I.tiTran EGSDU_S2B1MinTiRtlTran_I.tiTranRaw EGSDU_S2B1MinTiRtlTran_I.tiTranSeg EGSDU_S2B1MinTiRtlTran_I.tiUStop EGSDU_S2B1MinTiRtlTran_I.ticorr EGSDU_S2B1MinTiRtlTran_I.uOld EGSDU_S2B1RtlMeasActvDur_I.flgMeasTran EGSDU_S2B1RtlMeasActvDur_I.flgRprtTran EGSDU_S2B1RtlMeasActvDur_I.stParlOld EGSDU_S2B1RtlMeasActvDur_I.flgActvMeasTranFF_I.status EGSDU_stS2B1VirtParlOld IF_MinTiLtrTranS2_I.flgLtr IF_MinTiLtrTranS2_I.flgTOut IF_MinTiLtrTranS2_I.mO2TOut_C IF_MinTiLtrTranS2_I.swtO2Extd IF_MinTiLtrTranS2_I.tiTout_C IF_MinTiLtrTranS2_I.uEndRtlTran_C IF_MinTiRtlTranS2_I.flgLtr IF_MinTiRtlTranS2_I.flgTOut IF_MinTiRtlTranS2_I.mO2TOut_C IF_MinTiRtlTranS2_I.swtO2Extd IF_MinTiRtlTranS2_I.tiTout_C IF_MinTiRtlTranS2_I.uEndRtlTran_C /end LOC_MEASUREMENT
 FUNCTION_VERSION "1.25.0" /end FUNCTION
/begin FUNCTION EGSPrepn_ClassLib "1.3.0     Class library for EGSPrepn specific functions" FUNCTION_VERSION "1.3.0" /end FUNCTION
/begin FUNCTION EGSPrepn_Srv "1.8.0     Services for EGSPrepn package" /begin DEF_CHARACTERISTIC EGSPrepn_idxDmEgFlowArySnsr1Bnk1_C /end DEF_CHARACTERISTIC /begin IN_MEASUREMENT ExhMod_dmExhS1B1 ExhMod_dmExhS2B1 UEGO_flgSysSuprtdS1B1 /end IN_MEASUREMENT
 /begin OUT_MEASUREMENT EGSPrepn_dmEgFlowSnsr1Bnk1 EGSPrepn_flgEgSnsrPrsntSnsr1Bnk1 /end OUT_MEASUREMENT
 /begin LOC_MEASUREMENT EGSPrepn_dmExhAry /end LOC_MEASUREMENT
 FUNCTION_VERSION "1.8.0" /end FUNCTION
/begin FUNCTION EGSSig_LamCorrnVal "1.14.0    Calculation of correction values for lambda"
 /begin DEF_CHARACTERISTIC EGSSig_ratIntfrCorrnFlexfuMod_M EGSSig_ratIntfrCorrnFlexfuVHEMod_M EGSSig_ratIntfrCorrnHomMod_M EGSSig_ratIntfrCorrnVHEMod_M /end DEF_CHARACTERISTIC
 /begin IN_MEASUREMENT B_vhegfe_msg Epm_nEngLRes fethmnmx_w_msg rl_w_msg /end IN_MEASUREMENT
 /begin OUT_MEASUREMENT EGSSig_flgHomOperMod EGSSig_ratLamDeltaIntfrS1B1 EGSSig_ratLamDeltaScavS1B1 /end OUT_MEASUREMENT
 FUNCTION_VERSION "1.14.0" /end FUNCTION
/begin FUNCTION EGSSig_LamSymc "1.4.0     Symmetrization of lambda" /begin DEF_CHARACTERISTIC EGSSig_tiConTrigFil_C /end DEF_CHARACTERISTIC
 /begin IN_MEASUREMENT EGSDO2_flgDynAdpnLtrS1B1 EGSDO2_flgDynAdpnRtlS1B1 EGSDO2_tiDlyAdpnS1B1 EGSDO2_tiTranAdpnS1B1 EGSPrepn_flgEgSnsrPrsntSnsr1Bnk1 EGSSig_ratLamS1B1 /end IN_MEASUREMENT
 /begin OUT_MEASUREMENT EGSSig_ratLamSymcS1B1 UEGO_ratLamSymS1B1 /end OUT_MEASUREMENT
 /begin LOC_MEASUREMENT EGSSig_LamSymcS1B1_I.flgAdpnFil EGSSig_LamSymcS1B1_I.ratLam EGSSig_LamSymcS1B1_I.ratLamAdpnDir EGSSig_LamSymcS1B1_I.ratLamAdpn_LT_I.memory EGSSig_LamSymcS1B1_I.tiAdpnDTTtOpt_I.buffer EGSSig_LamSymcS1B1_I.tiAdpnDTTtOpt_I.counter EGSSig_LamSymcS1B1_I.tiAdpnDTTtOpt_I.pointer EGSSig_LamSymcS1B1_I.tiConAdpn_LT_I.memory /end LOC_MEASUREMENT
 FUNCTION_VERSION "1.4.0" /end FUNCTION
/begin FUNCTION EGSSig_O2Sig "2.16.0    Signal Processing of O2 Sensors"
 /begin DEF_CHARACTERISTIC EGSSig_IntfrCorrn_T EGSSig_LamCorrnDeIO2ChartcCrv_T EGSSig_O2SigS1B1_I.LamCorrnDeIO2ChartcCrv_T EGSSig_O2SigS1B1_I.LamCorrnDeIO2ChartcFlexfuelCrv_T EGSSig_swtPSeln_C /end DEF_CHARACTERISTIC
 /begin IN_MEASUREMENT EGSDO2_ratLamOffsS1B1 EGSPrepn_flgEgSnsrPrsntSnsr1Bnk1 EGSSig_flgHomOperMod EGSSig_ratLamDeltaIntfrS1B1 EGSSig_ratLamDeltaScavS1B1 ExhMod_pExhCat1UsB1 fethmnmx_w_msg pabnav_w_msg UEGO_facCrvtChartcCrvS1B1 UEGO_flgO2EquivVldS1B1 UEGO_pPDpdS1B1 UEGO_ratO2EquivLnrS1B1 /end IN_MEASUREMENT
 /begin OUT_MEASUREMENT B_elsxbb_msg B_sbblsu_msg B_sbbvk_msg EGSSig_flgO2NoErrS1B1 EGSSig_flgO2PhyRelsS1B1 EGSSig_flgO2RelsS1B1 EGSSig_ratLamCorrdS1B1 EGSSig_ratLamPTCorrdS1B1 EGSSig_ratLamS1B1 EGSSig_ratLamSrv1S1B1 EGSSig_ratLamTCorrdS1B1 lamsonb_w_msg UEGO_ratLamSrv1S1B1 UEGO_rLamEquivElecCorrdS1B1 UEGO_rLamS1B1 /end OUT_MEASUREMENT
 /begin LOC_MEASUREMENT EGSSig_AirQntyCmb EGSSig_LamTCorrdCalcnS1B1.DenomLamCalc EGSSig_LamTCorrdCalcnS1B1.NumrLamCalc EGSSig_O2CrvtCompS1B1.facPAct EGSSig_O2CrvtCompS1B1.facPCorrn EGSSig_O2CrvtCompS1B1.facPNorm EGSSig_O2CrvtCompS1B1.ratO2LnrPCorrd EGSSig_O2PCrvtCompS1B1_I.facPAct EGSSig_O2PCrvtCompS1B1_I.facPCorrn EGSSig_O2PCrvtCompS1B1_I.facPNorm EGSSig_O2PCrvtCompS1B1_I.ratO2LnrPCorrd EGSSig_O2SigS1B1_I.flgffv EGSSig_O2SigS1B1_I.ratLam EGSSig_O2SigS1B1_I.ratLamCorrd EGSSig_O2SigS1B1_I.ratLamOffsCorrd EGSSig_O2SigS1B1_I.ratLamPhy EGSSig_O2SigS1B1_I.ratO2Srv1 EGSSig_O2SigS1B1_I.LamCalc_I.DenomLamCalc EGSSig_O2SigS1B1_I.LamCalc_I.NumrLamCalc EGSSig_ratO2TCorrdS1B1 flgactlskh flghomopermod /end LOC_MEASUREMENT
 FUNCTION_VERSION "2.16.0" /end FUNCTION
/begin FUNCTION EGSSig_Twc "1.1.0     Processing of O2 and Nox signals for TWC package" FUNCTION_VERSION "1.1.0" /end FUNCTION
/begin FUNCTION ElecLd_VD "3.1.0     Electrical load current sensing"
 /begin DEF_CHARACTERISTIC ElecLd_facEPSLd_C ElecLd_iAirCmprGsl_C ElecLd_iBlowrFanAutoAC_CUR ElecLd_iBlowrFanManAC_CUR ElecLd_iComBase_C ElecLd_iComElecLoadReplcmt_C ElecLd_iComErrDftValGslAutAC_C ElecLd_iComErrDftValGslManAC_C ElecLd_iFan0_C ElecLd_iFan1_C ElecLd_iFan2_C ElecLd_iFanExt_C ElecLd_iFrntDeicer1_C ElecLd_iFrntDeicerSwt_C ElecLd_iFrntFog1_C ElecLd_iFrntFogSwt_C ElecLd_iLiSwt0_C ElecLd_iLiSwt1_C ElecLd_iLiSwt2_C ElecLd_iLiSwt3_C ElecLd_iReDeFoggerAutoAC1_C ElecLd_iReDeFoggerAutoACSwt_C ElecLd_iReDeFoggerManAC1_C ElecLd_iReDeFoggerManACSwt_C ElecLd_iReFog1_C ElecLd_iReFogSwt_C ElecLd_iWiprHi_C ElecLd_iWiprLo_C ElecLd_iWiprOffErr_C ElecLd_RmpSlp.Pos_C ElecLd_RmpSlp.Neg_C ElecLd_stSwtHdLiInfoSeln_C ElecLd_swtCurrMdl_C ElecLd_swtEPSLd_C ElecLd_tiAirCdnLrng_C ElecLd_tiLdFltPT1_C ElecLd_tiMdlLoadCalc_C ElecLd_tiPT1FltEPSLd_C ElecLd_TransStg.Dfl_C ElecLd_TransStg.stSensId_C /end DEF_CHARACTERISTIC
 /begin IN_MEASUREMENT ACCtl_stOut BattU_u CoEng_st Com_bDeIce Com_bMicuInfo Com_bReDEFOutCdn Com_bReDEFSwCdn Com_bRMHLHiRly Com_bRMHLLoRly Com_bRMILLSml Com_iElecLd Com_stACFailInfo Com_stAcInfo Com_stFailCode Com_stFrtFog Com_stLiSwtInfo Com_stMCUUnFailCode Com_stRrFog Com_stWiprActvnCdn Com_uFrntBlowrU Com_uMICUTxBlowrU ElecLd_iSensLd ElecLd_stSRCChk FanCtl_stStg SyC_ctPostDrvLeave /end IN_MEASUREMENT
 /begin OUT_MEASUREMENT ElecLd_iAirCmpr ElecLd_iBlowrFanAC ElecLd_iEPSLd ElecLd_iEPSLoadOnly ElecLd_iFan ElecLd_iFrntDeicer ElecLd_iFrntFog ElecLd_iLd ElecLd_iLd1 ElecLd_iLd2 ElecLd_iLiSwt ElecLd_iLoadMdlUnFild ElecLd_iReDeFoggerAutoAC ElecLd_iReDeFoggerManAC ElecLd_iReFog ElecLd_iWipr ElecLd_stHdLiInfo ElecLd_swtCurrMdl /end OUT_MEASUREMENT
 /begin LOC_MEASUREMENT ElecLd_cntrReIni ElecLd_iFild1EPSLoad ElecLd_iFildElecLoad ElecLd_iFildEPSLoad ElecLd_iUnfildLoad ElecLd_stAutoAC ElecLd_uHeatrMot /end LOC_MEASUREMENT
 FUNCTION_VERSION "3.1.0" /end FUNCTION
/begin FUNCTION EngDa_PwrEng "2.10.0    Engine power calculation"
 /begin DEF_CHARACTERISTIC EngDa_pwrCrksftMax_C EngDa_tqCrksftMax_C EngDa_tqInnrMax_C EngDa_volDispl_C /end DEF_CHARACTERISTIC
 /begin OUT_MEASUREMENT EngDa_pwrCrksftMax EngDa_pwrCrksftMax_f EngDa_tqCrksftMax EngDa_tqCrksftMax_f EngDa_tqInnrMax EngDa_tqInnrMax_f EngDa_volDispl EngDa_volDispl_f /end OUT_MEASUREMENT
 FUNCTION_VERSION "2.10.0" /end FUNCTION
/begin FUNCTION EngDem_TrqLimCoord "2.37.0_2.2.0Coordination of the limiting torques of engine demands"
 /begin DEF_CHARACTERISTIC EngDem_dTqSlpLimnNeg_T EngDem_dTqSlpLimnPos_T EngDem_flgFcoEna_C EngDem_idxMapTqLimnInjMod_CA EngDem_nrRampSlpCfg_T EngDem_swtTqLimnCfg_C EngDem_swtTqLimnRmpReIni_C EngDem_tiRampIniRst_C EngDem_tqLimnCamsftErr_T EngDem_tqLimnInjMod_T EngDem_tqLimnOilPmp_T EngDem_tqLimnThmstHeatCtrlCirc_T EngDem_trqLimErrAPP_CUR /end DEF_CHARACTERISTIC
 /begin IN_MEASUREMENT CoVeh_trqAcs EngPrt_trqLim EngPrt_trqLimLead EngPrt_trqLimMech EngPrt_trqLimMechLead EngReq_trqLim EngReq_trqLimLead Epm_nEng InjSys_stInjMod PthLead_trqInrLead RngMod_trqCrSMin SpdGov_tqCluLimnMeclFco ThrVlv_bSngSensErr_msg /end IN_MEASUREMENT
 /begin OUT_MEASUREMENT EngDem_stLimErr EngDem_trqInrLim EngDem_trqInrLimCtOff EngDem_trqInrLimLead EngDem_trqLimErr /end OUT_MEASUREMENT
 /begin LOC_MEASUREMENT EngDem_dTqSlpLimnNeg EngDem_dTqSlpLimnPos EngDem_flgRampIni EngDem_flgRampLeadReInit EngDem_flgRampTgtRea EngDem_flgTqLimnErr EngDem_RampTgHldFF_I.status EngDem_ReInitCurrTqLeadERNM_I.oldSignal EngDem_ReInitErrTqLeadERNM_I.oldSignal EngDem_stLimErrMn EngDem_TqLimnLeadRMP_I.Dir EngDem_TqLimnLeadRMP_I.State EngDem_TqLimnLeadRMP_I.Target EngDem_tqLimnRampLead EngDem_trqLimLeadRslt /end LOC_MEASUREMENT
 FUNCTION_VERSION "2.37.0_2.2.0" /end FUNCTION
/begin FUNCTION EngECU_Eng1 "32.2.0_6SAAThe function prepares and sends the CAN messages Motor_1 (ENG1)" /begin OUT_MEASUREMENT Com_ctCRingENG1 Com_numCsumENG1 /end OUT_MEASUREMENT FUNCTION_VERSION "32.2.0_6SAA" /end FUNCTION
/begin FUNCTION EngECU_Eng10 "9.2.0_6SAATransmission process for the CAN frame Engine 10" /begin IN_MEASUREMENT PEnv_pRaw /end IN_MEASUREMENT /begin OUT_MEASUREMENT Com_ctCRingENG10 Com_numCsumENG10 Com_pEnvPRaw /end OUT_MEASUREMENT FUNCTION_VERSION "9.2.0_6SAA" /end FUNCTION
/begin FUNCTION EngECU_Eng11 "15.3.0    Transmission process for the CAN frame Engine 11"
 /begin IN_MEASUREMENT APP_uRaw1unLim CoEng_tiNormalOBD ects2svc_msg I14229_stVINWriteClrReq I15031_PID1C tmottstr_w /end IN_MEASUREMENT
 /begin OUT_MEASUREMENT Com_ctCRingENG11 Com_numCsumENG11 /end OUT_MEASUREMENT
 FUNCTION_VERSION "15.3.0" /end FUNCTION
/begin FUNCTION EngECU_Eng15 "12.3.0    Transmission process for the CAN frame Engine 15"
 /begin DEF_CHARACTERISTIC Com_rThrVlvActAdj_C Com_stIdleNeutMsk_C Com_swtTqRvsnEnaFlg_C Com_tiHACCut_C /end DEF_CHARACTERISTIC
 /begin IN_MEASUREMENT AccPed_swtDrvMod ACCtl_flgACCutPrms ACCtl_flgACOnCdnTCU ACCtl_nrACCutPrms AirC_stPsCmpr AirSys_rPhiThrVlv HLSDem_nSetPLo TCE_flgCylIndFcoStrtd TCE_flgFcoRdy TCE_tiExptFcoStrt ThrVlv_dRatPrVB1 VMD_rVirtAPP /end IN_MEASUREMENT
 /begin OUT_MEASUREMENT Com_ctCRingENG15 Com_flgACReq Com_flgCylIndFcoStrtd Com_flgFcoRdy Com_flgVirtApp Com_nrCsumENG15 Com_nSetPLo Com_rThrVlvAct Com_stTqRvsnEnaFlg Com_swtDrvMod Com_tiExptFcoStrt Com_tiHACCut /end OUT_MEASUREMENT
 FUNCTION_VERSION "12.3.0" /end FUNCTION
/begin FUNCTION EngECU_Eng16 "8.1.0_6SAATransmission process for the CAN frame Engine 16" /begin DEF_CHARACTERISTIC Com_nEngHi_C Com_nEngLo_C Com_swtNEng_C /end DEF_CHARACTERISTIC /begin IN_MEASUREMENT Epm_nEng Epm_nEng10ms /end IN_MEASUREMENT
 /begin OUT_MEASUREMENT Com_ctCRingENG16 Com_nEngSpd Com_numCsumENG16 Com_stEngStop Com_stTrqAccuracySlow Com_stTrqReqFast Com_stTrqReqSlow /end OUT_MEASUREMENT
 FUNCTION_VERSION "8.1.0_6SAA" /end FUNCTION
/begin FUNCTION EngECU_Eng17 "9.1.0_6SAATransmission process for the CAN frame Engine 17" /begin IN_MEASUREMENT PIntkVUs_p /end IN_MEASUREMENT
 /begin OUT_MEASUREMENT Com_ctCRingENG17 Com_numCsumENG17 Com_stAltFail Com_stEngCooltTFail Com_stEngIntkAirFail Com_stEngSpd30DegFail Com_stPBSensFail Com_stThrPosnFail /end OUT_MEASUREMENT
 FUNCTION_VERSION "9.1.0_6SAA" /end FUNCTION
/begin FUNCTION EngECU_Eng18 "7.2.0     Transmission process for the CAN frame Engine 18" /begin DEF_CHARACTERISTIC Com_dENG18SigSel_C /end DEF_CHARACTERISTIC /begin IN_MEASUREMENT CoVOM_bCVTIdleStop CoVOM_bCVTStopEna /end IN_MEASUREMENT
 /begin OUT_MEASUREMENT Com_bCVTIdleStop Com_bCVTStopEna Com_ctCRingENG18 Com_numCsumENG18 Com_rDrvAccrPedlPosn /end OUT_MEASUREMENT
 FUNCTION_VERSION "7.2.0" /end FUNCTION
/begin COMPU_METHOD AirMassPerTime "" RAT_FUNC "%6.3" "Kg/h" COEFFS 0 10 0 0 0 1 /end COMPU_METHOD
/begin COMPU_METHOD B_TRUE "" TAB_VERB "%6.3" "" COMPU_TAB_REF B_TRUE /end COMPU_METHOD
/begin COMPU_VTAB B_TRUE "" TAB_VERB 2 0 "FALSE" 1 "TRUE" /end COMPU_VTAB
/begin COMPU_METHOD Com_deg_q0p02441 "" RAT_FUNC "%6.4" "deg" COEFFS 0 65536 0 0 0 1600 /end COMPU_METHOD
/begin COMPU_METHOD Curr_A "" RAT_FUNC "%6.4" "A" COEFFS 0 100 0 0 0 1 /end COMPU_METHOD
/begin COMPU_METHOD dez "" RAT_FUNC "%6.2" "" COEFFS 0 1 0 0 0 1 /end COMPU_METHOD
/begin COMPU_METHOD EngN "" RAT_FUNC "%6.3" "rpm" COEFFS 0 2 0 0 0 1 /end COMPU_METHOD
/begin COMPU_METHOD Fact "" RAT_FUNC "%6.5" "-" COEFFS 0 8192 0 0 0 1 /end COMPU_METHOD
/begin COMPU_METHOD Fact1 "" RAT_FUNC "%6.4" "-" COEFFS 0 128 0 0 0 1 /end COMPU_METHOD
/begin COMPU_METHOD fak_q0p000244 "" RAT_FUNC "%6.5" "-" COEFFS 0 65536 0 0 0 16 /end COMPU_METHOD
/begin COMPU_METHOD fak_q1Em5 "" RAT_FUNC "%8.7" "-" COEFFS 0 100000 0 0 0 1 /end COMPU_METHOD
/begin COMPU_METHOD fak_q1Em6 "" RAT_FUNC "%9.8" "-" COEFFS 0 1000000 0 0 0 1 /end COMPU_METHOD
/begin COMPU_METHOD fak_q3p72529Em9 "" RAT_FUNC "%11.10" "" COEFFS 0 268435456 0 0 0 1 /end COMPU_METHOD
/begin COMPU_METHOD fak_sw_b1 "" RAT_FUNC "%7.6" "-" COEFFS 0 65536 0 0 0 2 /end COMPU_METHOD
/begin COMPU_METHOD fak_sw_b8 "" RAT_FUNC "%6.5" "-" COEFFS 0 65536 0 0 0 16 /end COMPU_METHOD
/begin COMPU_METHOD fak_ub_b1 "" RAT_FUNC "%6.4" "-" COEFFS 0 256 0 0 0 1 /end COMPU_METHOD
/begin COMPU_METHOD fak_ub_b2 "" RAT_FUNC "%8.5" "-" COEFFS 0 256 0 0 0 2 /end COMPU_METHOD
/begin COMPU_METHOD fak_uw_b16 "" RAT_FUNC "%6.5" "-" COEFFS 0 65536 0 0 0 16 /end COMPU_METHOD
/begin COMPU_METHOD fak_uw_b2 "" RAT_FUNC "%7.6" "-" COEFFS 0 65536 0 0 0 2 /end COMPU_METHOD
/begin COMPU_METHOD fak_uw_b4 "" RAT_FUNC "%7.6" "-" COEFFS 0 65536 0 0 0 4 /end COMPU_METHOD
/begin COMPU_METHOD FPCACTVDCARBONFILMDL_SC_Compu "" TAB_VERB "%6.3" "" COMPU_TAB_REF FPCACTVDCARBONFILMDL_SC_Compu /end COMPU_METHOD
/begin COMPU_VTAB FPCACTVDCARBONFILMDL_SC_Compu "" TAB_VERB 2 0 "False" 1 "True" /end COMPU_VTAB
/begin COMPU_METHOD FPCAIRLIMN_SC_Compu "" TAB_VERB "%6.3" "" COMPU_TAB_REF FPCAIRLIMN_SC_Compu /end COMPU_METHOD
/begin COMPU_VTAB FPCAIRLIMN_SC_Compu "" TAB_VERB 2 0 "False" 1 "True" /end COMPU_VTAB
/begin COMPU_METHOD FPCCPVADPN_SC_Compu "" TAB_VERB "%6.3" "" COMPU_TAB_REF FPCCPVADPN_SC_Compu /end COMPU_METHOD
/begin COMPU_VTAB FPCCPVADPN_SC_Compu "" TAB_VERB 2 0 "False" 1 "True" /end COMPU_VTAB
/begin COMPU_METHOD FPCDHV_SC_Compu "" TAB_VERB "%6.3" "" COMPU_TAB_REF FPCDHV_SC_Compu /end COMPU_METHOD
/begin COMPU_VTAB FPCDHV_SC_Compu "" TAB_VERB 2 0 "False" 1 "True" /end COMPU_VTAB
/begin COMPU_METHOD FPCDSSP_SC_Compu "" TAB_VERB "%6.3" "" COMPU_TAB_REF FPCDSSP_SC_Compu /end COMPU_METHOD
/begin COMPU_VTAB FPCDSSP_SC_Compu "" TAB_VERB 2 0 "False" 1 "True" /end COMPU_VTAB
/begin COMPU_METHOD FPCEVLNRLMIN_SC_Compu "" TAB_VERB "%6.3" "" COMPU_TAB_REF FPCEVLNRLMIN_SC_Compu /end COMPU_METHOD
/begin COMPU_VTAB FPCEVLNRLMIN_SC_Compu "" TAB_VERB 2 0 "False" 1 "True" /end COMPU_VTAB
/begin COMPU_METHOD FPCEXTTANKFCTMODL_SC_Compu "" TAB_VERB "%6.3" "" COMPU_TAB_REF FPCEXTTANKFCTMODL_SC_Compu /end COMPU_METHOD
/begin COMPU_VTAB FPCEXTTANKFCTMODL_SC_Compu "" TAB_VERB 2 0 "False" 1 "True" /end COMPU_VTAB
/begin COMPU_METHOD FPCMCAN_SC_Compu "" TAB_VERB "%6.3" "" COMPU_TAB_REF FPCMCAN_SC_Compu /end COMPU_METHOD
/begin COMPU_VTAB FPCMCAN_SC_Compu "" TAB_VERB 3 0 "0" 1 "1" 2 "2" /end COMPU_VTAB
/begin COMPU_METHOD FPCMSLSU_SC_Compu "" TAB_VERB "%6.3" "" COMPU_TAB_REF FPCMSLSU_SC_Compu /end COMPU_METHOD
/begin COMPU_VTAB FPCMSLSU_SC_Compu "" TAB_VERB 2 0 "False" 1 "True" /end COMPU_VTAB
/begin COMPU_METHOD FPCOPTSTOPINHBN_SC_Compu "" TAB_VERB "%6.3" "" COMPU_TAB_REF FPCOPTSTOPINHBN_SC_Compu /end COMPU_METHOD
/begin COMPU_VTAB FPCOPTSTOPINHBN_SC_Compu "" TAB_VERB 2 0 "False" 1 "True" /end COMPU_VTAB
/begin COMPU_METHOD FPCPRIOTEHEX_SC_Compu "" TAB_VERB "%6.3" "" COMPU_TAB_REF FPCPRIOTEHEX_SC_Compu /end COMPU_METHOD
/begin COMPU_VTAB FPCPRIOTEHEX_SC_Compu "" TAB_VERB 2 0 "False" 1 "True" /end COMPU_VTAB
/begin COMPU_METHOD FPCTL_ADPNWOMIXADPNFLT_SC_Compu "" TAB_VERB "%6.3" "" COMPU_TAB_REF FPCTL_ADPNWOMIXADPNFLT_SC_Compu /end COMPU_METHOD
/begin COMPU_VTAB FPCTL_ADPNWOMIXADPNFLT_SC_Compu "" TAB_VERB 2 0 "False" 1 "True" /end COMPU_VTAB
/begin COMPU_METHOD FPCTL_CASCCPV_SC_Compu "" TAB_VERB "%6.3" "" COMPU_TAB_REF FPCTL_CASCCPV_SC_Compu /end COMPU_METHOD
/begin COMPU_VTAB FPCTL_CASCCPV_SC_Compu "" TAB_VERB 2 0 "False" 1 "True" /end COMPU_VTAB
/begin COMPU_METHOD FPCTL_EXTVACREQ_SC_Compu "" TAB_VERB "%6.3" "" COMPU_TAB_REF FPCTL_EXTVACREQ_SC_Compu /end COMPU_METHOD
/begin COMPU_VTAB FPCTL_EXTVACREQ_SC_Compu "" TAB_VERB 2 0 "False" 1 "True" /end COMPU_VTAB
/begin COMPU_METHOD FPCTL_FRZFTIVPREVN_SC_Compu "" TAB_VERB "%6.3" "" COMPU_TAB_REF FPCTL_FRZFTIVPREVN_SC_Compu /end COMPU_METHOD
/begin COMPU_VTAB FPCTL_FRZFTIVPREVN_SC_Compu "" TAB_VERB 2 0 "FPCTL_FRZFTIVPREVN_SC = 0" 1 "FPCTL_FRZFTIVPREVN_SC = 1" /end COMPU_VTAB
/begin COMPU_METHOD FPCTL_INHOUSE_SC_Compu "" TAB_VERB "%6.3" "" COMPU_TAB_REF FPCTL_INHOUSE_SC_Compu /end COMPU_METHOD
/begin COMPU_VTAB FPCTL_INHOUSE_SC_Compu "" TAB_VERB 2 0 "FALSE" 1 "TRUE" /end COMPU_VTAB
/begin COMPU_METHOD FPCTL_INTEGDFUMNGT_SC_Compu "" TAB_VERB "%6.3" "" COMPU_TAB_REF FPCTL_INTEGDFUMNGT_SC_Compu /end COMPU_METHOD
/begin COMPU_VTAB FPCTL_INTEGDFUMNGT_SC_Compu "" TAB_VERB 2 0 "False" 1 "True" /end COMPU_VTAB
/begin COMPU_METHOD FPCTL_MFLOWLIMNLOADCHG_SC_Compu "" TAB_VERB "%6.3" "" COMPU_TAB_REF FPCTL_MFLOWLIMNLOADCHG_SC_Compu /end COMPU_METHOD
/begin COMPU_VTAB FPCTL_MFLOWLIMNLOADCHG_SC_Compu "" TAB_VERB 2 0 "NO_LIMNMFLOW" 1 "ACTV_LIMNMFLOW" /end COMPU_VTAB
/begin COMPU_METHOD FPCTL_REDNPURGIDLEMOD_SC_Compu "" TAB_VERB "%6.3" "" COMPU_TAB_REF FPCTL_REDNPURGIDLEMOD_SC_Compu /end COMPU_METHOD
/begin COMPU_VTAB FPCTL_REDNPURGIDLEMOD_SC_Compu "" TAB_VERB 2 0 "False" 1 "True" /end COMPU_VTAB
/begin COMPU_METHOD FPCTL_VAR_SY_Compu "" TAB_VERB "%6.3" "" COMPU_TAB_REF FPCTL_VAR_SY_Compu /end COMPU_METHOD
/begin COMPU_VTAB FPCTL_VAR_SY_Compu "" TAB_VERB 44 1 "DAI" 3 "VWW" 4 "POR" 5 "AUD" 6 "OPE" 9 "FIA" 11 "BMW" 14 "PSA" 15 "REN" 17 "ALF" 18 "SAB" 19 "VOL" 20 "NIS" 21 "GMU" 22 "FOR" 26 "IMJ" 51 "SEA" 53 "CHR" 54 "JAG" 55 "ROL" 69 "FER" 72 "TOY" 123 "MIT" 147 "HYU" 159 "HON" 160 "MAZ" 183 "CU" 190 "LRG" 204 "VVW" 214 "AVT" 242 "Iveco" 243 "DMC" 248 "SUZ" 267 "SSANGYONG" 270 "KEF" 289 "AMG" 308 "TAT" 319 "MVM" 385 "UAES" 590 "Scania" 828 "RBCD" 999 "ALL" 2887 "Nonox" 9454 "Fuso" /end COMPU_VTAB
/begin COMPU_METHOD FPCTL_VOLFLOWTOMFLOW_SC_Compu "" TAB_VERB "%6.3" "" COMPU_TAB_REF FPCTL_VOLFLOWTOMFLOW_SC_Compu /end COMPU_METHOD
/begin COMPU_VTAB FPCTL_VOLFLOWTOMFLOW_SC_Compu "" TAB_VERB 2 0 "normalized_mass_flow_PCV" 1 "volume_flow" /end COMPU_VTAB
/begin COMPU_METHOD FRARTP_SC_Compu "" TAB_VERB "%6.3" "" COMPU_TAB_REF FRARTP_SC_Compu /end COMPU_METHOD
/begin COMPU_VTAB FRARTP_SC_Compu "" TAB_VERB 2 0 "NO_FRARTP" 1 "FRARTP_USED" /end COMPU_VTAB
/begin COMPU_METHOD FRNM_SC_Compu "" TAB_VERB "%6.3" "" COMPU_TAB_REF FRNM_SC_Compu /end COMPU_METHOD
/begin COMPU_VTAB FRNM_SC_Compu "" TAB_VERB 2 0 "False" 1 "True" /end COMPU_VTAB
/begin COMPU_METHOD FrqCylPres "" RAT_FUNC "%6.2" "Hz" COEFFS 0 1 0 0 0 1 /end COMPU_METHOD
/begin COMPU_METHOD FRTP_SC_Compu "" TAB_VERB "%6.3" "" COMPU_TAB_REF FRTP_SC_Compu /end COMPU_METHOD
/begin COMPU_VTAB FRTP_SC_Compu "" TAB_VERB 2 0 "False" 1 "True" /end COMPU_VTAB
/begin COMPU_METHOD FRTSYN_SC_Compu "" TAB_VERB "%6.3" "" COMPU_TAB_REF FRTSYN_SC_Compu /end COMPU_METHOD
/begin COMPU_VTAB FRTSYN_SC_Compu "" TAB_VERB 2 0 "False" 1 "True" /end COMPU_VTAB
/begin COMPU_METHOD FSNW_SY_Compu "" TAB_VERB "%6.3" "" COMPU_TAB_REF FSNW_SY_Compu /end COMPU_METHOD
/begin COMPU_VTAB FSNW_SY_Compu "" TAB_VERB 2 0 "0" 1 "1" /end COMPU_VTAB
/begin COMPU_METHOD FTIVCPVR_SC_Compu "" TAB_VERB "%6.3" "" COMPU_TAB_REF FTIVCPVR_SC_Compu /end COMPU_METHOD
/begin COMPU_VTAB FTIVCPVR_SC_Compu "" TAB_VERB 2 0 "False" 1 "True" /end COMPU_VTAB
/begin COMPU_METHOD FUAGIDETN_INDCNENA_SC_Compu "" TAB_VERB "%6.3" "" COMPU_TAB_REF FUAGIDETN_INDCNENA_SC_Compu /end COMPU_METHOD
/begin COMPU_VTAB FUAGIDETN_INDCNENA_SC_Compu "" TAB_VERB 2 0 "False" 1 "True" /end COMPU_VTAB
/begin COMPU_METHOD FUELP_SENSTYP_SY_Compu "" TAB_VERB "%6.3" "" COMPU_TAB_REF FUELP_SENSTYP_SY_Compu /end COMPU_METHOD
/begin COMPU_VTAB FUELP_SENSTYP_SY_Compu "" TAB_VERB 5 0 "NO_P" 1 "P_ABS_ADC" 2 "P_REL_ADC" 3 "P_ABS_CAN" 4 "P_REL_CAN" /end COMPU_VTAB
/begin COMPU_METHOD FUELP_SSPMON_SY_Compu "" TAB_VERB "%6.3" "" COMPU_TAB_REF FUELP_SSPMON_SY_Compu /end COMPU_METHOD
/begin COMPU_VTAB FUELP_SSPMON_SY_Compu "" TAB_VERB 7 0 "NO_SSPMON" 1 "SSPMON_ONE" 2 "SSPMON_TWO" 3 "SSPMON_THREE" 4 "SSPMON_FOUR" 5 "SSPMON_FIVE" 6 "SSPMON_SIX" /end COMPU_VTAB
/begin COMPU_METHOD FUELP_TYPAVL_SY_Compu "" TAB_VERB "%6.3" "" COMPU_TAB_REF FUELP_TYPAVL_SY_Compu /end COMPU_METHOD
/begin COMPU_VTAB FUELP_TYPAVL_SY_Compu "" TAB_VERB 2 0 "False" 1 "True" /end COMPU_VTAB
/begin COMPU_METHOD FUELT2_TYPAVL_SC_Compu "" TAB_VERB "%6.3" "" COMPU_TAB_REF FUELT2_TYPAVL_SC_Compu /end COMPU_METHOD
/begin COMPU_VTAB FUELT2_TYPAVL_SC_Compu "" TAB_VERB 2 0 "False" 1 "True" /end COMPU_VTAB
/begin COMPU_METHOD FUELT_SNSRBNK2_SC_Compu "" TAB_VERB "%6.3" "" COMPU_TAB_REF FUELT_SNSRBNK2_SC_Compu /end COMPU_METHOD
/begin COMPU_VTAB FUELT_SNSRBNK2_SC_Compu "" TAB_VERB 3 0 "NOTAVL" 1 "TFUELLP" 2 "TFUELLPHP" /end COMPU_VTAB
/begin COMPU_METHOD FUELT_TYPAVL_SY_Compu "" TAB_VERB "%6.3" "" COMPU_TAB_REF FUELT_TYPAVL_SY_Compu /end COMPU_METHOD
/begin COMPU_VTAB FUELT_TYPAVL_SY_Compu "" TAB_VERB 2 0 "False" 1 "True" /end COMPU_VTAB
/begin COMPU_METHOD FUEVAPDIAG_CALDIAGTYP_SC_Compu "" TAB_VERB "%6.3" "" COMPU_TAB_REF FUEVAPDIAG_CALDIAGTYP_SC_Compu /end COMPU_METHOD
/begin COMPU_VTAB FUEVAPDIAG_CALDIAGTYP_SC_Compu "" TAB_VERB 2 0 "False" 1 "True" /end COMPU_VTAB
/begin COMPU_METHOD FUEVAPDIAG_ENADTESKDRV_SC_Compu "" TAB_VERB "%6.3" "" COMPU_TAB_REF FUEVAPDIAG_ENADTESKDRV_SC_Compu /end COMPU_METHOD
/begin COMPU_VTAB FUEVAPDIAG_ENADTESKDRV_SC_Compu "" TAB_VERB 2 0 "False" 1 "True" /end COMPU_VTAB
/begin COMPU_METHOD FUEVAPOILBNKIND_SC_Compu "" TAB_VERB "%6.3" "" COMPU_TAB_REF FUEVAPOILBNKIND_SC_Compu /end COMPU_METHOD
/begin COMPU_VTAB FUEVAPOILBNKIND_SC_Compu "" TAB_VERB 2 0 "False" 1 "True" /end COMPU_VTAB
/begin COMPU_METHOD FUEVAPOIL_SC_Compu "" TAB_VERB "%6.3" "" COMPU_TAB_REF FUEVAPOIL_SC_Compu /end COMPU_METHOD
/begin COMPU_VTAB FUEVAPOIL_SC_Compu "" TAB_VERB 4 0 "no modelling" 1 "only model" 2 "lambda adaptation" 3 "LAMKORRLL adaptation" /end COMPU_VTAB
/begin COMPU_METHOD FUEVAPPURGP_TYPAVL_SC_Compu "" TAB_VERB "%6.3" "" COMPU_TAB_REF FUEVAPPURGP_TYPAVL_SC_Compu /end COMPU_METHOD
/begin COMPU_VTAB FUEVAPPURGP_TYPAVL_SC_Compu "" TAB_VERB 2 0 "False" 1 "True" /end COMPU_VTAB
/begin COMPU_METHOD FUEVAPPURGT_TYPAVL_SC_Compu "" TAB_VERB "%6.3" "" COMPU_TAB_REF FUEVAPPURGT_TYPAVL_SC_Compu /end COMPU_METHOD
/begin COMPU_VTAB FUEVAPPURGT_TYPAVL_SC_Compu "" TAB_VERB 2 0 "False" 1 "True" /end COMPU_VTAB
/begin COMPU_METHOD FUEVAPPURGT_TYPTWINFLW_SC_Compu "" TAB_VERB "%6.3" "" COMPU_TAB_REF FUEVAPPURGT_TYPTWINFLW_SC_Compu /end COMPU_METHOD
/begin COMPU_VTAB FUEVAPPURGT_TYPTWINFLW_SC_Compu "" TAB_VERB 2 0 "False" 1 "True" /end COMPU_VTAB
/begin COMPU_METHOD FUFLAPCTRL_SC_Compu "" TAB_VERB "%6.3" "" COMPU_TAB_REF FUFLAPCTRL_SC_Compu /end COMPU_METHOD
/begin COMPU_VTAB FUFLAPCTRL_SC_Compu "" TAB_VERB 2 0 "False" 1 "True" /end COMPU_VTAB
/begin COMPU_METHOD FUFLAPSNSR_SC_Compu "" TAB_VERB "%6.3" "" COMPU_TAB_REF FUFLAPSNSR_SC_Compu /end COMPU_METHOD
/begin COMPU_VTAB FUFLAPSNSR_SC_Compu "" TAB_VERB 2 0 "False" 1 "True" /end COMPU_VTAB
/begin COMPU_METHOD InjSys_InjMode_Set_COMPU_VERB "" TAB_VERB "%6.3" "-" COMPU_TAB_REF InjSys_InjMode_Set_COMPU_VERB /end COMPU_METHOD
/begin COMPU_VTAB InjSys_InjMode_Set_COMPU_VERB "" TAB_VERB 20 0 "GDIOff" 1 "HO1" 2 "HO2" 3 "HO3" 4 "HO1_WU" 5 "HO2_WU" 6 "HO3_WU" 7 "HP2" 8 "HP3" 9 "HP2_CH" 10 "HP3_CH" 11 "HP2Z" 12 "HP3Z" 13 "SHO1" 14 "SHO2" 15 "SHO3" 16 "SHP3" 17 "SH1" 18 "SH2" 19 "SH3" /end COMPU_VTAB
/begin COMPU_METHOD lambda "" RAT_FUNC "%6.5" "-" COEFFS 0 1000 0 0 0 1 /end COMPU_METHOD
/begin COMPU_METHOD m_q0p1 "" RAT_FUNC "%6.3" "kg/h" COEFFS 0 10 0 0 0 1 /end COMPU_METHOD
/begin COMPU_METHOD m_q1_mg "" RAT_FUNC "%6.2" "mg" COEFFS 0 1 0 0 0 1 /end COMPU_METHOD
/begin COMPU_METHOD nmot_q40 "" RAT_FUNC "%6.1" "1/min" COEFFS 0 1 0 0 0 40 /end COMPU_METHOD
/begin COMPU_METHOD O2 "" RAT_FUNC "%8.7" "-" COEFFS 0 100000 0 0 0 1 /end COMPU_METHOD
/begin COMPU_METHOD OneToOne "" RAT_FUNC "%6.2" "-" COEFFS 0 1 0 0 0 1 /end COMPU_METHOD
/begin COMPU_METHOD Pres_1_kPa "" RAT_FUNC "%6.2" "kPa" COEFFS 0 1 0 0 0 1 /end COMPU_METHOD
/begin COMPU_METHOD Pwr_kW "" RAT_FUNC "%6.4" "kW" COEFFS 0 100 0 0 0 1 /end COMPU_METHOD
/begin COMPU_METHOD q0p005_Perc "" RAT_FUNC "%6.4" "%" COEFFS 0 200 0 0 0 1 /end COMPU_METHOD
/begin COMPU_METHOD q1p5259Em7_s "" RAT_FUNC "%9.8" "s" COEFFS 0 65536 0 0 0 0.01 /end COMPU_METHOD
/begin COMPU_METHOD q4p88281Em4 "" RAT_FUNC "%6.5" "-" COEFFS 0 65536 0 0 0 32 /end COMPU_METHOD
/begin COMPU_METHOD RBPtCel_pwr_kw_1p0_1 "" RAT_FUNC "%6.2" "" COEFFS 0 1 0 0 0 1 /end COMPU_METHOD
/begin COMPU_METHOD RBPtCel_tq_1p0_1 "" RAT_FUNC "%6.2" "Nm" COEFFS 0 1 0 0 0 1 /end COMPU_METHOD
/begin COMPU_METHOD RBPtCel_vol_1p0_1 "" RAT_FUNC "%6.2" "l" COEFFS 0 1 0 0 0 1 /end COMPU_METHOD
/begin COMPU_METHOD reldeg_q0p002441 "" RAT_FUNC "%6.4" "deg/V" COEFFS 0 65536 0 0 0 160 /end COMPU_METHOD
/begin COMPU_METHOD rel_uw_q0p0234 "" RAT_FUNC "%6.4" "%" COEFFS 0 32 0 0 0 0.75 /end COMPU_METHOD
/begin COMPU_METHOD RmpCurr_A "" RAT_FUNC "%6.5" "A/s" COEFFS 0 6553.6 0 0 0 1 /end COMPU_METHOD
/begin COMPU_METHOD RmpTrq "" RAT_FUNC "%6.4" "Nm/s" COEFFS 0 655.36 0 0 0 1 /end COMPU_METHOD
/begin COMPU_METHOD spg_q1p221Em3_V "" RAT_FUNC "%6.4" "V" COEFFS 0 65536 0 0 0 80 /end COMPU_METHOD
/begin COMPU_METHOD TimeDelay_s "" RAT_FUNC "%6.1" "s" COEFFS 0 0 1 0 0.00023283064365387 0 /end COMPU_METHOD
/begin COMPU_METHOD Time_ms_to_us "" RAT_FUNC "%6.5" "ms" COEFFS 0 1000 0 0 0 1 /end COMPU_METHOD
/begin COMPU_METHOD Time_s "" RAT_FUNC "%6.4" "s" COEFFS 0 100 0 0 0 1 /end COMPU_METHOD
/begin COMPU_METHOD Trq "" RAT_FUNC "%6.3" "Nm" COEFFS 0 10 0 0 0 1 /end COMPU_METHOD
/begin COMPU_METHOD TrqHigh "" RAT_FUNC "%6.5" "Nm" COEFFS 0 1000 0 0 0 1 /end COMPU_METHOD
/begin COMPU_METHOD t_q0p01 "" RAT_FUNC "%6.4" "s" COEFFS 0 100 0 0 0 1 /end COMPU_METHOD
/begin COMPU_METHOD t_q0p02 "" RAT_FUNC "%6.4" "s" COEFFS 0 100 0 0 0 2 /end COMPU_METHOD
/begin COMPU_METHOD t_q1_ms "" RAT_FUNC "%6.2" "ms" COEFFS 0 1 0 0 0 1 /end COMPU_METHOD
/begin COMPU_METHOD Vol "" RAT_FUNC "%6.4" "l" COEFFS 0 100 0 0 0 1 /end COMPU_METHOD
/begin COMPU_METHOD Volt_Batt "" RAT_FUNC "%6.1" "mV" COEFFS 0 0.05 0 0 0 1 /end COMPU_METHOD
/begin COMPU_METHOD Volt_q1 "" RAT_FUNC "%6.2" "V" COEFFS 0 1 0 0 0 1 /end COMPU_METHOD
/begin COMPU_METHOD zk10msxs_uw_b655p36 "" RAT_FUNC "%6.2" "s" COEFFS 0 0 65536 0 100 0 /end COMPU_METHOD
/begin RECORD_LAYOUT Kw_Ws16 FNC_VALUES 1 SWORD COLUMN_DIR DIRECT /end RECORD_LAYOUT
/begin RECORD_LAYOUT Kw_Ws32 FNC_VALUES 1 SLONG COLUMN_DIR DIRECT /end RECORD_LAYOUT
/begin RECORD_LAYOUT Kw_Wu8 FNC_VALUES 1 UBYTE COLUMN_DIR DIRECT /end RECORD_LAYOUT
/begin RECORD_LAYOUT RB_Curve_S16_S16 NO_AXIS_PTS_X 1 SWORD AXIS_PTS_X 2 SWORD INDEX_INCR DIRECT FNC_VALUES 3 SWORD COLUMN_DIR DIRECT /end RECORD_LAYOUT
/begin RECORD_LAYOUT RB_Curve_U16_S16_Static NO_AXIS_PTS_X 1 UWORD AXIS_PTS_X 2 UWORD INDEX_INCR DIRECT FNC_VALUES 3 SWORD COLUMN_DIR DIRECT STATIC_RECORD_LAYOUT /end RECORD_LAYOUT
/begin RECORD_LAYOUT RB_Curve_U16_U16 NO_AXIS_PTS_X 1 UWORD AXIS_PTS_X 2 UWORD INDEX_INCR DIRECT FNC_VALUES 3 UWORD COLUMN_DIR DIRECT /end RECORD_LAYOUT
/begin RECORD_LAYOUT RB_Curve_U16_U8_Static NO_AXIS_PTS_X 1 UWORD AXIS_PTS_X 2 UWORD INDEX_INCR DIRECT FNC_VALUES 3 UBYTE COLUMN_DIR DIRECT STATIC_RECORD_LAYOUT /end RECORD_LAYOUT
/begin RECORD_LAYOUT RB_FixCurve_U8_U8 FNC_VALUES 1 UBYTE COLUMN_DIR DIRECT /end RECORD_LAYOUT
/begin RECORD_LAYOUT RB_Map_U16S16_U16 NO_AXIS_PTS_X 1 UWORD NO_AXIS_PTS_Y 2 UWORD AXIS_PTS_X 3 UWORD INDEX_INCR DIRECT AXIS_PTS_Y 4 SWORD INDEX_INCR DIRECT FNC_VALUES 5 UWORD COLUMN_DIR DIRECT /end RECORD_LAYOUT
/begin RECORD_LAYOUT RB_Map_U8U16_S16 NO_AXIS_PTS_X 1 UBYTE NO_AXIS_PTS_Y 2 UBYTE AXIS_PTS_X 3 UBYTE INDEX_INCR DIRECT AXIS_PTS_Y 4 UWORD INDEX_INCR DIRECT FNC_VALUES 5 SWORD ROW_DIR DIRECT /end RECORD_LAYOUT
/begin RECORD_LAYOUT RB_ValA_Ws32 FNC_VALUES 1 SLONG COLUMN_DIR DIRECT /end RECORD_LAYOUT
/begin RECORD_LAYOUT RB_ValA_Wu8 FNC_VALUES 1 UBYTE COLUMN_DIR DIRECT /end RECORD_LAYOUT
/begin RECORD_LAYOUT RB_Val_Wboolean FNC_VALUES 1 UBYTE COLUMN_DIR DIRECT /end RECORD_LAYOUT
/begin RECORD_LAYOUT RB_Val_Wr32 FNC_VALUES 1 FLOAT32_IEEE COLUMN_DIR DIRECT /end RECORD_LAYOUT
/begin RECORD_LAYOUT RB_Val_Ws16 FNC_VALUES 1 SWORD COLUMN_DIR DIRECT /end RECORD_LAYOUT
/begin RECORD_LAYOUT RB_Val_Ws32 FNC_VALUES 1 SLONG COLUMN_DIR DIRECT /end RECORD_LAYOUT
/begin RECORD_LAYOUT RB_Val_Wu16 FNC_VALUES 1 UWORD COLUMN_DIR DIRECT /end RECORD_LAYOUT
/begin RECORD_LAYOUT RB_Val_Wu32 FNC_VALUES 1 ULONG COLUMN_DIR DIRECT /end RECORD_LAYOUT
/begin RECORD_LAYOUT RB_Val_Wu8 FNC_VALUES 1 UBYTE COLUMN_DIR DIRECT /end RECORD_LAYOUT
/begin RECORD_LAYOUT Val_Ws16 FNC_VALUES 1 SWORD COLUMN_DIR DIRECT /end RECORD_LAYOUT
/end MODULE
/end PROJECT
