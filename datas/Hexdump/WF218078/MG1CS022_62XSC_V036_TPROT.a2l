ASAP2_VERSION 1 60
/begin PROJECT MG1CS022 "MG1CS022"
/begin HEADER "" VERSION "MG1CS022_62XSC_V036_TPROT" PROJECT_NO MG1CS022 /end HEADER
/begin MODULE DIM ""
/begin MOD_COMMON "" BYTE_ORDER MSB_LAST ALIGNMENT_BYTE 1 ALIGNMENT_WORD 2 ALIGNMENT_LONG 4 ALIGNMENT_INT64 4 ALIGNMENT_FLOAT32_IEEE 4 ALIGNMENT_FLOAT64_IEEE 4 DATA_SIZE 32 /end MOD_COMMON
/begin AXIS_PTS CoEOM_stEomDesReqd_AX "distribution for requested mode of operation - interpolation of group axis allowed only in synchro task" 0x8052744A NO_INPUT_QUANTITY RB_Axis_U16 7951.00000000 CoEOM_stEomStgTot_VERB 26 0.00 7951.00000000 FORMAT "%13.8" DEPOSIT ABSOLUTE /end AXIS_PTS
/begin CHARACTERISTIC CWFVETHS "Code word error suspicion ethanol sensor" VALUE 0x80582028 RB_Val_Wu8 255.0 dez 0.00 255.0 FORMAT "%5.1" /end CHARACTERISTIC
/begin CHARACTERISTIC CWIGC "Codeword ignition control (IGC)" VALUE 0x80583350 RB_Val_Wu8 255.0 dez 0.00 255.0 FORMAT "%5.1" /end CHARACTERISTIC
/begin CHARACTERISTIC CWVSTMSV "configuration feed forward control MSV" VALUE 0x80581BBC RB_Val_Wu8 255.0 dez 0.00 255.0 FORMAT "%5.1" /end CHARACTERISTIC
/begin CHARACTERISTIC CWWDKSOM "codeword WDKSOM (throttle angle without torque-structure)" VALUE 0x80581E78 RB_Val_Wu8 255.0 dez 0.00 255.0 FORMAT "%5.1" /end CHARACTERISTIC
/begin CHARACTERISTIC CWZWGRU "Codeword to activate FC-interal features(ZWGRU)" VALUE 0x805834AA RB_Val_Wu8 255.0 dez 0.00 255.0 FORMAT "%5.1" /end CHARACTERISTIC
/begin CHARACTERISTIC CWZWMINBG "Codeword to activate FC-interal features(ZWMINBG)" VALUE 0x80586E84 RB_Val_Wu8 255.0 dez 0.00 255.0 FORMAT "%5.1" /end CHARACTERISTIC
/begin CHARACTERISTIC CWZWMINBVG "Codeword to activate FC-interal features(ZWMINBVG)" VALUE 0x8058769E RB_Val_Wu8 255.0 dez 0.00 255.0 FORMAT "%5.1" /end CHARACTERISTIC
/begin CHARACTERISTIC CWZWOPTWL "codeword for switchover of zwopt" VALUE 0x80588C80 RB_Val_Wu8 255.0 dez 0.00 255.0 FORMAT "%5.1" /end CHARACTERISTIC
/begin CHARACTERISTIC DVHEGOFF "Delta of numbers of synchros after setting B_vhegzsy on asegvhe" VALUE 0x80589454 RB_Val_Ws8 255.0 dez -128.0 127.0 FORMAT "%5.1" /end CHARACTERISTIC
/begin CHARACTERISTIC DVHEKOFF "Delta of numbers of synchros after resetting B_vhegzsy on asegvhe" VALUE 0x80589455 RB_Val_Ws8 255.0 dez -128.0 127.0 FORMAT "%5.1" /end CHARACTERISTIC
/begin CHARACTERISTIC DWVSTMSVAP "calibration value feed forward control MSV" VALUE 0x80581BBE RB_Val_Ws16 6553.500 kw_q0p1 -3276.800 3276.700 FORMAT "%8.3" /end CHARACTERISTIC
/begin CHARACTERISTIC DWVSTMSVST "start value feed forward control MSV" VALUE 0x80581BC0 RB_Val_Ws16 6553.500 kw_q0p1 -3276.800 3276.700 FORMAT "%8.3" /end CHARACTERISTIC
/begin CHARACTERISTIC DZWOM "temperature-dependent offset of optimized model reference ignition angle" CURVE 0x80588C82 RB_Curve_U16_S16_Static 191.9971 zw_q2p9297Em3_deg_KW -96.00000 95.99707 FORMAT "%8.5"
 /begin AXIS_DESCR STD_AXIS NO_INPUT_QUANTITY temp_ub_q0p75_o48 5 -48.0000 143.2500 FORMAT "%8.4" EXTENDED_LIMITS -48.00000 49103.25 DEPOSIT ABSOLUTE /end AXIS_DESCR
/end CHARACTERISTIC
/begin CHARACTERISTIC DZWOMHSP "temperature-dependent offset of optimized model reference ignition angle for HSP" CURVE 0x80588C98 RB_Curve_U16_S16_Static 191.9971 zw_q2p9297Em3_deg_KW -96.00000 95.99707 FORMAT "%8.5"
 /begin AXIS_DESCR STD_AXIS NO_INPUT_QUANTITY temp_ub_q0p75_o48 5 -48.0000 143.2500 FORMAT "%8.4" EXTENDED_LIMITS -48.00000 49103.25 DEPOSIT ABSOLUTE /end AXIS_DESCR
/end CHARACTERISTIC
/begin AXIS_PTS EngStrt_agDistAgIgn_AX "Base point distribution over angular distance to TDC for the ignition angle at start" 0x80588CBC wdirst_msg RB_Axis_U8 510.0 kw_q2 3 0.00 510.0 FORMAT "%5.1" DEPOSIT ABSOLUTE /end AXIS_PTS
/begin AXIS_PTS EngStrt_cntrInjAgIgn_AX "Base point distribution over injection counter for the ignition angle at start" 0x80588CC0 anztib_msg RB_Axis_U8 255.0 OneToOne 8 0.00 255.0 FORMAT "%5.1" DEPOSIT ABSOLUTE /end AXIS_PTS
/begin CHARACTERISTIC EngStrt_diaEngWrmUpEth_M "Delta ignition angle during engine warm up phase for Flex fuel from engine and intake air temperature" MAP 0x80589458 RB_Map_S16U8_S16 6553.500 zw_q0p1 -3276.800 3276.700 FORMAT "%8.3"
 /begin AXIS_DESCR STD_AXIS CEngDsT_t Temp_Cels 6 -3549.940 3003.560 FORMAT "%8.3" DEPOSIT ABSOLUTE /end AXIS_DESCR
 /begin AXIS_DESCR STD_AXIS EngStrt_selTForIgnDurgWrmUp temp_ub_q0p75_o48 6 -48.0 143.3 FORMAT "%5.1" DEPOSIT ABSOLUTE /end AXIS_DESCR
/end CHARACTERISTIC
/begin CHARACTERISTIC EngStrt_diaTDurgWrmUp_M "Delta ignition angle during engine warm up phase from engine and intake air temperature" MAP 0x805894B6 RB_Map_S16U8_S16 6553.500 zw_q0p1 -3276.800 3276.700 FORMAT "%8.3"
 /begin AXIS_DESCR STD_AXIS CEngDsT_t Temp_Cels 6 -3549.940 3003.560 FORMAT "%8.3" DEPOSIT ABSOLUTE /end AXIS_DESCR
 /begin AXIS_DESCR STD_AXIS EngStrt_selTForIgnDurgWrmUp temp_ub_q0p75_o48 6 -48.0 143.3 FORMAT "%5.1" DEPOSIT ABSOLUTE /end AXIS_DESCR
/end CHARACTERISTIC
/begin AXIS_PTS EngStrt_facCorrAltiAgIgn_AX "axis for distrubution for factor correction based on altitude" 0x80588CCA PEnv_facCorrAlti RB_Axis_U16 3.999939 fak_uw_b4 8 0.00 3.999939 FORMAT "%8.6" DEPOSIT ABSOLUTE /end AXIS_PTS
/begin CHARACTERISTIC EngStrt_facDeltaIgnAgEth_M "Ethanol Factor for Delta Ignition Angle" MAP 0x80589514 RB_Map_S16U16_U16 511.9922 fak_uw_b512 0.00 511.9922 FORMAT "%8.4"
 /begin AXIS_DESCR STD_AXIS Epm_nEng EngN 16 -16384.00 16383.50 FORMAT "%8.2" DEPOSIT ABSOLUTE /end AXIS_DESCR
 /begin AXIS_DESCR STD_AXIS rl_w_msg rel_q0p0234 12 0.00 1535.977 FORMAT "%8.3" DEPOSIT ABSOLUTE /end AXIS_DESCR
/end CHARACTERISTIC
/begin CHARACTERISTIC EngStrt_facDeltaIgnAgHSPEth_M "Weighting of delta ignition angle at warm-up(for GDI Homogeneous Split Mode) for Flex Fuel" MAP 0x805896D0 RB_Map_S16U16_U16 511.9922 fak_uw_b512 0.00 511.9922 FORMAT "%8.4"
 /begin AXIS_DESCR STD_AXIS Epm_nEng EngN 16 -16384.00 16383.50 FORMAT "%8.2" DEPOSIT ABSOLUTE /end AXIS_DESCR
 /begin AXIS_DESCR STD_AXIS rl_w_msg rel_q0p0234 12 0.00 1535.977 FORMAT "%8.3" DEPOSIT ABSOLUTE /end AXIS_DESCR
/end CHARACTERISTIC
/begin CHARACTERISTIC EngStrt_facDeltaIgnAgHSP_M "Weighting of delta ignition angle at warm-up(for direct injection Homogeneous Split Mode)" MAP 0x8058988C RB_Map_S16U16_U16 511.9922 fak_uw_b512 0.00 511.9922 FORMAT "%8.4"
 /begin AXIS_DESCR STD_AXIS Epm_nEng EngN 16 -16384.00 16383.50 FORMAT "%8.2" DEPOSIT ABSOLUTE /end AXIS_DESCR
 /begin AXIS_DESCR STD_AXIS rl_w_msg rel_q0p0234 12 0.00 1535.977 FORMAT "%8.3" DEPOSIT ABSOLUTE /end AXIS_DESCR
/end CHARACTERISTIC
/begin CHARACTERISTIC EngStrt_facDeltaIgnAgVlvlftSpclEth_M "Weighting of delta ignition angle for warm-up at special valve lifting for Flex Fuel" MAP 0x80589A48 RB_Map_S16U16_U16 511.9922 fak_uw_b512 0.00 511.9922 FORMAT "%8.4"
 /begin AXIS_DESCR STD_AXIS Epm_nEng EngN 16 -16384.00 16383.50 FORMAT "%8.2" DEPOSIT ABSOLUTE /end AXIS_DESCR
 /begin AXIS_DESCR STD_AXIS rl_w_msg rel_q0p0234 12 0.00 1535.977 FORMAT "%8.3" DEPOSIT ABSOLUTE /end AXIS_DESCR
/end CHARACTERISTIC
/begin CHARACTERISTIC EngStrt_facDeltaIgnAgVlvlftSpcl_M "Weighting of delta ignition angle for warm-up at special valve lifting." MAP 0x80589C04 RB_Map_S16U16_U16 511.9922 fak_uw_b512 0.00 511.9922 FORMAT "%8.4"
 /begin AXIS_DESCR STD_AXIS Epm_nEng EngN 16 -16384.00 16383.50 FORMAT "%8.2" DEPOSIT ABSOLUTE /end AXIS_DESCR
 /begin AXIS_DESCR STD_AXIS rl_w_msg rel_q0p0234 12 0.00 1535.977 FORMAT "%8.3" DEPOSIT ABSOLUTE /end AXIS_DESCR
/end CHARACTERISTIC
/begin CHARACTERISTIC EngStrt_facDeltaIgnAgVlvlftStdEth_M "Weighting of delta ignition angle for warm-up at standard valve lifting for Flex Fuel" MAP 0x80589DC0 RB_Map_S16U16_U16 511.9922 fak_uw_b512 0.00 511.9922 FORMAT "%8.4"
 /begin AXIS_DESCR STD_AXIS Epm_nEng EngN 16 -16384.00 16383.50 FORMAT "%8.2" DEPOSIT ABSOLUTE /end AXIS_DESCR
 /begin AXIS_DESCR STD_AXIS rl_w_msg rel_q0p0234 12 0.00 1535.977 FORMAT "%8.3" DEPOSIT ABSOLUTE /end AXIS_DESCR
/end CHARACTERISTIC
/begin CHARACTERISTIC EngStrt_facDeltaIgnAgVlvlftStd_M "Weighting of delta ignition angle for warm-up at standard valve lifting." MAP 0x80589F7C RB_Map_S16U16_U16 511.9922 fak_uw_b512 0.00 511.9922 FORMAT "%8.4"
 /begin AXIS_DESCR STD_AXIS Epm_nEng EngN 16 -16384.00 16383.50 FORMAT "%8.2" DEPOSIT ABSOLUTE /end AXIS_DESCR
 /begin AXIS_DESCR STD_AXIS rl_w_msg rel_q0p0234 12 0.00 1535.977 FORMAT "%8.3" DEPOSIT ABSOLUTE /end AXIS_DESCR
/end CHARACTERISTIC
/begin CHARACTERISTIC EngStrt_facDeltaIgnAg_M "Weighting of delta ignition angle at warm-up" MAP 0x8058A138 RB_Map_S16U16_U16 511.9922 fak_uw_b512 0.00 511.9922 FORMAT "%8.4"
 /begin AXIS_DESCR STD_AXIS Epm_nEng EngN 16 -16384.00 16383.50 FORMAT "%8.2" DEPOSIT ABSOLUTE /end AXIS_DESCR
 /begin AXIS_DESCR STD_AXIS rl_w_msg rel_q0p0234 12 0.00 1535.977 FORMAT "%8.3" DEPOSIT ABSOLUTE /end AXIS_DESCR
/end CHARACTERISTIC
/begin CHARACTERISTIC EngStrt_facIntpnAgIgnEthCurr_T "Curve weighting ethanol factor for interpolation between maps for fuel and ethanol" CURVE 0x80588CDC RB_Curve_U16_U8_Static 0.9961 fak_ub_b1 0.00 0.9961
 /begin AXIS_DESCR STD_AXIS FfPrm_facEthCurr fak_uw_b2 4 0.00 1.999969 FORMAT "%8.6" DEPOSIT ABSOLUTE /end AXIS_DESCR
/end CHARACTERISTIC
/begin CHARACTERISTIC EngStrt_facIntrpnEthDrctStrt_T "ethanol factor for interpolation between maps for fuel and ethanol for flex fuel vechicle" CURVE 0x80588CEA RB_Curve_U16_U8_Static 0.9961 fak_ub_b1 0.00 0.9961
 /begin AXIS_DESCR STD_AXIS FfPrm_facEthCurr fak_uw_b2 4 0.00 1.999969 FORMAT "%8.6" DEPOSIT ABSOLUTE /end AXIS_DESCR
/end CHARACTERISTIC
/begin CHARACTERISTIC EngStrt_facIntrpnFuEthCurr_T "Curve for ethanol factor for interpolation between maps for fuel and ethanol for flex fuel vechicle" CURVE 0x80588CF8 RB_Curve_U16_U8_Static 0.9961 fak_ub_b1 0.00 0.9961
 /begin AXIS_DESCR STD_AXIS FfPrm_facEthCurr fak_uw_b2 4 0.00 1.999969 FORMAT "%8.6" DEPOSIT ABSOLUTE /end AXIS_DESCR
/end CHARACTERISTIC
/begin CHARACTERISTIC EngStrt_facIpoEth_CUR "Weight factor for characteristic space interpolation" CURVE 0x8058A2F4 RB_Curve_U16_U8_Static 0.9961 fak_ub_b1 0.00 0.9961
 /begin AXIS_DESCR STD_AXIS FfPrm_facEthCurr fak_uw_b2 4 0.00 1.999969 FORMAT "%8.6" DEPOSIT ABSOLUTE /end AXIS_DESCR
/end CHARACTERISTIC
/begin CHARACTERISTIC EngStrt_facIpoVlvlftStdEth_CUR "Weight factor for delta ignition angle for warm-up at standard valve lifting for Flex Fuel" CURVE 0x8058A302 RB_Curve_U16_U8_Static 0.9961 fak_ub_b1 0.00 0.9961
 /begin AXIS_DESCR STD_AXIS FfPrm_facEthCurr fak_uw_b2 4 0.00 1.999969 FORMAT "%8.6" DEPOSIT ABSOLUTE /end AXIS_DESCR
/end CHARACTERISTIC
/begin CHARACTERISTIC EngStrt_idxClassSelnAgIgn_T "Curve class selector for ignition angle during start" CURVE 0x80588D06 RB_Curve_U16_U8_Static 255.0 OneToOne 0.00 255.0 FORMAT "%5.1"
 /begin AXIS_DESCR STD_AXIS EngStrt_stStrtReq ENGSTRT_STSTRTREQ_SET_COMPU_VERB 19 0.00 32770.0000000 FORMAT "%13.7" DEPOSIT ABSOLUTE /end AXIS_DESCR
/end CHARACTERISTIC
/begin CHARACTERISTIC EngStrt_idxSelnAgIgnCoMStrt_T "Curve class instance selector for ignition angle during start (change of mind)" CURVE 0x80588D42 RB_Curve_U16_U8_Static 1.00000000000 ENGSTRT_AGIGNCOMSTRT_SET_COMPU_VERB 0.00 1.00000000000 FORMAT "%13.11"
 /begin AXIS_DESCR STD_AXIS EngStrt_stStrtReq ENGSTRT_STSTRTREQ_SET_COMPU_VERB 19 0.00 32770.0000000 FORMAT "%13.7" DEPOSIT ABSOLUTE /end AXIS_DESCR
/end CHARACTERISTIC
/begin CHARACTERISTIC EngStrt_idxSelnAgIgnDrctStrt_T "Curve class instance selector for ignition angle during start (direct start)" CURVE 0x80588D7E RB_Curve_U16_U8_Static 0.00 ENGSTRT_AGIGNDRCTSTRT_SET_COMPU_VERB 0.00 0.00 FORMAT "%13.2"
 /begin AXIS_DESCR STD_AXIS EngStrt_stStrtReq ENGSTRT_STSTRTREQ_SET_COMPU_VERB 19 0.00 32770.0000000 FORMAT "%13.7" DEPOSIT ABSOLUTE /end AXIS_DESCR
/end CHARACTERISTIC
/begin CHARACTERISTIC EngStrt_idxSelnAgIgnStrtCorrOffs_T "curve for calculating correction offset" CURVE 0x80588DBA RB_Curve_U16_U8_Static 1.00000000000 ENGSTRT_AGIGNSTRTCORROFFS_SET_COMPU_VERB 0.00 1.00000000000 FORMAT "%13.11"
 /begin AXIS_DESCR STD_AXIS EngStrt_stStrtReq ENGSTRT_STSTRTREQ_SET_COMPU_VERB 19 0.00 32770.0000000 FORMAT "%13.7" DEPOSIT ABSOLUTE /end AXIS_DESCR
/end CHARACTERISTIC
/begin CHARACTERISTIC EngStrt_idxSelnAgIgnStrtOffs_T "Curve class instance selector for ignition angle during start (offset)" CURVE 0x80588DF6 RB_Curve_U16_U8_Static 0.00 ENGSTRT_AGIGNSTRTOFFS_SET_COMPU_VERB 0.00 0.00 FORMAT "%13.2"
 /begin AXIS_DESCR STD_AXIS EngStrt_stStrtReq ENGSTRT_STSTRTREQ_SET_COMPU_VERB 19 0.00 32770.0000000 FORMAT "%13.7" DEPOSIT ABSOLUTE /end AXIS_DESCR
/end CHARACTERISTIC
/begin CHARACTERISTIC EngStrt_idxSelnAgIgnStrt_T "Curve class instance selector for ignition angle during start (base calibration)" CURVE 0x80588E32 RB_Curve_U16_U8_Static 2.00000000000 ENGSTRT_AGIGNSTRT_SET_COMPU_VERB 0.00 2.00000000000 FORMAT "%13.11"
 /begin AXIS_DESCR STD_AXIS EngStrt_stStrtReq ENGSTRT_STSTRTREQ_SET_COMPU_VERB 19 0.00 32770.0000000 FORMAT "%13.7" DEPOSIT ABSOLUTE /end AXIS_DESCR
/end CHARACTERISTIC
/begin AXIS_PTS EngStrt_ignCntr_AX "Distribution list: Ignition counter" 0x80588E6E zzaehl_msg RB_Axis_U8 255.0 OneToOne 12 0.00 255.0 FORMAT "%5.1" DEPOSIT ABSOLUTE /end AXIS_PTS
/begin AXIS_PTS EngStrt_nEngAgIgn_AX "Base point distribution over engine speed for the ignition angle at start" 0x80588E7C Epm_nEng RB_Axis_S16 32767.50 EngN 12 -16384.00 16383.50 FORMAT "%8.2" DEPOSIT ABSOLUTE /end AXIS_PTS
/begin CHARACTERISTIC EngStrt_nrCmbDirSt_C "Direction start: number of combustion" VALUE 0x80588E96 RB_Val_Wu8 255.0 OneToOne 0.00 255.0 FORMAT "%5.1" /end CHARACTERISTIC
/begin CHARACTERISTIC EngStrt_ratAPedlwst_C "Threshold for standardized accelerator pedal position" VALUE 0x80588E98 RB_Val_Ws16 799.9878 Prc -400.0000 399.9878 FORMAT "%8.4" /end CHARACTERISTIC
/begin AXIS_PTS EngStrt_ratChrgAgIgnStrt_AX "Base point distribution over air charge for the ignition angle at start" 0x80588E9A AirMod_ratChrgAirCyl RB_Axis_U16 1535.977 rel_q0p02344 6 0.00 1535.977 FORMAT "%8.3" DEPOSIT ABSOLUTE /end AXIS_PTS
/begin AXIS_PTS EngStrt_rPedAgIgn_AX "Base point distribution over accelerator pedal angle for ignition path at start" 0x80588EA8 APP_r RB_Axis_S16 799.9878 Prc 10 -400.0000 399.9878 FORMAT "%8.4" DEPOSIT ABSOLUTE /end AXIS_PTS
/begin CHARACTERISTIC EngStrt_selTForIgnDurgWrmUp_C "EngStrt_selTForIgnDurgWrmUp_C selects temperature sensor for delta ignition angle calculation during warmup." VALUE 0x8058A310 RB_Val_Wu8 6.000 dez 0.00 6.000 FORMAT "%5.3" EXTENDED_LIMITS 0.00 255.0 /end CHARACTERISTIC
/begin AXIS_PTS EngStrt_tIntkMnfldAgIgn_AX "axis for distribution for intake air temperature in manifold" 0x80588EBE IntkAirT_tIntkMnfld RB_Axis_S16 6553.500 Temp_Cels 6 -3549.940 3003.560 FORMAT "%8.3" DEPOSIT ABSOLUTE /end AXIS_PTS
/begin AXIS_PTS EngStrt_tqActClthAgIgn_AX "Base point distribution over actual torque transmission for the ignition angle at start" 0x80588ECC Gbx_trqActClth RB_Axis_S16 6553.500 Trq 4 -3276.800 3276.700 FORMAT "%8.3" DEPOSIT ABSOLUTE /end AXIS_PTS
/begin AXIS_PTS EngStrt_tStrtAgIgn_AX "Base point distribution over start temperature for the ignition angle at start" 0x80588ED6 EngStrt_tStrtCoor RB_Axis_S16 3276.700 Temp_Cels 12 -273.140 3003.560 FORMAT "%8.3" EXTENDED_LIMITS -3549.940 3003.560 DEPOSIT ABSOLUTE /end AXIS_PTS
/begin CHARACTERISTIC ExhMgT_facFillgRednCptProtn_C "threshold for maximum air charge for component protection if transmission intervention is active" VALUE 0x805870F4 RB_Val_Wu16 1.999969 fak_uw_b2 0.00 1.999969 FORMAT "%8.6" /end CHARACTERISTIC
/begin CHARACTERISTIC ExhMgT_iaHiVlvLftHomFfv_M "latest allowed ignition timing for component protection for valve lift adjustment for 2nd fuel (long valve lift)" MAP 0x805870F6 RB_MapGroup_S8 191.3 zw_sb_q0p75 -96.00 95.25 FORMAT "%5.2"
 /begin AXIS_DESCR COM_AXIS Epm_nEng EngN 20 -16384.00 16383.50 FORMAT "%8.2" AXIS_PTS_REF Ign_nEng20_AX /end AXIS_DESCR
 /begin AXIS_DESCR COM_AXIS Ign_ratChrgAirCyl rel_q0p0234 12 0.00 1535.977 FORMAT "%8.3" AXIS_PTS_REF Ign_ratChrgAir12_AX /end AXIS_DESCR
/end CHARACTERISTIC
/begin CHARACTERISTIC ExhMgT_iaLoVlvLftHomFfv_M "latest allowed ignition timing for component protection for valve lift adjustment for 2nd fuel (short valve lift)" MAP 0x805871E6 RB_MapGroup_S8 191.3 zw_sb_q0p75 -96.00 95.25 FORMAT "%5.2"
 /begin AXIS_DESCR COM_AXIS Epm_nEng EngN 20 -16384.00 16383.50 FORMAT "%8.2" AXIS_PTS_REF Ign_nEngVS12_AX /end AXIS_DESCR
 /begin AXIS_DESCR COM_AXIS Ign_ratChrgAirCyl rel_q0p0234 12 0.00 1535.977 FORMAT "%8.3" AXIS_PTS_REF Ign_ratChrgAirVS12_AX /end AXIS_DESCR
/end CHARACTERISTIC
/begin CHARACTERISTIC ExhMgT_iaLoVlvLftHom_M "latest ign.angle for low valve-lift HOM for component protection" MAP 0x805872D6 RB_MapGroup_S8 191.3 zw_sb_q0p75 -96.00 95.25 FORMAT "%5.2"
 /begin AXIS_DESCR COM_AXIS Epm_nEng EngN 20 -16384.00 16383.50 FORMAT "%8.2" AXIS_PTS_REF Ign_nEngVS12_AX /end AXIS_DESCR
 /begin AXIS_DESCR COM_AXIS Ign_ratChrgAirCyl rel_q0p0234 12 0.00 1535.977 FORMAT "%8.3" AXIS_PTS_REF Ign_ratChrgAirVS12_AX /end AXIS_DESCR
/end CHARACTERISTIC
/begin CHARACTERISTIC ExhMgT_tThdIaCptProtn_C "temperature threshold for related ignition timing for component protection if transmission intervention is active." VALUE 0x805873C6 RB_Val_Ws16 6553.500 temp_q0p1_K -3276.800 3276.700 FORMAT "%8.3" /end CHARACTERISTIC
/begin CHARACTERISTIC ExhMgT_tThdIaLteBl_C "temperature threshold for related ignition timing for Brennbarkeitsgrenze" VALUE 0x805873C8 RB_Val_Ws16 6553.500 temp_q0p1_K -3276.800 3276.700 FORMAT "%8.3" /end CHARACTERISTIC
/begin CHARACTERISTIC FDZWPU "weighting factor (intake-pressure dep.) for zwmn-offs." CURVE 0x805876A0 RB_Curve_U16_U8_Static 0.9961 fak_ub_b1 0.00 0.9961
 /begin AXIS_DESCR STD_AXIS PEnv_p p_uw_q0p039 5 0.00 2559.961 FORMAT "%8.3" DEPOSIT ABSOLUTE /end AXIS_DESCR
/end CHARACTERISTIC
/begin CHARACTERISTIC FLAMTMPBTS "temperature threshold for related ignition timing for component protection" VALUE 0x805873CA RB_Val_Ws16 6553.500 temp_q0p1_K -3276.800 3276.700 FORMAT "%8.3" /end CHARACTERISTIC
/begin CHARACTERISTIC FLAMTMPBVG "temperature threshold for related ignition timing for Brennbarkeitsgrenze" VALUE 0x805873CC RB_Val_Ws16 6553.500 temp_q0p1_K -3276.800 3276.700 FORMAT "%8.3" /end CHARACTERISTIC
/begin CHARACTERISTIC FRKKMA "Factor matching relative fuel quantity in light load activation" VALUE 0x80581BC2 RB_Val_Wu8 7.969 fak_ub_b8 0.00 7.969 FORMAT "%5.3" /end CHARACTERISTIC
/begin CHARACTERISTIC FUBAOF "Opening time for interval ignition" VALUE 0x80581E86 RB_Val_Wu16 65.53500 t_q0p001_ms 0.00 65.53500 FORMAT "%8.5" /end CHARACTERISTIC
/begin CHARACTERISTIC FuPHi_pDeltaMSVEngStrt_C "Delta pressure for switching to normal MSV feed forward control angle during engine start" VALUE 0x80581BC4 RB_Val_Ws16 131.0700 RBPtCel_p_0p002_1 -65.53600 65.53400 FORMAT "%8.5" /end CHARACTERISTIC
/begin CHARACTERISTIC FuPHi_pRlSpChgGrdt_T "Map dynamic portion from prsoll_w gradient pre-control MSV" MAP 0x80581BC6 RB_Map_S16U16_S16 6553.500 kw_q0p1 -3276.800 3276.700 FORMAT "%8.3"
 /begin AXIS_DESCR STD_AXIS FuPHi_pRlSpChgGrdtLoc RBPtCel_p_0p002_1 5 -65.53600 65.53400 FORMAT "%8.5" DEPOSIT ABSOLUTE /end AXIS_DESCR
 /begin AXIS_DESCR STD_AXIS NO_INPUT_QUANTITY nmot_uw_q0p25 5 0.00 16383.75 FORMAT "%8.2" DEPOSIT ABSOLUTE /end AXIS_DESCR
/end CHARACTERISTIC
/begin AXIS_PTS IGCTL_Bat08_AX "Distribution dependent of BattU_u" 0x80581E88 BattU_u RB_Axis_S16 1310700. Volt_Batt 8 -655360.0 655340.0 FORMAT "%8.1" DEPOSIT ABSOLUTE /end AXIS_PTS
/begin CHARACTERISTIC IgCtl_diaAltiCorrnKnkCtrlFlexfu_M "Altitude correction ignition offset map for flex fuel" MAP 0x805861B6 RB_Map_U16U16_S16 6553.500 zw_q0p1 -3276.800 3276.700 FORMAT "%8.3"
 /begin AXIS_DESCR STD_AXIS PEnv_facCorrAlti fak_uw_b4 6 0.00 3.999939 FORMAT "%8.6" DEPOSIT ABSOLUTE /end AXIS_DESCR
 /begin AXIS_DESCR STD_AXIS AirMod_ratChrgAirCyl rel_q0p0234 6 0.00 1535.977 FORMAT "%8.3" DEPOSIT ABSOLUTE /end AXIS_DESCR
/end CHARACTERISTIC
/begin CHARACTERISTIC IgCtl_diaAltiCorrnKnkCtrl_M "Delta ignition angle for knock control with altitude correction" MAP 0x8058621A RB_Map_U16U16_S16 6553.500 zw_q0p1 -3276.800 3276.700 FORMAT "%8.3"
 /begin AXIS_DESCR STD_AXIS PEnv_facCorrAlti fak_uw_b4 6 0.00 3.999939 FORMAT "%8.6" DEPOSIT ABSOLUTE /end AXIS_DESCR
 /begin AXIS_DESCR STD_AXIS AirMod_ratChrgAirCyl rel_q0p0234 6 0.00 1535.977 FORMAT "%8.3" DEPOSIT ABSOLUTE /end AXIS_DESCR
/end CHARACTERISTIC
/begin CHARACTERISTIC IgCtl_diaBasEom1Ethnl_GM "Characteristic map for delta ignition angle for ethanol dependent on engine speed and air charge" MAP 0x8058585A RB_MapGroup_S16 6553.500 zw_q0p1 -3276.800 3276.700 FORMAT "%8.3"
 /begin AXIS_DESCR COM_AXIS Epm_nEng EngN 12 -16384.00 16383.50 FORMAT "%8.2" AXIS_PTS_REF Ign_nEng12_AX /end AXIS_DESCR
 /begin AXIS_DESCR COM_AXIS Ign_ratChrgAirCyl rel_q0p0234 12 0.00 1535.977 FORMAT "%8.3" AXIS_PTS_REF Ign_ratChrgAirGdiPfi12_AX /end AXIS_DESCR
/end CHARACTERISTIC
/begin CHARACTERISTIC IgCtl_diaBasEom2Ethnl_GM "Characteristic map for delta ignition angle for ethanol dependent on engine speed and air charge" MAP 0x8058597A RB_MapGroup_S16 6553.500 zw_q0p1 -3276.800 3276.700 FORMAT "%8.3"
 /begin AXIS_DESCR COM_AXIS Epm_nEng EngN 12 -16384.00 16383.50 FORMAT "%8.2" AXIS_PTS_REF Ign_nEng12_AX /end AXIS_DESCR
 /begin AXIS_DESCR COM_AXIS Ign_ratChrgAirCyl rel_q0p0234 12 0.00 1535.977 FORMAT "%8.3" AXIS_PTS_REF Ign_ratChrgAirGdiPfi12_AX /end AXIS_DESCR
/end CHARACTERISTIC
/begin CHARACTERISTIC IgCtl_diaBasEom3Ethnl_GM "Characteristic map for delta ignition angle for ethanol dependent on engine speed and air charge" MAP 0x80585A9A RB_MapGroup_S16 6553.500 zw_q0p1 -3276.800 3276.700 FORMAT "%8.3"
 /begin AXIS_DESCR COM_AXIS Epm_nEng EngN 12 -16384.00 16383.50 FORMAT "%8.2" AXIS_PTS_REF Ign_nEng12_AX /end AXIS_DESCR
 /begin AXIS_DESCR COM_AXIS Ign_ratChrgAirCyl rel_q0p0234 12 0.00 1535.977 FORMAT "%8.3" AXIS_PTS_REF Ign_ratChrgAirGdiPfi12_AX /end AXIS_DESCR
/end CHARACTERISTIC
/begin CHARACTERISTIC IgCtl_diaBasEom4Ethnl_GM "Characteristic map for delta ignition angle for ethanol dependent on engine speed and air charge" MAP 0x80585BBA RB_MapGroup_S16 6553.500 zw_q0p1 -3276.800 3276.700 FORMAT "%8.3"
 /begin AXIS_DESCR COM_AXIS Epm_nEng EngN 12 -16384.00 16383.50 FORMAT "%8.2" AXIS_PTS_REF Ign_nEng12_AX /end AXIS_DESCR
 /begin AXIS_DESCR COM_AXIS Ign_ratChrgAirCyl rel_q0p0234 12 0.00 1535.977 FORMAT "%8.3" AXIS_PTS_REF Ign_ratChrgAirGdiPfi12_AX /end AXIS_DESCR
/end CHARACTERISTIC
/begin CHARACTERISTIC IgCtl_diaExtEgrAirChrgSecFu_GM "Map for shift of optimum ignition angle depending on external EGR and air charge for 2nd fuel" MAP 0x805834AC RB_MapGroup_S16 191.3000 zw_q0p1 -96.00000 95.30000 FORMAT "%8.5" EXTENDED_LIMITS -3276.800 3276.700
 /begin AXIS_DESCR COM_AXIS Ign_ratChrgAirCyl rel_q0p0234 16 0.00 1535.977 FORMAT "%8.3" AXIS_PTS_REF Ign_ratChrgAir16_AX /end AXIS_DESCR
 /begin AXIS_DESCR COM_AXIS AirMod_ratInertEgrExtCyl rel_uw_b100 6 0.00 99.99847 FORMAT "%8.5" AXIS_PTS_REF IgCtl_ratInertEgrExtCyl_AX /end AXIS_DESCR
/end CHARACTERISTIC
/begin CHARACTERISTIC IgCtl_diaExtEgrAirChrg_GM "ignition angle offset depending on external inert gas and actual air charge" MAP 0x8058356C RB_MapGroup_S16 191.3000 zw_q0p1 -96.00000 95.30000 FORMAT "%8.5" EXTENDED_LIMITS -3276.800 3276.700
 /begin AXIS_DESCR COM_AXIS Ign_ratChrgAirCyl rel_q0p0234 16 0.00 1535.977 FORMAT "%8.3" AXIS_PTS_REF Ign_ratChrgAir16_AX /end AXIS_DESCR
 /begin AXIS_DESCR COM_AXIS AirMod_ratInertEgrExtCyl rel_uw_b100 6 0.00 99.99847 FORMAT "%8.5" AXIS_PTS_REF IgCtl_ratInertEgrExtCyl_AX /end AXIS_DESCR
/end CHARACTERISTIC
/begin CHARACTERISTIC IgCtl_diaExtEgrEngSpdSecFu_GM "Map for shift of optimum ignition angle depending on external EGR and engine speed for 2nd fuel" MAP 0x8058362C RB_MapGroup_S16 191.3000 kw_q0p1 -96.00000 95.30000 FORMAT "%8.5" EXTENDED_LIMITS -3276.800 3276.700
 /begin AXIS_DESCR COM_AXIS Epm_nEng EngN 16 -16384.00 16383.50 FORMAT "%8.2" AXIS_PTS_REF Ign_nEng16_AX /end AXIS_DESCR
 /begin AXIS_DESCR COM_AXIS AirMod_ratInertEgrExtCyl rel_uw_b100 6 0.00 99.99847 FORMAT "%8.5" AXIS_PTS_REF IgCtl_ratInertEgrExtCyl_AX /end AXIS_DESCR
/end CHARACTERISTIC
/begin CHARACTERISTIC IgCtl_diaExtEgrEngSpd_GM "ignition angle offset depending on external inert gas and actual engine speed" MAP 0x805836EC RB_MapGroup_S16 191.3000 kw_q0p1 -96.00000 95.30000 FORMAT "%8.5" EXTENDED_LIMITS -3276.800 3276.700
 /begin AXIS_DESCR COM_AXIS Epm_nEng EngN 16 -16384.00 16383.50 FORMAT "%8.2" AXIS_PTS_REF Ign_nEng16_AX /end AXIS_DESCR
 /begin AXIS_DESCR COM_AXIS AirMod_ratInertEgrExtCyl rel_uw_b100 6 0.00 99.99847 FORMAT "%8.5" AXIS_PTS_REF IgCtl_ratInertEgrExtCyl_AX /end AXIS_DESCR
/end CHARACTERISTIC
/begin CHARACTERISTIC IgCtl_diaKnkLimHomEgrSecFu_M "Characteristic map for delta ignition angle knock limit for homogeneous EGR second fuel" MAP 0x805837AC RB_Map_S16U8_S16 6553.500 zw_q0p1 -3276.800 3276.700 FORMAT "%8.3"
 /begin AXIS_DESCR STD_AXIS Epm_nEng EngN 20 -16384.00 16383.50 FORMAT "%8.2" DEPOSIT ABSOLUTE /end AXIS_DESCR
 /begin AXIS_DESCR STD_AXIS AirMod_ratChrgAirCylLoResl rel_q0p75 20 0.00 191.3 FORMAT "%5.1" DEPOSIT ABSOLUTE /end AXIS_DESCR
/end CHARACTERISTIC
/begin CHARACTERISTIC IgCtl_diaKnkLimHomEgr_M "ignition angle correction due to knock limit shift for homogeneous+egr-mode" MAP 0x80583B0C RB_Map_S16U8_S16 6553.500 zw_q0p1 -3276.800 3276.700 FORMAT "%8.3"
 /begin AXIS_DESCR STD_AXIS Epm_nEng EngN 20 -16384.00 16383.50 FORMAT "%8.2" DEPOSIT ABSOLUTE /end AXIS_DESCR
 /begin AXIS_DESCR STD_AXIS AirMod_ratChrgAirCylLoResl rel_q0p75 20 0.00 191.3 FORMAT "%5.1" DEPOSIT ABSOLUTE /end AXIS_DESCR
/end CHARACTERISTIC
/begin CHARACTERISTIC IgCtl_diaKnkTEngIntkFlexfu_M "Intake air and engine temperature ignition offset for flex fuel" MAP 0x8058627E RB_Map_S16S16_S16 6553.500 zw_q0p1 -3276.800 3276.700 FORMAT "%8.3"
 /begin AXIS_DESCR STD_AXIS CEngDsT_t Temp_Cels 6 -3549.940 3003.560 FORMAT "%8.3" DEPOSIT ABSOLUTE /end AXIS_DESCR
 /begin AXIS_DESCR STD_AXIS IgCtl_tSelTKnkCtrlIntk Temp_Cels 6 -3549.940 3003.560 FORMAT "%8.3" DEPOSIT ABSOLUTE /end AXIS_DESCR
/end CHARACTERISTIC
/begin CHARACTERISTIC IgCtl_diaKnkTEngIntk_M "Delta ignition angle for knock control from engine and intake air temperature" MAP 0x805862E2 RB_Map_S16S16_S16 6553.500 zw_q0p1 -3276.800 3276.700 FORMAT "%8.3"
 /begin AXIS_DESCR STD_AXIS CEngDsT_t Temp_Cels 6 -3549.940 3003.560 FORMAT "%8.3" DEPOSIT ABSOLUTE /end AXIS_DESCR
 /begin AXIS_DESCR STD_AXIS IgCtl_tSelTKnkCtrlIntk Temp_Cels 6 -3549.940 3003.560 FORMAT "%8.3" DEPOSIT ABSOLUTE /end AXIS_DESCR
/end CHARACTERISTIC
/begin CHARACTERISTIC IgCtl_diaPrimCorrnInertEgr_M "Calibratable IA offset based on delta between actual and reference inert gas rate (internal and external)" MAP 0x80583E6C RB_Map_S16S16_S16 6553.500 zw_q0p1 -3276.800 3276.700 FORMAT "%8.3"
 /begin AXIS_DESCR STD_AXIS IgCtl_ratDeltaInertEgrIntRef rel_uw_b100 12 -50.00000 49.99847 FORMAT "%8.5" DEPOSIT ABSOLUTE /end AXIS_DESCR
 /begin AXIS_DESCR STD_AXIS IgCtl_ratDeltaInertEgrExtRef rel_uw_b100 12 -50.00000 49.99847 FORMAT "%8.5" DEPOSIT ABSOLUTE /end AXIS_DESCR
/end CHARACTERISTIC
/begin CHARACTERISTIC IgCtl_diaRampFuCutOff_C "Delta ignition angle offset during fuel cut-off after a calibratable amount of time" VALUE 0x80586E85 RB_Val_Ws8 191.3 kw_q0p75 -96.00 95.25 FORMAT "%5.2" /end CHARACTERISTIC
/begin CHARACTERISTIC IgCtl_facAirChrgMtnEgr_T "Correction factor with respect to charge motion influence on ignition angle offset for consideration of internal and external residual gas influences" CURVE 0x80583FC0 RB_Curve_S16_U16_Static 1.999969 fak_uw_b2 0.00 1.999969 FORMAT "%8.6"
 /begin AXIS_DESCR STD_AXIS GEVCtl_agIntkClsd kw_q0p0156 10 -512.0000 511.9844 FORMAT "%8.4" DEPOSIT ABSOLUTE /end AXIS_DESCR
/end CHARACTERISTIC
/begin CHARACTERISTIC IgCtl_facBasEom_T "Curve for basic EOM ethanol factor" CURVE 0x80585CDA RB_Curve_U16_U8_Static 0.9961 fak_ub_b1 0.00 0.9961
 /begin AXIS_DESCR STD_AXIS fethmnmx_w_msg fak_uw_b2 4 0.00 1.999969 FORMAT "%8.6" DEPOSIT ABSOLUTE /end AXIS_DESCR
/end CHARACTERISTIC
/begin CHARACTERISTIC IgCtl_facIaKnkColdEthnlMax_M "Weighting of delta ignition angle for knock control during cold start condition with maximum second fuel" MAP 0x80586346 RB_Map_S16U16_U8 1.992188 fak_ub_b2 0.00 1.992188 FORMAT "%8.6"
 /begin AXIS_DESCR STD_AXIS Epm_nEng EngN 16 -16384.00 16383.50 FORMAT "%8.2" DEPOSIT ABSOLUTE /end AXIS_DESCR
 /begin AXIS_DESCR STD_AXIS AirMod_ratChrgAirCyl rel_q0p0234 12 0.00 1535.977 FORMAT "%8.3" DEPOSIT ABSOLUTE /end AXIS_DESCR
/end CHARACTERISTIC
/begin CHARACTERISTIC IgCtl_facIaKnkColdEthnlMin_M "Weighting of delta ignition angle for knock control during cold start condition with minimum second fuel" MAP 0x80586442 RB_Map_S16U16_U8 1.992188 fak_ub_b2 0.00 1.992188 FORMAT "%8.6"
 /begin AXIS_DESCR STD_AXIS Epm_nEng EngN 16 -16384.00 16383.50 FORMAT "%8.2" DEPOSIT ABSOLUTE /end AXIS_DESCR
 /begin AXIS_DESCR STD_AXIS AirMod_ratChrgAirCyl rel_q0p0234 12 0.00 1535.977 FORMAT "%8.3" DEPOSIT ABSOLUTE /end AXIS_DESCR
/end CHARACTERISTIC
/begin CHARACTERISTIC IgCtl_facIaKnkHiAlti_M "map of altitude correction factor for knock protection" MAP 0x8058653E RB_Map_S16U16_U8 1.992188 fak_ub_b2 0.00 1.992188 FORMAT "%8.6"
 /begin AXIS_DESCR STD_AXIS Epm_nEng EngN 16 -16384.00 16383.50 FORMAT "%8.2" DEPOSIT ABSOLUTE /end AXIS_DESCR
 /begin AXIS_DESCR STD_AXIS AirMod_ratChrgAirCyl rel_q0p0234 12 0.00 1535.977 FORMAT "%8.3" DEPOSIT ABSOLUTE /end AXIS_DESCR
/end CHARACTERISTIC
/begin CHARACTERISTIC IgCtl_facIaKnkWrmEthnlMax_M "Weighting of delta ignition angle for knock control during warm condition with maximum second fuel" MAP 0x8058663A RB_Map_S16U16_U8 1.992188 fak_ub_b2 0.00 1.992188 FORMAT "%8.6"
 /begin AXIS_DESCR STD_AXIS Epm_nEng EngN 16 -16384.00 16383.50 FORMAT "%8.2" DEPOSIT ABSOLUTE /end AXIS_DESCR
 /begin AXIS_DESCR STD_AXIS AirMod_ratChrgAirCyl rel_q0p0234 12 0.00 1535.977 FORMAT "%8.3" DEPOSIT ABSOLUTE /end AXIS_DESCR
/end CHARACTERISTIC
/begin CHARACTERISTIC IgCtl_facIaKnkWrmEthnlMin_M "Weighting of delta ignition angle for knock control during warm condition with minimum second fuel" MAP 0x80586736 RB_Map_S16U16_U8 1.992188 fak_ub_b2 0.00 1.992188 FORMAT "%8.6"
 /begin AXIS_DESCR STD_AXIS Epm_nEng EngN 16 -16384.00 16383.50 FORMAT "%8.2" DEPOSIT ABSOLUTE /end AXIS_DESCR
 /begin AXIS_DESCR STD_AXIS AirMod_ratChrgAirCyl rel_q0p0234 12 0.00 1535.977 FORMAT "%8.3" DEPOSIT ABSOLUTE /end AXIS_DESCR
/end CHARACTERISTIC
/begin CHARACTERISTIC IgCtl_facInertEgrCorrn_M "Factor to correct the EGR-specific ignition angle offset" MAP 0x80583FEA RB_MapGroup_U16 1.999969 fak_uw_b2 0.00 1.999969 FORMAT "%8.6"
 /begin AXIS_DESCR COM_AXIS Epm_nEng EngN 16 -16384.00 16383.50 FORMAT "%8.2" AXIS_PTS_REF Ign_nEng16_AX /end AXIS_DESCR
 /begin AXIS_DESCR COM_AXIS Ign_ratChrgAirCyl rel_q0p0234 16 0.00 1535.977 FORMAT "%8.3" AXIS_PTS_REF Ign_ratChrgAir16_AX /end AXIS_DESCR
/end CHARACTERISTIC
/begin CHARACTERISTIC IgCtl_facIntrpnEthnlFlexfu_T "Ethanol based interpolation factor for flex fuel" CURVE 0x80586832 RB_Curve_U16_U8_Static 0.9961 fak_ub_b1 0.00 0.9961
 /begin AXIS_DESCR STD_AXIS fethmnmx_w_msg fak_uw_b2 6 0.00 1.999969 FORMAT "%8.6" DEPOSIT ABSOLUTE /end AXIS_DESCR
/end CHARACTERISTIC
/begin CHARACTERISTIC IgCtl_facIntrpnEthnlSecFu_T "Ethanol based interpolation factor curve for 2nd fuel" CURVE 0x80586846 RB_Curve_U16_U8_Static 0.9961 fak_ub_b1 0.00 0.9961
 /begin AXIS_DESCR STD_AXIS fethmnmx_w_msg fak_uw_b2 6 0.00 1.999969 FORMAT "%8.6" DEPOSIT ABSOLUTE /end AXIS_DESCR
/end CHARACTERISTIC
/begin CHARACTERISTIC IgCtl_facKnkLimSecFu_GM "Knock limit factor for 2nd fuel" MAP 0x80582029 RB_MapGroup_U8 1.992188 fak_ub_b2 0.00 1.992188 FORMAT "%8.6"
 /begin AXIS_DESCR COM_AXIS Epm_nEng EngN 16 -16384.00 16383.50 FORMAT "%8.2" AXIS_PTS_REF Ign_nEng16_AX /end AXIS_DESCR
 /begin AXIS_DESCR COM_AXIS Ign_ratChrgAirCyl rel_q0p0234 12 0.00 1535.977 FORMAT "%8.3" AXIS_PTS_REF Ign_ratChrgAir12_AX /end AXIS_DESCR
/end CHARACTERISTIC
/begin CHARACTERISTIC IgCtl_facNrFolwUpSprkSecFu_T "Characteristic curve for actual weighting factor of 2nd fuel - ignition" CURVE 0x80581E9A RB_Curve_U8_U8 10.00 fak_q0p0392 0.00 10.00 FORMAT "%5.2"
 /begin AXIS_DESCR STD_AXIS f2kazw_msg fak_ub_b1 11 0.00 0.9961 DEPOSIT ABSOLUTE /end AXIS_DESCR
/end CHARACTERISTIC
/begin CHARACTERISTIC IgCtl_flgEnaFolwUpSprk_C "Flag for enabling follow up spark" VALUE 0x80581EB1 RB_Val_Wboolean 1.00000000000 B_TRUE 0.00 1.00000000000 FORMAT "%13.11" /end CHARACTERISTIC
/begin CHARACTERISTIC IgCtl_iaCalApprch_C "Application interface fixed basic ignition angle" VALUE 0x80583352 RB_Val_Ws16 6553.500 zw_q0p1 -3276.800 3276.700 FORMAT "%8.3" /end CHARACTERISTIC
/begin CHARACTERISTIC IgCtl_iaDiffKnkAdpn_C "threshold for difference between base and desired ignition angle to detect intervention of knock adaption via ignition angle" VALUE 0x80588CAE RB_Val_Ws16 1.000000 zw_q0p1 0.00 1.000000 FORMAT "%8.6" EXTENDED_LIMITS -3276.800 3276.700 /end CHARACTERISTIC
/begin CHARACTERISTIC IgCtl_iaFixdOutpAppl_C "Application interface fixed output ignition angle" VALUE 0x80588CB0 RB_Val_Ws16 6553.500 zw_q0p1 -3276.800 3276.700 FORMAT "%8.3" /end CHARACTERISTIC
/begin CHARACTERISTIC IgCtl_iaLineEndTestEgrLftDmdActvHiResl_C "Calibration for ignition angle line end test EGR active lift demand" VALUE 0x805841EA RB_Val_Ws16 191.3000 zw_q0p1 -96.00000 95.30000 FORMAT "%8.5" EXTENDED_LIMITS -3276.800 3276.700 /end CHARACTERISTIC
/begin CHARACTERISTIC IgCtl_iaLoVlvLftGearShift_GM "Low valve lift dependent ignition angle during gearshift" MAP 0x80586E86 RB_MapGroup_S8 191.3 kw_q0p75 -96.00 95.25 FORMAT "%5.2"
 /begin AXIS_DESCR COM_AXIS Epm_nEng EngN 16 -16384.00 16383.50 FORMAT "%8.2" AXIS_PTS_REF Ign_nEng16_AX /end AXIS_DESCR
 /begin AXIS_DESCR COM_AXIS Ign_ratChrgAirCyl rel_q0p0234 12 0.00 1535.977 FORMAT "%8.3" AXIS_PTS_REF Ign_ratChrgAir12_AX /end AXIS_DESCR
/end CHARACTERISTIC
/begin CHARACTERISTIC IgCtl_iaLteGearShiftCng_GM "Map for minimal ignition angle during gearshift , CNG" MAP 0x80586F46 RB_MapGroup_S8 191.3 kw_q0p75 -96.00 95.25 FORMAT "%5.2"
 /begin AXIS_DESCR COM_AXIS Epm_nEng EngN 16 -16384.00 16383.50 FORMAT "%8.2" AXIS_PTS_REF Ign_nEng16_AX /end AXIS_DESCR
 /begin AXIS_DESCR COM_AXIS Ign_ratChrgAirCyl rel_q0p0234 12 0.00 1535.977 FORMAT "%8.3" AXIS_PTS_REF Ign_ratChrgAir12_AX /end AXIS_DESCR
/end CHARACTERISTIC
/begin CHARACTERISTIC IgCtl_iaLteLimIntkCamsftHspEth2_GM "Group Map2 to limit the late ignition angle for inlet camshaft position during HSP mode for Flex fuel" MAP 0x805876B2 RB_MapGroup_S8 191.3 kw_q0p75 -96.00 95.25 FORMAT "%5.2"
 /begin AXIS_DESCR COM_AXIS Epm_nEng EngN 12 -16384.00 16383.50 FORMAT "%8.2" AXIS_PTS_REF Ign_nEng12_AX /end AXIS_DESCR
 /begin AXIS_DESCR COM_AXIS Ign_ratChrgAirCyl rel_q0p0234 12 0.00 1535.977 FORMAT "%8.3" AXIS_PTS_REF Ign_ratChrgAir12_AX /end AXIS_DESCR
/end CHARACTERISTIC
/begin CHARACTERISTIC IgCtl_iaLteLimIntkCamsftHspEth_GM "Group Map to limit the late ignition angle for inlet camshaft position during HSP mode for Flex fuel" MAP 0x80587742 RB_MapGroup_S8 191.3 kw_q0p75 -96.00 95.25 FORMAT "%5.2"
 /begin AXIS_DESCR COM_AXIS Epm_nEng EngN 12 -16384.00 16383.50 FORMAT "%8.2" AXIS_PTS_REF Ign_nEng12_AX /end AXIS_DESCR
 /begin AXIS_DESCR COM_AXIS Ign_ratChrgAirCyl rel_q0p0234 12 0.00 1535.977 FORMAT "%8.3" AXIS_PTS_REF Ign_ratChrgAir12_AX /end AXIS_DESCR
/end CHARACTERISTIC
/begin CHARACTERISTIC IgCtl_iaLteLoVlvlft2SecFl_GM "Group Map2 for latest ign.angle for low valve-lift for 2nd Fuel" MAP 0x805877D2 RB_MapGroup_S8 191.3 kw_q0p75 -96.00 95.25 FORMAT "%5.2"
 /begin AXIS_DESCR COM_AXIS Epm_nEng EngN 16 -16384.00 16383.50 FORMAT "%8.2" AXIS_PTS_REF Ign_nEng16_AX /end AXIS_DESCR
 /begin AXIS_DESCR COM_AXIS Ign_ratChrgAirCyl rel_q0p0234 12 0.00 1535.977 FORMAT "%8.3" AXIS_PTS_REF Ign_ratChrgAir12_AX /end AXIS_DESCR
/end CHARACTERISTIC
/begin CHARACTERISTIC IgCtl_iaLteLoVlvlftPos3Egr_GM "latest ign.angle for low valve-lift variant 2 Considering EGR" MAP 0x80587892 RB_MapGroup_S8 191.3 kw_q0p75 -96.00 95.25 FORMAT "%5.2"
 /begin AXIS_DESCR COM_AXIS Epm_nEng EngN 16 -16384.00 16383.50 FORMAT "%8.2" AXIS_PTS_REF Ign_nEng16_AX /end AXIS_DESCR
 /begin AXIS_DESCR COM_AXIS Ign_ratChrgAirCyl rel_q0p0234 12 0.00 1535.977 FORMAT "%8.3" AXIS_PTS_REF Ign_ratChrgAir12_AX /end AXIS_DESCR
/end CHARACTERISTIC
/begin CHARACTERISTIC IgCtl_iaLteLoVlvlftPos3SecFlEgr_GM "Group Map2 for latest ign.angle for low valve-lift for 2nd Fuel Considering EGR" MAP 0x80587952 RB_MapGroup_S8 191.3 kw_q0p75 -96.00 95.25 FORMAT "%5.2"
 /begin AXIS_DESCR COM_AXIS Epm_nEng EngN 16 -16384.00 16383.50 FORMAT "%8.2" AXIS_PTS_REF Ign_nEng16_AX /end AXIS_DESCR
 /begin AXIS_DESCR COM_AXIS Ign_ratChrgAirCyl rel_q0p0234 12 0.00 1535.977 FORMAT "%8.3" AXIS_PTS_REF Ign_ratChrgAir12_AX /end AXIS_DESCR
/end CHARACTERISTIC
/begin CHARACTERISTIC IgCtl_iaLteLoVlvlftSecFl_GM "Group Map for latest ign.angle for low valve-lift for 2 2nd Fuel" MAP 0x80587A12 RB_MapGroup_S8 191.3 kw_q0p75 -96.00 95.25 FORMAT "%5.2"
 /begin AXIS_DESCR COM_AXIS Epm_nEng EngN 16 -16384.00 16383.50 FORMAT "%8.2" AXIS_PTS_REF Ign_nEng16_AX /end AXIS_DESCR
 /begin AXIS_DESCR COM_AXIS Ign_ratChrgAirCyl rel_q0p0234 12 0.00 1535.977 FORMAT "%8.3" AXIS_PTS_REF Ign_ratChrgAir12_AX /end AXIS_DESCR
/end CHARACTERISTIC
/begin CHARACTERISTIC IgCtl_iaLtePosn3BrngLmtEgr_GM "Map for latest ignition angle variant 2, describes burning limit variant 2 Considering EGR" MAP 0x80587AD2 RB_MapGroup_S8 191.3 kw_q0p75 -96.00 95.25 FORMAT "%5.2"
 /begin AXIS_DESCR COM_AXIS Epm_nEng EngN 16 -16384.00 16383.50 FORMAT "%8.2" AXIS_PTS_REF Ign_nEng16_AX /end AXIS_DESCR
 /begin AXIS_DESCR COM_AXIS Ign_ratChrgAirCyl rel_q0p0234 12 0.00 1535.977 FORMAT "%8.3" AXIS_PTS_REF Ign_ratChrgAir12_AX /end AXIS_DESCR
/end CHARACTERISTIC
/begin CHARACTERISTIC IgCtl_iaLteTEngHsp_T "Characteristic curve for correcting the latest ignition angle depending on the engine temperature in Homogeneous Split Mode (HSP)" CURVE 0x80587B92 RB_Curve_S16_S8_Static 191.3 kw_q0p75 -96.00 95.25 FORMAT "%5.2"
 /begin AXIS_DESCR STD_AXIS CEngDsT_t Temp_Cels 8 -3549.940 3003.560 FORMAT "%8.3" DEPOSIT ABSOLUTE /end AXIS_DESCR
/end CHARACTERISTIC
/begin CHARACTERISTIC IgCtl_iaLteTEng_T "Characteristic curve for correcting the latest ignition angle depending on the engine temperature in Homogenmodus (HOM)" CURVE 0x80587BAC RB_Curve_S16_S8_Static 191.3 kw_q0p75 -96.00 95.25 FORMAT "%5.2"
 /begin AXIS_DESCR STD_AXIS CEngDsT_t Temp_Cels 8 -3549.940 3003.560 FORMAT "%8.3" DEPOSIT ABSOLUTE /end AXIS_DESCR
/end CHARACTERISTIC
/begin CHARACTERISTIC IgCtl_iaPrimEgr_GM "Calibration map for primary ignition angle considering EGR-system" MAP 0x805841EC RB_MapGroup_S16 6553.500 zw_q0p1 -3276.800 3276.700 FORMAT "%8.3"
 /begin AXIS_DESCR COM_AXIS Epm_nEng EngN 16 -16384.00 16383.50 FORMAT "%8.2" AXIS_PTS_REF Ign_nEng16_AX /end AXIS_DESCR
 /begin AXIS_DESCR COM_AXIS Ign_ratChrgAirCyl rel_q0p0234 16 0.00 1535.977 FORMAT "%8.3" AXIS_PTS_REF Ign_ratChrgAir16_AX /end AXIS_DESCR
/end CHARACTERISTIC
/begin CHARACTERISTIC IgCtl_iaPrimIntkSpEgr_GM "Calibration map for primary ignition angle considering inlet-CS setpoint position and EGR-system" MAP 0x805843EC RB_MapGroup_S16 6553.500 zw_q0p1 -3276.800 3276.700 FORMAT "%8.3"
 /begin AXIS_DESCR COM_AXIS Epm_nEng EngN 16 -16384.00 16383.50 FORMAT "%8.2" AXIS_PTS_REF Ign_nEng16_AX /end AXIS_DESCR
 /begin AXIS_DESCR COM_AXIS Ign_ratChrgAirCyl rel_q0p0234 16 0.00 1535.977 FORMAT "%8.3" AXIS_PTS_REF Ign_ratChrgAir16_AX /end AXIS_DESCR
/end CHARACTERISTIC
/begin CHARACTERISTIC IgCtl_iaPrimSecFuEgr_GM "EGR specific primary ignition angle for second fuel" MAP 0x805820EA RB_MapGroup_S16 191.3000 zw_q0p1 -96.00000 95.30000 FORMAT "%8.5" EXTENDED_LIMITS -3276.800 3276.700
 /begin AXIS_DESCR COM_AXIS Epm_nEng EngN 16 -16384.00 16383.50 FORMAT "%8.2" AXIS_PTS_REF Ign_nEng16_AX /end AXIS_DESCR
 /begin AXIS_DESCR COM_AXIS Ign_ratChrgAirCyl rel_q0p0234 16 0.00 1535.977 FORMAT "%8.3" AXIS_PTS_REF Ign_ratChrgAir16_AX /end AXIS_DESCR
/end CHARACTERISTIC
/begin CHARACTERISTIC IgCtl_iaPrimSecFuIntkSpEgr_GM "Intake camshaft position primary ignition angle including EGR for 2nd fuel" MAP 0x805822EA RB_MapGroup_S16 191.3000 zw_q0p1 -96.00000 95.30000 FORMAT "%8.5" EXTENDED_LIMITS -3276.800 3276.700
 /begin AXIS_DESCR COM_AXIS Epm_nEng EngN 16 -16384.00 16383.50 FORMAT "%8.2" AXIS_PTS_REF Ign_nEng16_AX /end AXIS_DESCR
 /begin AXIS_DESCR COM_AXIS Ign_ratChrgAirCyl rel_q0p0234 16 0.00 1535.977 FORMAT "%8.3" AXIS_PTS_REF Ign_ratChrgAir16_AX /end AXIS_DESCR
/end CHARACTERISTIC
/begin CHARACTERISTIC IgCtl_iaPrimSecFuVlvlftEgr_GM "Pimary ignition angle for 2nd fuel including low valve lift EGR" MAP 0x805824EA RB_MapGroup_S16 191.3000 zw_q0p1 -96.00000 95.30000 FORMAT "%8.5" EXTENDED_LIMITS -3276.800 3276.700
 /begin AXIS_DESCR COM_AXIS Epm_nEng EngN 16 -16384.00 16383.50 FORMAT "%8.2" AXIS_PTS_REF Ign_nEng16_AX /end AXIS_DESCR
 /begin AXIS_DESCR COM_AXIS Ign_ratChrgAirCyl rel_q0p0234 16 0.00 1535.977 FORMAT "%8.3" AXIS_PTS_REF Ign_ratChrgAir16_AX /end AXIS_DESCR
/end CHARACTERISTIC
/begin CHARACTERISTIC IgCtl_iaPrimSecFuVlvlftIntkSpEgr_GM "Primary ignition angle for 2nd fuel including intake camshaft dependent low valve lift EGR" MAP 0x805826EA RB_MapGroup_S16 191.3000 zw_q0p1 -96.00000 95.30000 FORMAT "%8.5" EXTENDED_LIMITS -3276.800 3276.700
 /begin AXIS_DESCR COM_AXIS Epm_nEng EngN 16 -16384.00 16383.50 FORMAT "%8.2" AXIS_PTS_REF Ign_nEng16_AX /end AXIS_DESCR
 /begin AXIS_DESCR COM_AXIS Ign_ratChrgAirCyl rel_q0p0234 16 0.00 1535.977 FORMAT "%8.3" AXIS_PTS_REF Ign_ratChrgAir16_AX /end AXIS_DESCR
/end CHARACTERISTIC
/begin CHARACTERISTIC IgCtl_iaPrimVlvlftEgr_GM "Calibration map for primary ignition angle at low valve lift and active EGR system" MAP 0x805845EC RB_MapGroup_S16 6553.500 zw_q0p1 -3276.800 3276.700 FORMAT "%8.3"
 /begin AXIS_DESCR COM_AXIS Epm_nEng EngN 16 -16384.00 16383.50 FORMAT "%8.2" AXIS_PTS_REF Ign_nEng16_AX /end AXIS_DESCR
 /begin AXIS_DESCR COM_AXIS Ign_ratChrgAirCyl rel_q0p0234 16 0.00 1535.977 FORMAT "%8.3" AXIS_PTS_REF Ign_ratChrgAir16_AX /end AXIS_DESCR
/end CHARACTERISTIC
/begin CHARACTERISTIC IgCtl_iaPrimVlvlftIntkSpEgr_GM "Calibration map for primary ignition angle at low valve lift, inlet camshaft in setpoint position and active EGR system" MAP 0x805847EC RB_MapGroup_S16 6553.500 zw_q0p1 -3276.800 3276.700 FORMAT "%8.3"
 /begin AXIS_DESCR COM_AXIS Epm_nEng EngN 16 -16384.00 16383.50 FORMAT "%8.2" AXIS_PTS_REF Ign_nEng16_AX /end AXIS_DESCR
 /begin AXIS_DESCR COM_AXIS Ign_ratChrgAirCyl rel_q0p0234 16 0.00 1535.977 FORMAT "%8.3" AXIS_PTS_REF Ign_ratChrgAir16_AX /end AXIS_DESCR
/end CHARACTERISTIC
/begin CHARACTERISTIC IgCtl_iaSecFuBrngLim2_GM "Ignition Angle influence by Combustion Limits for second fuel" MAP 0x80587BC6 RB_MapGroup_S8 191.3 kw_q0p75 -96.00 95.25 FORMAT "%5.2"
 /begin AXIS_DESCR COM_AXIS Epm_nEng EngN 16 -16384.00 16383.50 FORMAT "%8.2" AXIS_PTS_REF Ign_nEng16_AX /end AXIS_DESCR
 /begin AXIS_DESCR COM_AXIS Ign_ratChrgAirCyl rel_q0p0234 12 0.00 1535.977 FORMAT "%8.3" AXIS_PTS_REF Ign_ratChrgAir12_AX /end AXIS_DESCR
/end CHARACTERISTIC
/begin CHARACTERISTIC IgCtl_iaSecFuBrngLim3Egr_GM "Ignition Angle influence by Combustion Limits for second fuel considering EGR" MAP 0x80587C86 RB_MapGroup_S8 191.3 kw_q0p75 -96.00 95.25 FORMAT "%5.2"
 /begin AXIS_DESCR COM_AXIS Epm_nEng EngN 16 -16384.00 16383.50 FORMAT "%8.2" AXIS_PTS_REF Ign_nEng16_AX /end AXIS_DESCR
 /begin AXIS_DESCR COM_AXIS Ign_ratChrgAirCyl rel_q0p0234 12 0.00 1535.977 FORMAT "%8.3" AXIS_PTS_REF Ign_ratChrgAir12_AX /end AXIS_DESCR
/end CHARACTERISTIC
/begin CHARACTERISTIC IgCtl_iaSecFuBrngLim_GM "Ignition Angle influence by Combustion Limits for second fuel" MAP 0x80587D46 RB_MapGroup_S8 191.3 kw_q0p75 -96.00 95.25 FORMAT "%5.2"
 /begin AXIS_DESCR COM_AXIS Epm_nEng EngN 16 -16384.00 16383.50 FORMAT "%8.2" AXIS_PTS_REF Ign_nEng16_AX /end AXIS_DESCR
 /begin AXIS_DESCR COM_AXIS Ign_ratChrgAirCyl rel_q0p0234 12 0.00 1535.977 FORMAT "%8.3" AXIS_PTS_REF Ign_ratChrgAir12_AX /end AXIS_DESCR
/end CHARACTERISTIC
/begin CHARACTERISTIC IgCtl_idxIgnAg_GT "Curve selection of the ignition offs.map for addressed injection mode(GDIPFI,HKS,HSP)" CURVE 0x80585CE8 RB_CurveGroup_U8 255.0 dez 0.00 255.0 FORMAT "%5.1"
 /begin AXIS_DESCR COM_AXIS NO_INPUT_QUANTITY CoEOM_stEomStgTot_VERB 26 0.00 7951.00000000 FORMAT "%13.8" AXIS_PTS_REF CoEOM_stEomDesReqd_AX /end AXIS_DESCR
/end CHARACTERISTIC
/begin CHARACTERISTIC IgCtl_nEngThdFixdIa_C "engine speed threshold for fixed ign.angle output" VALUE 0x80588CB2 RB_Val_Ws16 32767.50 EngN -16384.00 16383.50 FORMAT "%8.2" /end CHARACTERISTIC
/begin CHARACTERISTIC IgCtl_nrSegIntkVlvlftSwtDly_C "number of segments to delay intake valve lift switchover for ignition" VALUE 0x80589456 RB_Val_Wu8 255.0 dez 0.00 255.0 FORMAT "%5.1" /end CHARACTERISTIC
/begin CHARACTERISTIC IgCtl_offsFacDiaLteFuCutOff_C "Offset to ramp down the ignition angle during fuel cut-off" VALUE 0x80587006 RB_Val_Wu8 0.9961 fak_ub_b1 0.00 0.9961 /end CHARACTERISTIC
/begin CHARACTERISTIC IgCtl_pIntkThdFixdIaPlaMod_C "Inlet pressure threshold for fixed ign.angle output(plant-mode)" VALUE 0x80588CB4 RB_Val_Wu16 5119.922 p_uw_q0p078 0.00 5119.922 FORMAT "%8.3" /end CHARACTERISTIC
/begin CHARACTERISTIC IgCtl_pIntkThdFixdIa_C "Inlet pressure threshold for fixed ign.angle output" VALUE 0x80588CB6 RB_Val_Wu16 5119.922 p_uw_q0p078 0.00 5119.922 FORMAT "%8.3" /end CHARACTERISTIC
/begin CHARACTERISTIC IgCtl_ratCluHysL_C "lower threshold for clutch indicating gearshift" VALUE 0x80587008 RB_Val_Ws16 255.9961 Prc_Fact256 -128.0000 127.9961 FORMAT "%8.4" /end CHARACTERISTIC
/begin CHARACTERISTIC IgCtl_ratCluHysR_C "upper threshold for clutch indicating gearshift" VALUE 0x8058700A RB_Val_Ws16 255.9961 Prc_Fact256 -128.0000 127.9961 FORMAT "%8.4" /end CHARACTERISTIC
/begin AXIS_PTS IgCtl_ratInertEgrExtCyl_AX "base point distribution for the external inert gas" 0x805849EC AirMod_ratInertEgrExtCyl RB_Axis_U16 99.99847 rel_uw_b100 6 0.00 99.99847 FORMAT "%8.5" DEPOSIT ABSOLUTE /end AXIS_PTS
/begin CHARACTERISTIC IgCtl_ratInertExtCylEgrActv_GM "External reference residual gas rate at active EGR system" MAP 0x805849FA RB_MapGroup_U16 99.99847 rel_uw_b100 0.00 99.99847 FORMAT "%8.5"
 /begin AXIS_DESCR COM_AXIS Epm_nEng EngN 16 -16384.00 16383.50 FORMAT "%8.2" AXIS_PTS_REF Ign_nEng16_AX /end AXIS_DESCR
 /begin AXIS_DESCR COM_AXIS Ign_ratChrgAirCyl rel_q0p0234 16 0.00 1535.977 FORMAT "%8.3" AXIS_PTS_REF Ign_ratChrgAir16_AX /end AXIS_DESCR
/end CHARACTERISTIC
/begin CHARACTERISTIC IgCtl_ratInertIntCylEgrActv_GM "Internal reference residual gas rate at active EGR system" MAP 0x80584BFA RB_MapGroup_U16 99.99847 rel_uw_b100 0.00 99.99847 FORMAT "%8.5"
 /begin AXIS_DESCR COM_AXIS Epm_nEng EngN 16 -16384.00 16383.50 FORMAT "%8.2" AXIS_PTS_REF Ign_nEng16_AX /end AXIS_DESCR
 /begin AXIS_DESCR COM_AXIS Ign_ratChrgAirCyl rel_q0p0234 16 0.00 1535.977 FORMAT "%8.3" AXIS_PTS_REF Ign_ratChrgAir16_AX /end AXIS_DESCR
/end CHARACTERISTIC
/begin CHARACTERISTIC IgCtl_ratInertIntCylEgrDeacv_GM "Internal reference residual gas rate at inactive EGR system" MAP 0x80584DFA RB_MapGroup_U16 99.99847 rel_uw_b100 0.00 99.99847 FORMAT "%8.5"
 /begin AXIS_DESCR COM_AXIS Epm_nEng EngN 16 -16384.00 16383.50 FORMAT "%8.2" AXIS_PTS_REF Ign_nEng16_AX /end AXIS_DESCR
 /begin AXIS_DESCR COM_AXIS Ign_ratChrgAirCyl rel_q0p0234 16 0.00 1535.977 FORMAT "%8.3" AXIS_PTS_REF Ign_ratChrgAir16_AX /end AXIS_DESCR
/end CHARACTERISTIC
/begin CHARACTERISTIC IgCtl_selTIgnKnkCtrl_C "codeword for selection of temperature for delta ignition angle calculation for knock protection" VALUE 0x8058685A RB_Val_Wu8 6.000 dez 0.00 6.000 FORMAT "%5.3" EXTENDED_LIMITS 0.00 255.0 /end CHARACTERISTIC
/begin AXIS_PTS IGCTL_tEng08_AX "Distribution dependent of EngDa_tEng" 0x80587E06 CEngDsT_t RB_Axis_S16 6553.500 Temp_Cels 8 -3549.940 3003.560 FORMAT "%8.3" DEPOSIT ABSOLUTE /end AXIS_PTS
/begin AXIS_PTS IGCTL_tEng12_AX "Distribution dependent of EngDa_tEng(12x)" 0x80587E18 CEngDsT_t RB_Axis_S16 6553.500 Temp_Cels 12 -3549.940 3003.560 FORMAT "%8.3" DEPOSIT ABSOLUTE /end AXIS_PTS
/begin CHARACTERISTIC IgCtl_tiMaxTqIntvGearShift_C "max.time for torque-intervention(zwsol) during gear-shift(with spec.late ign.angle)" VALUE 0x8058700C RB_Val_Wu8 2.550 t_q0p01 0.00 2.550 FORMAT "%5.3" /end CHARACTERISTIC
/begin CHARACTERISTIC IgCtl_tiMaxTqIntvGearShift_T "Max.time for torque-intervention(zwsol) during gear-shift(with spec.late ign.angle) depending on engine speed" CURVE 0x8058700E RB_Curve_S16_U16_Static 655.3500 t_q0p01 0.00 655.3500 FORMAT "%8.4"
 /begin AXIS_DESCR STD_AXIS Epm_nEng EngN 8 -16384.00 16383.50 FORMAT "%8.2" DEPOSIT ABSOLUTE /end AXIS_DESCR
/end CHARACTERISTIC
/begin CHARACTERISTIC IgCtl_tiResiGasCutOff_C "Time until residual gas pushed out at cut-off" VALUE 0x80587030 RB_Val_Wu8 2.550 t_q0p01 0.00 2.550 FORMAT "%5.3" /end CHARACTERISTIC
/begin CHARACTERISTIC IgCtl_tThdFixdIa_C "Temp.threshold for fixed ign.angle output" VALUE 0x80588CB8 RB_Val_Ws16 6553.500 Temp_Cels -3549.940 3003.560 FORMAT "%8.3" /end CHARACTERISTIC
/begin CHARACTERISTIC IgCtl_vThdVehMax_C "calibration threshold for vehicle speed" VALUE 0x80587032 RB_Val_Ws16 655.3500 Vel -327.6800 327.6700 FORMAT "%8.4" /end CHARACTERISTIC
/begin CHARACTERISTIC Ign_diaAPP_C "Application interface ignition angle adjustment" VALUE 0x80583354 RB_Val_Ws16 6553.500 zw_q0p1 -3276.800 3276.700 FORMAT "%8.3" /end CHARACTERISTIC
/begin CHARACTERISTIC Ign_diaBasEom1s16_GM "offset for zwbas mode dep." MAP 0x80585D02 RB_MapGroup_S16 6553.500 zw_q0p1 -3276.800 3276.700 FORMAT "%8.3"
 /begin AXIS_DESCR COM_AXIS Epm_nEng EngN 12 -16384.00 16383.50 FORMAT "%8.2" AXIS_PTS_REF Ign_nEng12_AX /end AXIS_DESCR
 /begin AXIS_DESCR COM_AXIS Ign_ratChrgAirCyl rel_q0p0234 12 0.00 1535.977 FORMAT "%8.3" AXIS_PTS_REF Ign_ratChrgAirGdiPfi12_AX /end AXIS_DESCR
/end CHARACTERISTIC
/begin CHARACTERISTIC Ign_diaBasEom2s16_GM "offset for zwbas mode dep." MAP 0x80585E22 RB_MapGroup_S16 6553.500 zw_q0p1 -3276.800 3276.700 FORMAT "%8.3"
 /begin AXIS_DESCR COM_AXIS Epm_nEng EngN 12 -16384.00 16383.50 FORMAT "%8.2" AXIS_PTS_REF Ign_nEng12_AX /end AXIS_DESCR
 /begin AXIS_DESCR COM_AXIS Ign_ratChrgAirCyl rel_q0p0234 12 0.00 1535.977 FORMAT "%8.3" AXIS_PTS_REF Ign_ratChrgAirGdiPfi12_AX /end AXIS_DESCR
/end CHARACTERISTIC
/begin CHARACTERISTIC Ign_diaBasEom3s16_GM "offset for zwbas mode dep." MAP 0x80585F42 RB_MapGroup_S16 6553.500 zw_q0p1 -3276.800 3276.700 FORMAT "%8.3"
 /begin AXIS_DESCR COM_AXIS Epm_nEng EngN 12 -16384.00 16383.50 FORMAT "%8.2" AXIS_PTS_REF Ign_nEng12_AX /end AXIS_DESCR
 /begin AXIS_DESCR COM_AXIS Ign_ratChrgAirCyl rel_q0p0234 12 0.00 1535.977 FORMAT "%8.3" AXIS_PTS_REF Ign_ratChrgAirGdiPfi12_AX /end AXIS_DESCR
/end CHARACTERISTIC
/begin CHARACTERISTIC Ign_diaBasEom4s16_GM "offset for zwbas mode dep." MAP 0x80586062 RB_MapGroup_S16 6553.500 zw_q0p1 -3276.800 3276.700 FORMAT "%8.3"
 /begin AXIS_DESCR COM_AXIS Epm_nEng EngN 12 -16384.00 16383.50 FORMAT "%8.2" AXIS_PTS_REF Ign_nEng12_AX /end AXIS_DESCR
 /begin AXIS_DESCR COM_AXIS Ign_ratChrgAirCyl rel_q0p0234 12 0.00 1535.977 FORMAT "%8.3" AXIS_PTS_REF Ign_ratChrgAirGdiPfi12_AX /end AXIS_DESCR
/end CHARACTERISTIC
/begin CHARACTERISTIC Ign_diaKpermVlvlft_GM "ignition angle shift during permanent knocking at special intake valve lift position" MAP 0x8058685C RB_MapGroup_S16 191.3000 zw_q0p1 -96.00000 95.30000 FORMAT "%8.5" EXTENDED_LIMITS -3276.800 3276.700
 /begin AXIS_DESCR COM_AXIS Epm_nEng EngN 16 -16384.00 16383.50 FORMAT "%8.2" AXIS_PTS_REF Ign_nEng16_AX /end AXIS_DESCR
 /begin AXIS_DESCR COM_AXIS Ign_ratChrgAirCyl rel_q0p0234 16 0.00 1535.977 FORMAT "%8.3" AXIS_PTS_REF Ign_ratChrgAir16_AX /end AXIS_DESCR
/end CHARACTERISTIC
/begin CHARACTERISTIC Ign_diaKperm_GM "map for Delta ignition angle with permanent knocking, fine resolution" MAP 0x80586A5C RB_MapGroup_S16 191.3000 zw_q0p1 -96.00000 95.30000 FORMAT "%8.5" EXTENDED_LIMITS -3276.800 3276.700
 /begin AXIS_DESCR COM_AXIS Epm_nEng EngN 16 -16384.00 16383.50 FORMAT "%8.2" AXIS_PTS_REF Ign_nEng16_AX /end AXIS_DESCR
 /begin AXIS_DESCR COM_AXIS Ign_ratChrgAirCyl rel_q0p0234 16 0.00 1535.977 FORMAT "%8.3" AXIS_PTS_REF Ign_ratChrgAir16_AX /end AXIS_DESCR
/end CHARACTERISTIC
/begin CHARACTERISTIC Ign_diaLtpuHOM_M "delta of Latest ignition angle in HOM mode dependent on ambient pressure" MAP 0x80587E32 RB_MapGroup_S8 191.3 kw_q0p75 -96.00 95.25 FORMAT "%5.2"
 /begin AXIS_DESCR COM_AXIS Epm_nEng EngN 16 -16384.00 16383.50 FORMAT "%8.2" AXIS_PTS_REF Ign_nEng16_AX /end AXIS_DESCR
 /begin AXIS_DESCR COM_AXIS Ign_ratChrgAirCyl rel_q0p0234 12 0.00 1535.977 FORMAT "%8.3" AXIS_PTS_REF Ign_ratChrgAir12_AX /end AXIS_DESCR
/end CHARACTERISTIC
/begin CHARACTERISTIC Ign_diaLtpuHSP_M "delta of Latest ignition angle in HSP mode dependent on ambient pressure" MAP 0x80587EF2 RB_MapGroup_S8 191.3 kw_q0p75 -96.00 95.25 FORMAT "%5.2"
 /begin AXIS_DESCR COM_AXIS Epm_nEng EngN 16 -16384.00 16383.50 FORMAT "%8.2" AXIS_PTS_REF Ign_nEng16_AX /end AXIS_DESCR
 /begin AXIS_DESCR COM_AXIS Ign_ratChrgAirCyl rel_q0p0234 12 0.00 1535.977 FORMAT "%8.3" AXIS_PTS_REF Ign_ratChrgAir12_AX /end AXIS_DESCR
/end CHARACTERISTIC
/begin CHARACTERISTIC Ign_flgIaThrVlvIceActv_C "Activation of ignition angle calculation for iced up throttle valve" VALUE 0x80587FB2 RB_Val_Wboolean 1.00000000000 B_TRUE 0.00 1.00000000000 FORMAT "%13.11" /end CHARACTERISTIC
/begin CHARACTERISTIC Ign_flgIdleDetnActv_C "Detection of engine idle speed for activation of ignition angle calculation for iced up throttle valve" VALUE 0x80587FB3 RB_Val_Wboolean 1.00000000000 B_TRUE 0.00 1.00000000000 FORMAT "%13.11" /end CHARACTERISTIC
/begin CHARACTERISTIC Ign_iaBasMax_M "Maximum base ignition-angle" MAP 0x80583356 RB_Map_S16U16_S16 6553.500 zw_q0p1 -3276.800 3276.700 FORMAT "%8.3"
 /begin AXIS_DESCR STD_AXIS Epm_nEng EngN 12 -16384.00 16383.50 FORMAT "%8.2" DEPOSIT ABSOLUTE /end AXIS_DESCR
 /begin AXIS_DESCR STD_AXIS AirMod_ratChrgAirCyl rel_q0p0234 12 0.00 1535.977 FORMAT "%8.3" DEPOSIT ABSOLUTE /end AXIS_DESCR
/end CHARACTERISTIC
/begin CHARACTERISTIC Ign_iaEthMnThrVlvIce_M "Ethanol Temperature based retarded ignition angle curve in case of iced throttle valve" MAP 0x80587FB4 RB_Map_S16U16_S8 191.3 kw_q0p75 -96.00 95.25 FORMAT "%5.2"
 /begin AXIS_DESCR STD_AXIS CEngDsT_t Temp_Cels 8 -3549.940 3003.560 FORMAT "%8.3" DEPOSIT ABSOLUTE /end AXIS_DESCR
 /begin AXIS_DESCR STD_AXIS fethmnmx_w_msg fak_uw_b2 4 0.00 1.999969 FORMAT "%8.6" DEPOSIT ABSOLUTE /end AXIS_DESCR
/end CHARACTERISTIC
/begin CHARACTERISTIC Ign_iaKnKLim2F_M "Ignition angle correction due to knock limit shift and 2nd fuel" MAP 0x805828EA RB_Map_S16U16_S16 191.3000 zw_q0p1 -96.00000 95.30000 FORMAT "%8.5" EXTENDED_LIMITS -3276.800 3276.700
 /begin AXIS_DESCR STD_AXIS Epm_nEng EngN 8 -16384.00 16383.50 FORMAT "%8.2" DEPOSIT ABSOLUTE /end AXIS_DESCR
 /begin AXIS_DESCR STD_AXIS lambas_w_msg fak_uw_b16 20 0.00 15.99976 FORMAT "%8.5" DEPOSIT ABSOLUTE /end AXIS_DESCR
/end CHARACTERISTIC
/begin CHARACTERISTIC Ign_iaPr2F2_10_GM "Ignition angle 2nd fuel, inlet-cam pos.2, flap 1=1, flap2=0" MAP 0x80582A66 RB_MapGroup_S16 191.3000 zw_q0p1 -96.00000 95.30000 FORMAT "%8.5" EXTENDED_LIMITS -3276.800 3276.700
 /begin AXIS_DESCR COM_AXIS Epm_nEng EngN 16 -16384.00 16383.50 FORMAT "%8.2" AXIS_PTS_REF Ign_nEng16_AX /end AXIS_DESCR
 /begin AXIS_DESCR COM_AXIS Ign_ratChrgAirCyl rel_q0p0234 16 0.00 1535.977 FORMAT "%8.3" AXIS_PTS_REF Ign_ratChrgAir16_AX /end AXIS_DESCR
/end CHARACTERISTIC
/begin CHARACTERISTIC Ign_iaPr2F2_GM "earliest ignition angle for 2.fuel and inlet cam in 2. endposition" MAP 0x80582C66 RB_MapGroup_S16 191.3000 zw_q0p1 -96.00000 95.30000 FORMAT "%8.5" EXTENDED_LIMITS -3276.800 3276.700
 /begin AXIS_DESCR COM_AXIS Epm_nEng EngN 16 -16384.00 16383.50 FORMAT "%8.2" AXIS_PTS_REF Ign_nEng16_AX /end AXIS_DESCR
 /begin AXIS_DESCR COM_AXIS Ign_ratChrgAirCyl rel_q0p0234 16 0.00 1535.977 FORMAT "%8.3" AXIS_PTS_REF Ign_ratChrgAir16_AX /end AXIS_DESCR
/end CHARACTERISTIC
/begin CHARACTERISTIC Ign_iaPr2_GM "primary ignition angle map var.2" MAP 0x80584FFA RB_MapGroup_S16 191.3000 zw_q0p1 -96.00000 95.30000 FORMAT "%8.5" EXTENDED_LIMITS -3276.800 3276.700
 /begin AXIS_DESCR COM_AXIS Epm_nEng EngN 16 -16384.00 16383.50 FORMAT "%8.2" AXIS_PTS_REF Ign_nEng16_AX /end AXIS_DESCR
 /begin AXIS_DESCR COM_AXIS Ign_ratChrgAirCyl rel_q0p0234 16 0.00 1535.977 FORMAT "%8.3" AXIS_PTS_REF Ign_ratChrgAir16_AX /end AXIS_DESCR
/end CHARACTERISTIC
/begin CHARACTERISTIC Ign_iaPrF2_10_GM "ignition-angle" MAP 0x80582E66 RB_MapGroup_S16 191.3000 zw_q0p1 -96.00000 95.30000 FORMAT "%8.5" EXTENDED_LIMITS -3276.800 3276.700
 /begin AXIS_DESCR COM_AXIS Epm_nEng EngN 16 -16384.00 16383.50 FORMAT "%8.2" AXIS_PTS_REF Ign_nEng16_AX /end AXIS_DESCR
 /begin AXIS_DESCR COM_AXIS Ign_ratChrgAirCyl rel_q0p0234 16 0.00 1535.977 FORMAT "%8.3" AXIS_PTS_REF Ign_ratChrgAir16_AX /end AXIS_DESCR
/end CHARACTERISTIC
/begin CHARACTERISTIC Ign_iaPrF2_GM "earliest ignition angle for 2.fuel" MAP 0x80583066 RB_MapGroup_S16 191.3000 zw_q0p1 -96.00000 95.30000 FORMAT "%8.5" EXTENDED_LIMITS -3276.800 3276.700
 /begin AXIS_DESCR COM_AXIS Epm_nEng EngN 16 -16384.00 16383.50 FORMAT "%8.2" AXIS_PTS_REF Ign_nEng16_AX /end AXIS_DESCR
 /begin AXIS_DESCR COM_AXIS Ign_ratChrgAirCyl rel_q0p0234 16 0.00 1535.977 FORMAT "%8.3" AXIS_PTS_REF Ign_ratChrgAir16_AX /end AXIS_DESCR
/end CHARACTERISTIC
/begin CHARACTERISTIC Ign_iaPrVL1_GM "Ignition-angle map at changed valve lift" MAP 0x805851FA RB_MapGroup_S16 191.3000 zw_q0p1 -96.00000 95.30000 FORMAT "%8.5" EXTENDED_LIMITS -3276.800 3276.700
 /begin AXIS_DESCR COM_AXIS Epm_nEng EngN 16 -16384.00 16383.50 FORMAT "%8.2" AXIS_PTS_REF Ign_nEng16_AX /end AXIS_DESCR
 /begin AXIS_DESCR COM_AXIS Ign_ratChrgAirCyl rel_q0p0234 16 0.00 1535.977 FORMAT "%8.3" AXIS_PTS_REF Ign_ratChrgAir16_AX /end AXIS_DESCR
/end CHARACTERISTIC
/begin CHARACTERISTIC Ign_iaPrVL2_GM "Ignition-angle map version 2 at changed valve lift" MAP 0x805853FA RB_MapGroup_S16 191.3000 zw_q0p1 -96.00000 95.30000 FORMAT "%8.5" EXTENDED_LIMITS -3276.800 3276.700
 /begin AXIS_DESCR COM_AXIS Epm_nEng EngN 16 -16384.00 16383.50 FORMAT "%8.2" AXIS_PTS_REF Ign_nEng16_AX /end AXIS_DESCR
 /begin AXIS_DESCR COM_AXIS Ign_ratChrgAirCyl rel_q0p0234 16 0.00 1535.977 FORMAT "%8.3" AXIS_PTS_REF Ign_ratChrgAir16_AX /end AXIS_DESCR
/end CHARACTERISTIC
/begin CHARACTERISTIC Ign_iaPr_GM "primary ignition angle map" MAP 0x805855FA RB_MapGroup_S16 191.3000 zw_q0p1 -96.00000 95.30000 FORMAT "%8.5" EXTENDED_LIMITS -3276.800 3276.700
 /begin AXIS_DESCR COM_AXIS Epm_nEng EngN 16 -16384.00 16383.50 FORMAT "%8.2" AXIS_PTS_REF Ign_nEng16_AX /end AXIS_DESCR
 /begin AXIS_DESCR COM_AXIS Ign_ratChrgAirCyl rel_q0p0234 16 0.00 1535.977 FORMAT "%8.3" AXIS_PTS_REF Ign_ratChrgAir16_AX /end AXIS_DESCR
/end CHARACTERISTIC
/begin AXIS_PTS Ign_nEng08_AX "Distribution dependent of Epm_nEng(8)" 0x80581EB2 Epm_nEng RB_Axis_S16 32767.50 EngN 8 -16384.00 16383.50 FORMAT "%8.2" DEPOSIT ABSOLUTE /end AXIS_PTS
/begin AXIS_PTS Ign_nEng12_AX "Distribution dependent of Epm_nEng(12)" 0x80586182 Epm_nEng RB_Axis_S16 32767.50 EngN 12 -16384.00 16383.50 FORMAT "%8.2" DEPOSIT ABSOLUTE /end AXIS_PTS
/begin AXIS_PTS Ign_nEng16_AX "Distribution dependent of Epm_nEng(16)" 0x805857FA Epm_nEng RB_Axis_S16 32767.50 EngN 16 -16384.00 16383.50 FORMAT "%8.2" DEPOSIT ABSOLUTE /end AXIS_PTS
/begin AXIS_PTS Ign_nEng20_AX "Distribution dependent of Epm_nEng(20)" 0x8057E788 Epm_nEng RB_Axis_S16 32767.50 EngN 20 -16384.00 16383.50 FORMAT "%8.2" DEPOSIT ABSOLUTE /end AXIS_PTS
/begin AXIS_PTS Ign_nEngVS12_AX "engine speed dep.map" 0x8057E7B2 Epm_nEng RB_Axis_S16 32767.50 EngN 20 -16384.00 16383.50 FORMAT "%8.2" DEPOSIT ABSOLUTE /end AXIS_PTS
/begin AXIS_PTS Ign_ratChrgAir12_AX "Distribution(12) dependent of AirMod_ratChrgAirCyl(rl_w)" 0x8058581C Ign_ratChrgAirCyl RB_Axis_U16 1535.977 rel_q0p0234 12 0.00 1535.977 FORMAT "%8.3" DEPOSIT ABSOLUTE /end AXIS_PTS
/begin AXIS_PTS Ign_ratChrgAir16_AX "Distribution(16) dependent of AirMod_ratChrgAirCyl(rl_w)" 0x80585836 Ign_ratChrgAirCyl RB_Axis_U16 1535.977 rel_q0p0234 16 0.00 1535.977 FORMAT "%8.3" DEPOSIT ABSOLUTE /end AXIS_PTS
/begin AXIS_PTS Ign_ratChrgAirGdiPfi12_AX "Distribution(12) dependent of AirMod_ratChrgAirCyl or Ign_ratChrgAirCyl" 0x8058619C Ign_ratChrgAirCyl RB_Axis_U16 1535.977 rel_q0p0234 12 0.00 1535.977 FORMAT "%8.3" DEPOSIT ABSOLUTE /end AXIS_PTS
/begin AXIS_PTS Ign_ratChrgAirVS12_AX "load dep. map" 0x8057E7DC Ign_ratChrgAirCyl RB_Axis_U16 1535.977 rel_q0p0234 12 0.00 1535.977 FORMAT "%8.3" DEPOSIT ABSOLUTE /end AXIS_PTS
/begin CHARACTERISTIC Ign_StepIgnAgPrRmpDplKnk_C "Increment of the basic ignition angle ramp for the shift of the knock limit due to external EGR" VALUE 0x80585858 RB_Val_Ws16 94.90000 zw_q0p1 0.10000 95.00000 FORMAT "%8.5" EXTENDED_LIMITS -3276.800 3276.700 /end CHARACTERISTIC
/begin CHARACTERISTIC Ign_tEngMinThd_C "Minimum temperature to activate low-octane functionality" VALUE 0x80586C5C RB_Val_Ws16 3276.700 Temp_Cels -273.140 3003.560 FORMAT "%8.3" EXTENDED_LIMITS -3549.940 3003.560 /end CHARACTERISTIC
/begin CHARACTERISTIC KFDZMNIDST "Map for offset minimal ignition angle during idle after-start overshoot" MAP 0x80587FF0 RB_Map_S16S16_S8 191.3 kw_q0p75 -96.00 95.25 FORMAT "%5.2"
 /begin AXIS_DESCR STD_AXIS Epm_nEng EngN 4 -16384.00 16383.50 FORMAT "%8.2" DEPOSIT ABSOLUTE /end AXIS_DESCR
 /begin AXIS_DESCR STD_AXIS CEngDsT_tStrt Temp_Cels 6 -3549.940 3003.560 FORMAT "%8.3" DEPOSIT ABSOLUTE /end AXIS_DESCR
/end CHARACTERISTIC
/begin CHARACTERISTIC KFDZMNST "Map for offset minimal ignition angle during after-start overshoot" MAP 0x80588020 RB_Map_S16S16_S8 191.3 kw_q0p75 -96.00 95.25 FORMAT "%5.2"
 /begin AXIS_DESCR STD_AXIS Epm_nEng EngN 4 -16384.00 16383.50 FORMAT "%8.2" DEPOSIT ABSOLUTE /end AXIS_DESCR
 /begin AXIS_DESCR STD_AXIS CEngDsT_tStrt Temp_Cels 6 -3549.940 3003.560 FORMAT "%8.3" DEPOSIT ABSOLUTE /end AXIS_DESCR
/end CHARACTERISTIC
/begin CHARACTERISTIC KFFDZWMNRG "Weighting factor for correction of maximum retarded spark limitation due to residual gas" MAP 0x80588050 RB_MapGroup_S8 31.88 fak_sb_b16 -16.00 15.88 FORMAT "%5.2"
 /begin AXIS_DESCR COM_AXIS Epm_nEng EngN 16 -16384.00 16383.50 FORMAT "%8.2" AXIS_PTS_REF Ign_nEng16_AX /end AXIS_DESCR
 /begin AXIS_DESCR COM_AXIS Ign_ratChrgAirCyl rel_q0p0234 12 0.00 1535.977 FORMAT "%8.3" AXIS_PTS_REF Ign_ratChrgAir12_AX /end AXIS_DESCR
/end CHARACTERISTIC
/begin CHARACTERISTIC KFFFANZ "Number of sequential sparks" MAP 0x80581EC4 RB_Map_S16S16_S16 255.0000 dez 0.00 255.0000 FORMAT "%8.4" EXTENDED_LIMITS -32768.00 32767.00
 /begin AXIS_DESCR STD_AXIS CEngDsT_t Temp_Cels 6 -3549.940 3003.560 FORMAT "%8.3" DEPOSIT ABSOLUTE /end AXIS_DESCR
 /begin AXIS_DESCR STD_AXIS Epm_nEng EngN 6 -16384.00 16383.50 FORMAT "%8.2" DEPOSIT ABSOLUTE /end AXIS_DESCR
/end CHARACTERISTIC
/begin CHARACTERISTIC KFFSTE100 "special ramp for late ignition angle during postart with E100-fuel" MAP 0x80588110 RB_Map_S16U16_U16 0.9999847 fak_uw_b1 0.00 0.9999847 FORMAT "%9.7"
 /begin AXIS_DESCR STD_AXIS CEngDsT_t Temp_Cels 6 -3549.940 3003.560 FORMAT "%8.3" DEPOSIT ABSOLUTE /end AXIS_DESCR
 /begin AXIS_DESCR STD_AXIS Ign_fac2F_iaLT fak_ub_b1 6 0.00 0.9960938 FORMAT "%9.7" EXTENDED_LIMITS 0.00 255.9961 DEPOSIT ABSOLUTE /end AXIS_DESCR
/end CHARACTERISTIC
/begin CHARACTERISTIC KFFSZFF "ratio main dwell-time to follow-up dwell-time" MAP 0x80581F28 RB_MapGroup_U8 0.9961 fak_ub_b1 0.00 0.9961
 /begin AXIS_DESCR COM_AXIS Epm_nEng EngN 8 -16384.00 16383.50 FORMAT "%8.2" AXIS_PTS_REF Ign_nEng08_AX /end AXIS_DESCR
 /begin AXIS_DESCR COM_AXIS CEngDsT_t Temp_Cels 8 -3549.940 3003.560 FORMAT "%8.3" AXIS_PTS_REF IGCTL_tEng08_AX /end AXIS_DESCR
/end CHARACTERISTIC
/begin CHARACTERISTIC KFFSZNM "dwell-time shortening for reducing power dissipation during high engine-speed + temperature" MAP 0x80581F68 RB_MapGroup_U8 0.9961 fak_ub_b1 0.00 0.9961
 /begin AXIS_DESCR COM_AXIS Epm_nEng EngN 8 -16384.00 16383.50 FORMAT "%8.2" AXIS_PTS_REF Ign_nEng08_AX /end AXIS_DESCR
 /begin AXIS_DESCR COM_AXIS CEngDsT_t Temp_Cels 8 -3549.940 3003.560 FORMAT "%8.3" AXIS_PTS_REF IGCTL_tEng08_AX /end AXIS_DESCR
/end CHARACTERISTIC
/begin CHARACTERISTIC KFSWKFZK "Threshold of the ignition-angle timing retards for ignition-angle map switch-over" MAP 0x80586C5E RB_MapGroup_S8 191.3 kw_q0p75 -96.00 95.25 FORMAT "%5.2"
 /begin AXIS_DESCR COM_AXIS Epm_nEng EngN 16 -16384.00 16383.50 FORMAT "%8.2" AXIS_PTS_REF Ign_nEng16_AX /end AXIS_DESCR
 /begin AXIS_DESCR COM_AXIS Ign_ratChrgAirCyl rel_q0p0234 16 0.00 1535.977 FORMAT "%8.3" AXIS_PTS_REF Ign_ratChrgAir16_AX /end AXIS_DESCR
/end CHARACTERISTIC
/begin CHARACTERISTIC KFSWKFZKR "Threshold of the ignition-angle timing retards for ignition-angle map return switch-over" MAP 0x80586D5E RB_MapGroup_S8 191.3 kw_q0p75 -96.00 95.25 FORMAT "%5.2"
 /begin AXIS_DESCR COM_AXIS Epm_nEng EngN 16 -16384.00 16383.50 FORMAT "%8.2" AXIS_PTS_REF Ign_nEng16_AX /end AXIS_DESCR
 /begin AXIS_DESCR COM_AXIS Ign_ratChrgAirCyl rel_q0p0234 16 0.00 1535.977 FORMAT "%8.3" AXIS_PTS_REF Ign_ratChrgAir16_AX /end AXIS_DESCR
/end CHARACTERISTIC
/begin CHARACTERISTIC KFSZT "Dwell angle characteristic map" MAP 0x80581FA8 RB_MapGroup_U16 65.53500 t_q0p001_ms 0.00 65.53500 FORMAT "%8.5"
 /begin AXIS_DESCR COM_AXIS BattU_u Volt_Batt 8 -655360.0 655340.0 FORMAT "%8.1" AXIS_PTS_REF IGCTL_Bat08_AX /end AXIS_DESCR
 /begin AXIS_DESCR COM_AXIS CEngDsT_t Temp_Cels 8 -3549.940 3003.560 FORMAT "%8.3" AXIS_PTS_REF IGCTL_tEng08_AX /end AXIS_DESCR
/end CHARACTERISTIC
/begin CHARACTERISTIC KFVSTMSVO "offset feed forward control MSV" MAP 0x80581C10 RB_MapGroup_S16 6553.500 kw_q0p1 -3276.800 3276.700 FORMAT "%8.3"
 /begin AXIS_DESCR COM_AXIS NO_INPUT_QUANTITY nmot_uw_q0p25 8 0.00 16383.75 FORMAT "%8.2" AXIS_PTS_REF SNM08HDUW /end AXIS_DESCR
 /begin AXIS_DESCR COM_AXIS NO_INPUT_QUANTITY RBPtCel_p_0p002_1 6 0.00 131.0700 FORMAT "%8.4" AXIS_PTS_REF SPR06HDUW /end AXIS_DESCR
/end CHARACTERISTIC
/begin CHARACTERISTIC KFW2KAGRU "correction for interpolation E0- E85" MAP 0x80583266 RB_MapGroup_U8 1.992188 fak_ub_b2 0.00 1.992188 FORMAT "%8.6"
 /begin AXIS_DESCR COM_AXIS Epm_nEng EngN 16 -16384.00 16383.50 FORMAT "%8.2" AXIS_PTS_REF Ign_nEng16_AX /end AXIS_DESCR
 /begin AXIS_DESCR COM_AXIS Ign_ratChrgAirCyl rel_q0p0234 12 0.00 1535.977 FORMAT "%8.3" AXIS_PTS_REF Ign_ratChrgAir12_AX /end AXIS_DESCR
/end CHARACTERISTIC
/begin CHARACTERISTIC KFZWMN "Map for latest ignition angle, describes burning limit." MAP 0x80588174 RB_MapGroup_S8 191.3 kw_q0p75 -96.00 95.25 FORMAT "%5.2"
 /begin AXIS_DESCR COM_AXIS Epm_nEng EngN 16 -16384.00 16383.50 FORMAT "%8.2" AXIS_PTS_REF Ign_nEng16_AX /end AXIS_DESCR
 /begin AXIS_DESCR COM_AXIS Ign_ratChrgAirCyl rel_q0p0234 12 0.00 1535.977 FORMAT "%8.3" AXIS_PTS_REF Ign_ratChrgAir12_AX /end AXIS_DESCR
/end CHARACTERISTIC
/begin CHARACTERISTIC KFZWMN2 "Map for latest ignition angle variant 2, describes burning limit variant 2" MAP 0x80588234 RB_MapGroup_S8 191.3 kw_q0p75 -96.00 95.25 FORMAT "%5.2"
 /begin AXIS_DESCR COM_AXIS Epm_nEng EngN 16 -16384.00 16383.50 FORMAT "%8.2" AXIS_PTS_REF Ign_nEng16_AX /end AXIS_DESCR
 /begin AXIS_DESCR COM_AXIS Ign_ratChrgAirCyl rel_q0p0234 12 0.00 1535.977 FORMAT "%8.3" AXIS_PTS_REF Ign_ratChrgAir12_AX /end AXIS_DESCR
/end CHARACTERISTIC
/begin CHARACTERISTIC KFZWMNAGRBTSVH "latest allowed delta ignition timing for component protection because of EGR for valve lift adjustment (long valve lift)" MAP 0x805873CE RB_MapGroup_S8 31.88 fak_sb_b16 -16.00 15.88 FORMAT "%5.2"
 /begin AXIS_DESCR COM_AXIS Epm_nEng EngN 20 -16384.00 16383.50 FORMAT "%8.2" AXIS_PTS_REF Ign_nEng20_AX /end AXIS_DESCR
 /begin AXIS_DESCR COM_AXIS Ign_ratChrgAirCyl rel_q0p0234 12 0.00 1535.977 FORMAT "%8.3" AXIS_PTS_REF Ign_ratChrgAir12_AX /end AXIS_DESCR
/end CHARACTERISTIC
/begin CHARACTERISTIC KFZWMNAGRBTSVHK "latest allowed delta ignition timing for component protection because of EGR for valve lift adjustment (short valve lift)" MAP 0x805874BE RB_MapGroup_S8 31.88 fak_sb_b16 -16.00 15.88 FORMAT "%5.2"
 /begin AXIS_DESCR COM_AXIS Epm_nEng EngN 20 -16384.00 16383.50 FORMAT "%8.2" AXIS_PTS_REF Ign_nEng20_AX /end AXIS_DESCR
 /begin AXIS_DESCR COM_AXIS Ign_ratChrgAirCyl rel_q0p0234 12 0.00 1535.977 FORMAT "%8.3" AXIS_PTS_REF Ign_ratChrgAir12_AX /end AXIS_DESCR
/end CHARACTERISTIC
/begin CHARACTERISTIC KFZWMNBTSVH "latest allowed ignition timing for component protection for valve lift adjustment (long valve lift)" MAP 0x805875AE RB_MapGroup_S8 191.3 zw_sb_q0p75 -96.00 95.25 FORMAT "%5.2"
 /begin AXIS_DESCR COM_AXIS Epm_nEng EngN 20 -16384.00 16383.50 FORMAT "%8.2" AXIS_PTS_REF Ign_nEng20_AX /end AXIS_DESCR
 /begin AXIS_DESCR COM_AXIS Ign_ratChrgAirCyl rel_q0p0234 12 0.00 1535.977 FORMAT "%8.3" AXIS_PTS_REF Ign_ratChrgAir12_AX /end AXIS_DESCR
/end CHARACTERISTIC
/begin CHARACTERISTIC KFZWMNGS "Map for latest ignition angle during geasrshift" MAP 0x80587034 RB_MapGroup_S8 191.3 kw_q0p75 -96.00 95.25 FORMAT "%5.2"
 /begin AXIS_DESCR COM_AXIS Epm_nEng EngN 16 -16384.00 16383.50 FORMAT "%8.2" AXIS_PTS_REF Ign_nEng16_AX /end AXIS_DESCR
 /begin AXIS_DESCR COM_AXIS Ign_ratChrgAirCyl rel_q0p0234 12 0.00 1535.977 FORMAT "%8.3" AXIS_PTS_REF Ign_ratChrgAir12_AX /end AXIS_DESCR
/end CHARACTERISTIC
/begin CHARACTERISTIC KFZWMNHSP "Map for late limit ignition angle catalyst HSP" MAP 0x805882F4 RB_MapGroup_S8 191.3 kw_q0p75 -96.00 95.25 FORMAT "%5.2"
 /begin AXIS_DESCR COM_AXIS Epm_nEng EngN 12 -16384.00 16383.50 FORMAT "%8.2" AXIS_PTS_REF Ign_nEng12_AX /end AXIS_DESCR
 /begin AXIS_DESCR COM_AXIS Ign_ratChrgAirCyl rel_q0p0234 12 0.00 1535.977 FORMAT "%8.3" AXIS_PTS_REF Ign_ratChrgAir12_AX /end AXIS_DESCR
/end CHARACTERISTIC
/begin CHARACTERISTIC KFZWMNHSP02 "Map for late limit ignition angle catalyst warm-up(HSP) variant 2" MAP 0x80588384 RB_MapGroup_S8 191.3 kw_q0p75 -96.00 95.25 FORMAT "%5.2"
 /begin AXIS_DESCR COM_AXIS Epm_nEng EngN 12 -16384.00 16383.50 FORMAT "%8.2" AXIS_PTS_REF Ign_nEng12_AX /end AXIS_DESCR
 /begin AXIS_DESCR COM_AXIS Ign_ratChrgAirCyl rel_q0p0234 12 0.00 1535.977 FORMAT "%8.3" AXIS_PTS_REF Ign_ratChrgAir12_AX /end AXIS_DESCR
/end CHARACTERISTIC
/begin CHARACTERISTIC KFZWMNKHLL "Map for minimal ignition angle catalyst warm-up by idle speed" MAP 0x80588414 RB_Map_S16U16_S8 191.3 kw_q0p75 -96.00 95.25 FORMAT "%5.2"
 /begin AXIS_DESCR STD_AXIS Epm_nEng EngN 4 -16384.00 16383.50 FORMAT "%8.2" DEPOSIT ABSOLUTE /end AXIS_DESCR
 /begin AXIS_DESCR STD_AXIS AirMod_ratChrgAirCyl rel_q0p0234 4 0.00 1535.977 FORMAT "%8.3" DEPOSIT ABSOLUTE /end AXIS_DESCR
/end CHARACTERISTIC
/begin CHARACTERISTIC KFZWMNKHLLHSP "Map for minimal ignition angle catalyst warm-up by idle speed(HSP)" MAP 0x80588438 RB_Map_S16U16_S8 191.3 kw_q0p75 -96.00 95.25 FORMAT "%5.2"
 /begin AXIS_DESCR STD_AXIS Epm_nEng EngN 4 -16384.00 16383.50 FORMAT "%8.2" DEPOSIT ABSOLUTE /end AXIS_DESCR
 /begin AXIS_DESCR STD_AXIS AirMod_ratChrgAirCyl rel_q0p0234 4 0.00 1535.977 FORMAT "%8.3" DEPOSIT ABSOLUTE /end AXIS_DESCR
/end CHARACTERISTIC
/begin CHARACTERISTIC KFZWMNKHLLVHK "Late ign.angle map for special intake valve lift" MAP 0x8058845C RB_Map_S16U16_S8 191.3 kw_q0p75 -96.00 95.25 FORMAT "%5.2"
 /begin AXIS_DESCR STD_AXIS Epm_nEng EngN 4 -16384.00 16383.50 FORMAT "%8.2" DEPOSIT ABSOLUTE /end AXIS_DESCR
 /begin AXIS_DESCR STD_AXIS AirMod_ratChrgAirCyl rel_q0p0234 4 0.00 1535.977 FORMAT "%8.3" DEPOSIT ABSOLUTE /end AXIS_DESCR
/end CHARACTERISTIC
/begin CHARACTERISTIC KFZWMNWL "Map for minimal ignition angle at engine warm-up" MAP 0x80588480 RB_MapGroup_S8 191.3 kw_q0p75 -96.00 95.25 FORMAT "%5.2"
 /begin AXIS_DESCR COM_AXIS Epm_nEng EngN 16 -16384.00 16383.50 FORMAT "%8.2" AXIS_PTS_REF Ign_nEng16_AX /end AXIS_DESCR
 /begin AXIS_DESCR COM_AXIS Ign_ratChrgAirCyl rel_q0p0234 12 0.00 1535.977 FORMAT "%8.3" AXIS_PTS_REF Ign_ratChrgAir12_AX /end AXIS_DESCR
/end CHARACTERISTIC
/begin CHARACTERISTIC KFZWMVHK "latest ign.angle for low valve-lift" MAP 0x80588540 RB_MapGroup_S8 191.3 kw_q0p75 -96.00 95.25 FORMAT "%5.2"
 /begin AXIS_DESCR COM_AXIS Epm_nEng EngN 16 -16384.00 16383.50 FORMAT "%8.2" AXIS_PTS_REF Ign_nEng16_AX /end AXIS_DESCR
 /begin AXIS_DESCR COM_AXIS Ign_ratChrgAirCyl rel_q0p0234 12 0.00 1535.977 FORMAT "%8.3" AXIS_PTS_REF Ign_ratChrgAir12_AX /end AXIS_DESCR
/end CHARACTERISTIC
/begin CHARACTERISTIC KFZWMVHK2 "latest ign.angle for low valve-lift variant 2" MAP 0x80588600 RB_MapGroup_S8 191.3 kw_q0p75 -96.00 95.25 FORMAT "%5.2"
 /begin AXIS_DESCR COM_AXIS Epm_nEng EngN 16 -16384.00 16383.50 FORMAT "%8.2" AXIS_PTS_REF Ign_nEng16_AX /end AXIS_DESCR
 /begin AXIS_DESCR COM_AXIS Ign_ratChrgAirCyl rel_q0p0234 12 0.00 1535.977 FORMAT "%8.3" AXIS_PTS_REF Ign_ratChrgAir12_AX /end AXIS_DESCR
/end CHARACTERISTIC
/begin CHARACTERISTIC KFZWOP "Optimized model reference ignition angle" MAP 0x805886E8 RB_MapGroup_S16 191.9971 zw_q2p9297Em3_deg_KW -96.00000 95.99707 FORMAT "%8.5"
 /begin AXIS_DESCR COM_AXIS NO_INPUT_QUANTITY nmot_uw_q0p25 16 0.00 16383.75 FORMAT "%8.2" AXIS_PTS_REF SNMOPUW /end AXIS_DESCR
 /begin AXIS_DESCR COM_AXIS NO_INPUT_QUANTITY rel_uw_q0p0234 20 0.00 1535.977 FORMAT "%8.3" AXIS_PTS_REF SRLOPUW /end AXIS_DESCR
/end CHARACTERISTIC
/begin CHARACTERISTIC KFZWOPV "Optimized model reference ignition angle, low valve lift" MAP 0x80588968 RB_MapGroup_S16 191.9971 zw_q2p9297Em3_deg_KW -96.00000 95.99707 FORMAT "%8.5"
 /begin AXIS_DESCR COM_AXIS NO_INPUT_QUANTITY nmot_uw_q0p25 16 0.00 16383.75 FORMAT "%8.2" AXIS_PTS_REF SNMOVUW /end AXIS_DESCR
 /begin AXIS_DESCR COM_AXIS NO_INPUT_QUANTITY rel_uw_q0p0234 20 0.00 1535.977 FORMAT "%8.3" AXIS_PTS_REF SRLOVUW /end AXIS_DESCR
/end CHARACTERISTIC
/begin CHARACTERISTIC KLDZWMNLAM "Correction of the maximum retarded spark limitation due to lambda" CURVE 0x805886C0 RB_Curve_U8_S8_Static 191.3 kw_q0p75 -96.00 95.25 FORMAT "%5.2"
 /begin AXIS_DESCR STD_AXIS lambas_msg fak_ub_b2 8 0.00 1.992188 FORMAT "%8.6" DEPOSIT ABSOLUTE /end AXIS_DESCR
/end CHARACTERISTIC
/begin CHARACTERISTIC KLDZWMNLAMHSP "Correction of the maximum retarded spark limitation due to lambda(HSP)" CURVE 0x805886D2 RB_Curve_U8_S8_Static 191.3 kw_q0p75 -96.00 95.25 FORMAT "%5.2"
 /begin AXIS_DESCR STD_AXIS lambas_msg fak_ub_b2 8 0.00 1.992188 FORMAT "%8.6" DEPOSIT ABSOLUTE /end AXIS_DESCR
/end CHARACTERISTIC
/begin CHARACTERISTIC KLF2KAGRU "interpolation E0 - E85" CURVE 0x80583326 RB_Curve_U16_U8_Static 1.992188 fak_ub_b2 0.00 1.992188 FORMAT "%8.6"
 /begin AXIS_DESCR STD_AXIS fethmnmx_w_msg fak_uw_b2 6 0.00 1.999969 FORMAT "%8.6" DEPOSIT ABSOLUTE /end AXIS_DESCR
/end CHARACTERISTIC
/begin CHARACTERISTIC KLF2KAMN "interpolation E0 - E85 for latest ign.angle" CURVE 0x8058333A RB_Curve_U16_U8_Static 0.9961 fak_ub_b1 0.00 0.9961
 /begin AXIS_DESCR STD_AXIS fethmnmx_w_msg fak_uw_b2 6 0.00 1.999969 FORMAT "%8.6" DEPOSIT ABSOLUTE /end AXIS_DESCR
/end CHARACTERISTIC
/begin CHARACTERISTIC KLFVSTGTF "gain correction of feed forward control MSV dependant on fuel temperature" CURVE 0x80581C70 RB_Curve_U8_U8 1.992188 fak_ub_b2 0.00 1.992188 FORMAT "%8.6"
 /begin AXIS_DESCR STD_AXIS tfuelsq_msg temp_ub_q0p75_o48 3 -48.0 143.3 FORMAT "%5.1" DEPOSIT ABSOLUTE /end AXIS_DESCR
/end CHARACTERISTIC
/begin CHARACTERISTIC KLFVSTOTF "offset correction of feed forward control MSV dependant on fuel temperature" CURVE 0x80581C77 RB_Curve_U8_U8 1.992188 fak_ub_b2 0.00 1.992188 FORMAT "%8.6"
 /begin AXIS_DESCR STD_AXIS tfuelsq_msg temp_ub_q0p75_o48 3 -48.0 143.3 FORMAT "%5.1" DEPOSIT ABSOLUTE /end AXIS_DESCR
/end CHARACTERISTIC
/begin CHARACTERISTIC KLLOWOCTN "Speed dependent curve used to enable integrator." CURVE 0x80586E5E RB_CurveGroup_U16 1535.977 rel_q0p0234 0.00 1535.977 FORMAT "%8.3"
 /begin AXIS_DESCR COM_AXIS Epm_nEng EngN 16 -16384.00 16383.50 FORMAT "%8.2" AXIS_PTS_REF Ign_nEng16_AX /end AXIS_DESCR
/end CHARACTERISTIC
/begin CHARACTERISTIC KLNMSVZPAS "threshold engine speed MSV two-point-control dependant on engine temperature" CURVE 0x80581C7E RB_Curve_U8_U8 10200. nmot_ub_q40 0.00 10200. FORMAT "%5.0"
 /begin AXIS_DESCR STD_AXIS NO_INPUT_QUANTITY temp_ub_q0p75_o48 4 -48.0 143.3 FORMAT "%5.1" DEPOSIT ABSOLUTE /end AXIS_DESCR
/end CHARACTERISTIC
/begin CHARACTERISTIC KLRKMSVZPA "threshold relative fuel mass MSV two-point-control dependant on engine temperature" CURVE 0x80581C88 RB_Curve_U8_U16_Static 3071.953 rel_uw_b3072 0.00 3071.953 FORMAT "%8.3"
 /begin AXIS_DESCR STD_AXIS NO_INPUT_QUANTITY temp_ub_q0p75_o48 4 -48.0 143.3 FORMAT "%5.1" DEPOSIT ABSOLUTE /end AXIS_DESCR
/end CHARACTERISTIC
/begin CHARACTERISTIC KLVSTMSVG "gain feed forward control MSV" CURVE 0x80581C96 RB_CurveGroup_U16 3.999939 fak_uw_b4 0.00 3.999939 FORMAT "%8.6"
 /begin AXIS_DESCR COM_AXIS NO_INPUT_QUANTITY nmot_uw_q0p25 8 0.00 16383.75 FORMAT "%8.2" AXIS_PTS_REF SNM08HDUW /end AXIS_DESCR
/end CHARACTERISTIC
/begin CHARACTERISTIC NMSVKMAH "hysteresis threshold engine speed MSV light-load-control" VALUE 0x80581CA6 RB_Val_Wu8 10200. nmot_ub_q40 0.00 10200. FORMAT "%5.0" /end CHARACTERISTIC
/begin CHARACTERISTIC NMSVKMAO "upper threshold engine speed MSV light-load-control" VALUE 0x80581CA7 RB_Val_Wu8 10200. nmot_ub_q40 0.00 10200. FORMAT "%5.0" /end CHARACTERISTIC
/begin CHARACTERISTIC NMSVKMAU "lower threshold engine speed MSV light-load-control" VALUE 0x80581CA8 RB_Val_Wu8 10200. nmot_ub_q40 0.00 10200. FORMAT "%5.0" /end CHARACTERISTIC
/begin CHARACTERISTIC NMSVZPAH "hysteresis threshold engine speed MSV two-point-control" VALUE 0x80581CA9 RB_Val_Wu8 10200. nmot_ub_q40 0.00 10200. FORMAT "%5.0" /end CHARACTERISTIC
/begin CHARACTERISTIC PHIDIFLIN "Schwelle Nockenwellendifferenz zur Ref.pos" VALUE 0x805886E4 RB_Val_Ws16 1439.978 AngleCrS -720.0000 719.9780 FORMAT "%8.4" /end CHARACTERISTIC
/begin CHARACTERISTIC RKMSVKMAH "hysteresis of threshold relative fuel mass MSV light-load-control" VALUE 0x80581CAA RB_Val_Wu16 3071.953 rel_uw_b3072 0.00 3071.953 FORMAT "%8.3" /end CHARACTERISTIC
/begin CHARACTERISTIC RKMSVKMAS "threshold relative fuel mass MSV light-load-control" VALUE 0x80581CAC RB_Val_Wu16 3071.953 rel_uw_b3072 0.00 3071.953 FORMAT "%8.3" /end CHARACTERISTIC
/begin CHARACTERISTIC RKMSVZPAH "hysteresis of threshold relative fuel mass MSV two-point-control" VALUE 0x80581CAE RB_Val_Wu16 3071.953 rel_uw_b3072 0.00 3071.953 FORMAT "%8.3" /end CHARACTERISTIC
/begin CHARACTERISTIC RRIZWMNMX "maximum egr inertgas rate for special late ign.angle" VALUE 0x805886E6 RB_Val_Wu16 99.99847 rel_uw_b100 0.00 99.99847 FORMAT "%8.5" /end CHARACTERISTIC
/begin AXIS_PTS SNM08HDUW "distribution for engine speed" 0x80581CB0 NO_INPUT_QUANTITY RB_Axis_U16 16383.75 nmot_uw_q0p25 8 0.00 16383.75 FORMAT "%8.2" DEPOSIT ABSOLUTE /end AXIS_PTS
/begin CHARACTERISTIC SNMDKSRF "level detection of engine stop for throttle self-cleaning-function" VALUE 0x80581E79 RB_Val_Wu8 280.0 EngN_LRes 0.00 280.0 FORMAT "%5.1" EXTENDED_LIMITS 0.00 10200. /end CHARACTERISTIC
/begin AXIS_PTS SNMOPUW "set points engine speed" 0x80588BE8 NO_INPUT_QUANTITY RB_Axis_U16 16383.75 nmot_uw_q0p25 16 0.00 16383.75 FORMAT "%8.2" DEPOSIT ABSOLUTE /end AXIS_PTS
/begin AXIS_PTS SNMOVUW "set points engine speed for low valve lift" 0x80588C0A NO_INPUT_QUANTITY RB_Axis_U16 16383.75 nmot_uw_q0p25 16 0.00 16383.75 FORMAT "%8.2" DEPOSIT ABSOLUTE /end AXIS_PTS
/begin AXIS_PTS SPR06HDUW "distribution for rail pressure" 0x80581CC2 NO_INPUT_QUANTITY RB_Axis_U16 131.0700 RBPtCel_p_0p002_1 6 0.00 131.0700 FORMAT "%8.4" DEPOSIT ABSOLUTE /end AXIS_PTS
/begin AXIS_PTS SRLOPUW "set point distribution relative charge" 0x80588C2C NO_INPUT_QUANTITY RB_Axis_U16 1535.977 rel_uw_q0p0234 20 0.00 1535.977 FORMAT "%8.3" DEPOSIT ABSOLUTE /end AXIS_PTS
/begin AXIS_PTS SRLOVUW "set point distribution relative charge for low valve lift" 0x80588C56 NO_INPUT_QUANTITY RB_Axis_U16 1535.977 rel_uw_q0p0234 20 0.00 1535.977 FORMAT "%8.3" DEPOSIT ABSOLUTE /end AXIS_PTS
/begin CHARACTERISTIC SVFDKSRF "level detection of vehicle stop for throttle self-cleaning-function" VALUE 0x80581E7A RB_Val_Ws16 655.3500 Vel -327.6800 327.6700 FORMAT "%8.4" /end CHARACTERISTIC
/begin CHARACTERISTIC TLOWORN "Integrator time constant for positive shift of delta ignition angle during permanent knocking" VALUE 0x80586E7E RB_Val_Wu16 6553.4999985 zk100msxs_uw_b6553p6 0.1000015 6553.6000000 FORMAT "%12.7" EXTENDED_LIMITS 0.10000152590 6553.6000000 /end CHARACTERISTIC
/begin CHARACTERISTIC TLOWORP "Integrator time constant for negative shift of delta ignition angle during permanent knocking" VALUE 0x80586E80 RB_Val_Wu16 6553.4999985 zk100msxs_uw_b6553p6 0.1000015 6553.6000000 FORMAT "%12.7" EXTENDED_LIMITS 0.10000152590 6553.6000000 /end CHARACTERISTIC
/begin CHARACTERISTIC TMMSVKMAU "Lower threshold of MSV light-load-control" VALUE 0x80581CD0 RB_Val_Wu8 191.3 temp_ub_q0p75_o48 -48.0 143.3 FORMAT "%5.1" /end CHARACTERISTIC
/begin CHARACTERISTIC TMMSVZPAO "Upper threshold of MSV two-point-control" VALUE 0x80581CD1 RB_Val_Wu8 191.3 temp_ub_q0p75_o48 -48.0 143.3 FORMAT "%5.1" /end CHARACTERISTIC
/begin CHARACTERISTIC TMMSVZPAU "Lower threshold of MSV two-point-control" VALUE 0x80581CD2 RB_Val_Wu8 191.3 temp_ub_q0p75_o48 -48.0 143.3 FORMAT "%5.1" /end CHARACTERISTIC
/begin CHARACTERISTIC TNSTMSVKMA "threshold time after start MSV light-load-control" VALUE 0x80581CD4 RB_Val_Wu16 6553.500 t100msxs_uw_b6553p5 0.00 6553.500 FORMAT "%8.3" /end CHARACTERISTIC
/begin CHARACTERISTIC TNSTMSVZPA "threshold time after start MSV two-point-control" VALUE 0x80581CD6 RB_Val_Wu16 6553.500 t100msxs_uw_b6553p5 0.00 6553.500 FORMAT "%8.3" /end CHARACTERISTIC
/begin CHARACTERISTIC TNSTVSTDYN "threshold time after start for release the dynamic component of feed forward control MSV" VALUE 0x80581CD8 RB_Val_Wu16 6553.500 t100msxs_uw_b6553p5 0.00 6553.500 FORMAT "%8.3" /end CHARACTERISTIC
/begin CHARACTERISTIC TSRFDKI "fixed time for initialization (throttle self-cleaning-function)" VALUE 0x80581E7C RB_Val_Wu16 655.3500 t_q0p01 0.00 655.3500 FORMAT "%8.4" /end CHARACTERISTIC
/begin CHARACTERISTIC TSRFDKO "fixed time for upper stop position (throttle self-cleaning-function)" VALUE 0x80581E7E RB_Val_Wu8 2.550 t_q0p01 0.00 2.550 FORMAT "%5.3" /end CHARACTERISTIC
/begin CHARACTERISTIC TSRFDKU "fixed time for lower stop position (throttle self-cleaning-function)" VALUE 0x80581E7F RB_Val_Wu8 2.550 t_q0p01 0.00 2.550 FORMAT "%5.3" /end CHARACTERISTIC
/begin CHARACTERISTIC TSWZK "Time delay for detection of permanent knocking due to low-octane fuel" VALUE 0x80586E82 RB_Val_Wu8 25.50 t_q0p1 0.00 25.50 FORMAT "%5.2" /end CHARACTERISTIC
/begin CHARACTERISTIC TSWZKR "Time delay for resetting ignition delay due to low-octane fuel" VALUE 0x80586E83 RB_Val_Wu8 25.50 t_q0p1 0.00 25.50 FORMAT "%5.2" /end CHARACTERISTIC
/begin CHARACTERISTIC TWKRMNA "time-constant for withdrawal to E0 after errors in knock- or ath.-detection" VALUE 0x8058334E RB_Val_Wu8 25.4996 zk100msxs_ub_b25p5 0.1004 25.6000 FORMAT "%7.4" EXTENDED_LIMITS 0.100392 25.6000 /end CHARACTERISTIC
/begin CHARACTERISTIC VMSVZPA "velocity for deactivate MSV two-point-control" VALUE 0x80581CDA RB_Val_Wu8 318.8 vfzg_ub_q1p25 0.00 318.8 FORMAT "%5.1" /end CHARACTERISTIC
/begin CHARACTERISTIC VMSVZPAH "hysteresis of vehicle speed threshold of MSV two-point-control" VALUE 0x80581CDB RB_Val_Wu8 318.8 vfzg_ub_q1p25 0.00 318.8 FORMAT "%5.1" /end CHARACTERISTIC
/begin CHARACTERISTIC WDKSRFE "throttle angle end position (self-cleaning-function)" VALUE 0x80581E80 RB_Val_Wu8 99.61 relDK_q0p390631 0.00 99.61 FORMAT "%5.2" /end CHARACTERISTIC
/begin CHARACTERISTIC WDKSRFI "throttle angle initial position (self-cleaning-function)" VALUE 0x80581E81 RB_Val_Wu8 99.61 relDK_q0p390631 0.00 99.61 FORMAT "%5.2" /end CHARACTERISTIC
/begin CHARACTERISTIC WDKSRFO "throttle angle upper stop position (self-cleaning-function)" VALUE 0x80581E82 RB_Val_Wu8 99.61 relDK_q0p390631 0.00 99.61 FORMAT "%5.2" /end CHARACTERISTIC
/begin CHARACTERISTIC WDKSRFU "throttle angle lower stop position (self-cleaning-function)" VALUE 0x80581E83 RB_Val_Wu8 99.61 relDK_q0p390631 0.00 99.61 FORMAT "%5.2" /end CHARACTERISTIC
/begin CHARACTERISTIC Wiper_stActv_C "Calibration for wiper active status" VALUE 0x80581E84 RB_Val_Wu8 255.0 OneToOne 0.00 255.0 FORMAT "%5.1" /end CHARACTERISTIC
/begin CHARACTERISTIC Wiper_stSwt_C "Calibration for the diffrerent content of CAN message input" VALUE 0x80581E85 RB_Val_Wu8 1.000 OneToOne 0.00 1.000 FORMAT "%5.3" EXTENDED_LIMITS 0.00 255.0 /end CHARACTERISTIC
/begin CHARACTERISTIC ZWSTT_COM.agIgnCoMStrt_GM "Class instance for ignition angle at change of mind / Grouped map Ignition angle at change of mind" MAP 0x80589084 RB_MapGroup_S8 191.3 zw_sb_q0p75 -96.00 95.25 FORMAT "%5.2"
 /begin AXIS_DESCR COM_AXIS AirMod_ratChrgAirCyl rel_q0p02344 6 0.00 1535.977 FORMAT "%8.3" AXIS_PTS_REF EngStrt_ratChrgAgIgnStrt_AX /end AXIS_DESCR
 /begin AXIS_DESCR COM_AXIS Epm_nEng EngN 12 -16384.00 16383.50 FORMAT "%8.2" AXIS_PTS_REF EngStrt_nEngAgIgn_AX /end AXIS_DESCR
/end CHARACTERISTIC
/begin CHARACTERISTIC ZWSTT_COMWAITSTRTR.agIgnCoMStrt_GM " / Grouped map Ignition angle at change of mind" MAP 0x80588EF4 RB_MapGroup_S8 191.3 zw_sb_q0p75 -96.00 95.25 FORMAT "%5.2"
 /begin AXIS_DESCR COM_AXIS AirMod_ratChrgAirCyl rel_q0p02344 6 0.00 1535.977 FORMAT "%8.3" AXIS_PTS_REF EngStrt_ratChrgAgIgnStrt_AX /end AXIS_DESCR
 /begin AXIS_DESCR COM_AXIS Epm_nEng EngN 12 -16384.00 16383.50 FORMAT "%8.2" AXIS_PTS_REF EngStrt_nEngAgIgn_AX /end AXIS_DESCR
/end CHARACTERISTIC
/begin CHARACTERISTIC ZWSTT_CORR.agIgnEthOffsCorrAlti_T "correction factor / Group Map: ignition angle ethanol offset altitudecorrection" CURVE 0x805890D0 RB_CurveGroup_S8 191.3 zw_sb_q0p75 -96.00 95.25 FORMAT "%5.2"
 /begin AXIS_DESCR COM_AXIS PEnv_facCorrAlti fak_uw_b4 8 0.00 3.999939 FORMAT "%8.6" AXIS_PTS_REF EngStrt_facCorrAltiAgIgn_AX /end AXIS_DESCR
/end CHARACTERISTIC
/begin CHARACTERISTIC ZWSTT_CORR.agIgnEthOffsIntkAir_T "correction factor / calibration ignition angle ethanol offset intake air" CURVE 0x805890D8 RB_CurveGroup_S8 191.3 zw_sb_q0p75 -96.00 95.25 FORMAT "%5.2"
 /begin AXIS_DESCR COM_AXIS IntkAirT_tIntkMnfld Temp_Cels 6 -3549.940 3003.560 FORMAT "%8.3" AXIS_PTS_REF EngStrt_tIntkMnfldAgIgn_AX /end AXIS_DESCR
/end CHARACTERISTIC
/begin CHARACTERISTIC ZWSTT_CORR.agIgnOffsCorrAlti_T "correction factor / Altitude correction curve" CURVE 0x805890DE RB_CurveGroup_S8 191.3 zw_sb_q0p75 -96.00 95.25 FORMAT "%5.2"
 /begin AXIS_DESCR COM_AXIS PEnv_facCorrAlti fak_uw_b4 8 0.00 3.999939 FORMAT "%8.6" AXIS_PTS_REF EngStrt_facCorrAltiAgIgn_AX /end AXIS_DESCR
/end CHARACTERISTIC
/begin CHARACTERISTIC ZWSTT_CORR.agIgnOffsIntkAir_T "correction factor / Intake air offset correction curve" CURVE 0x805890E6 RB_CurveGroup_S8 191.3 zw_sb_q0p75 -96.00 95.25 FORMAT "%5.2"
 /begin AXIS_DESCR COM_AXIS IntkAirT_tIntkMnfld Temp_Cels 6 -3549.940 3003.560 FORMAT "%8.3" AXIS_PTS_REF EngStrt_tIntkMnfldAgIgn_AX /end AXIS_DESCR
/end CHARACTERISTIC
/begin CHARACTERISTIC ZWSTT_CORR_2.agIgnEthOffsCorrAlti_T " / Group Map: ignition angle ethanol offset altitudecorrection" CURVE 0x80588F40 RB_CurveGroup_S8 191.3 zw_sb_q0p75 -96.00 95.25 FORMAT "%5.2"
 /begin AXIS_DESCR COM_AXIS PEnv_facCorrAlti fak_uw_b4 8 0.00 3.999939 FORMAT "%8.6" AXIS_PTS_REF EngStrt_facCorrAltiAgIgn_AX /end AXIS_DESCR
/end CHARACTERISTIC
/begin CHARACTERISTIC ZWSTT_CORR_2.agIgnEthOffsIntkAir_T " / calibration ignition angle ethanol offset intake air" CURVE 0x80588F48 RB_CurveGroup_S8 191.3 zw_sb_q0p75 -96.00 95.25 FORMAT "%5.2"
 /begin AXIS_DESCR COM_AXIS IntkAirT_tIntkMnfld Temp_Cels 6 -3549.940 3003.560 FORMAT "%8.3" AXIS_PTS_REF EngStrt_tIntkMnfldAgIgn_AX /end AXIS_DESCR
/end CHARACTERISTIC
/begin CHARACTERISTIC ZWSTT_CORR_2.agIgnOffsCorrAlti_T " / Altitude correction curve" CURVE 0x80588F4E RB_CurveGroup_S8 191.3 zw_sb_q0p75 -96.00 95.25 FORMAT "%5.2"
 /begin AXIS_DESCR COM_AXIS PEnv_facCorrAlti fak_uw_b4 8 0.00 3.999939 FORMAT "%8.6" AXIS_PTS_REF EngStrt_facCorrAltiAgIgn_AX /end AXIS_DESCR
/end CHARACTERISTIC
/begin CHARACTERISTIC ZWSTT_CORR_2.agIgnOffsIntkAir_T " / Intake air offset correction curve" CURVE 0x80588F56 RB_CurveGroup_S8 191.3 zw_sb_q0p75 -96.00 95.25 FORMAT "%5.2"
 /begin AXIS_DESCR COM_AXIS IntkAirT_tIntkMnfld Temp_Cels 6 -3549.940 3003.560 FORMAT "%8.3" AXIS_PTS_REF EngStrt_tIntkMnfldAgIgn_AX /end AXIS_DESCR
/end CHARACTERISTIC
/begin CHARACTERISTIC ZWSTT_DRCT.agIgnEthDrctStrtOffs2_GM "Class instance for ignition angle at direct start / Group Map: ignition angle ethanol direct start offset 2" MAP 0x805890F0 RB_MapGroup_S8 191.3 zw_sb_q0p75 -96.00 95.25 FORMAT "%5.2"
 /begin AXIS_DESCR COM_AXIS anztib_msg OneToOne 8 0.00 255.0 FORMAT "%5.1" AXIS_PTS_REF EngStrt_cntrInjAgIgn_AX /end AXIS_DESCR
 /begin AXIS_DESCR COM_AXIS Gbx_trqActClth Trq 4 -3276.800 3276.700 FORMAT "%8.3" AXIS_PTS_REF EngStrt_tqActClthAgIgn_AX /end AXIS_DESCR
/end CHARACTERISTIC
/begin CHARACTERISTIC ZWSTT_DRCT.agIgnEthDrctStrtOffs_GM "Class instance for ignition angle at direct start / Group Map: ignition angle ethanol direct start offset" MAP 0x80589110 RB_MapGroup_S8 191.3 zw_sb_q0p75 -96.00 95.25 FORMAT "%5.2"
 /begin AXIS_DESCR COM_AXIS anztib_msg OneToOne 8 0.00 255.0 FORMAT "%5.1" AXIS_PTS_REF EngStrt_cntrInjAgIgn_AX /end AXIS_DESCR
 /begin AXIS_DESCR COM_AXIS wdirst_msg kw_q2 3 0.00 510.0 FORMAT "%5.1" AXIS_PTS_REF EngStrt_agDistAgIgn_AX /end AXIS_DESCR
/end CHARACTERISTIC
/begin CHARACTERISTIC ZWSTT_DRCT.agIgnEthDrctStrt_GM "Class instance for ignition angle at direct start / Group Map: ignition angle ethanol direct start" MAP 0x80589128 RB_MapGroup_S8 191.3 zw_sb_q0p75 -96.00 95.25 FORMAT "%5.2"
 /begin AXIS_DESCR COM_AXIS Epm_nEng EngN 12 -16384.00 16383.50 FORMAT "%8.2" AXIS_PTS_REF EngStrt_nEngAgIgn_AX /end AXIS_DESCR
 /begin AXIS_DESCR COM_AXIS EngStrt_tStrtCoor Temp_Cels 12 -273.140 3003.560 FORMAT "%8.3" EXTENDED_LIMITS -3549.940 3003.560 AXIS_PTS_REF EngStrt_tStrtAgIgn_AX /end AXIS_DESCR
/end CHARACTERISTIC
/begin CHARACTERISTIC ZWSTT_FOLW.agIgnStrtOffsP_GM "Class instance for ignition angle offset at following start / Group Map: ignition angle start offset pressure" MAP 0x805891BC RB_MapGroup_S8 191.3 zw_sb_q0p75 -96.00 95.25 FORMAT "%5.2"
 /begin AXIS_DESCR COM_AXIS Epm_nEng EngN 12 -16384.00 16383.50 FORMAT "%8.2" AXIS_PTS_REF EngStrt_nEngAgIgn_AX /end AXIS_DESCR
 /begin AXIS_DESCR COM_AXIS PEnv_facCorrAlti fak_uw_b4 8 0.00 3.999939 FORMAT "%8.6" AXIS_PTS_REF EngStrt_facCorrAltiAgIgn_AX /end AXIS_DESCR
/end CHARACTERISTIC
/begin CHARACTERISTIC ZWSTT_FOLW.agIgnStrtOffsT_GM "Class instance for ignition angle offset at following start / Group Map: ignition angle start offset temperature" MAP 0x8058921C RB_MapGroup_S8 191.3 zw_sb_q0p75 -96.00 95.25 FORMAT "%5.2"
 /begin AXIS_DESCR COM_AXIS Epm_nEng EngN 12 -16384.00 16383.50 FORMAT "%8.2" AXIS_PTS_REF EngStrt_nEngAgIgn_AX /end AXIS_DESCR
 /begin AXIS_DESCR COM_AXIS EngStrt_tStrtCoor Temp_Cels 12 -273.140 3003.560 FORMAT "%8.3" EXTENDED_LIMITS -3549.940 3003.560 AXIS_PTS_REF EngStrt_tStrtAgIgn_AX /end AXIS_DESCR
/end CHARACTERISTIC
/begin CHARACTERISTIC ZWSTT_FOLW.agIgnStrtOffs_GM "Class instance for ignition angle offset at following start / Grouped map Ignition angle offset at start (driver request)" MAP 0x805892AC RB_MapGroup_S8 191.3 zw_sb_q0p75 -96.00 95.25 FORMAT "%5.2"
 /begin AXIS_DESCR COM_AXIS APP_r Prc 10 -400.0000 399.9878 FORMAT "%8.4" AXIS_PTS_REF EngStrt_rPedAgIgn_AX /end AXIS_DESCR
 /begin AXIS_DESCR COM_AXIS Epm_nEng EngN 12 -16384.00 16383.50 FORMAT "%8.2" AXIS_PTS_REF EngStrt_nEngAgIgn_AX /end AXIS_DESCR
/end CHARACTERISTIC
/begin CHARACTERISTIC ZWSTT_FOLW.facAgIgnStrtOffs_GT "Class instance for ignition angle offset at following start / Grouped curve factor for ignition angle offset at start (driver request)" CURVE 0x80589324 RB_CurveGroup_U8 1.992188 fak_ub_b2 0.00 1.992188 FORMAT "%8.6"
 /begin AXIS_DESCR COM_AXIS EngStrt_tStrtCoor Temp_Cels 12 -273.140 3003.560 FORMAT "%8.3" EXTENDED_LIMITS -3549.940 3003.560 AXIS_PTS_REF EngStrt_tStrtAgIgn_AX /end AXIS_DESCR
/end CHARACTERISTIC
/begin CHARACTERISTIC ZWSTT_HIP.agIgnStrtEth_GM " / Grouped map Ignition angle at start with ethanol (base value)" MAP 0x80588F60 RB_MapGroup_S8 191.3 zw_sb_q0p75 -96.00 95.25 FORMAT "%5.2"
 /begin AXIS_DESCR COM_AXIS Epm_nEng EngN 12 -16384.00 16383.50 FORMAT "%8.2" AXIS_PTS_REF EngStrt_nEngAgIgn_AX /end AXIS_DESCR
 /begin AXIS_DESCR COM_AXIS EngStrt_tStrtCoor Temp_Cels 12 -273.140 3003.560 FORMAT "%8.3" EXTENDED_LIMITS -3549.940 3003.560 AXIS_PTS_REF EngStrt_tStrtAgIgn_AX /end AXIS_DESCR
/end CHARACTERISTIC
/begin CHARACTERISTIC ZWSTT_HIP.agIgnStrt_GM " / Grouped map Ignition angle at start (base value)" MAP 0x80588FF0 RB_MapGroup_S8 191.3 zw_sb_q0p75 -96.00 95.25 FORMAT "%5.2"
 /begin AXIS_DESCR COM_AXIS Epm_nEng EngN 12 -16384.00 16383.50 FORMAT "%8.2" AXIS_PTS_REF EngStrt_nEngAgIgn_AX /end AXIS_DESCR
 /begin AXIS_DESCR COM_AXIS EngStrt_tStrtCoor Temp_Cels 12 -273.140 3003.560 FORMAT "%8.3" EXTENDED_LIMITS -3549.940 3003.560 AXIS_PTS_REF EngStrt_tStrtAgIgn_AX /end AXIS_DESCR
/end CHARACTERISTIC
/begin CHARACTERISTIC ZWSTT_LOP.agIgnStrtEth_GM "Class instance for ignition angle at low pressure start / Grouped map Ignition angle at start with ethanol (base value)" MAP 0x80589334 RB_MapGroup_S8 191.3 zw_sb_q0p75 -96.00 95.25 FORMAT "%5.2"
 /begin AXIS_DESCR COM_AXIS Epm_nEng EngN 12 -16384.00 16383.50 FORMAT "%8.2" AXIS_PTS_REF EngStrt_nEngAgIgn_AX /end AXIS_DESCR
 /begin AXIS_DESCR COM_AXIS EngStrt_tStrtCoor Temp_Cels 12 -273.140 3003.560 FORMAT "%8.3" EXTENDED_LIMITS -3549.940 3003.560 AXIS_PTS_REF EngStrt_tStrtAgIgn_AX /end AXIS_DESCR
/end CHARACTERISTIC
/begin CHARACTERISTIC ZWSTT_LOP.agIgnStrt_GM "Class instance for ignition angle at low pressure start / Grouped map Ignition angle at start (base value)" MAP 0x805893C4 RB_MapGroup_S8 191.3 zw_sb_q0p75 -96.00 95.25 FORMAT "%5.2"
 /begin AXIS_DESCR COM_AXIS Epm_nEng EngN 12 -16384.00 16383.50 FORMAT "%8.2" AXIS_PTS_REF EngStrt_nEngAgIgn_AX /end AXIS_DESCR
 /begin AXIS_DESCR COM_AXIS EngStrt_tStrtCoor Temp_Cels 12 -273.140 3003.560 FORMAT "%8.3" EXTENDED_LIMITS -3549.940 3003.560 AXIS_PTS_REF EngStrt_tStrtAgIgn_AX /end AXIS_DESCR
/end CHARACTERISTIC
/begin MEASUREMENT bdemodv_msg "new: Ign_stEomNxtCmb_u16" UBYTE dez 1 100 0.00 255.0 FORMAT "%5.1" ECU_ADDRESS 0x70003667 /end MEASUREMENT
/begin MEASUREMENT bdemodzw_msg "new: Ign_stEomNxtIA_u16" UBYTE dez 1 100 0.00 255.0 FORMAT "%5.1" ECU_ADDRESS 0x70003666 /end MEASUREMENT
/begin MEASUREMENT bdezwflag "Bitarray for switch-over of GDI-operating mode of actual ignition cylinders" UBYTE dez 1 100 0.00 255.0 FORMAT "%5.1" ECU_ADDRESS 0x70001F03 /end MEASUREMENT
/begin MEASUREMENT B_engoff_msg "Condition engine off (throttle self-cleaning-function)" UBYTE B_TRUE 1 100 0.00 1.00000000000 BIT_MASK 0x1 FORMAT "%13.11" ECU_ADDRESS 0x60000231 /end MEASUREMENT
/begin MEASUREMENT B_msvkmaloc "Condition light load activation MSV active local" UBYTE B_TRUE 1 100 0.00 1.00000000000 BIT_MASK 0x1 FORMAT "%13.11" ECU_ADDRESS 0x600000C9 /end MEASUREMENT
/begin MEASUREMENT B_msvkma_msg "Condition light load activation MSV active" UBYTE B_TRUE 1 100 0.00 1.00000000000 BIT_MASK 0x1 FORMAT "%13.11" ECU_ADDRESS 0x600001F9 /end MEASUREMENT
/begin MEASUREMENT B_msvzpaloc "condition MSV two-point-control active local" UBYTE B_TRUE 1 100 0.00 1.00000000000 BIT_MASK 0x1 FORMAT "%13.11" ECU_ADDRESS 0x600000C8 /end MEASUREMENT
/begin MEASUREMENT B_msvzpa_msg "Condition two-point control mass flow valve active" UBYTE B_TRUE 1 100 0.00 1.00000000000 BIT_MASK 0x1 FORMAT "%13.11" ECU_ADDRESS 0x600001F8 /end MEASUREMENT
/begin MEASUREMENT B_srfdke_msg "Condition throttle in end position (self-cleaning-function)" UBYTE B_TRUE 1 100 0.00 1.00000000000 BIT_MASK 0x1 FORMAT "%13.11" ECU_ADDRESS 0x600001D3 /end MEASUREMENT
/begin MEASUREMENT B_srfdko_msg "Condition throttle in upper stop position (self-cleaning-function)" UBYTE B_TRUE 1 100 0.00 1.00000000000 BIT_MASK 0x1 FORMAT "%13.11" ECU_ADDRESS 0x600001D2 /end MEASUREMENT
/begin MEASUREMENT B_srfdku_msg "Condition throttle in lower stop position (self-cleaning-function)" UBYTE B_TRUE 1 100 0.00 1.00000000000 BIT_MASK 0x1 FORMAT "%13.11" ECU_ADDRESS 0x600001D1 /end MEASUREMENT
/begin MEASUREMENT B_zwmngs_msg "Ignition angle late limit during gearshift with ignition angle intervention" UBYTE B_TRUE 1 100 0.00 1.00000000000 BIT_MASK 0x1 FORMAT "%13.11" ECU_ADDRESS 0x6000F200 /end MEASUREMENT
/begin MEASUREMENT B_zwms_msg "engine prot." UBYTE B_TRUE 1 100 0.00 1.00000000000 BIT_MASK 0x1 FORMAT "%13.11" ECU_ADDRESS 0x70000AE1 /end MEASUREMENT
/begin MEASUREMENT B_zwsyn "Condition crankshaft-synchronous calculation of maps for ignition angle" UBYTE B_TRUE 1 100 0.00 1.00000000000 BIT_MASK 0x1 FORMAT "%13.11" ECU_ADDRESS 0x70001EB8 /end MEASUREMENT
/begin MEASUREMENT ChrCtl_B_srfdko_EF_I.buffer "Falling edge of B_srfdko / memory to detect falling edge" UBYTE B_TRUE 1 100 0.00 1.00000000000 BIT_MASK 0x1 FORMAT "%13.11" ECU_ADDRESS 0x60000E26 /end MEASUREMENT
/begin MEASUREMENT ChrCtl_B_srfdko_EF_I.oldSignal "Falling edge of B_srfdko / memory to detect falling edge" UBYTE B_TRUE 1 100 0.00 1.00000000000 BIT_MASK 0x1 FORMAT "%13.11" ECU_ADDRESS 0x60000E27 /end MEASUREMENT
/begin MEASUREMENT ChrCtl_B_srfdku_EF_I.buffer "Falling edge of B_srfdku / memory to detect falling edge" UBYTE B_TRUE 1 100 0.00 1.00000000000 BIT_MASK 0x1 FORMAT "%13.11" ECU_ADDRESS 0x60000E24 /end MEASUREMENT
/begin MEASUREMENT ChrCtl_B_srfdku_EF_I.oldSignal "Falling edge of B_srfdku / memory to detect falling edge" UBYTE B_TRUE 1 100 0.00 1.00000000000 BIT_MASK 0x1 FORMAT "%13.11" ECU_ADDRESS 0x60000E25 /end MEASUREMENT
/begin MEASUREMENT ChrCtl_SRFDKI_TONV_I.outbit "Variable TurnOnDelay counter for SRFDKI / return value" UBYTE B_TRUE 1 100 0.00 1.00000000000 BIT_MASK 0x1 FORMAT "%13.11" ECU_ADDRESS 0x60000E20 /end MEASUREMENT
/begin MEASUREMENT ChrCtl_SRFDKI_TONV_I.time "Variable TurnOnDelay counter for SRFDKI / expired delay time" UWORD t_q0p01 1 100 0.00 655.3500 FORMAT "%8.4" ECU_ADDRESS 0x60000E22 /end MEASUREMENT
/begin MEASUREMENT ChrCtl_SRFDKO_TE_I.inOld "TimerEnabled counter for SRFDKO / Previous state of input value" UBYTE B_TRUE 1 100 0.00 1.00000000000 BIT_MASK 0x1 FORMAT "%13.11" ECU_ADDRESS 0x60000E1E /end MEASUREMENT
/begin MEASUREMENT ChrCtl_SRFDKO_TE_I.timeCounter "TimerEnabled counter for SRFDKO / Remaining time of the timer" UBYTE t_q0p01 1 100 0.00 2.550 FORMAT "%5.3" ECU_ADDRESS 0x60000E1F /end MEASUREMENT
/begin MEASUREMENT ChrCtl_SRFDKU_T_I.timeCounter "Timer counter for SRFDKU / Remaining time of the timer" UBYTE t_q0p01 1 100 0.00 2.550 FORMAT "%5.3" ECU_ADDRESS 0x60000E1C /end MEASUREMENT
/begin MEASUREMENT CoEng_bHOMNxtCmb "Condition GDI mode homogeneous of next combustion" UBYTE B_TRUE 1 100 0.00 1.00000000000 BIT_MASK 0x1 FORMAT "%13.11" ECU_ADDRESS 0x70003626 /end MEASUREMENT
/begin MEASUREMENT dwmsvvst_w_msg "feed forward control MSV" SWORD kw_q0p1 1 100 -3276.800 3276.700 FORMAT "%8.3" ECU_ADDRESS 0x6000163C /end MEASUREMENT
/begin MEASUREMENT dzwkg2k_w "lambda dependent shift of the knock limit in primary ign.angle(2nd fuel)" SWORD zw_q0p1 1 100 -96.00000 95.30000 FORMAT "%8.5" ECU_ADDRESS 0x70001F12 /end MEASUREMENT
/begin MEASUREMENT dzwmnlam "Offset for the maximum retarded spark limitation due to variations of lambda" SBYTE kw_q0p75 1 100 -96.00 95.25 FORMAT "%5.2" ECU_ADDRESS 0x70001ED7 /end MEASUREMENT
/begin MEASUREMENT dzwmnlamhsp "Offset for the maximum retarded spark limitation due to variations of lambda (HSP)" SBYTE kw_q0p75 1 100 -96.00 95.25 FORMAT "%5.2" ECU_ADDRESS 0x70001ED6 /end MEASUREMENT
/begin MEASUREMENT dzwmntmhsp "Offset for the maximum retarded spark limitation due to engine temperature(HSP)" SBYTE kw_q0p75 1 100 -96.00 95.25 FORMAT "%5.2" ECU_ADDRESS 0x70001ED5 /end MEASUREMENT
/begin MEASUREMENT dzwmntmp "temp.delta late ign. angle" SBYTE kw_q0p75 1 100 -96.00 95.25 FORMAT "%5.2" ECU_ADDRESS 0x70001ED4 /end MEASUREMENT
/begin MEASUREMENT dzwmntmphsp "temp.delta late ign. angle(HSP)" SBYTE kw_q0p75 1 100 -96.00 95.25 FORMAT "%5.2" ECU_ADDRESS 0x70001ED3 /end MEASUREMENT
/begin MEASUREMENT dzwotm_w_msg "temperature-dependent correction of optimized model reference ignition angle" SWORD zw_q2p9297Em3_deg_KW 1 100 -96.00000 95.99707 FORMAT "%8.5" ECU_ADDRESS 0x500008B2 /end MEASUREMENT
/begin MEASUREMENT dzwvs2k_w "ign.angle offset for spec.valve-lift and 2nd fuel (e.g. CNG or ethanol)" SWORD zw_q0p1 1 100 -3276.800 3276.700 FORMAT "%8.3" ECU_ADDRESS 0x70001F10 /end MEASUREMENT
/begin MEASUREMENT dzwwl_msg "delta ignition angle from warm-up" SBYTE zw_sb_q0p75 1 100 -96.00 95.25 FORMAT "%5.2" ECU_ADDRESS 0x60014160 /end MEASUREMENT
/begin MEASUREMENT dzwzkvf_w "Output from map for delta ignition angle with permanent knocking" SWORD zw_q0p1 1 100 -96.00000 95.30000 FORMAT "%8.5" ECU_ADDRESS 0x6000646C /end MEASUREMENT
/begin MEASUREMENT EngStrt_agIgnStrtCorrOffsLoc "start offset correction factor for ignition angle" SBYTE zw_sb_q0p75 1 100 -96.00 95.25 FORMAT "%5.2" ECU_ADDRESS 0x70001ECD /end MEASUREMENT
/begin MEASUREMENT EngStrt_diaTDurgWrmUp "Delta ignition angle for basic warm up with finer resolution" SWORD zw_q0p1 1 100 -3276.800 3276.700 FORMAT "%8.3" ECU_ADDRESS 0x60006468 /end MEASUREMENT
/begin MEASUREMENT EngStrt_diaWrmUp "ignition angle offset during warmup" SWORD zw_q0p1 1 100 -3276.800 3276.700 FORMAT "%8.3" ECU_ADDRESS 0x50005CD8 /end MEASUREMENT
/begin MEASUREMENT EngStrt_facIpoEthLoc "Factor for the Interpolation Calculation for Flex Fuel" UBYTE fak_ub_b1 1 100 0.00 0.9961 ECU_ADDRESS 0x6000AC85 /end MEASUREMENT
/begin MEASUREMENT EngStrt_facIpoVlvlftStdEthLoc "Factor for the Interpolation Calculation at standard valve lifting for Flex Fuel" UBYTE fak_ub_b1 1 100 0.00 0.9961 ECU_ADDRESS 0x6000AC84 /end MEASUREMENT
/begin MEASUREMENT EngStrt_idxClassSelnAgIgnLoc "Local variable for class selection at ignition angle" UBYTE OneToOne 1 100 0.00 255.0 FORMAT "%5.1" ECU_ADDRESS 0x70001ECC /end MEASUREMENT
/begin MEASUREMENT EngStrt_selTForIgnDurgWrmUp "EngStrt_selTForIgnDurgWrmUp_C selected temperature for delta ignition angle calculation during warmup" UBYTE temp_ub_q0p75_o48 1 100 -48.0 143.3 FORMAT "%5.1" ECU_ADDRESS 0x6000AC83 /end MEASUREMENT
/begin MEASUREMENT ExhMgT_facCptProtnGearShift "factor component prot. during gearshift" UBYTE fak_ub_b1 1 100 0.00 0.9961 ECU_ADDRESS 0x6000EF9E /end MEASUREMENT
/begin MEASUREMENT fagr "quotient rriext_w / rriehsk_w" UBYTE fak_ub_b1 1 100 0.00 0.9961 ECU_ADDRESS 0x6000AC88 /end MEASUREMENT
/begin MEASUREMENT fdzwzk_w "Integrator output e.g. factor to calculate delta ignition angle during permanent knocking." UWORD fak_uw_b1 1 100 0.00 0.9999847 FORMAT "%9.7" ECU_ADDRESS 0x60038914 /end MEASUREMENT
/begin MEASUREMENT flambts_msg "factor lambda component protection" UBYTE fak_ub_b1 1 100 0.00 0.9961 ECU_ADDRESS 0x6000EEEA /end MEASUREMENT
/begin MEASUREMENT ftstm "factor engine temperature dependency during dwell-period calculation" UBYTE fak_ub_b1 1 100 0.00 0.9961 ECU_ADDRESS 0x6000AC8A /end MEASUREMENT
/begin MEASUREMENT ftsztl "factor for dwell period reduction (i.e.depends on air charge)" UBYTE fak_ub_b1 1 100 0.00 0.9961 ECU_ADDRESS 0x6000AC89 /end MEASUREMENT
/begin MEASUREMENT FuPHi_pRlSpChgGrdtLoc "gradient of rail pressure setpoint" SWORD RBPtCel_p_0p002_1 1 100 -65.53600 65.53400 FORMAT "%8.5" ECU_ADDRESS 0x60000E34 /end MEASUREMENT
/begin MEASUREMENT FuPHi_pRlSpOldLoc "old local value rail pressure setpoint" UWORD RBPtCel_p_0p002_1 1 100 0.00 131.0700 FORMAT "%8.4" ECU_ADDRESS 0x60000E32 /end MEASUREMENT
/begin MEASUREMENT fzwmn_w "fade out factor for latest ignition angle during afterstart" UWORD fak_uw_b1 1 100 0.00 0.9999847 FORMAT "%9.7" ECU_ADDRESS 0x6000646A /end MEASUREMENT
/begin MEASUREMENT Gen_ctCylAdv "EPM SW-cylinder counter doubled range" UBYTE dez 1 100 0.00 255.0 FORMAT "%5.1" ECU_ADDRESS 0x5000098C /end MEASUREMENT
/begin MEASUREMENT IgCtl_diaAltiCorrnKnkCtrl "Delta ignition angle for knock control with altitude correction" SWORD zw_q0p1 1 100 -3276.800 3276.700 FORMAT "%8.3" ECU_ADDRESS 0x60006472 /end MEASUREMENT
/begin MEASUREMENT IgCtl_diaBasEom "Local variable for delta basic ignition angle EOM" SWORD zw_q0p1 1 100 -3276.800 3276.700 FORMAT "%8.3" ECU_ADDRESS 0x70001EE4 /end MEASUREMENT
/begin MEASUREMENT IgCtl_diaCorrnPEnv "Ignition angle correction due to ambient pressure" SBYTE kw_q0p75 1 100 -96.00 95.25 FORMAT "%5.2" ECU_ADDRESS 0x70003747 /end MEASUREMENT
/begin MEASUREMENT IgCtl_diaKnklimEgr "Shift of knock limit due to external EGR" SWORD zw_q0p1 1 100 -3276.800 3276.700 FORMAT "%8.3" ECU_ADDRESS 0x60006478 /end MEASUREMENT
/begin MEASUREMENT IgCtl_diaKnklimEgrEngAirCyl "Shift of knock limit due to external EGR - value from interpolation of maps" SWORD zw_q0p1 1 100 -3276.800 3276.700 FORMAT "%8.3" ECU_ADDRESS 0x60006476 /end MEASUREMENT
/begin MEASUREMENT IgCtl_diaKnkTEngIntk "Delta ignition angle for knock control from engine and intake air temperature" SWORD zw_q0p1 1 100 -3276.800 3276.700 FORMAT "%8.3" ECU_ADDRESS 0x60006470 /end MEASUREMENT
/begin MEASUREMENT IgCtl_diaLteActEgrRate "Late IA offset based on delta between actual and reference inert gas rate (internal and external)" SBYTE kw_q0p75 1 100 -96.00 95.25 FORMAT "%5.2" ECU_ADDRESS 0x70003746 /end MEASUREMENT
/begin MEASUREMENT IgCtl_diaLteEngT "Offset for the maximum retarded spark limitation due to engine temperature" SBYTE kw_q0p75 1 100 -96.00 95.25 FORMAT "%5.2" ECU_ADDRESS 0x70003745 /end MEASUREMENT
/begin MEASUREMENT IgCtl_diaLteFuCutOff "delta ignition angle offset for fuel cut-off" SBYTE kw_q0p75 1 100 -96.00 95.25 FORMAT "%5.2" ECU_ADDRESS 0x70001EDA /end MEASUREMENT
/begin MEASUREMENT IgCtl_diaPrimActEgrRate "IA offset based on delta between actual and reference inert gas rate (internal and external)" SWORD zw_q0p1 1 100 -3276.800 3276.700 FORMAT "%8.3" ECU_ADDRESS 0x70001F00 /end MEASUREMENT
/begin MEASUREMENT IgCtl_dwltfol_u16 "dwell-time within sparc-band ignition-mode" UWORD t_q0p001_ms 1 100 0.00 65.53500 FORMAT "%8.5" ECU_ADDRESS 0x60013F90 /end MEASUREMENT
/begin MEASUREMENT IgCtl_dwlt_u16 "dwell-time" UWORD t_q0p001_ms 1 100 0.00 65.53500 FORMAT "%8.5" ECU_ADDRESS 0x60013F8E /end MEASUREMENT
/begin MEASUREMENT IgCtl_facIntrpnEthnlFlexfu "Ethanol based interpolation factor for flex fuel" UBYTE fak_ub_b1 1 100 0.00 0.9961 ECU_ADDRESS 0x6000F3F2 /end MEASUREMENT
/begin MEASUREMENT IgCtl_facIntrpnEthnlSecFu "Ethanol based interpolation factor curve for 2nd fuel" UBYTE fak_ub_b1 1 100 0.00 0.9961 ECU_ADDRESS 0x6000F3F1 /end MEASUREMENT
/begin MEASUREMENT IgCtl_facRampIaLteFuCutOff "fuel cut-off request" UBYTE fak_ub_b1 1 100 0.00 0.9961 ECU_ADDRESS 0x700036FB /end MEASUREMENT
/begin MEASUREMENT IgCtl_flgEgrActv "exhaust gas recirculation system (EGR) active" UBYTE B_TRUE 1 100 0.00 1.00000000000 BIT_MASK 0x1 FORMAT "%13.11" ECU_ADDRESS 0x70003617 /end MEASUREMENT
/begin MEASUREMENT IgCtl_flgFixdIaOutpTstr "Flag of Ignition angle is fixed due to T-terminal request" UBYTE B_TRUE 1 100 0.00 1.00000000000 BIT_MASK 0x1 FORMAT "%13.11" ECU_ADDRESS 0x70003616 /end MEASUREMENT
/begin MEASUREMENT IgCtl_flgFuCutOffDetn "Fuel cut-off detection flag" UBYTE B_TRUE 1 100 0.00 1.00000000000 BIT_MASK 0x1 FORMAT "%13.11" ECU_ADDRESS 0x6000F0EC /end MEASUREMENT
/begin MEASUREMENT IgCtl_flgIntkVlvlftSwtDly "intake valve lift switchover delay for ignition" UBYTE B_TRUE 1 100 0.00 1.00000000000 BIT_MASK 0x1 FORMAT "%13.11" ECU_ADDRESS 0x70003615 /end MEASUREMENT
/begin MEASUREMENT IgCtl_iaDiffKnkAdpn "difference between base and desired ignition angle to detect intervention of knock adaption via ignition angle" SWORD zw_q0p1 1 100 -3276.800 3276.700 FORMAT "%8.3" ECU_ADDRESS 0x70001ECE /end MEASUREMENT
/begin MEASUREMENT IgCtl_iaLteCamsftPha "Ignition late limit, dependent on camshaft angular position resp. valve timing" SBYTE kw_q0p75 1 100 -96.00 95.25 FORMAT "%5.2" ECU_ADDRESS 0x70001ED2 /end MEASUREMENT
/begin MEASUREMENT IgCtl_iaLteCamsftPhaLowVlvlft "Ignition late limit, dependent on camshaft angular position resp. valve timing - Low valve lift" SBYTE kw_q0p75 1 100 -96.00 95.25 FORMAT "%5.2" ECU_ADDRESS 0x70001ED1 /end MEASUREMENT
/begin MEASUREMENT IgCtl_iaLteGearShiftSecFu "late ignition angle for gear shift" SBYTE kw_q0p75 1 100 -96.00 95.25 FORMAT "%5.2" ECU_ADDRESS 0x70001ED9 /end MEASUREMENT
/begin MEASUREMENT IgCtl_iaLteLimDyn "dynamic late ignition angle limit (temporary available)" SBYTE kw_q0p75 1 100 -96.00 95.25 FORMAT "%5.2" ECU_ADDRESS 0x70001ED8 /end MEASUREMENT
/begin MEASUREMENT IgCtl_iaLteLimStat "static late ignition angle limit (permanent possible)" SBYTE kw_q0p75 1 100 -96.00 95.25 FORMAT "%5.2" ECU_ADDRESS 0x70003743 /end MEASUREMENT
/begin MEASUREMENT IgCtl_iaOutpRdnt "redundancy of output ignition angle" UWORD dez 1 100 0.00 65535.00 FORMAT "%8.2" ECU_ADDRESS 0x70003968 /end MEASUREMENT
/begin MEASUREMENT IgCtl_iaPrimEgrFac "Primary ignition angle considering the EGR system" SWORD zw_q0p1 1 100 -3276.800 3276.700 FORMAT "%8.3" ECU_ADDRESS 0x70001EFE /end MEASUREMENT
/begin MEASUREMENT IgCtl_iaPrimHomMinCptProtnIntv "primary ignition angle HOM assuming minimal component protection intervention through lambda" SWORD zw_q0p1 1 100 -96.00000 95.30000 FORMAT "%8.5" ECU_ADDRESS 0x70003BB4 /end MEASUREMENT
/begin MEASUREMENT IgCtl_iaPrimMap "current map value of prim.ign.angle(pos.1)" SWORD zw_q0p1 1 100 -3276.800 3276.700 FORMAT "%8.3" ECU_ADDRESS 0x70001EFC /end MEASUREMENT
/begin MEASUREMENT IgCtl_iaPrimMapEgr "Primary ignition angle from calibration maps considering EGR-system" SWORD zw_q0p1 1 100 -3276.800 3276.700 FORMAT "%8.3" ECU_ADDRESS 0x70001EFA /end MEASUREMENT
/begin MEASUREMENT IgCtl_iaPrimMapSecFu "Primary ignition angle for second fuel without EGR" SWORD zw_q0p1 1 100 -96.00000 95.30000 FORMAT "%8.5" ECU_ADDRESS 0x70001F0E /end MEASUREMENT
/begin MEASUREMENT IgCtl_iaPrimMapSecFuEgr "Primary ignition angle for second fuel with EGR" SWORD zw_q0p1 1 100 -96.00000 95.30000 FORMAT "%8.5" ECU_ADDRESS 0x70001F0C /end MEASUREMENT
/begin MEASUREMENT IgCtl_iaPrimMapVlvlft "Primary ignition angle from calibration map at low valve lift" SWORD zw_q0p1 1 100 -3276.800 3276.700 FORMAT "%8.3" ECU_ADDRESS 0x70001EF8 /end MEASUREMENT
/begin MEASUREMENT IgCtl_iaPrimMapVlvlftEgr "Primary ignition angle from calibration map at low valve lift and active EGR system" SWORD zw_q0p1 1 100 -3276.800 3276.700 FORMAT "%8.3" ECU_ADDRESS 0x70001EF6 /end MEASUREMENT
/begin MEASUREMENT IgCtl_iaPrimMinCptProtnIntv "primary ignition angle(16bit) assuming minimal component protection intervention through lambda" SWORD zw_q0p1 1 100 -96.00000 95.30000 FORMAT "%8.5" ECU_ADDRESS 0x70003BB2 /end MEASUREMENT
/begin MEASUREMENT IgCtl_iaPrimSecFuMapVlvlft "Valve lift primary ignition angle for second fuel" SWORD zw_q0p1 1 100 -96.00000 95.30000 FORMAT "%8.5" ECU_ADDRESS 0x70001F0A /end MEASUREMENT
/begin MEASUREMENT IgCtl_iaPrimSecFuMapVlvlftEgr "Valve lift EGR primary ignition angle for second fuel" SWORD zw_q0p1 1 100 -96.00000 95.30000 FORMAT "%8.5" ECU_ADDRESS 0x70001F08 /end MEASUREMENT
/begin MEASUREMENT IgCtl_iaPrimVlvlftEgrFac "Primary ignition angle for low valve lift considering the EGR system" SWORD zw_q0p1 1 100 -3276.800 3276.700 FORMAT "%8.3" ECU_ADDRESS 0x70001EF4 /end MEASUREMENT
/begin MEASUREMENT IgCtl_iaPrimWoLam "primary ignition angle without lambda correction" SWORD zw_q0p1 1 100 -3276.800 3276.700 FORMAT "%8.3" ECU_ADDRESS 0x70001EF2 /end MEASUREMENT
/begin MEASUREMENT IgCtl_iaRefEgrRateCorrnHiResl "Referance ignition angle EGR correction" SWORD zw_q0p1 1 100 -96.00000 95.30000 FORMAT "%8.5" ECU_ADDRESS 0x60009076 /end MEASUREMENT
/begin MEASUREMENT IgCtl_idxIgnAg "Curve selection of the ignition offs.map for addressed injection mode(GDIPFI,HKS,HSP)" UBYTE dez 1 100 0.00 255.0 FORMAT "%5.1" ECU_ADDRESS 0x700036FA /end MEASUREMENT
/begin MEASUREMENT IgCtl_numfol_u8 "number of follow-up sparcs during sparc-band ignition-mode" UBYTE dez 1 100 0.00 255.0 FORMAT "%5.1" ECU_ADDRESS 0x50006020 /end MEASUREMENT
/begin MEASUREMENT IgCtl_opntfol_u16 "open-time within sparc-band ignition" UWORD t_q0p001_ms 1 100 0.00 65.53500 FORMAT "%8.5" ECU_ADDRESS 0x60013F92 /end MEASUREMENT
/begin MEASUREMENT igctl_ovl_u8 "Start-Dwell overlap counter" UBYTE dez 1 100 0.00 255.0 FORMAT "%5.1" ECU_ADDRESS 0x7000365B /end MEASUREMENT
/begin MEASUREMENT IgCtl_ratDeltaInertEgrExtRef "Difference between actual and reference external residual gas rate" SWORD rel_uw_b100 1 100 -50.00000 49.99847 FORMAT "%8.5" ECU_ADDRESS 0x70001EF0 /end MEASUREMENT
/begin MEASUREMENT IgCtl_ratDeltaInertEgrIntRef "Delta between current internal residual gas rate and internal residual gas rate in reference position" SWORD rel_uw_b100 1 100 -50.00000 49.99847 FORMAT "%8.5" ECU_ADDRESS 0x70001EEE /end MEASUREMENT
/begin MEASUREMENT IgCtl_tSelTKnkCtrlIntk "selected temperature for delta ignition angle calculation for knock protection" SWORD Temp_Cels 1 100 -3549.940 3003.560 FORMAT "%8.3" ECU_ADDRESS 0x6000646E /end MEASUREMENT
/begin MEASUREMENT IgnSys_bHOMNxtCmb "Condition GDI mode homogeneous of next combustion" UBYTE B_TRUE 1 100 0.00 1.00000000000 BIT_MASK 0x1 FORMAT "%13.11" ECU_ADDRESS 0x70003614 /end MEASUREMENT
/begin MEASUREMENT Ign_bKperm "condition permanent knocking detected" UBYTE B_TRUE 1 100 0.00 1.00000000000 BIT_MASK 0x1 FORMAT "%13.11" ECU_ADDRESS 0x70000896 /end MEASUREMENT
/begin MEASUREMENT Ign_bstrt_iaLT "start-up phase with latest ignition angle not yet reached" UBYTE B_TRUE 1 100 0.00 1.00000000000 BIT_MASK 0x1 FORMAT "%13.11" ECU_ADDRESS 0x6000F0EB /end MEASUREMENT
/begin MEASUREMENT Ign_bVlvLInNxtCmbs "condition cylinder number with combustion with standard intake valve-lift" UBYTE B_TRUE 1 100 0.00 1.00000000000 BIT_MASK 0x1 FORMAT "%13.11" ECU_ADDRESS 0x70003613 /end MEASUREMENT
/begin MEASUREMENT Ign_bVlvLInNxtIAs "condition cylinder number with ignition angle for standard intake valve-lift" UBYTE B_TRUE 1 100 0.00 1.00000000000 BIT_MASK 0x1 FORMAT "%13.11" ECU_ADDRESS 0x70003612 /end MEASUREMENT
/begin MEASUREMENT Ign_ctCylAdv_a "2x array with extended ign.cyl.no." UBYTE dez 1 100 0.00 255.0 FORMAT "%5.1" ARRAY_SIZE 2 ECU_ADDRESS 0x500007E8 /end MEASUREMENT
/begin MEASUREMENT Ign_ctCyl_a "cyl.numbers for which new ign.angle values are calculated in current early sync. (must be DIRECT-SELECTABLE)" UBYTE dez 1 100 0.00 255.0 FORMAT "%5.1" ARRAY_SIZE 2 ECU_ADDRESS 0x500007EA /end MEASUREMENT
/begin MEASUREMENT Ign_diaBasBA_as16 "engine mode dependent ign.angle offset for basis ign.agle" SWORD zw_q0p1 1 100 -3276.800 3276.700 FORMAT "%8.3" ARRAY_SIZE 2 ECU_ADDRESS 0x70003BAE /end MEASUREMENT
/begin MEASUREMENT Ign_diaBasWoKnkMax_a "Ignition-angle delta (Maximum ignition angle - Base ignition angle), without selective knock-protection offsets" SWORD zw_q0p1 1 100 -3276.800 3276.700 FORMAT "%8.3" ARRAY_SIZE 4 ECU_ADDRESS 0x70003BA6 /end MEASUREMENT
/begin MEASUREMENT Ign_diaKLEgrR_s16 "Shift of knock limit due to ext.EGR - smoothed by ramp" SWORD zw_q0p1 1 100 -3276.800 3276.700 FORMAT "%8.3" ECU_ADDRESS 0x60006474 /end MEASUREMENT
/begin MEASUREMENT Ign_diaKperm_s16 "Delta ignition angle with permanent knocking, fine resolution" SWORD zw_q0p1 1 100 -96.00000 95.30000 FORMAT "%8.5" ECU_ADDRESS 0x50005D92 /end MEASUREMENT
/begin MEASUREMENT Ign_diaKperm_s8 "Delta ignition angle during permant knocking" SBYTE kw_q0p75 1 100 -96.00 95.25 FORMAT "%5.2" ECU_ADDRESS 0x6001413F /end MEASUREMENT
/begin MEASUREMENT Ign_diaKP_s16 "offset ignition angle knock protection" SWORD zw_q0p1 1 100 -3276.800 3276.700 FORMAT "%8.3" ECU_ADDRESS 0x50005D8E /end MEASUREMENT
/begin MEASUREMENT Ign_diaKP_s8 "Offset ignition angle knock protection" SBYTE kw_q0p75 1 100 -96.00 95.25 FORMAT "%5.2" ECU_ADDRESS 0x6001413E /end MEASUREMENT
/begin MEASUREMENT Ign_diaLTpuHSP "altitude dep.offset for the latest possible ign.angle(HSP)" SBYTE kw_q0p75 1 100 -96.00 95.25 FORMAT "%5.2" ECU_ADDRESS 0x70003742 /end MEASUREMENT
/begin MEASUREMENT Ign_diaPr2F_s16 "offset ign.angle 2nd fuel primary ign.angle" SWORD zw_q0p1 1 100 -96.00000 95.30000 FORMAT "%8.5" ECU_ADDRESS 0x70003BA4 /end MEASUREMENT
/begin MEASUREMENT Ign_diaVlvL_s16 "offset ign.angle switchable valvelift" SWORD zw_q0p1 1 100 -96.00000 95.30000 FORMAT "%8.5" ECU_ADDRESS 0x70003BA2 /end MEASUREMENT
/begin MEASUREMENT Ign_fac2F_iaLT "actual weighting factor of 2nd fuel - latest ignition angle" UBYTE fak_ub_b1 1 100 0.00 0.9961 ECU_ADDRESS 0x6000F3F0 /end MEASUREMENT
/begin MEASUREMENT Ign_fac2F_iaPr "actual weighting factor of 2nd fuel - basic ignition angle" UBYTE fak_ub_b1 1 100 0.00 0.9961 ECU_ADDRESS 0x6000F3EF /end MEASUREMENT
/begin MEASUREMENT Ign_facdiaKperm "Integrator output e.g. factor to calculate delta ignition angle during permanent knocking." UWORD fak_uw_b1 1 100 0.00 0.9999847 FORMAT "%9.7" ECU_ADDRESS 0x60008BEC /end MEASUREMENT
/begin MEASUREMENT Ign_flgEomNxtCmb "Flag: the ignition system switches over to a new mode of operation." UBYTE B_TRUE 1 100 0.00 1.00000000000 BIT_MASK 0x1 FORMAT "%13.11" ECU_ADDRESS 0x70003611 /end MEASUREMENT
/begin MEASUREMENT Ign_flgEomNxtIA "condition change of GDI-operating mode for ignition system active" UBYTE B_TRUE 1 100 0.00 1.00000000000 BIT_MASK 0x1 FORMAT "%13.11" ECU_ADDRESS 0x70003610 /end MEASUREMENT
/begin MEASUREMENT Ign_flgHomNxtCmb "Condition GDI mode homogeneous from next combustion on" UBYTE B_TRUE 1 100 0.00 1.00000000000 BIT_MASK 0x1 FORMAT "%13.11" ECU_ADDRESS 0x7000360F /end MEASUREMENT
/begin MEASUREMENT Ign_flgHomNxtIA "Condition GDI mode homogeneous of next ign.angle update" UBYTE B_TRUE 1 100 0.00 1.00000000000 BIT_MASK 0x1 FORMAT "%13.11" ECU_ADDRESS 0x7000360E /end MEASUREMENT
/begin MEASUREMENT Ign_flgHspNxtCmb "Condition Gasoline Direct Injection - homogenous split mode from next combustion on" UBYTE B_TRUE 1 100 0.00 1.00000000000 BIT_MASK 0x1 FORMAT "%13.11" ECU_ADDRESS 0x7000360D /end MEASUREMENT
/begin MEASUREMENT Ign_flgHspNxtIA "Condition GDI mode hom.split mode of next ign.angle update" UBYTE B_TRUE 1 100 0.00 1.00000000000 BIT_MASK 0x1 FORMAT "%13.11" ECU_ADDRESS 0x7000360C /end MEASUREMENT
/begin MEASUREMENT Ign_flgIAmapsyn "Condition crankshaft-synchronous calculation of maps for ignition angle" UBYTE B_TRUE 1 100 0.00 1.00000000000 BIT_MASK 0x1 FORMAT "%13.11" ECU_ADDRESS 0x7000360B /end MEASUREMENT
/begin MEASUREMENT Ign_iaBasAdv_as16 "extended array for basic ign.angle" SWORD zw_q0p1 1 100 -3276.800 3276.700 FORMAT "%8.3" ARRAY_SIZE 4 ECU_ADDRESS 0x70003B9A /end MEASUREMENT
/begin MEASUREMENT Ign_iaBasNKC_s16 "basic ign.angle without knock control" SWORD zw_q0p1 1 100 -96.00000 95.30000 FORMAT "%8.5" ECU_ADDRESS 0x500007EC /end MEASUREMENT
/begin MEASUREMENT Ign_iaBasNKC_s8 "basic ign.angle without knock control" SBYTE kw_q0p75 1 100 -96.00 95.25 FORMAT "%5.2" ECU_ADDRESS 0x50000993 /end MEASUREMENT
/begin MEASUREMENT Ign_iaBas_as16 "basic ignition angle (knock-limit) array (16bit)" SWORD zw_q0p1 1 100 -96.00000 95.30000 FORMAT "%8.5" ARRAY_SIZE 2 ECU_ADDRESS 0x50000638 /end MEASUREMENT
/begin MEASUREMENT Ign_iaBas_s16 "basic ignition angle (knock-limit) curr.cyl.(16bit)" SWORD zw_q0p1 1 100 -3276.800 3276.700 FORMAT "%8.3" ECU_ADDRESS 0x500007EE /end MEASUREMENT
/begin MEASUREMENT Ign_iaBas_s8 "basic ignition angle (knock-limit) current cylinder" SBYTE kw_q0p75 1 100 -96.00 95.25 FORMAT "%5.2" ECU_ADDRESS 0x50000994 /end MEASUREMENT
/begin MEASUREMENT Ign_iacalc_as8 "outcoming ignition angle array" SBYTE kw_q0p75 1 100 -96.00 95.25 FORMAT "%5.2" ARRAY_SIZE 4 ECU_ADDRESS 0x5000063C /end MEASUREMENT
/begin MEASUREMENT Ign_iacalc_s8 "current outcoming ignition angle" SBYTE kw_q0p75 1 100 -96.00 95.25 FORMAT "%5.2" ECU_ADDRESS 0x60000972 /end MEASUREMENT
/begin MEASUREMENT Ign_iacpl_au8 "(array)current complement of outcoming ignition angle" UBYTE dez 1 100 0.00 255.0 FORMAT "%5.1" ARRAY_SIZE 4 ECU_ADDRESS 0x700036F6 /end MEASUREMENT
/begin MEASUREMENT Ign_iacpl_u8 "current complement of outcoming ignition angle" UBYTE dez 1 100 0.00 255.0 FORMAT "%5.1" ECU_ADDRESS 0x700036F5 /end MEASUREMENT
/begin MEASUREMENT Ign_iaLT_bl "currently latest possible ign.angle(burning limit)" SBYTE kw_q0p75 1 100 -96.00 95.25 FORMAT "%5.2" ECU_ADDRESS 0x50000995 /end MEASUREMENT
/begin MEASUREMENT Ign_iaLT_bldes "desired value for latest poss.ign.angle(burning lim.) for next engine-mode" SBYTE kw_q0p75 1 100 -96.00 95.25 FORMAT "%5.2" ECU_ADDRESS 0x70003741 /end MEASUREMENT
/begin MEASUREMENT Ign_iaPrCamsftCtlEgr "Basic ignition angle with consideration of variable camshaft control and external EGR (word)" SWORD zw_q0p1 1 100 -96.00000 95.30000 FORMAT "%8.5" ECU_ADDRESS 0x60009074 /end MEASUREMENT
/begin MEASUREMENT Ign_iaPrHOM_s16 "primary ignition angle HOM(16bit)" SWORD zw_q0p1 1 100 -96.00000 95.30000 FORMAT "%8.5" ECU_ADDRESS 0x70003B98 /end MEASUREMENT
/begin MEASUREMENT Ign_iaPrMap_s16 "current map value of prim.ign.angle(16bit)" SWORD zw_q0p1 1 100 -3276.800 3276.700 FORMAT "%8.3" ECU_ADDRESS 0x70003B96 /end MEASUREMENT
/begin MEASUREMENT Ign_iaPr_s16 "primary ignition angle(16bit)" SWORD zw_q0p1 1 100 -96.00000 95.30000 FORMAT "%8.5" ECU_ADDRESS 0x500007F0 /end MEASUREMENT
/begin MEASUREMENT Ign_iaPr_s8 "primary ignition angle" SBYTE kw_q0p75 1 100 -96.00 95.25 FORMAT "%5.2" ECU_ADDRESS 0x60000970 /end MEASUREMENT
/begin MEASUREMENT Ign_ia_cyl1 "ign.angle cylinder 1" SBYTE kw_q0p75 1 100 -96.00 95.25 FORMAT "%5.2" ECU_ADDRESS 0x7000373F /end MEASUREMENT
/begin MEASUREMENT Ign_ia_LT "currently latest possible ign.angle" SBYTE kw_q0p75 1 100 -96.00 95.25 FORMAT "%5.2" ECU_ADDRESS 0x70003740 /end MEASUREMENT
/begin MEASUREMENT Ign_ia_LTdes "desired value for latest poss.ign.angle for next engine-mode" SBYTE kw_q0p75 1 100 -96.00 95.25 FORMAT "%5.2" ECU_ADDRESS 0x6000F7B6 /end MEASUREMENT
/begin MEASUREMENT Ign_ia_real_s16 "real ign.angle" SWORD zw_q0p1 1 100 -96.00000 95.30000 FORMAT "%8.5" ECU_ADDRESS 0x70003B94 /end MEASUREMENT
/begin MEASUREMENT Ign_ia_real_s8 "Ignition angle in real data type" SBYTE kw_q0p75 1 100 -96.00 95.25 FORMAT "%5.2" ECU_ADDRESS 0x50000997 /end MEASUREMENT
/begin MEASUREMENT Ign_ratChrgAirCyl "Relative charge of air in currently ignited cylinder" UWORD rel_q0p0234 1 100 0.00 1535.977 FORMAT "%8.3" ECU_ADDRESS 0x500007F2 /end MEASUREMENT
/begin MEASUREMENT Ign_ratChrgAirCylLoR "Relative charge of air in next ignited cylinder(8bit)" UBYTE rel_q0p75 1 100 0.00 191.3 FORMAT "%5.1" ECU_ADDRESS 0x700036F4 /end MEASUREMENT
/begin MEASUREMENT Ign_stEomNxtCmb_u16 "GDI operating mode for current combustion" UWORD dez 1 100 0.00 65535.00 FORMAT "%8.2" ECU_ADDRESS 0x70003966 /end MEASUREMENT
/begin MEASUREMENT Ign_stEomNxtIA_u16 "GDI operating mode for current ignition cylinder" UWORD dez 1 100 0.00 65535.00 FORMAT "%8.2" ECU_ADDRESS 0x70003964 /end MEASUREMENT
/begin MEASUREMENT Ign_stEomTarNxtCmb_u16 "GDI operating mode for current combustion" UWORD CoEOM_stEomStgTot_VERB 1 100 0.00 7951.00000000 FORMAT "%13.8" ECU_ADDRESS 0x70003962 /end MEASUREMENT
/begin MEASUREMENT Ign_stEomTarNxtIA_u16 "GDI operating mode for current ignition cylinder" UWORD CoEOM_stEomStgTot_VERB 1 100 0.00 7951.00000000 FORMAT "%13.8" ECU_ADDRESS 0x70003960 /end MEASUREMENT
/begin MEASUREMENT Ign_stiaBasKnk "Cylinder-individual bit pattern for detection of ignition angle interventions for knock control" UBYTE dez 1 100 0.00 255.0 FORMAT "%5.1" ECU_ADDRESS 0x60000975 /end MEASUREMENT
/begin MEASUREMENT Ign_stModIA "Bitarray for switch-over of GDI-operating mode of actual ignition cylinders" UBYTE dez 1 100 0.00 255.0 FORMAT "%5.1" ECU_ADDRESS 0x700036F3 /end MEASUREMENT
/begin MEASUREMENT Ign_stVlvLInIA "Bitarray for switching inlet valve-lift for cyl.-no of the next ignitions" UBYTE dez 1 100 0.00 255.0 FORMAT "%5.1" ECU_ADDRESS 0x60000974 /end MEASUREMENT
/begin MEASUREMENT rlmdzs_w_msg "synchronized relative air charge for torque model" UWORD rel_uw_q0p0234 1 100 0.00 1535.977 FORMAT "%8.3" ECU_ADDRESS 0x7000375A /end MEASUREMENT
/begin MEASUREMENT szouttem_w "temporare dwell time" UWORD t_q0p001_ms 1 100 0.00 65.53500 FORMAT "%8.5" ECU_ADDRESS 0x6000647A /end MEASUREMENT
/begin MEASUREMENT TMECmb_iaRefAdv_a "Optimized model reference ignition angle" SWORD zw_q2p9297Em3_deg_KW 1 100 -96.00000 95.99707 FORMAT "%8.5" ARRAY_SIZE 4 ECU_ADDRESS 0x70003A32 /end MEASUREMENT
/begin MEASUREMENT vstdta_w "DT1 part of feed forward control MSV" SWORD kw_q0p1 1 100 -3276.800 3276.700 FORMAT "%8.3" ECU_ADDRESS 0x60000E30 /end MEASUREMENT
/begin MEASUREMENT vstmsvfg_w "factor gain feed-forward-control MSV" UWORD fak_uw_b4 1 100 0.00 3.999939 FORMAT "%8.6" ECU_ADDRESS 0x60000E2E /end MEASUREMENT
/begin MEASUREMENT vstmsvga_w "secondary variable gain part of feed forward control MSV" UWORD kw_q0p1 1 100 0.00 6553.500 FORMAT "%8.3" ECU_ADDRESS 0x60000E2C /end MEASUREMENT
/begin MEASUREMENT vstmsvoa_w "secondary variable offset part of feed forward control MSV" SWORD kw_q0p1 1 100 -3276.800 3276.700 FORMAT "%8.3" ECU_ADDRESS 0x60000E2A /end MEASUREMENT
/begin MEASUREMENT vststa_w "static part of feed forward control MSV" SWORD kw_q0p1 1 100 -3276.800 3276.700 FORMAT "%8.3" ECU_ADDRESS 0x60000E28 /end MEASUREMENT
/begin MEASUREMENT wdksom_w_msg "desired throttle angle without torque structure" UWORD relDK_uw_b100 1 100 0.00 100.0000 FORMAT "%8.4" ECU_ADDRESS 0x60001522 /end MEASUREMENT
/begin MEASUREMENT Wiper_flgActv "Wind screen wiper active" UBYTE B_TRUE 1 100 0.00 1.00000000000 BIT_MASK 0x1 FORMAT "%13.11" ECU_ADDRESS 0x6000F05E /end MEASUREMENT
/begin MEASUREMENT zwgruhom_w "basic ignition angle for homogeneous operation" SWORD zw_q0p1 1 100 -3276.800 3276.700 FORMAT "%8.3" ECU_ADDRESS 0x70001EEC /end MEASUREMENT
/begin MEASUREMENT zwkfzw_w "primary ignition angle from map Ign_iaPr...GM" SWORD zw_q0p1 1 100 -3276.800 3276.700 FORMAT "%8.3" ECU_ADDRESS 0x70001EEA /end MEASUREMENT
/begin MEASUREMENT zwmn "retarded ignition timing" SBYTE kw_q0p75 1 100 -96.00 95.25 FORMAT "%5.2" ECU_ADDRESS 0x5000097F /end MEASUREMENT
/begin MEASUREMENT zwmnhom "maximum retarded spark limitation for operating mode HOM" SBYTE kw_q0p75 1 100 -96.00 95.25 FORMAT "%5.2" ECU_ADDRESS 0x70003737 /end MEASUREMENT
/begin MEASUREMENT zwmnhomst "maximum retarded spark limitation for operating mode HOM during engine start" SBYTE kw_q0p75 1 100 -96.00 95.25 FORMAT "%5.2" ECU_ADDRESS 0x6000F7AA /end MEASUREMENT
/begin MEASUREMENT zwmnhsp "latest possible ignition angle for operating mode HSP" SBYTE kw_q0p75 1 100 -96.00 95.25 FORMAT "%5.2" ECU_ADDRESS 0x70003736 /end MEASUREMENT
/begin MEASUREMENT zwmnhsploc "local value of latest possible ignition angle for operating mode HSP" SBYTE kw_q0p75 1 100 -96.00 95.25 FORMAT "%5.2" ECU_ADDRESS 0x70001ED0 /end MEASUREMENT
/begin MEASUREMENT zwmnhspst "maximum retarded spark limitation for operating mode HSP during engine start" SBYTE kw_q0p75 1 100 -96.00 95.25 FORMAT "%5.2" ECU_ADDRESS 0x6000AC87 /end MEASUREMENT
/begin MEASUREMENT zwmnst "latest possible ign.angle during start" SBYTE kw_q0p75 1 100 -96.00 95.25 FORMAT "%5.2" ECU_ADDRESS 0x6000AC86 /end MEASUREMENT
/begin MEASUREMENT zwnws0_w "Basic ignition anlge at KNWS: exhaust cam in position of rest" SWORD zw_q0p1 1 100 -96.00000 95.30000 FORMAT "%8.5" ECU_ADDRESS 0x70001F06 /end MEASUREMENT
/begin MEASUREMENT zwnws1_w "Basic ignition angle at KNWS: exhaust cam active" SWORD zw_q0p1 1 100 -96.00000 95.30000 FORMAT "%8.5" ECU_ADDRESS 0x70001F04 /end MEASUREMENT
/begin MEASUREMENT zwoptl1_w_msg "Optimized model reference ignition angle at lambda = 1 (high resolution)" SWORD zw_q2p9297Em3_deg_KW 1 100 -96.00000 95.99707 FORMAT "%8.5" ECU_ADDRESS 0x50000942 /end MEASUREMENT
/begin MEASUREMENT zwopt_w_msg "Optimized model reference ignition angle" SWORD zw_q2p9297Em3_deg_KW 1 100 -96.00000 95.99707 FORMAT "%8.5" ECU_ADDRESS 0x50000940 /end MEASUREMENT
/begin MEASUREMENT zwoutzyl_w_msg "Ignition angle output array" SWORD zw_q0p1 1 100 -96.00000 95.30000 FORMAT "%8.5" ARRAY_SIZE 4 ECU_ADDRESS 0x500006CC /end MEASUREMENT
/begin MEASUREMENT zwspaebts_msg "latest allowed ignition timing in case of component protection" SBYTE zw_sb_q0p75 1 100 -96.00 95.25 FORMAT "%5.2" ECU_ADDRESS 0x70003735 /end MEASUREMENT
/begin MEASUREMENT ZWSTT_COM.agIgnCoMStrt "Class instance for ignition angle at change of mind / Ignition angle at change of mind" SBYTE zw_sb_q0p75 1 100 -96.00 95.25 FORMAT "%5.2" ECU_ADDRESS 0x60000910 /end MEASUREMENT
/begin MEASUREMENT ZWSTT_COMWAITSTRTR.agIgnCoMStrt " / Ignition angle at change of mind" SBYTE zw_sb_q0p75 1 100 -96.00 95.25 FORMAT "%5.2" ECU_ADDRESS 0x6000090F /end MEASUREMENT
/begin MEASUREMENT ZWSTT_CORR.agIgnStrtCorrOffs "correction factor / Offset correction" SBYTE zw_sb_q0p75 1 100 -96.00 95.25 FORMAT "%5.2" ECU_ADDRESS 0x60000912 /end MEASUREMENT
/begin MEASUREMENT ZWSTT_CORR_2.agIgnStrtCorrOffs " / Offset correction" SBYTE zw_sb_q0p75 1 100 -96.00 95.25 FORMAT "%5.2" ECU_ADDRESS 0x60000911 /end MEASUREMENT
/begin MEASUREMENT ZWSTT_DRCT.agIgnDrctStrt "Class instance for ignition angle at direct start / Ignition angle at direct start" SBYTE zw_sb_q0p75 1 100 -96.00 95.25 FORMAT "%5.2" ECU_ADDRESS 0x70001EB9 /end MEASUREMENT
/begin MEASUREMENT ZWSTT_FOLW.agIgnStrtOffs "Class instance for ignition angle offset at following start / Ignition angle offset at start (driver request)" SBYTE zw_sb_q0p75 1 100 -96.00 95.25 FORMAT "%5.2" ECU_ADDRESS 0x60000913 /end MEASUREMENT
/begin MEASUREMENT ZWSTT_HIP.agIgnStrtBas " / Ignition angle at start (base value)" SBYTE zw_sb_q0p75 1 100 -96.00 95.25 FORMAT "%5.2" ECU_ADDRESS 0x70001EBA /end MEASUREMENT
/begin MEASUREMENT ZWSTT_LOP.agIgnStrtBas "Class instance for ignition angle at low pressure start / Ignition angle at start (base value)" SBYTE zw_sb_q0p75 1 100 -96.00 95.25 FORMAT "%5.2" ECU_ADDRESS 0x60000914 /end MEASUREMENT
/begin MEASUREMENT zwstt_msg "Ignition angle during sta" SBYTE zw_sb_q0p75 1 100 -96.00 95.25 FORMAT "%5.2" ECU_ADDRESS 0x600009A8 /end MEASUREMENT
/begin MEASUREMENT zzylzuear "cylinder numbers relevant to ignition angle calculation in actual bisynchro task" UBYTE dez 1 100 0.00 255.0 FORMAT "%5.1" ARRAY_SIZE 2 ECU_ADDRESS 0x500007BC /end MEASUREMENT
/begin MEASUREMENT zzylzuenmd "First cylinder in new mode for ignition at change of GDI-operating mode" UBYTE dez 1 100 0.00 255.0 FORMAT "%5.1" ECU_ADDRESS 0x70001F02 /end MEASUREMENT
/begin FUNCTION VSTMSV "51.2.0    Feed Forward Control MSV"
 /begin DEF_CHARACTERISTIC CWVSTMSV DWVSTMSVAP DWVSTMSVST FRKKMA FuPHi_pDeltaMSVEngStrt_C FuPHi_pRlSpChgGrdt_T KFVSTMSVO KLFVSTGTF KLFVSTOTF KLNMSVZPAS KLRKMSVZPA KLVSTMSVG NMSVKMAH NMSVKMAO NMSVKMAU NMSVZPAH RKMSVKMAH RKMSVKMAS RKMSVZPAH SNM08HDUW SPR06HDUW TMMSVKMAU TMMSVZPAO TMMSVZPAU TNSTMSVKMA TNSTMSVZPA TNSTVSTDYN VMSVZPA VMSVZPAH /end DEF_CHARACTERISTIC
 /begin REF_CHARACTERISTIC DWMSVMX /end REF_CHARACTERISTIC
 /begin IN_MEASUREMENT B_entist_msg B_hdrres_msg B_hdr_msg B_lr_msg CEngDsT_t EngStrt_bStrtEnd Epm_nEng Epm_nEngLRes FuPHi_pRail FuPHi_pRailSp FuPHi_pRailSpUnlim rkvmeeff_w_msg SyC_stSub tfuelsq_msg tnse_w_msg VehV_v /end IN_MEASUREMENT
 /begin OUT_MEASUREMENT B_msvkma_msg B_msvzpa_msg dwmsvvst_w_msg /end OUT_MEASUREMENT
 /begin LOC_MEASUREMENT B_msvkmaloc B_msvzpaloc FuPHi_pRlSpChgGrdtLoc FuPHi_pRlSpOldLoc vstdta_w vstmsvfg_w vstmsvga_w vstmsvoa_w vststa_w /end LOC_MEASUREMENT
 FUNCTION_VERSION "51.2.0" /end FUNCTION
/begin FUNCTION WDKSOM "5.2.0     calculation of desired throttle angle without torque structure"
 /begin DEF_CHARACTERISTIC CWWDKSOM SNMDKSRF SVFDKSRF TSRFDKI TSRFDKO TSRFDKU WDKSRFE WDKSRFI WDKSRFO WDKSRFU /end DEF_CHARACTERISTIC
 /begin IN_MEASUREMENT Epm_nEngLRes SyC_stSub VehV_v /end IN_MEASUREMENT
 /begin OUT_MEASUREMENT B_engoff_msg B_srfdke_msg B_srfdko_msg B_srfdku_msg wdksom_w_msg /end OUT_MEASUREMENT
 /begin LOC_MEASUREMENT ChrCtl_B_srfdko_EF_I.buffer ChrCtl_B_srfdko_EF_I.oldSignal ChrCtl_B_srfdku_EF_I.buffer ChrCtl_B_srfdku_EF_I.oldSignal ChrCtl_SRFDKI_TONV_I.outbit ChrCtl_SRFDKI_TONV_I.time ChrCtl_SRFDKO_TE_I.inOld ChrCtl_SRFDKO_TE_I.timeCounter ChrCtl_SRFDKU_T_I.timeCounter /end LOC_MEASUREMENT
 FUNCTION_VERSION "5.2.0" /end FUNCTION
/begin FUNCTION Wiper_DD "8.0.0     Device Driver for wiper active" /begin DEF_CHARACTERISTIC Wiper_stActv_C Wiper_stSwt_C /end DEF_CHARACTERISTIC /begin IN_MEASUREMENT Com_stWipr Com_stWiprActvnCdn T15_st /end IN_MEASUREMENT /begin OUT_MEASUREMENT Wiper_flgActv /end OUT_MEASUREMENT FUNCTION_VERSION "8.0.0" /end FUNCTION
/begin FUNCTION XcpAppl "4200.5.0_7.1.0XCP Calibration Protocol Applikation" FUNCTION_VERSION "4200.5.0_7.1.0" /end FUNCTION
/begin FUNCTION ZUESZ "44.1.0    Ignition, calculation of coil closing time"
 /begin DEF_CHARACTERISTIC FUBAOF IGCTL_Bat08_AX IgCtl_facNrFolwUpSprkSecFu_T IgCtl_flgEnaFolwUpSprk_C Ign_nEng08_AX KFFFANZ KFFSZFF KFFSZNM KFSZT /end DEF_CHARACTERISTIC
 /begin REF_CHARACTERISTIC IGCTL_tEng08_AX /end REF_CHARACTERISTIC
 /begin IN_MEASUREMENT BattU_u CEngDsT_t Epm_nEng f2kazw_msg SyC_stSub /end IN_MEASUREMENT
 /begin OUT_MEASUREMENT IgCtl_dwltfol_u16 IgCtl_dwlt_u16 IgCtl_numfol_u8 IgCtl_opntfol_u16 /end OUT_MEASUREMENT
 /begin LOC_MEASUREMENT ftstm ftsztl szouttem_w /end LOC_MEASUREMENT
 FUNCTION_VERSION "44.1.0" /end FUNCTION
/begin FUNCTION ZW2KA "10.6.0    ignition angles for 2nd fuel"
 /begin DEF_CHARACTERISTIC CWFVETHS IgCtl_facKnkLimSecFu_GM IgCtl_iaPrimSecFuEgr_GM IgCtl_iaPrimSecFuIntkSpEgr_GM IgCtl_iaPrimSecFuVlvlftEgr_GM IgCtl_iaPrimSecFuVlvlftIntkSpEgr_GM Ign_iaKnKLim2F_M Ign_iaPr2F2_10_GM Ign_iaPr2F2_GM Ign_iaPrF2_10_GM Ign_iaPrF2_GM KFW2KAGRU KLF2KAGRU KLF2KAMN TWKRMNA /end DEF_CHARACTERISTIC
 /begin REF_CHARACTERISTIC Ign_nEng16_AX Ign_ratChrgAir12_AX Ign_ratChrgAir16_AX /end REF_CHARACTERISTIC
 /begin IN_MEASUREMENT B_ethg_msg B_fvdeths_msg Epm_nEng fethmnmx_w_msg fwnwe_msg IgCtl_diaBascLamWoRefIa IgCtl_flgEgrActv Ign_bVlvLInNxtIAs Ign_diaVlvL_s16 Ign_iaPrMap_s16 Ign_ratChrgAirCyl IKCtl_flgRtdtMax IKCtl_flgSftyRtdt lambas_w_msg SyC_stSub TMECmb_facCamsftIntkPosnEgr /end IN_MEASUREMENT
 /begin OUT_MEASUREMENT Ign_diaPr2F_s16 Ign_fac2F_iaLT Ign_fac2F_iaPr /end OUT_MEASUREMENT
 /begin LOC_MEASUREMENT dzwkg2k_w dzwvs2k_w IgCtl_iaPrimMapSecFu IgCtl_iaPrimMapSecFuEgr IgCtl_iaPrimSecFuMapVlvlft IgCtl_iaPrimSecFuMapVlvlftEgr zwnws0_w zwnws1_w /end LOC_MEASUREMENT
 FUNCTION_VERSION "10.6.0" /end FUNCTION
/begin FUNCTION ZWBAS "44.4.0_1.1.0calculation ignition angles for zwbasar" /begin DEF_CHARACTERISTIC CWIGC IgCtl_iaCalApprch_C Ign_diaAPP_C Ign_iaBasMax_M /end DEF_CHARACTERISTIC
 /begin IN_MEASUREMENT AirMod_ratChrgAirCyl B_zesync_msg CoEng_bStrtEndIA CoEOM_stEomTarInj CoEOM_stOpMAct EngStrt_diaWrmUp Epm_ctCyl Epm_nEng IgCtl_flgIntkVlvlftSwtDly IgCtl_iaPrimHomMinCptProtnIntv Ign_bVlvLInNxtIAs Ign_diaBasBA_as16 Ign_diaKperm_s16 Ign_diaKP_s16 Ign_diaPr2F_s16 Ign_diaVlvL_s16 Ign_flgIAmapsyn Ign_iaPrHOM_s16 Ign_stVlvLInIA IKCtl_agKnkRtdtAry_s16 IKCtl_iaDynAdpnOffs_s16 zwstt_msg zzylh_msg /end IN_MEASUREMENT
 /begin OUT_MEASUREMENT bdemodv_msg bdemodzw_msg CoEng_bHOMNxtCmb Gen_ctCylAdv IgCtl_iaPrimMinCptProtnIntv igctl_ovl_u8 IgnSys_bHOMNxtCmb Ign_ctCylAdv_a Ign_ctCyl_a Ign_diaBasWoKnkMax_a Ign_flgEomNxtCmb Ign_flgEomNxtIA Ign_flgHomNxtCmb Ign_flgHomNxtIA Ign_flgHspNxtCmb Ign_flgHspNxtIA Ign_iaBasAdv_as16 Ign_iaBasNKC_s16 Ign_iaBasNKC_s8 Ign_iaBas_as16 Ign_iaBas_s16 Ign_iaBas_s8 Ign_iaPr_s16 Ign_iaPr_s8 Ign_stEomNxtCmb_u16 Ign_stEomNxtIA_u16 Ign_stEomTarNxtCmb_u16 Ign_stEomTarNxtIA_u16 Ign_stModIA /end OUT_MEASUREMENT
 /begin LOC_MEASUREMENT bdezwflag zzylzuear zzylzuenmd /end LOC_MEASUREMENT
 FUNCTION_VERSION "44.4.0_1.1.0" /end FUNCTION
/begin FUNCTION ZWGRU "61.0.0    Basic ignition angle"
 /begin DEF_CHARACTERISTIC CWZWGRU IgCtl_diaExtEgrAirChrgSecFu_GM IgCtl_diaExtEgrAirChrg_GM IgCtl_diaExtEgrEngSpdSecFu_GM IgCtl_diaExtEgrEngSpd_GM IgCtl_diaKnkLimHomEgrSecFu_M IgCtl_diaKnkLimHomEgr_M IgCtl_diaPrimCorrnInertEgr_M IgCtl_facAirChrgMtnEgr_T IgCtl_facInertEgrCorrn_M IgCtl_iaLineEndTestEgrLftDmdActvHiResl_C IgCtl_iaPrimEgr_GM IgCtl_iaPrimIntkSpEgr_GM IgCtl_iaPrimVlvlftEgr_GM IgCtl_iaPrimVlvlftIntkSpEgr_GM IgCtl_ratInertEgrExtCyl_AX IgCtl_ratInertExtCylEgrActv_GM IgCtl_ratInertIntCylEgrActv_GM IgCtl_ratInertIntCylEgrDeacv_GM Ign_iaPr2_GM Ign_iaPrVL1_GM Ign_iaPrVL2_GM Ign_iaPr_GM Ign_nEng16_AX Ign_ratChrgAir12_AX Ign_ratChrgAir16_AX Ign_StepIgnAgPrRmpDplKnk_C /end DEF_CHARACTERISTIC
 /begin IN_MEASUREMENT AirMod_ratChrgAirCylLoResl AirMod_ratInertEgrExtCyl AirMod_ratInertEgrIntCyl ChrSet_flgEgrRdyIndpdtIdle Epm_nEng f2kazw_msg fwnwe_msg GEVCtl_agIntkClsd I14229appl_stEGRLftDmd IgCtl_diaBascLam IgCtl_diaBascLamCptProtn IgCtl_flgIntkVlvlftSwtDly Ign_bVlvLInNxtIAs Ign_fac2F_iaPr Ign_flgIAmapsyn Ign_ratChrgAirCyl rriehsk_w_msg rriehvheksk_w_msg SyC_stSub TMECmb_facCamsftIntkPosnEgr /end IN_MEASUREMENT
 /begin OUT_MEASUREMENT IgCtl_flgEgrActv IgCtl_iaPrimHomMinCptProtnIntv IgCtl_iaRefEgrRateCorrnHiResl Ign_diaVlvL_s16 Ign_iaPrHOM_s16 Ign_iaPrMap_s16 /end OUT_MEASUREMENT
 /begin LOC_MEASUREMENT fagr IgCtl_diaKnklimEgr IgCtl_diaKnklimEgrEngAirCyl IgCtl_diaPrimActEgrRate IgCtl_iaPrimEgrFac IgCtl_iaPrimMap IgCtl_iaPrimMapEgr IgCtl_iaPrimMapVlvlft IgCtl_iaPrimMapVlvlftEgr IgCtl_iaPrimVlvlftEgrFac IgCtl_iaPrimWoLam IgCtl_ratDeltaInertEgrExtRef IgCtl_ratDeltaInertEgrIntRef Ign_diaKLEgrR_s16 Ign_iaPrCamsftCtlEgr zwgruhom_w zwkfzw_w /end LOC_MEASUREMENT
 FUNCTION_VERSION "61.0.0" /end FUNCTION
/begin FUNCTION ZWHBDEB2 "29.1.0    Correction of basic ignition angle for 2nd intake manifold & homogen. GDI-modes"
 /begin DEF_CHARACTERISTIC IgCtl_diaBasEom1Ethnl_GM IgCtl_diaBasEom2Ethnl_GM IgCtl_diaBasEom3Ethnl_GM IgCtl_diaBasEom4Ethnl_GM IgCtl_facBasEom_T IgCtl_idxIgnAg_GT Ign_diaBasEom1s16_GM Ign_diaBasEom2s16_GM Ign_diaBasEom3s16_GM Ign_diaBasEom4s16_GM Ign_nEng12_AX Ign_ratChrgAirGdiPfi12_AX /end DEF_CHARACTERISTIC
 /begin REF_CHARACTERISTIC CoEOM_stEomDesReqd_AX /end REF_CHARACTERISTIC
 /begin IN_MEASUREMENT CoEOM_stEomTarInj Epm_nEng fethmnmx_w_msg Ign_flgEomNxtIA Ign_ratChrgAirCyl Ign_stModIA SyC_stSub /end IN_MEASUREMENT
 /begin OUT_MEASUREMENT IgCtl_idxIgnAg Ign_diaBasBA_as16 /end OUT_MEASUREMENT
 /begin LOC_MEASUREMENT IgCtl_diaBasEom /end LOC_MEASUREMENT
 FUNCTION_VERSION "29.1.0" /end FUNCTION
/begin FUNCTION ZWKS "21.3.0    Ignition timing knock protection"
 /begin DEF_CHARACTERISTIC IgCtl_diaAltiCorrnKnkCtrlFlexfu_M IgCtl_diaAltiCorrnKnkCtrl_M IgCtl_diaKnkTEngIntkFlexfu_M IgCtl_diaKnkTEngIntk_M IgCtl_facIaKnkColdEthnlMax_M IgCtl_facIaKnkColdEthnlMin_M IgCtl_facIaKnkHiAlti_M IgCtl_facIaKnkWrmEthnlMax_M IgCtl_facIaKnkWrmEthnlMin_M IgCtl_facIntrpnEthnlFlexfu_T IgCtl_facIntrpnEthnlSecFu_T IgCtl_selTIgnKnkCtrl_C /end DEF_CHARACTERISTIC
 /begin IN_MEASUREMENT AirMod_ratChrgAirCyl CEngDsT_t Epm_nEng fethmnmx_w_msg IntkAirT_tAirFltDs IntkAirT_tIntkMnfld IntkAirT_tThrVlvUs PEnv_facCorrAlti SyC_stSub tansk_w_msg /end IN_MEASUREMENT
 /begin OUT_MEASUREMENT IgCtl_facIntrpnEthnlFlexfu IgCtl_facIntrpnEthnlSecFu Ign_diaKP_s16 Ign_diaKP_s8 /end OUT_MEASUREMENT
 /begin LOC_MEASUREMENT IgCtl_diaAltiCorrnKnkCtrl IgCtl_diaKnkTEngIntk IgCtl_tSelTKnkCtrlIntk /end LOC_MEASUREMENT
 FUNCTION_VERSION "21.3.0" /end FUNCTION
/begin FUNCTION ZWLOWOCT "18.4.0    Correction of basic ignition angle for permanent knocking due to low-octane fuel"
 /begin DEF_CHARACTERISTIC Ign_diaKpermVlvlft_GM Ign_diaKperm_GM Ign_tEngMinThd_C KFSWKFZK KFSWKFZKR KLLOWOCTN TLOWORN TLOWORP TSWZK TSWZKR /end DEF_CHARACTERISTIC
 /begin REF_CHARACTERISTIC Ign_nEng16_AX Ign_ratChrgAir16_AX /end REF_CHARACTERISTIC
 /begin IN_MEASUREMENT AirMod_ratChrgAirCyl B_tankg_msg B_tank_msg B_zesync_msg EngDa_tEng Epm_nEng Ign_bVlvLInNxtIAs Ign_fac2F_iaPr Ign_ratChrgAirCyl Ign_stiaBasKnk IKCtl_agKnkAvrgGen_s8 IKCtl_flgKnkEna IKCtl_flgSftyRtdt SyC_stSub /end IN_MEASUREMENT
 /begin OUT_MEASUREMENT Ign_bKperm Ign_diaKperm_s16 Ign_diaKperm_s8 Ign_facdiaKperm /end OUT_MEASUREMENT
 /begin LOC_MEASUREMENT dzwzkvf_w fdzwzk_w /end LOC_MEASUREMENT
 FUNCTION_VERSION "18.4.0" /end FUNCTION
/begin FUNCTION ZWMINBG "40.4.0    calculation of allowed retarded ignition"
 /begin DEF_CHARACTERISTIC CWZWMINBG IgCtl_diaRampFuCutOff_C IgCtl_iaLoVlvLftGearShift_GM IgCtl_iaLteGearShiftCng_GM IgCtl_offsFacDiaLteFuCutOff_C IgCtl_ratCluHysL_C IgCtl_ratCluHysR_C IgCtl_tiMaxTqIntvGearShift_C IgCtl_tiMaxTqIntvGearShift_T IgCtl_tiResiGasCutOff_C IgCtl_vThdVehMax_C KFZWMNGS /end DEF_CHARACTERISTIC
 /begin REF_CHARACTERISTIC Ign_nEng16_AX Ign_ratChrgAir12_AX /end REF_CHARACTERISTIC
 /begin IN_MEASUREMENT B_nozwe_msg B_sa_msg B_zwappl_msg Clth_r Clth_st CoETS_bTraIntvActv Epm_nEng flambts_msg IgCtl_diaCorrnPEnv IgCtl_diaLteActEgrRate IgCtl_diaLteEngT Ign_bstrt_iaLT Ign_bVlvLInNxtIAs Ign_fac2F_iaLT Ign_iaBas_s8 Ign_iaLT_bl Ign_iaLT_bldes Ign_ratChrgAirCyl PT_stTraType SyC_stSub VehV_v zwsol_w_msg zwspaebts_msg /end IN_MEASUREMENT
 /begin OUT_MEASUREMENT B_zwmngs_msg Ign_ia_LT Ign_ia_LTdes /end OUT_MEASUREMENT
 /begin LOC_MEASUREMENT IgCtl_diaLteFuCutOff IgCtl_facRampIaLteFuCutOff IgCtl_flgFuCutOffDetn IgCtl_iaLteGearShiftSecFu IgCtl_iaLteLimDyn IgCtl_iaLteLimStat /end LOC_MEASUREMENT
 FUNCTION_VERSION "40.4.0" /end FUNCTION
/begin FUNCTION ZWMINBTS "6.13.0_1.1.0Calculation of allowed retard ignition timing for component protection"
 /begin DEF_CHARACTERISTIC ExhMgT_facFillgRednCptProtn_C ExhMgT_iaHiVlvLftHomFfv_M ExhMgT_iaLoVlvLftHomFfv_M ExhMgT_iaLoVlvLftHom_M ExhMgT_tThdIaCptProtn_C ExhMgT_tThdIaLteBl_C FLAMTMPBTS FLAMTMPBVG KFZWMNAGRBTSVH KFZWMNAGRBTSVHK KFZWMNBTSVH /end DEF_CHARACTERISTIC
 /begin REF_CHARACTERISTIC Ign_nEng20_AX Ign_nEngVS12_AX Ign_ratChrgAir12_AX Ign_ratChrgAirVS12_AX /end REF_CHARACTERISTIC
 /begin IN_MEASUREMENT dzworriref_msg dzworri_msg Epm_nEng ExhMgT_tMinTExhCptProtnGlb frlmxbts_w_msg Ign_bVlvLInNxtIAs Ign_fac2F_iaLT Ign_flgIAmapsyn Ign_ratChrgAirCyl Ign_stVlvLInIA SyC_stSub /end IN_MEASUREMENT
 /begin OUT_MEASUREMENT B_zwms_msg ExhMgT_facCptProtnGearShift flambts_msg zwspaebts_msg /end OUT_MEASUREMENT
 FUNCTION_VERSION "6.13.0_1.1.0" /end FUNCTION
/begin FUNCTION ZWMINBVG "32.2.0    Calculation of maximum retarded spark limitation - burning limit"
 /begin DEF_CHARACTERISTIC CWZWMINBVG FDZWPU IgCtl_iaLteLimIntkCamsftHspEth2_GM IgCtl_iaLteLimIntkCamsftHspEth_GM IgCtl_iaLteLoVlvlft2SecFl_GM IgCtl_iaLteLoVlvlftPos3Egr_GM IgCtl_iaLteLoVlvlftPos3SecFlEgr_GM IgCtl_iaLteLoVlvlftSecFl_GM IgCtl_iaLtePosn3BrngLmtEgr_GM IgCtl_iaLteTEngHsp_T IgCtl_iaLteTEng_T IgCtl_iaSecFuBrngLim2_GM IgCtl_iaSecFuBrngLim3Egr_GM IgCtl_iaSecFuBrngLim_GM IGCTL_tEng08_AX IGCTL_tEng12_AX Ign_diaLtpuHOM_M Ign_diaLtpuHSP_M Ign_flgIaThrVlvIceActv_C Ign_flgIdleDetnActv_C Ign_iaEthMnThrVlvIce_M KFDZMNIDST KFDZMNST KFFDZWMNRG KFFSTE100 KFZWMN KFZWMN2 KFZWMNHSP KFZWMNHSP02 KFZWMNKHLL KFZWMNKHLLHSP KFZWMNKHLLVHK KFZWMNWL KFZWMVHK KFZWMVHK2 KLDZWMNLAM KLDZWMNLAMHSP PHIDIFLIN RRIZWMNMX /end DEF_CHARACTERISTIC
 /begin REF_CHARACTERISTIC Ign_nEng08_AX Ign_nEng12_AX Ign_nEng16_AX Ign_ratChrgAir12_AX /end REF_CHARACTERISTIC
 /begin IN_MEASUREMENT AirMod_ratChrgAirCyl B_hsps_msg B_ll_msg B_munst_msg B_stopz_msg CEngDsT_t CEngDsT_tStrt ChrSet_flgEgrRdyIndpdtIdle CoEng_bStrtEndIA EGSys_bCH EpmCaS_phiDiffLim Epm_nEng fethmnmx_w_msg fwnwe_msg IgCtl_iaRefEgrRateCorrnHiResl Ign_bVlvLInNxtIAs Ign_fac2F_iaLT Ign_flgHspNxtIA Ign_ratChrgAirCyl lambas_msg PEnv_p rriehsk_w_msg SyC_stSub ThrVlv_flgColdCdnOffsActvB1 zwstt_msg /end IN_MEASUREMENT
 /begin OUT_MEASUREMENT IgCtl_diaCorrnPEnv IgCtl_diaLteActEgrRate IgCtl_diaLteEngT Ign_bstrt_iaLT Ign_diaLTpuHSP Ign_iaLT_bl Ign_iaLT_bldes zwmnhom zwmnhomst /end OUT_MEASUREMENT
 /begin LOC_MEASUREMENT dzwmnlam dzwmnlamhsp dzwmntmhsp dzwmntmp dzwmntmphsp fzwmn_w IgCtl_iaLteCamsftPha IgCtl_iaLteCamsftPhaLowVlvlft zwmn zwmnhsp zwmnhsploc zwmnhspst zwmnst /end LOC_MEASUREMENT
 FUNCTION_VERSION "32.2.0" /end FUNCTION
/begin FUNCTION ZWOPT "8.5.0     Calculation of the optimized model reference ignition angle"
 /begin IN_MEASUREMENT dzwo2ka_w_msg dzwohsp_w_msg dzwolb_w_msg dzwol_w_msg dzworri_w_msg dzwotm_w_msg Gen_ctCylAdv Ign_flgHspNxtCmb zwoptl1_w_msg /end IN_MEASUREMENT
 /begin OUT_MEASUREMENT TMECmb_iaRefAdv_a zwopt_w_msg /end OUT_MEASUREMENT
 FUNCTION_VERSION "8.5.0" /end FUNCTION
/begin FUNCTION ZWOPTL1 "1.5.0     Calculation of the optimized model reference ignition angle at lambda=1" /begin DEF_CHARACTERISTIC KFZWOP KFZWOPV SNMOPUW SNMOVUW SRLOPUW SRLOVUW /end DEF_CHARACTERISTIC
 /begin IN_MEASUREMENT AirMod_ratChrgAirCylAdv_a Epm_nEng Gen_ctCylAdv Ign_bVlvLInNxtIAs /end IN_MEASUREMENT
 /begin OUT_MEASUREMENT rlmdzs_w_msg zwoptl1_w_msg /end OUT_MEASUREMENT
 FUNCTION_VERSION "1.5.0" /end FUNCTION
/begin FUNCTION ZWOPTWL "1.6.0     Calculation of the optimized correction model reference ignition angle for warm up" /begin DEF_CHARACTERISTIC CWZWOPTWL DZWOM DZWOMHSP /end DEF_CHARACTERISTIC /begin IN_MEASUREMENT CEngDsT_t dzwwl_msg Ign_flgHspNxtIA /end IN_MEASUREMENT /begin OUT_MEASUREMENT dzwotm_w_msg /end OUT_MEASUREMENT FUNCTION_VERSION "1.6.0" /end FUNCTION
/begin FUNCTION ZWOUT "22.11.0   Ignition angle calculation"
 /begin DEF_CHARACTERISTIC IgCtl_iaDiffKnkAdpn_C IgCtl_iaFixdOutpAppl_C IgCtl_nEngThdFixdIa_C IgCtl_pIntkThdFixdIaPlaMod_C IgCtl_pIntkThdFixdIa_C IgCtl_tThdFixdIa_C /end DEF_CHARACTERISTIC
 /begin IN_MEASUREMENT B_zwappl_msg CEngDsT_t DReqSwt_stClrDeb EngStrt_bStrtEnd Epm_ctCyl Epm_nEng Ign_ctCyl_a Ign_iaBas_as16 Ign_ia_LT InjSys_stActRedStg psr_w_msg PthSet_bIAIntv PthSet_bOvrRun SyC_stSub SysDiag_stTestMod VehV_v zwsol_w_msg /end IN_MEASUREMENT
 /begin OUT_MEASUREMENT IgCtl_flgFixdIaOutpTstr IgCtl_iaOutpRdnt Ign_iacalc_as8 Ign_iacalc_s8 Ign_iacpl_au8 Ign_iacpl_u8 Ign_ia_cyl1 Ign_ia_real_s16 Ign_ia_real_s8 Ign_stiaBasKnk zwoutzyl_w_msg /end OUT_MEASUREMENT
 /begin LOC_MEASUREMENT IgCtl_iaDiffKnkAdpn /end LOC_MEASUREMENT
 FUNCTION_VERSION "22.11.0" /end FUNCTION
/begin FUNCTION ZWSTT "12.10.0_2.6.0Igniton at start"
 /begin DEF_CHARACTERISTIC EngStrt_agDistAgIgn_AX EngStrt_cntrInjAgIgn_AX EngStrt_facCorrAltiAgIgn_AX EngStrt_facIntpnAgIgnEthCurr_T EngStrt_facIntrpnEthDrctStrt_T EngStrt_facIntrpnFuEthCurr_T EngStrt_idxClassSelnAgIgn_T EngStrt_idxSelnAgIgnCoMStrt_T EngStrt_idxSelnAgIgnDrctStrt_T EngStrt_idxSelnAgIgnStrtCorrOffs_T EngStrt_idxSelnAgIgnStrtOffs_T EngStrt_idxSelnAgIgnStrt_T EngStrt_ignCntr_AX EngStrt_nEngAgIgn_AX EngStrt_nrCmbDirSt_C EngStrt_ratAPedlwst_C EngStrt_ratChrgAgIgnStrt_AX EngStrt_rPedAgIgn_AX EngStrt_tIntkMnfldAgIgn_AX EngStrt_tqActClthAgIgn_AX EngStrt_tStrtAgIgn_AX ZWSTT_COM.agIgnCoMStrt_GM ZWSTT_COMWAITSTRTR.agIgnCoMStrt_GM ZWSTT_CORR.agIgnEthOffsCorrAlti_T ZWSTT_CORR.agIgnEthOffsIntkAir_T ZWSTT_CORR.agIgnOffsCorrAlti_T ZWSTT_CORR.agIgnOffsIntkAir_T ZWSTT_CORR_2.agIgnEthOffsCorrAlti_T ZWSTT_CORR_2.agIgnEthOffsIntkAir_T ZWSTT_CORR_2.agIgnOffsCorrAlti_T ZWSTT_CORR_2.agIgnOffsIntkAir_T ZWSTT_DRCT.agIgnEthDrctStrtOffs2_GM ZWSTT_DRCT.agIgnEthDrctStrtOffs_GM ZWSTT_DRCT.agIgnEthDrctStrt_GM ZWSTT_FOLW.agIgnStrtOffsP_GM ZWSTT_FOLW.agIgnStrtOffsT_GM ZWSTT_FOLW.agIgnStrtOffs_GM ZWSTT_FOLW.facAgIgnStrtOffs_GT ZWSTT_HIP.agIgnStrtEth_GM ZWSTT_HIP.agIgnStrt_GM ZWSTT_LOP.agIgnStrtEth_GM ZWSTT_LOP.agIgnStrt_GM /end DEF_CHARACTERISTIC
 /begin IN_MEASUREMENT AirMod_ratChrgAirCyl anztib_msg APP_r B_dirst_msg B_sthdr_msg EngStrt_flgStrtEndIgn EngStrt_stStrtReq EngStrt_tStrtCoor Epm_nEng FfPrm_facEthCurr Gbx_trqActClth IntkAirT_tIntkMnfld PEnv_facCorrAlti wdirst_msg zzaehl_msg /end IN_MEASUREMENT
 /begin OUT_MEASUREMENT zwstt_msg /end OUT_MEASUREMENT
 /begin LOC_MEASUREMENT EngStrt_agIgnStrtCorrOffsLoc EngStrt_idxClassSelnAgIgnLoc ZWSTT_COM.agIgnCoMStrt ZWSTT_COMWAITSTRTR.agIgnCoMStrt ZWSTT_CORR.agIgnStrtCorrOffs ZWSTT_CORR_2.agIgnStrtCorrOffs ZWSTT_DRCT.agIgnDrctStrt ZWSTT_FOLW.agIgnStrtOffs ZWSTT_HIP.agIgnStrtBas ZWSTT_LOP.agIgnStrtBas /end LOC_MEASUREMENT
 FUNCTION_VERSION "12.10.0_2.6.0" /end FUNCTION
/begin FUNCTION ZWSYNVHE "7.2.0     synchronization of ignition angle calculation for variable inlet valve lift" /begin DEF_CHARACTERISTIC DVHEGOFF DVHEKOFF IgCtl_nrSegIntkVlvlftSwtDly_C /end DEF_CHARACTERISTIC
 /begin IN_MEASUREMENT AirMod_ratChrgAirCyl B_rlvheg_msg drldvls_w_msg EngStrt_flgStrtEndIgn igctl_ovl_u8 VlvLft_flgCoornStrtofSwt VlvLft_nrSegSwtIntk_msg /end IN_MEASUREMENT
 /begin OUT_MEASUREMENT B_zwsyn IgCtl_flgIntkVlvlftSwtDly Ign_bVlvLInNxtCmbs Ign_bVlvLInNxtIAs Ign_flgIAmapsyn Ign_ratChrgAirCyl Ign_ratChrgAirCylLoR Ign_stVlvLInIA /end OUT_MEASUREMENT
 FUNCTION_VERSION "7.2.0" /end FUNCTION
/begin FUNCTION ZWWL "20.0.0_1.2.0Ignition during warm-up"
 /begin DEF_CHARACTERISTIC EngStrt_diaEngWrmUpEth_M EngStrt_diaTDurgWrmUp_M EngStrt_facDeltaIgnAgEth_M EngStrt_facDeltaIgnAgHSPEth_M EngStrt_facDeltaIgnAgHSP_M EngStrt_facDeltaIgnAgVlvlftSpclEth_M EngStrt_facDeltaIgnAgVlvlftSpcl_M EngStrt_facDeltaIgnAgVlvlftStdEth_M EngStrt_facDeltaIgnAgVlvlftStd_M EngStrt_facDeltaIgnAg_M EngStrt_facIpoEth_CUR EngStrt_facIpoVlvlftStdEth_CUR EngStrt_selTForIgnDurgWrmUp_C /end DEF_CHARACTERISTIC
 /begin IN_MEASUREMENT B_vheg_msg CEngDsT_t CoEOM_flgHsp Epm_nEng FfPrm_facEthCurr IntkAirT_tAirFltDs IntkAirT_tIntkMnfld IntkAirT_tThrVlvUs rl_w_msg SyC_stSub tans_msg /end IN_MEASUREMENT
 /begin OUT_MEASUREMENT dzwwl_msg EngStrt_diaWrmUp /end OUT_MEASUREMENT
 /begin LOC_MEASUREMENT EngStrt_diaTDurgWrmUp EngStrt_facIpoEthLoc EngStrt_facIpoVlvlftStdEthLoc EngStrt_selTForIgnDurgWrmUp /end LOC_MEASUREMENT
 FUNCTION_VERSION "20.0.0_1.2.0" /end FUNCTION
/begin COMPU_METHOD AngleCrS "" RAT_FUNC "%6.4" "deg CrS" COEFFS 0 45.5111111111 0 0 0 1 /end COMPU_METHOD
/begin COMPU_METHOD B_TRUE "" TAB_VERB "%6.3" "" COMPU_TAB_REF B_TRUE /end COMPU_METHOD
/begin COMPU_VTAB B_TRUE "" TAB_VERB 2 0 "FALSE" 1 "TRUE" /end COMPU_VTAB
/begin COMPU_METHOD CoEOM_stEomStgTot_VERB "" TAB_VERB "%6.3" "-" COMPU_TAB_REF CoEOM_stEomStgTot_VERB /end COMPU_METHOD
/begin COMPU_VTAB CoEOM_stEomStgTot_VERB "" TAB_VERB 513 0 "Base_HOM-SNGL_FullLft" 1 "Base_HOM_FullLft" 2 "Base_HSP_FullLft" 3 "Base_HSPIC_FullLft" 4 "Base_HOM-SNGL_EIVC" 5 "Base_HOM_EIVC" 6 "Base_HSP_EIVC" 7 "Base_HSPIC_EIVC" 8 "n/a [00;08]" 9 "n/a [00;09]" 10 "n/a [00;10]" 11 "n/a [00;11]" 12 "n/a [00;12]" 13 "n/a [00;13]" 14 "n/a [00;14]" 15 "n/a [00;15]" 255 "No_Demand" 256 "WarmUp_HOM-SNGL_FullLft" 257 "WarmUp_HOM_FullLft" 258 "WarmUp_HSP_FullLft" 259 "WarmUp_HSPIC_FullLft" 260 "WarmUp_HOM-SNGL_EIVC" 261 "WarmUp_HOM_EIVC" 262 "WarmUp_HSP_EIVC" 263 "WarmUp_HSPIC_EIVC" 264 "n/a [01;08]" 265 "n/a [01;09]" 266 "n/a [01;10]" 267 "n/a [01;11]" 268 "n/a [01;12]" 269 "n/a [01;13]" 270 "n/a [01;14]" 271 "n/a [01;15]" 512 "CatHtg_HOM-SNGL_FullLft" 513 "CatHtg_HOM_FullLft" 514 "CatHtg_HSP_FullLft" 515 "CatHtg_HSPIC_FullLft" 516 "CatHtg_HOM-SNGL_EIVC" 517 "CatHtg_HOM_EIVC" 518 "CatHtg_HSP_EIVC" 519 "CatHtg_HSPIC_EIVC" 520 "n/a [02;08]" 521 "n/a [02;09]" 522 "n/a [02;10]" 523 "n/a [02;11]" 524 "n/a [02;12]" 525 "n/a [02;13]" 526 "n/a [02;14]" 527 "n/a [02;15]" 768 "Start_FullLft" 769 "n/a [03;01]" 770 "n/a [03;02]" 771 "n/a [03;03]" 772 "Start_EIVC" 773 "n/a [03;05]" 774 "n/a [03;06]" 775 "n/a [03;07]" 776 "n/a [03;08]" 777 "n/a [03;09]" 778 "n/a [03;10]" 779 "n/a [03;11]" 780 "n/a [03;12]" 781 "n/a [03;13]" 782 "n/a [03;14]" 783 "n/a [03;15]" 1024 "n/a [04;00]" 1025 "n/a [04;01]" 1026 "n/a [04;02]" 1027 "n/a [04;03]" 1028 "n/a [04;04]" 1029 "n/a [04;05]" 1030 "n/a [04;06]" 1031 "n/a [04;07]" 1032 "n/a [04;08]" 1033 "n/a [04;09]" 1034 "n/a [04;10]" 1035 "n/a [04;11]" 1036 "n/a [04;12]" 1037 "n/a [04;13]" 1038 "n/a [04;14]" 1039 "n/a [04;15]" 1280 "n/a [05;00]" 1281 "n/a [05;01]" 1282 "n/a [05;02]" 1283 "n/a [05;03]" 1284 "n/a [05;04]" 1285 "n/a [05;05]" 1286 "n/a [05;06]" 1287 "n/a [05;07]" 1288 "n/a [05;08]" 1289 "n/a [05;09]" 1290 "n/a [05;10]" 1291 "n/a [05;11]" 1292 "n/a [05;12]" 1293 "n/a [05;13]" 1294 "n/a [05;14]" 1295 "n/a [05;15]" 1536 "n/a [06;00]" 1537 "n/a [06;01]" 1538 "n/a [06;02]" 1539 "n/a [06;03]" 1540 "n/a [06;04]" 1541 "n/a [06;05]" 1542 "n/a [06;06]" 1543 "n/a [06;07]" 1544 "n/a [06;08]" 1545 "n/a [06;09]" 1546 "n/a [06;10]" 1547 "n/a [06;11]" 1548 "n/a [06;12]" 1549 "n/a [06;13]" 1550 "n/a [06;14]" 1551 "n/a [06;15]" 1792 "n/a [07;00]" 1793 "n/a [07;01]" 1794 "n/a [07;02]" 1795 "n/a [07;03]" 1796 "n/a [07;04]" 1797 "n/a [07;05]" 1798 "n/a [07;06]" 1799 "n/a [07;07]" 1800 "n/a [07;08]" 1801 "n/a [07;09]" 1802 "n/a [07;10]" 1803 "n/a [07;11]" 1804 "n/a [07;12]" 1805 "n/a [07;13]" 1806 "n/a [07;14]" 1807 "n/a [07;15]" 2048 "n/a [08;00]" 2049 "n/a [08;01]" 2050 "n/a [08;02]" 2051 "n/a [08;03]" 2052 "n/a [08;04]" 2053 "n/a [08;05]" 2054 "n/a [08;06]" 2055 "n/a [08;07]" 2056 "n/a [08;08]" 2057 "n/a [08;09]" 2058 "n/a [08;10]" 2059 "n/a [08;11]" 2060 "n/a [08;12]" 2061 "n/a [08;13]" 2062 "n/a [08;14]" 2063 "n/a [08;15]" 2304 "n/a [09;00]" 2305 "n/a [09;01]" 2306 "n/a [09;02]" 2307 "n/a [09;03]" 2308 "n/a [09;04]" 2309 "n/a [09;05]" 2310 "n/a [09;06]" 2311 "n/a [09;07]" 2312 "n/a [09;08]" 2313 "n/a [09;09]" 2314 "n/a [09;10]" 2315 "n/a [09;11]" 2316 "n/a [09;12]" 2317 "n/a [09;13]" 2318 "n/a [09;14]" 2319 "n/a [09;15]" 2560 "n/a [10;00]" 2561 "n/a [10;01]" 2562 "n/a [10;02]" 2563 "n/a [10;03]" 2564 "n/a [10;04]" 2565 "n/a [10;05]" 2566 "n/a [10;06]" 2567 "n/a [10;07]" 2568 "n/a [10;08]" 2569 "n/a [10;09]" 2570 "n/a [10;10]" 2571 "n/a [10;11]" 2572 "n/a [10;12]" 2573 "n/a [10;13]" 2574 "n/a [10;14]" 2575 "n/a [10;15]" 2816 "n/a [11;00]" 2817 "n/a [11;01]" 2818 "n/a [11;02]" 2819 "n/a [11;03]" 2820 "n/a [11;04]" 2821 "n/a [11;05]" 2822 "n/a [11;06]" 2823 "n/a [11;07]" 2824 "n/a [11;08]" 2825 "n/a [11;09]" 2826 "n/a [11;10]" 2827 "n/a [11;11]" 2828 "n/a [11;12]" 2829 "n/a [11;13]" 2830 "n/a [11;14]" 2831 "n/a [11;15]" 3072 "n/a [12;00]" 3073 "n/a [12;01]" 3074 "n/a [12;02]" 3075 "n/a [12;03]" 3076 "n/a [12;04]" 3077 "n/a [12;05]" 3078 "n/a [12;06]" 3079 "n/a [12;07]" 3080 "n/a [12;08]" 3081 "n/a [12;09]" 3082 "n/a [12;10]" 3083 "n/a [12;11]" 3084 "n/a [12;12]" 3085 "n/a [12;13]" 3086 "n/a [12;14]" 3087 "n/a [12;15]" 3328 "n/a [13;00]" 3329 "n/a [13;01]" 3330 "n/a [13;02]" 3331 "n/a [13;03]" 3332 "n/a [13;04]" 3333 "n/a [13;05]" 3334 "n/a [13;06]" 3335 "n/a [13;07]" 3336 "n/a [13;08]" 3337 "n/a [13;09]" 3338 "n/a [13;10]" 3339 "n/a [13;11]" 3340 "n/a [13;12]" 3341 "n/a [13;13]" 3342 "n/a [13;14]" 3343 "n/a [13;15]" 3584 "n/a [14;00]" 3585 "n/a [14;01]" 3586 "n/a [14;02]" 3587 "n/a [14;03]" 3588 "n/a [14;04]" 3589 "n/a [14;05]" 3590 "n/a [14;06]" 3591 "n/a [14;07]" 3592 "n/a [14;08]" 3593 "n/a [14;09]" 3594 "n/a [14;10]" 3595 "n/a [14;11]" 3596 "n/a [14;12]" 3597 "n/a [14;13]" 3598 "n/a [14;14]" 3599 "n/a [14;15]" 3840 "n/a [15;00]" 3841 "n/a [15;01]" 3842 "n/a [15;02]" 3843 "n/a [15;03]" 3844 "n/a [15;04]" 3845 "n/a [15;05]" 3846 "n/a [15;06]" 3847 "n/a [15;07]" 3848 "n/a [15;08]" 3849 "n/a [15;09]" 3850 "n/a [15;10]" 3851 "n/a [15;11]" 3852 "n/a [15;12]" 3853 "n/a [15;13]" 3854 "n/a [15;14]" 3855 "n/a [15;15]" 4096 "n/a [16;00]" 4097 "n/a [16;01]" 4098 "n/a [16;02]" 4099 "n/a [16;03]" 4100 "n/a [16;04]" 4101 "n/a [16;05]" 4102 "n/a [16;06]" 4103 "n/a [16;07]" 4104 "n/a [16;08]" 4105 "n/a [16;09]" 4106 "n/a [16;10]" 4107 "n/a [16;11]" 4108 "n/a [16;12]" 4109 "n/a [16;13]" 4110 "n/a [16;14]" 4111 "n/a [16;15]" 4352 "n/a [17;00]" 4353 "n/a [17;01]" 4354 "n/a [17;02]" 4355 "n/a [17;03]" 4356 "n/a [17;04]" 4357 "n/a [17;05]" 4358 "n/a [17;06]" 4359 "n/a [17;07]" 4360 "n/a [17;08]" 4361 "n/a [17;09]" 4362 "n/a [17;10]" 4363 "n/a [17;11]" 4364 "n/a [17;12]" 4365 "n/a [17;13]" 4366 "n/a [17;14]" 4367 "n/a [17;15]" 4608 "n/a [18;00]" 4609 "n/a [18;01]" 4610 "n/a [18;02]" 4611 "n/a [18;03]" 4612 "n/a [18;04]" 4613 "n/a [18;05]" 4614 "n/a [18;06]" 4615 "n/a [18;07]" 4616 "n/a [18;08]" 4617 "n/a [18;09]" 4618 "n/a [18;10]" 4619 "n/a [18;11]" 4620 "n/a [18;12]" 4621 "n/a [18;13]" 4622 "n/a [18;14]" 4623 "n/a [18;15]" 4864 "n/a [19;00]" 4865 "n/a [19;01]" 4866 "n/a [19;02]" 4867 "n/a [19;03]" 4868 "n/a [19;04]" 4869 "n/a [19;05]" 4870 "n/a [19;06]" 4871 "n/a [19;07]" 4872 "n/a [19;08]" 4873 "n/a [19;09]" 4874 "n/a [19;10]" 4875 "n/a [19;11]" 4876 "n/a [19;12]" 4877 "n/a [19;13]" 4878 "n/a [19;14]" 4879 "n/a [19;15]" 5120 "n/a [20;00]" 5121 "n/a [20;01]" 5122 "n/a [20;02]" 5123 "n/a [20;03]" 5124 "n/a [20;04]" 5125 "n/a [20;05]" 5126 "n/a [20;06]" 5127 "n/a [20;07]" 5128 "n/a [20;08]" 5129 "n/a [20;09]" 5130 "n/a [20;10]" 5131 "n/a [20;11]" 5132 "n/a [20;12]" 5133 "n/a [20;13]" 5134 "n/a [20;14]" 5135 "n/a [20;15]" 5376 "n/a [21;00]" 5377 "n/a [21;01]" 5378 "n/a [21;02]" 5379 "n/a [21;03]" 5380 "n/a [21;04]" 5381 "n/a [21;05]" 5382 "n/a [21;06]" 5383 "n/a [21;07]" 5384 "n/a [21;08]" 5385 "n/a [21;09]" 5386 "n/a [21;10]" 5387 "n/a [21;11]" 5388 "n/a [21;12]" 5389 "n/a [21;13]" 5390 "n/a [21;14]" 5391 "n/a [21;15]" 5632 "n/a [22;00]" 5633 "n/a [22;01]" 5634 "n/a [22;02]" 5635 "n/a [22;03]" 5636 "n/a [22;04]" 5637 "n/a [22;05]" 5638 "n/a [22;06]" 5639 "n/a [22;07]" 5640 "n/a [22;08]" 5641 "n/a [22;09]" 5642 "n/a [22;10]" 5643 "n/a [22;11]" 5644 "n/a [22;12]" 5645 "n/a [22;13]" 5646 "n/a [22;14]" 5647 "n/a [22;15]" 5888 "n/a [23;00]" 5889 "n/a [23;01]" 5890 "n/a [23;02]" 5891 "n/a [23;03]" 5892 "n/a [23;04]" 5893 "n/a [23;05]" 5894 "n/a [23;06]" 5895 "n/a [23;07]" 5896 "n/a [23;08]" 5897 "n/a [23;09]" 5898 "n/a [23;10]" 5899 "n/a [23;11]" 5900 "n/a [23;12]" 5901 "n/a [23;13]" 5902 "n/a [23;14]" 5903 "n/a [23;15]" 6144 "n/a [24;00]" 6145 "n/a [24;01]" 6146 "n/a [24;02]" 6147 "n/a [24;03]" 6148 "n/a [24;04]" 6149 "n/a [24;05]" 6150 "n/a [24;06]" 6151 "n/a [24;07]" 6152 "n/a [24;08]" 6153 "n/a [24;09]" 6154 "n/a [24;10]" 6155 "n/a [24;11]" 6156 "n/a [24;12]" 6157 "n/a [24;13]" 6158 "n/a [24;14]" 6159 "n/a [24;15]" 6400 "n/a [25;00]" 6401 "n/a [25;01]" 6402 "n/a [25;02]" 6403 "n/a [25;03]" 6404 "n/a [25;04]" 6405 "n/a [25;05]" 6406 "n/a [25;06]" 6407 "n/a [25;07]" 6408 "n/a [25;08]" 6409 "n/a [25;09]" 6410 "n/a [25;10]" 6411 "n/a [25;11]" 6412 "n/a [25;12]" 6413 "n/a [25;13]" 6414 "n/a [25;14]" 6415 "n/a [25;15]" 6656 "n/a [26;00]" 6657 "n/a [26;01]" 6658 "n/a [26;02]" 6659 "n/a [26;03]" 6660 "n/a [26;04]" 6661 "n/a [26;05]" 6662 "n/a [26;06]" 6663 "n/a [26;07]" 6664 "n/a [26;08]" 6665 "n/a [26;09]" 6666 "n/a [26;10]" 6667 "n/a [26;11]" 6668 "n/a [26;12]" 6669 "n/a [26;13]" 6670 "n/a [26;14]" 6671 "n/a [26;15]" 6912 "n/a [27;00]" 6913 "n/a [27;01]" 6914 "n/a [27;02]" 6915 "n/a [27;03]" 6916 "n/a [27;04]" 6917 "n/a [27;05]" 6918 "n/a [27;06]" 6919 "n/a [27;07]" 6920 "n/a [27;08]" 6921 "n/a [27;09]" 6922 "n/a [27;10]" 6923 "n/a [27;11]" 6924 "n/a [27;12]" 6925 "n/a [27;13]" 6926 "n/a [27;14]" 6927 "n/a [27;15]" 7168 "n/a [28;00]" 7169 "n/a [28;01]" 7170 "n/a [28;02]" 7171 "n/a [28;03]" 7172 "n/a [28;04]" 7173 "n/a [28;05]" 7174 "n/a [28;06]" 7175 "n/a [28;07]" 7176 "n/a [28;08]" 7177 "n/a [28;09]" 7178 "n/a [28;10]" 7179 "n/a [28;11]" 7180 "n/a [28;12]" 7181 "n/a [28;13]" 7182 "n/a [28;14]" 7183 "n/a [28;15]" 7424 "n/a [29;00]" 7425 "n/a [29;01]" 7426 "n/a [29;02]" 7427 "n/a [29;03]" 7428 "n/a [29;04]" 7429 "n/a [29;05]" 7430 "n/a [29;06]" 7431 "n/a [29;07]" 7432 "n/a [29;08]" 7433 "n/a [29;09]" 7434 "n/a [29;10]" 7435 "n/a [29;11]" 7436 "n/a [29;12]" 7437 "n/a [29;13]" 7438 "n/a [29;14]" 7439 "n/a [29;15]" 7680 "n/a [30;00]" 7681 "n/a [30;01]" 7682 "n/a [30;02]" 7683 "n/a [30;03]" 7684 "n/a [30;04]" 7685 "n/a [30;05]" 7686 "n/a [30;06]" 7687 "n/a [30;07]" 7688 "n/a [30;08]" 7689 "n/a [30;09]" 7690 "n/a [30;10]" 7691 "n/a [30;11]" 7692 "n/a [30;12]" 7693 "n/a [30;13]" 7694 "n/a [30;14]" 7695 "n/a [30;15]" 7936 "n/a [31;00]" 7937 "n/a [31;01]" 7938 "n/a [31;02]" 7939 "n/a [31;03]" 7940 "n/a [31;04]" 7941 "n/a [31;05]" 7942 "n/a [31;06]" 7943 "n/a [31;07]" 7944 "n/a [31;08]" 7945 "n/a [31;09]" 7946 "n/a [31;10]" 7947 "n/a [31;11]" 7948 "n/a [31;12]" 7949 "n/a [31;13]" 7950 "n/a [31;14]" 7951 "n/a [31;15]" /end COMPU_VTAB
/begin COMPU_METHOD dez "" RAT_FUNC "%6.2" "" COEFFS 0 1 0 0 0 1 /end COMPU_METHOD
/begin COMPU_METHOD EngN "" RAT_FUNC "%6.3" "rpm" COEFFS 0 2 0 0 0 1 /end COMPU_METHOD
/begin COMPU_METHOD EngN_LRes "" RAT_FUNC "%6.1" "rpm" COEFFS 0 0.025 0 0 0 1 /end COMPU_METHOD
/begin COMPU_METHOD ENGSTRT_AGIGNCOMSTRT_SET_COMPU_VERB "" TAB_VERB "%6.3" "-" COMPU_TAB_REF ENGSTRT_AGIGNCOMSTRT_SET_COMPU_VERB /end COMPU_METHOD
/begin COMPU_VTAB ENGSTRT_AGIGNCOMSTRT_SET_COMPU_VERB "" TAB_VERB 2 0 "ZWSTT_COM" 1 "ZWSTT_COMWAITSTRTR" /end COMPU_VTAB
/begin COMPU_METHOD ENGSTRT_AGIGNDRCTSTRT_SET_COMPU_VERB "" TAB_VERB "%6.3" "-" COMPU_TAB_REF ENGSTRT_AGIGNDRCTSTRT_SET_COMPU_VERB /end COMPU_METHOD
/begin COMPU_VTAB ENGSTRT_AGIGNDRCTSTRT_SET_COMPU_VERB "" TAB_VERB 1 0 "ZWSTT_DRCT" /end COMPU_VTAB
/begin COMPU_METHOD ENGSTRT_AGIGNSTRTCORROFFS_SET_COMPU_VERB "" TAB_VERB "%6.3" "-" COMPU_TAB_REF ENGSTRT_AGIGNSTRTCORROFFS_SET_COMPU_VERB /end COMPU_METHOD
/begin COMPU_VTAB ENGSTRT_AGIGNSTRTCORROFFS_SET_COMPU_VERB "" TAB_VERB 2 0 "ZWSTT_CORR" 1 "ZWSTT_CORR_2" /end COMPU_VTAB
/begin COMPU_METHOD ENGSTRT_AGIGNSTRTOFFS_SET_COMPU_VERB "" TAB_VERB "%6.3" "-" COMPU_TAB_REF ENGSTRT_AGIGNSTRTOFFS_SET_COMPU_VERB /end COMPU_METHOD
/begin COMPU_VTAB ENGSTRT_AGIGNSTRTOFFS_SET_COMPU_VERB "" TAB_VERB 1 0 "ZWSTT_FOLW" /end COMPU_VTAB
/begin COMPU_METHOD ENGSTRT_AGIGNSTRT_SET_COMPU_VERB "" TAB_VERB "%6.3" "-" COMPU_TAB_REF ENGSTRT_AGIGNSTRT_SET_COMPU_VERB /end COMPU_METHOD
/begin COMPU_VTAB ENGSTRT_AGIGNSTRT_SET_COMPU_VERB "" TAB_VERB 3 0 "ZWSTT_LOP" 1 "ZWSTT_FOLW" 2 "ZWSTT_HIP" /end COMPU_VTAB
/begin COMPU_METHOD ENGSTRT_STSTRTREQ_SET_COMPU_VERB "" TAB_VERB "%6.3" "-" COMPU_TAB_REF ENGSTRT_STSTRTREQ_SET_COMPU_VERB /end COMPU_METHOD
/begin COMPU_VTAB ENGSTRT_STSTRTREQ_SET_COMPU_VERB "" TAB_VERB 19 0 "ENGSTRT_NOSTRT" 1024 "ENGSTRT_LOP" 1028 "ENGSTRT_EOL" 1029 "ENGSTRT_PREINJ" 1031 "ENGSTRT_HIPEOL" 8192 "ENGSTRT_COMRUNNG" 8193 "ENGSTRT_COMSTRTG" 8194 "ENGSTRT_COMWAITSTRTR" 16384 "ENGSTRT_FOLW" 16385 "ENGSTRT_STRTR_DRCT" 32768 "ENGSTRT_HIPCOLD" 32769 "ENGSTRT_HIPMID" 32770 "ENGSTRT_HIPWRM" 256 "ENGSTRT_FOLWWRM" 257 "ENGSTRT_FOLWMID" 258 "ENGSTRT_FOLWCOLD" 259 "ENGSTRT_STRTR_DRCTWRM" 260 "ENGSTRT_STRTR_DRCTMID" 261 "ENGSTRT_STRTR_DRCTCOLD" /end COMPU_VTAB
/begin COMPU_METHOD fak_q0p0392 "" RAT_FUNC "%6.4" "" COEFFS 0 255 0 0 0 10 /end COMPU_METHOD
/begin COMPU_METHOD fak_sb_b16 "" RAT_FUNC "%6.3" "-" COEFFS 0 256 0 0 0 32 /end COMPU_METHOD
/begin COMPU_METHOD fak_ub_b1 "" RAT_FUNC "%6.4" "-" COEFFS 0 256 0 0 0 1 /end COMPU_METHOD
/begin COMPU_METHOD fak_ub_b2 "" RAT_FUNC "%8.5" "-" COEFFS 0 256 0 0 0 2 /end COMPU_METHOD
/begin COMPU_METHOD fak_ub_b8 "" RAT_FUNC "%6.4" "-" COEFFS 0 256 0 0 0 8 /end COMPU_METHOD
/begin COMPU_METHOD fak_uw_b1 "" RAT_FUNC "%7.6" "-" COEFFS 0 65536 0 0 0 1 /end COMPU_METHOD
/begin COMPU_METHOD fak_uw_b16 "" RAT_FUNC "%6.5" "-" COEFFS 0 65536 0 0 0 16 /end COMPU_METHOD
/begin COMPU_METHOD fak_uw_b2 "" RAT_FUNC "%7.6" "-" COEFFS 0 65536 0 0 0 2 /end COMPU_METHOD
/begin COMPU_METHOD fak_uw_b4 "" RAT_FUNC "%7.6" "-" COEFFS 0 65536 0 0 0 4 /end COMPU_METHOD
/begin COMPU_METHOD fak_uw_b512 "" RAT_FUNC "%6.4" "-" COEFFS 0 65536 0 0 0 512 /end COMPU_METHOD
/begin COMPU_METHOD kw_q0p0156 "" RAT_FUNC "%6.4" "Grad KW" COEFFS 0 64 0 0 0 1 /end COMPU_METHOD
/begin COMPU_METHOD kw_q0p1 "" RAT_FUNC "%6.3" "Grad KW" COEFFS 0 10 0 0 0 1 /end COMPU_METHOD
/begin COMPU_METHOD kw_q0p75 "" RAT_FUNC "%6.3" "Grad KW" COEFFS 0 4 0 0 0 3 /end COMPU_METHOD
/begin COMPU_METHOD kw_q2 "" RAT_FUNC "%6.2" "deg KW" COEFFS 0 1 0 0 0 2 /end COMPU_METHOD
/begin COMPU_METHOD nmot_ub_q40 "" RAT_FUNC "%6.1" "1/min" COEFFS 0 1 0 0 0 40 /end COMPU_METHOD
/begin COMPU_METHOD nmot_uw_q0p25 "" RAT_FUNC "%6.3" "1/min" COEFFS 0 1 0 0 0 0.25 /end COMPU_METHOD
/begin COMPU_METHOD OneToOne "" RAT_FUNC "%6.2" "-" COEFFS 0 1 0 0 0 1 /end COMPU_METHOD
/begin COMPU_METHOD Prc "" RAT_FUNC "%6.4" "%" COEFFS 0 81.92 0 0 0 1 /end COMPU_METHOD
/begin COMPU_METHOD Prc_Fact256 "" RAT_FUNC "%6.4" "%" COEFFS 0 256 0 0 0 1 /end COMPU_METHOD
/begin COMPU_METHOD p_uw_q0p039 "" RAT_FUNC "%6.4" "hPa" COEFFS 0 256 0 0 0 10 /end COMPU_METHOD
/begin COMPU_METHOD p_uw_q0p078 "" RAT_FUNC "%6.4" "hPa" COEFFS 0 256 0 0 0 20 /end COMPU_METHOD
/begin COMPU_METHOD RBPtCel_p_0p002_1 "" RAT_FUNC "%6.4" "MPa" COEFFS 0 1000 0 0 0 2 /end COMPU_METHOD
/begin COMPU_METHOD relDK_q0p390631 "" RAT_FUNC "%6.3" "%" COEFFS 0 65535 0 0 0 25600 /end COMPU_METHOD
/begin COMPU_METHOD relDK_uw_b100 "" RAT_FUNC "%6.4" "%DK" COEFFS 0 65535 0 0 0 100 /end COMPU_METHOD
/begin COMPU_METHOD rel_q0p0234 "" RAT_FUNC "%6.4" "%" COEFFS 0 128 0 0 0 3 /end COMPU_METHOD
/begin COMPU_METHOD rel_q0p02344 "" RAT_FUNC "%6.4" "%" COEFFS 0 32 0 0 0 0.75 /end COMPU_METHOD
/begin COMPU_METHOD rel_q0p75 "" RAT_FUNC "%6.3" "%" COEFFS 0 4 0 0 0 3 /end COMPU_METHOD
/begin COMPU_METHOD rel_uw_b100 "" RAT_FUNC "%6.4" "%" COEFFS 0 65536 0 0 0 100 /end COMPU_METHOD
/begin COMPU_METHOD rel_uw_b3072 "" RAT_FUNC "%6.4" "%" COEFFS 0 65536 0 0 0 3072 /end COMPU_METHOD
/begin COMPU_METHOD rel_uw_q0p0234 "" RAT_FUNC "%6.4" "%" COEFFS 0 32 0 0 0 0.75 /end COMPU_METHOD
/begin COMPU_METHOD t100msxs_uw_b6553p5 "" RAT_FUNC "%6.3" "s" COEFFS 0 1 0 0 0 0.1 /end COMPU_METHOD
/begin COMPU_METHOD Temp_Cels "" RAT_FUNC "%6.1" "deg C" COEFFS 0 10 2731.4 0 0 1 /end COMPU_METHOD
/begin COMPU_METHOD temp_q0p1_K "" RAT_FUNC "%6.3" "K" COEFFS 0 10 0 0 0 1 /end COMPU_METHOD
/begin COMPU_METHOD temp_ub_q0p75_o48 "" RAT_FUNC "%6.2" "Grad C" COEFFS 0 1 48 0 0 0.75 /end COMPU_METHOD
/begin COMPU_METHOD Trq "" RAT_FUNC "%6.3" "Nm" COEFFS 0 10 0 0 0 1 /end COMPU_METHOD
/begin COMPU_METHOD t_q0p001_ms "" RAT_FUNC "%6.5" "ms" COEFFS 0 1 0 0 0 0.001 /end COMPU_METHOD
/begin COMPU_METHOD t_q0p01 "" RAT_FUNC "%6.4" "s" COEFFS 0 100 0 0 0 1 /end COMPU_METHOD
/begin COMPU_METHOD t_q0p1 "" RAT_FUNC "%6.3" "s" COEFFS 0 10 0 0 0 1 /end COMPU_METHOD
/begin COMPU_METHOD Vel "" RAT_FUNC "%6.4" "km/h" COEFFS 0 100 0 0 0 1 /end COMPU_METHOD
/begin COMPU_METHOD vfzg_ub_q1p25 "" RAT_FUNC "%6.2" "km/h" COEFFS 0 1 0 0 0 1.25 /end COMPU_METHOD
/begin COMPU_METHOD VLVLFT_TYPINTK_SC_Compu "" TAB_VERB "%6.3" "" COMPU_TAB_REF VLVLFT_TYPINTK_SC_Compu /end COMPU_METHOD
/begin COMPU_VTAB VLVLFT_TYPINTK_SC_Compu "" TAB_VERB 8 0 "NoLift" 1 "ValveTronic" 2 "VarioCam+" 3 "AVS" 4 "VTEC" 5 "UniAir" 6 "CamTronic" 7 "UniValve" /end COMPU_VTAB
/begin COMPU_METHOD VLVLFT_TYPOUTL_SC_Compu "" TAB_VERB "%6.3" "" COMPU_TAB_REF VLVLFT_TYPOUTL_SC_Compu /end COMPU_METHOD
/begin COMPU_VTAB VLVLFT_TYPOUTL_SC_Compu "" TAB_VERB 8 0 "NoLift" 1 "ValveTronic" 2 "VarioCam+" 3 "AVS" 4 "VTEC" 5 "UniAir" 6 "CamTronic" 7 "UniValve" /end COMPU_VTAB
/begin COMPU_METHOD VLVLFT_UNIAIRINTK_SC_Compu "" TAB_VERB "%6.3" "" COMPU_TAB_REF VLVLFT_UNIAIRINTK_SC_Compu /end COMPU_METHOD
/begin COMPU_VTAB VLVLFT_UNIAIRINTK_SC_Compu "" TAB_VERB 2 0 "False" 1 "True" /end COMPU_VTAB
/begin COMPU_METHOD VMSI_RAMPENDINTV_SC_Compu "" TAB_VERB "%6.3" "" COMPU_TAB_REF VMSI_RAMPENDINTV_SC_Compu /end COMPU_METHOD
/begin COMPU_VTAB VMSI_RAMPENDINTV_SC_Compu "" TAB_VERB 2 0 "False" 1 "True" /end COMPU_VTAB
/begin COMPU_METHOD VNQ6040_SC_Compu "" TAB_VERB "%6.3" "" COMPU_TAB_REF VNQ6040_SC_Compu /end COMPU_METHOD
/begin COMPU_VTAB VNQ6040_SC_Compu "" TAB_VERB 11 0 "NoneASIC" 1 "OneASIC" 2 "TwoASICs" 3 "ThreeASICs" 4 "FourASICs" 5 "FiveASICs" 6 "SixASICs" 7 "SevenASICs" 8 "EightASICs" 9 "NineASICs" 10 "TenASICs" /end COMPU_VTAB
/begin COMPU_METHOD Vol1 "" RAT_FUNC "%9.8" "l" COEFFS 0 3600000 0 0 0 1 /end COMPU_METHOD
/begin COMPU_METHOD volAdd_ml "" RAT_FUNC "%6.3" "ml" COEFFS 0 10 0 0 0 1 /end COMPU_METHOD
/begin COMPU_METHOD volAdd_ml_fine "" RAT_FUNC "%6.5" "ml" COEFFS 0 1000 0 0 0 1 /end COMPU_METHOD
/begin COMPU_METHOD VolEngCap_COMPU "" RAT_FUNC "%9.8" "m^3" COEFFS 0 1000000 0 0 0 1 /end COMPU_METHOD
/begin COMPU_METHOD VolFine "" RAT_FUNC "%7.6" "m^3" COEFFS 0 10000 0 0 0 1 /end COMPU_METHOD
/begin COMPU_METHOD VoltPres "" RAT_FUNC "%6.3" "mV*hPa" COEFFS 0 10 0 0 0 1 /end COMPU_METHOD
/begin COMPU_METHOD VoltPres_HiRes "" RAT_FUNC "%6.4" "mV*hPa" COEFFS 0 100 0 0 0 1 /end COMPU_METHOD
/begin COMPU_METHOD Volt_Batt "" RAT_FUNC "%6.1" "mV" COEFFS 0 0.05 0 0 0 1 /end COMPU_METHOD
/begin COMPU_METHOD Volt_FnReso1 "" RAT_FUNC "%6.3" "mV" COEFFS 0 10 0 0 0 1 /end COMPU_METHOD
/begin COMPU_METHOD Volt_FnReso2 "" RAT_FUNC "%6.5" "mV" COEFFS 0 1000 0 0 0 1 /end COMPU_METHOD
/begin COMPU_METHOD Volt_per_Pres "" RAT_FUNC "%6.5" "mV/hPa" COEFFS 0 1000 0 0 0 1 /end COMPU_METHOD
/begin COMPU_METHOD Volt_q0p002_COMPU "" RAT_FUNC "%6.4" "V" COEFFS 0 500 0 0 0 1 /end COMPU_METHOD
/begin COMPU_METHOD Volt_Sq_HiRes "" RAT_FUNC "%6.3" "mV*mV" COEFFS 0 10 0 0 0 1 /end COMPU_METHOD
/begin COMPU_METHOD Vol_NSC "" RAT_FUNC "%7.6" "L" COEFFS 0 10000 0 0 0 1 /end COMPU_METHOD
/begin COMPU_METHOD vol_q7p6294Em8_l "" RAT_FUNC "%10.9" "L" COEFFS 0 13107200 0 0 0 1 /end COMPU_METHOD
/begin COMPU_METHOD VSWVLVI_TYPAVL_SC_Compu "" TAB_VERB "%6.3" "" COMPU_TAB_REF VSWVLVI_TYPAVL_SC_Compu /end COMPU_METHOD
/begin COMPU_VTAB VSWVLVI_TYPAVL_SC_Compu "" TAB_VERB 2 0 "False" 1 "True" /end COMPU_VTAB
/begin COMPU_METHOD VSWVLV_AIRACTR_SC_Compu "" TAB_VERB "%6.3" "" COMPU_TAB_REF VSWVLV_AIRACTR_SC_Compu /end COMPU_METHOD
/begin COMPU_VTAB VSWVLV_AIRACTR_SC_Compu "" TAB_VERB 2 0 "False" 1 "True" /end COMPU_VTAB
/begin COMPU_METHOD VSWVLV_TYPAVLCONVENTIONAL_SC_Compu "" TAB_VERB "%6.3" "" COMPU_TAB_REF VSWVLV_TYPAVLCONVENTIONAL_SC_Compu /end COMPU_METHOD
/begin COMPU_VTAB VSWVLV_TYPAVLCONVENTIONAL_SC_Compu "" TAB_VERB 2 0 "False" 1 "True" /end COMPU_VTAB
/begin COMPU_METHOD VVTDSLAVL_SC_Compu "" TAB_VERB "%6.3" "" COMPU_TAB_REF VVTDSLAVL_SC_Compu /end COMPU_METHOD
/begin COMPU_VTAB VVTDSLAVL_SC_Compu "" TAB_VERB 2 0 "Disabled" 1 "Enabled" /end COMPU_VTAB
/begin COMPU_METHOD VVTIDLEMOD_SC_Compu "" TAB_VERB "%6.3" "" COMPU_TAB_REF VVTIDLEMOD_SC_Compu /end COMPU_METHOD
/begin COMPU_VTAB VVTIDLEMOD_SC_Compu "" TAB_VERB 2 0 "False" 1 "True" /end COMPU_VTAB
/begin COMPU_METHOD WAHT_SY_Compu "" TAB_VERB "%6.3" "" COMPU_TAB_REF WAHT_SY_Compu /end COMPU_METHOD
/begin COMPU_VTAB WAHT_SY_Compu "" TAB_VERB 2 0 "FALSE" 1 "TRUE" /end COMPU_VTAB
/begin COMPU_METHOD WaterMsPrHr "" RAT_FUNC "%6.5" "Kg/h" COEFFS 0 1000 0 0 0 1 /end COMPU_METHOD
/begin COMPU_METHOD WDGS_CFGADPR_SC_Compu "" TAB_VERB "%6.3" "" COMPU_TAB_REF WDGS_CFGADPR_SC_Compu /end COMPU_METHOD
/begin COMPU_VTAB WDGS_CFGADPR_SC_Compu "" TAB_VERB 2 0 "False" 1 "True" /end COMPU_VTAB
/begin COMPU_METHOD WESDEM_SY_Compu "" TAB_VERB "%6.3" "" COMPU_TAB_REF WESDEM_SY_Compu /end COMPU_METHOD
/begin COMPU_VTAB WESDEM_SY_Compu "" TAB_VERB 2 0 "False" 1 "True" /end COMPU_VTAB
/begin COMPU_METHOD wink_q0p03125_deg "" RAT_FUNC "%6.4" "deg" COEFFS 0 32 0 0 0 1 /end COMPU_METHOD
/begin COMPU_METHOD WIPRIFTYP_SC_Compu "" TAB_VERB "%6.3" "" COMPU_TAB_REF WIPRIFTYP_SC_Compu /end COMPU_METHOD
/begin COMPU_VTAB WIPRIFTYP_SC_Compu "" TAB_VERB 5 0 "WIPRIFTYP_NON" 1 "WIPRIFTYP_DIG" 2 "WIPRIFTYP_ADC" 3 "WIPRIFTYP_MISC" 4 "WIPRIFTYP_BUS" /end COMPU_VTAB
/begin COMPU_METHOD WNTR_SY_Compu "" TAB_VERB "%6.3" "" COMPU_TAB_REF WNTR_SY_Compu /end COMPU_METHOD
/begin COMPU_VTAB WNTR_SY_Compu "" TAB_VERB 2 0 "False" 1 "True" /end COMPU_VTAB
/begin COMPU_METHOD WRMUPCSERS_SC_Compu "" TAB_VERB "%6.3" "" COMPU_TAB_REF WRMUPCSERS_SC_Compu /end COMPU_METHOD
/begin COMPU_VTAB WRMUPCSERS_SC_Compu "" TAB_VERB 2 0 "False" 1 "True" /end COMPU_VTAB
/begin COMPU_METHOD WTRCACT_TYPAVL_SC_Compu "" TAB_VERB "%6.3" "" COMPU_TAB_REF WTRCACT_TYPAVL_SC_Compu /end COMPU_METHOD
/begin COMPU_VTAB WTRCACT_TYPAVL_SC_Compu "" TAB_VERB 2 0 "False" 1 "True" /end COMPU_VTAB
/begin COMPU_METHOD WTRCOOLTP1_TYPAVL_SY_Compu "" TAB_VERB "%6.3" "" COMPU_TAB_REF WTRCOOLTP1_TYPAVL_SY_Compu /end COMPU_METHOD
/begin COMPU_VTAB WTRCOOLTP1_TYPAVL_SY_Compu "" TAB_VERB 2 0 "False" 1 "True" /end COMPU_VTAB
/begin COMPU_METHOD WTRCOOLTP_TYPAVL_SY_Compu "" TAB_VERB "%6.3" "" COMPU_TAB_REF WTRCOOLTP_TYPAVL_SY_Compu /end COMPU_METHOD
/begin COMPU_VTAB WTRCOOLTP_TYPAVL_SY_Compu "" TAB_VERB 2 0 "False" 1 "True" /end COMPU_VTAB
/begin COMPU_METHOD WTRINJSYS_SC_Compu "" TAB_VERB "%6.3" "" COMPU_TAB_REF WTRINJSYS_SC_Compu /end COMPU_METHOD
/begin COMPU_VTAB WTRINJSYS_SC_Compu "" TAB_VERB 3 0 "No_WtrInjSys" 1 "WtrInjSys_PWI" 2 "WtrInjSys_DWI" /end COMPU_VTAB
/begin COMPU_METHOD WTRPMP1_SC_Compu "" TAB_VERB "%6.3" "" COMPU_TAB_REF WTRPMP1_SC_Compu /end COMPU_METHOD
/begin COMPU_VTAB WTRPMP1_SC_Compu "" TAB_VERB 2 0 "False" 1 "True" /end COMPU_VTAB
/begin COMPU_METHOD WTRPMP2_SC_Compu "" TAB_VERB "%6.3" "" COMPU_TAB_REF WTRPMP2_SC_Compu /end COMPU_METHOD
/begin COMPU_VTAB WTRPMP2_SC_Compu "" TAB_VERB 2 0 "False" 1 "True" /end COMPU_VTAB
/begin COMPU_METHOD WTRPMP_VARNTYP_SC_Compu "" TAB_VERB "%6.3" "" COMPU_TAB_REF WTRPMP_VARNTYP_SC_Compu /end COMPU_METHOD
/begin COMPU_VTAB WTRPMP_VARNTYP_SC_Compu "" TAB_VERB 4 0 "None" 1 "SwaPmp_Demand" 2 "WtrPmp_Coorr" 3 "CustObject" /end COMPU_VTAB
/begin COMPU_METHOD XCORECDD_SC_Compu "" TAB_VERB "%6.3" "" COMPU_TAB_REF XCORECDD_SC_Compu /end COMPU_METHOD
/begin COMPU_VTAB XCORECDD_SC_Compu "" TAB_VERB 2 0 "False" 1 "True" /end COMPU_VTAB
/begin COMPU_METHOD XCPVERS_SC_Compu "" TAB_VERB "%6.3" "" COMPU_TAB_REF XCPVERS_SC_Compu /end COMPU_METHOD
/begin COMPU_VTAB XCPVERS_SC_Compu "" TAB_VERB 5 1 "XCP_1_0" 2 "XCP_1_1" 3 "XCP_1_2" 4 "XCP_1_3" 5 "XCP_1_4" /end COMPU_VTAB
/begin COMPU_METHOD XCP_SY_Compu "" TAB_VERB "%6.3" "" COMPU_TAB_REF XCP_SY_Compu /end COMPU_METHOD
/begin COMPU_VTAB XCP_SY_Compu "" TAB_VERB 2 0 "No XCP" 1 "XCP" /end COMPU_VTAB
/begin COMPU_METHOD XDI_SC_Compu "" TAB_VERB "%6.3" "" COMPU_TAB_REF XDI_SC_Compu /end COMPU_METHOD
/begin COMPU_VTAB XDI_SC_Compu "" TAB_VERB 2 0 "False" 1 "True" /end COMPU_VTAB
/begin COMPU_METHOD zk100msxs_ub_b25p5 "" RAT_FUNC "%6.3" "s" COEFFS 0 0 256 0 10 0 /end COMPU_METHOD
/begin COMPU_METHOD zk100msxs_uw_b6553p6 "" RAT_FUNC "%6.1" "s" COEFFS 0 0 65536 0 10 0 /end COMPU_METHOD
/begin COMPU_METHOD ZWMIN_ENAG_SC_Compu "" TAB_VERB "%6.3" "" COMPU_TAB_REF ZWMIN_ENAG_SC_Compu /end COMPU_METHOD
/begin COMPU_VTAB ZWMIN_ENAG_SC_Compu "" TAB_VERB 2 0 "False" 1 "True" /end COMPU_VTAB
/begin COMPU_METHOD zw_q0p1 "" RAT_FUNC "%6.3" "Grad KW" COEFFS 0 10 0 0 0 1 /end COMPU_METHOD
/begin COMPU_METHOD zw_q2p9297Em3_deg_KW "" RAT_FUNC "%6.4" "deg KW" COEFFS 0 1024 0 0 0 3 /end COMPU_METHOD
/begin COMPU_METHOD zw_sb_q0p75 "" RAT_FUNC "%6.3" "Grad KW" COEFFS 0 255 0 0 0 191.25 /end COMPU_METHOD
/begin RECORD_LAYOUT RB_Axis_S16 NO_AXIS_PTS_X 1 SWORD AXIS_PTS_X 2 SWORD INDEX_INCR DIRECT /end RECORD_LAYOUT
/begin RECORD_LAYOUT RB_Axis_U16 NO_AXIS_PTS_X 1 UWORD AXIS_PTS_X 2 UWORD INDEX_INCR DIRECT /end RECORD_LAYOUT
/begin RECORD_LAYOUT RB_Axis_U8 NO_AXIS_PTS_X 1 UBYTE AXIS_PTS_X 2 UBYTE INDEX_INCR DIRECT /end RECORD_LAYOUT
/begin RECORD_LAYOUT RB_CurveGroup_S8 FNC_VALUES 1 SBYTE COLUMN_DIR DIRECT /end RECORD_LAYOUT
/begin RECORD_LAYOUT RB_CurveGroup_U16 FNC_VALUES 1 UWORD COLUMN_DIR DIRECT /end RECORD_LAYOUT
/begin RECORD_LAYOUT RB_CurveGroup_U8 FNC_VALUES 1 UBYTE COLUMN_DIR DIRECT /end RECORD_LAYOUT
/begin RECORD_LAYOUT RB_Curve_S16_S8_Static NO_AXIS_PTS_X 1 SWORD AXIS_PTS_X 2 SWORD INDEX_INCR DIRECT FNC_VALUES 3 SBYTE COLUMN_DIR DIRECT STATIC_RECORD_LAYOUT /end RECORD_LAYOUT
/begin RECORD_LAYOUT RB_Curve_S16_U16_Static NO_AXIS_PTS_X 1 SWORD AXIS_PTS_X 2 SWORD INDEX_INCR DIRECT FNC_VALUES 3 UWORD COLUMN_DIR DIRECT STATIC_RECORD_LAYOUT /end RECORD_LAYOUT
/begin RECORD_LAYOUT RB_Curve_U16_S16_Static NO_AXIS_PTS_X 1 UWORD AXIS_PTS_X 2 UWORD INDEX_INCR DIRECT FNC_VALUES 3 SWORD COLUMN_DIR DIRECT STATIC_RECORD_LAYOUT /end RECORD_LAYOUT
/begin RECORD_LAYOUT RB_Curve_U16_U8_Static NO_AXIS_PTS_X 1 UWORD AXIS_PTS_X 2 UWORD INDEX_INCR DIRECT FNC_VALUES 3 UBYTE COLUMN_DIR DIRECT STATIC_RECORD_LAYOUT /end RECORD_LAYOUT
/begin RECORD_LAYOUT RB_Curve_U8_S8_Static NO_AXIS_PTS_X 1 UBYTE AXIS_PTS_X 2 UBYTE INDEX_INCR DIRECT FNC_VALUES 3 SBYTE COLUMN_DIR DIRECT STATIC_RECORD_LAYOUT /end RECORD_LAYOUT
/begin RECORD_LAYOUT RB_Curve_U8_U16_Static NO_AXIS_PTS_X 1 UBYTE AXIS_PTS_X 2 UBYTE INDEX_INCR DIRECT FNC_VALUES 3 UWORD COLUMN_DIR DIRECT STATIC_RECORD_LAYOUT /end RECORD_LAYOUT
/begin RECORD_LAYOUT RB_Curve_U8_U8 NO_AXIS_PTS_X 1 UBYTE AXIS_PTS_X 2 UBYTE INDEX_INCR DIRECT FNC_VALUES 3 UBYTE COLUMN_DIR DIRECT /end RECORD_LAYOUT
/begin RECORD_LAYOUT RB_MapGroup_S16 FNC_VALUES 1 SWORD COLUMN_DIR DIRECT /end RECORD_LAYOUT
/begin RECORD_LAYOUT RB_MapGroup_S8 FNC_VALUES 1 SBYTE COLUMN_DIR DIRECT /end RECORD_LAYOUT
/begin RECORD_LAYOUT RB_MapGroup_U16 FNC_VALUES 1 UWORD COLUMN_DIR DIRECT /end RECORD_LAYOUT
/begin RECORD_LAYOUT RB_MapGroup_U8 FNC_VALUES 1 UBYTE COLUMN_DIR DIRECT /end RECORD_LAYOUT
/begin RECORD_LAYOUT RB_Map_S16S16_S16 NO_AXIS_PTS_X 1 SWORD NO_AXIS_PTS_Y 2 SWORD AXIS_PTS_X 3 SWORD INDEX_INCR DIRECT AXIS_PTS_Y 4 SWORD INDEX_INCR DIRECT FNC_VALUES 5 SWORD COLUMN_DIR DIRECT /end RECORD_LAYOUT
/begin RECORD_LAYOUT RB_Map_S16S16_S8 NO_AXIS_PTS_X 1 SWORD NO_AXIS_PTS_Y 2 SWORD AXIS_PTS_X 3 SWORD INDEX_INCR DIRECT AXIS_PTS_Y 4 SWORD INDEX_INCR DIRECT FNC_VALUES 5 SBYTE COLUMN_DIR DIRECT /end RECORD_LAYOUT
/begin RECORD_LAYOUT RB_Map_S16U16_S16 NO_AXIS_PTS_X 1 SWORD NO_AXIS_PTS_Y 2 SWORD AXIS_PTS_X 3 SWORD INDEX_INCR DIRECT AXIS_PTS_Y 4 UWORD INDEX_INCR DIRECT FNC_VALUES 5 SWORD ROW_DIR DIRECT /end RECORD_LAYOUT
/begin RECORD_LAYOUT RB_Map_S16U16_S8 NO_AXIS_PTS_X 1 SWORD NO_AXIS_PTS_Y 2 SWORD AXIS_PTS_X 3 SWORD INDEX_INCR DIRECT AXIS_PTS_Y 4 UWORD INDEX_INCR DIRECT FNC_VALUES 5 SBYTE ROW_DIR DIRECT /end RECORD_LAYOUT
/begin RECORD_LAYOUT RB_Map_S16U16_U16 NO_AXIS_PTS_X 1 SWORD NO_AXIS_PTS_Y 2 SWORD AXIS_PTS_X 3 SWORD INDEX_INCR DIRECT AXIS_PTS_Y 4 UWORD INDEX_INCR DIRECT FNC_VALUES 5 UWORD ROW_DIR DIRECT /end RECORD_LAYOUT
/begin RECORD_LAYOUT RB_Map_S16U16_U8 NO_AXIS_PTS_X 1 SWORD NO_AXIS_PTS_Y 2 SWORD AXIS_PTS_X 3 SWORD INDEX_INCR DIRECT AXIS_PTS_Y 4 UWORD INDEX_INCR DIRECT FNC_VALUES 5 UBYTE ROW_DIR DIRECT /end RECORD_LAYOUT
/begin RECORD_LAYOUT RB_Map_S16U8_S16 NO_AXIS_PTS_X 1 SWORD NO_AXIS_PTS_Y 2 SWORD AXIS_PTS_X 3 SWORD INDEX_INCR DIRECT AXIS_PTS_Y 4 UBYTE INDEX_INCR DIRECT FNC_VALUES 5 SWORD COLUMN_DIR DIRECT /end RECORD_LAYOUT
/begin RECORD_LAYOUT RB_Map_U16U16_S16 NO_AXIS_PTS_X 1 UWORD NO_AXIS_PTS_Y 2 UWORD AXIS_PTS_X 3 UWORD INDEX_INCR DIRECT AXIS_PTS_Y 4 UWORD INDEX_INCR DIRECT FNC_VALUES 5 SWORD COLUMN_DIR DIRECT /end RECORD_LAYOUT
/begin RECORD_LAYOUT RB_Val_Wboolean FNC_VALUES 1 UBYTE COLUMN_DIR DIRECT /end RECORD_LAYOUT
/begin RECORD_LAYOUT RB_Val_Ws16 FNC_VALUES 1 SWORD COLUMN_DIR DIRECT /end RECORD_LAYOUT
/begin RECORD_LAYOUT RB_Val_Ws8 FNC_VALUES 1 SBYTE COLUMN_DIR DIRECT /end RECORD_LAYOUT
/begin RECORD_LAYOUT RB_Val_Wu16 FNC_VALUES 1 UWORD COLUMN_DIR DIRECT /end RECORD_LAYOUT
/begin RECORD_LAYOUT RB_Val_Wu8 FNC_VALUES 1 UBYTE COLUMN_DIR DIRECT /end RECORD_LAYOUT
/begin UNIT AUTOSAR_CanIf_Units_NoUnit "No Unit" "noUnit" EXTENDED_SI SI_EXPONENTS 0 0 0 0 0 0 0 /end UNIT
/begin UNIT AUTOSAR_Com_Units_NoUnit "No Unit" "noUnit" EXTENDED_SI SI_EXPONENTS 0 0 0 0 0 0 0 /end UNIT
/begin UNIT AUTOSAR_ComM_Units_NoUnit "No Unit" "noUnit" EXTENDED_SI SI_EXPONENTS 0 0 0 0 0 0 0 /end UNIT
/begin UNIT AUTOSAR_LinIf_Units_NoUnit "No Unit" "noUnit" EXTENDED_SI SI_EXPONENTS 0 0 0 0 0 0 0 /end UNIT
/begin UNIT AUTOSAR_PduR_Units_NoUnit "No Unit" "noUnit" EXTENDED_SI SI_EXPONENTS 0 0 0 0 0 0 0 /end UNIT
/begin UNIT RB_RBA_rba_ComScl_Units_NoUnit "No Unit" "noUnit" EXTENDED_SI SI_EXPONENTS 0 0 0 0 0 0 0 /end UNIT
/begin UNIT RB_RBA_rba_Dme_Units_NoUnit "" "noUnit" EXTENDED_SI SI_EXPONENTS 0 0 0 0 0 0 0 /end UNIT
/begin UNIT RB_RBA_rba_Etks_Units_NoUnit "No Unit" "noUnit" EXTENDED_SI SI_EXPONENTS 0 0 0 0 0 0 0 /end UNIT
/begin UNIT RB_RBA_rba_IoExtLib_Units_NoUnit "No Unit" "noUnit" EXTENDED_SI SI_EXPONENTS 0 0 0 0 0 0 0 /end UNIT
/begin UNIT RB_RBA_rba_OsShell_Units_NoUnit "No Unit" "noUnit" EXTENDED_SI SI_EXPONENTS 0 0 0 0 0 0 0 /end UNIT
/begin UNIT RB_RBA_rba_SvbbDrv_Units_NoUnit "No Unit" "noUnit" EXTENDED_SI SI_EXPONENTS 0 0 0 0 0 0 0 /end UNIT
/end MODULE
/end PROJECT
