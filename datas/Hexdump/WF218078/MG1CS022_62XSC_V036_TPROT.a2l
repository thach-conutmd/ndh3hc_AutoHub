ASAP2_VERSION 1 60
/begin PROJECT MG1CS022 "MG1CS022"
/begin HEADER "" VERSION "MG1CS022_62XSC_V036_TPROT" PROJECT_NO MG1CS022 /end HEADER
/begin MODULE DIM ""
/begin MOD_COMMON "" BYTE_ORDER MSB_LAST ALIGNMENT_BYTE 1 ALIGNMENT_WORD 2 ALIGNMENT_LONG 4 ALIGNMENT_INT64 4 ALIGNMENT_FLOAT32_IEEE 4 ALIGNMENT_FLOAT64_IEEE 4 DATA_SIZE 32 /end MOD_COMMON
/begin MEASUREMENT DINH_nrActvInhReas.FId_ComPBSensFail "Number of active inhibit reasons for the FIds / Number of active inhibit reasons for FId_ComPBSensFail" UWORD DINH_ct_Compu 1 100 -4095.000 4096.000 BIT_MASK 0x1fff FORMAT "%8.3" ECU_ADDRESS 0x600138C8 /end MEASUREMENT
/begin MEASUREMENT DINH_nrActvInhReas.FId_ComPCU "Number of active inhibit reasons for the FIds / Number of active inhibit reasons for FId_ComPCU" UWORD DINH_ct_Compu 1 100 -4095.000 4096.000 BIT_MASK 0x1fff FORMAT "%8.3" ECU_ADDRESS 0x600138CA /end MEASUREMENT
/begin MEASUREMENT DINH_nrActvInhReas.FId_ComPCUMon "Number of active inhibit reasons for the FIds / Number of active inhibit reasons for FId_ComPCUMon" UWORD DINH_ct_Compu 1 100 -4095.000 4096.000 BIT_MASK 0x1fff FORMAT "%8.3" ECU_ADDRESS 0x600138CC /end MEASUREMENT
/begin MEASUREMENT DINH_nrActvInhReas.FId_ComPosActnSpdLimrFctReq "Number of active inhibit reasons for the FIds / Number of active inhibit reasons for FId_ComPosActnSpdLimrFctReq" UWORD DINH_ct_Compu 1 100 -4095.000 4096.000 BIT_MASK 0x1fff FORMAT "%8.3" ECU_ADDRESS 0x600138CE /end MEASUREMENT
/begin MEASUREMENT DINH_nrActvInhReas.FId_ComSRS "Number of active inhibit reasons for the FIds / Number of active inhibit reasons for FId_ComSRS" UWORD DINH_ct_Compu 1 100 -4095.000 4096.000 BIT_MASK 0x1fff FORMAT "%8.3" ECU_ADDRESS 0x600138D0 /end MEASUREMENT
/begin MEASUREMENT DINH_nrActvInhReas.FId_ComSRSA "Number of active inhibit reasons for the FIds / Number of active inhibit reasons for FId_ComSRSA" UWORD DINH_ct_Compu 1 100 -4095.000 4096.000 BIT_MASK 0x1fff FORMAT "%8.3" ECU_ADDRESS 0x600138D2 /end MEASUREMENT
/begin MEASUREMENT DINH_nrActvInhReas.FId_ComSRSAMon "Number of active inhibit reasons for the FIds / Number of active inhibit reasons for FId_ComSRSAMon" UWORD DINH_ct_Compu 1 100 -4095.000 4096.000 BIT_MASK 0x1fff FORMAT "%8.3" ECU_ADDRESS 0x600138D4 /end MEASUREMENT
/begin MEASUREMENT DINH_nrActvInhReas.FId_ComSRSB "Number of active inhibit reasons for the FIds / Number of active inhibit reasons for FId_ComSRSB" UWORD DINH_ct_Compu 1 100 -4095.000 4096.000 BIT_MASK 0x1fff FORMAT "%8.3" ECU_ADDRESS 0x600138D6 /end MEASUREMENT
/begin MEASUREMENT DINH_nrActvInhReas.FId_ComSRSBMon "Number of active inhibit reasons for the FIds / Number of active inhibit reasons for FId_ComSRSBMon" UWORD DINH_ct_Compu 1 100 -4095.000 4096.000 BIT_MASK 0x1fff FORMAT "%8.3" ECU_ADDRESS 0x600138D8 /end MEASUREMENT
/begin MEASUREMENT DINH_nrActvInhReas.FId_ComSRSMon "Number of active inhibit reasons for the FIds / Number of active inhibit reasons for FId_ComSRSMon" UWORD DINH_ct_Compu 1 100 -4095.000 4096.000 BIT_MASK 0x1fff FORMAT "%8.3" ECU_ADDRESS 0x600138DA /end MEASUREMENT
/begin MEASUREMENT DINH_nrActvInhReas.FId_ComSRSUnitCfmdErr "Number of active inhibit reasons for the FIds / Number of active inhibit reasons for FId_ComSRSUnitCfmdErr" UWORD DINH_ct_Compu 1 100 -4095.000 4096.000 BIT_MASK 0x1fff FORMAT "%8.3" ECU_ADDRESS 0x600138DC /end MEASUREMENT
/begin MEASUREMENT DINH_nrActvInhReas.FId_ComSRSUnitNotTstd "Number of active inhibit reasons for the FIds / Number of active inhibit reasons for FId_ComSRSUnitNotTstd" UWORD DINH_ct_Compu 1 100 -4095.000 4096.000 BIT_MASK 0x1fff FORMAT "%8.3" ECU_ADDRESS 0x600138DE /end MEASUREMENT
/begin MEASUREMENT DINH_nrActvInhReas.FId_ComSTFlt "Number of active inhibit reasons for the FIds / Number of active inhibit reasons for FId_ComSTFlt" UWORD DINH_ct_Compu 1 100 -4095.000 4096.000 BIT_MASK 0x1fff FORMAT "%8.3" ECU_ADDRESS 0x600138E0 /end MEASUREMENT
/begin MEASUREMENT DINH_nrActvInhReas.FId_ComSpdLimrDevActvn "Number of active inhibit reasons for the FIds / Number of active inhibit reasons for FId_ComSpdLimrDevActvn" UWORD DINH_ct_Compu 1 100 -4095.000 4096.000 BIT_MASK 0x1fff FORMAT "%8.3" ECU_ADDRESS 0x600138E2 /end MEASUREMENT
/begin MEASUREMENT DINH_nrActvInhReas.FId_ComTCU01 "Number of active inhibit reasons for the FIds / Number of active inhibit reasons for FId_ComTCU01" UWORD DINH_ct_Compu 1 100 -4095.000 4096.000 BIT_MASK 0x1fff FORMAT "%8.3" ECU_ADDRESS 0x600138E4 /end MEASUREMENT
/begin MEASUREMENT DINH_nrActvInhReas.FId_ComTCU02 "Number of active inhibit reasons for the FIds / Number of active inhibit reasons for FId_ComTCU02" UWORD DINH_ct_Compu 1 100 -4095.000 4096.000 BIT_MASK 0x1fff FORMAT "%8.3" ECU_ADDRESS 0x600138E6 /end MEASUREMENT
/begin MEASUREMENT DINH_nrActvInhReas.FId_ComTCU1 "Number of active inhibit reasons for the FIds / Number of active inhibit reasons for FId_ComTCU1" UWORD DINH_ct_Compu 1 100 -4095.000 4096.000 BIT_MASK 0x1fff FORMAT "%8.3" ECU_ADDRESS 0x600138E8 /end MEASUREMENT
/begin MEASUREMENT DINH_nrActvInhReas.FId_ComTCU11 "Number of active inhibit reasons for the FIds / Number of active inhibit reasons for FId_ComTCU11" UWORD DINH_ct_Compu 1 100 -4095.000 4096.000 BIT_MASK 0x1fff FORMAT "%8.3" ECU_ADDRESS 0x600138EA /end MEASUREMENT
/begin MEASUREMENT DINH_nrActvInhReas.FId_ComTCU12 "Number of active inhibit reasons for the FIds / Number of active inhibit reasons for FId_ComTCU12" UWORD DINH_ct_Compu 1 100 -4095.000 4096.000 BIT_MASK 0x1fff FORMAT "%8.3" ECU_ADDRESS 0x600138EC /end MEASUREMENT
/begin MEASUREMENT DINH_nrActvInhReas.FId_ComTCU13 "Number of active inhibit reasons for the FIds / Number of active inhibit reasons for FId_ComTCU13" UWORD DINH_ct_Compu 1 100 -4095.000 4096.000 BIT_MASK 0x1fff FORMAT "%8.3" ECU_ADDRESS 0x600138EE /end MEASUREMENT
/begin MEASUREMENT DINH_nrActvInhReas.FId_ComTCU14 "Number of active inhibit reasons for the FIds / Number of active inhibit reasons for FId_ComTCU14" UWORD DINH_ct_Compu 1 100 -4095.000 4096.000 BIT_MASK 0x1fff FORMAT "%8.3" ECU_ADDRESS 0x600138F0 /end MEASUREMENT
/begin MEASUREMENT DINH_nrActvInhReas.FId_ComTCU2 "Number of active inhibit reasons for the FIds / Number of active inhibit reasons for FId_ComTCU2" UWORD DINH_ct_Compu 1 100 -4095.000 4096.000 BIT_MASK 0x1fff FORMAT "%8.3" ECU_ADDRESS 0x600138F2 /end MEASUREMENT
/begin MEASUREMENT DINH_nrActvInhReas.FId_ComTCU3 "Number of active inhibit reasons for the FIds / Number of active inhibit reasons for FId_ComTCU3" UWORD DINH_ct_Compu 1 100 -4095.000 4096.000 BIT_MASK 0x1fff FORMAT "%8.3" ECU_ADDRESS 0x600138F4 /end MEASUREMENT
/begin MEASUREMENT DINH_nrActvInhReas.FId_ComTCU4 "Number of active inhibit reasons for the FIds / Number of active inhibit reasons for FId_ComTCU4" UWORD DINH_ct_Compu 1 100 -4095.000 4096.000 BIT_MASK 0x1fff FORMAT "%8.3" ECU_ADDRESS 0x600138F6 /end MEASUREMENT
/begin MEASUREMENT DINH_nrActvInhReas.FId_ComTCUGear "Number of active inhibit reasons for the FIds / Number of active inhibit reasons for FId_ComTCUGear" UWORD DINH_ct_Compu 1 100 -4095.000 4096.000 BIT_MASK 0x1fff FORMAT "%8.3" ECU_ADDRESS 0x600138F8 /end MEASUREMENT
/begin MEASUREMENT DINH_nrActvInhReas.FId_ComTarGearDwnShift "Number of active inhibit reasons for the FIds / Number of active inhibit reasons for FId_ComTarGearDwnShift" UWORD DINH_ct_Compu 1 100 -4095.000 4096.000 BIT_MASK 0x1fff FORMAT "%8.3" ECU_ADDRESS 0x600138FA /end MEASUREMENT
/begin MEASUREMENT DINH_nrActvInhReas.FId_ComTarGearUpShift "Number of active inhibit reasons for the FIds / Number of active inhibit reasons for FId_ComTarGearUpShift" UWORD DINH_ct_Compu 1 100 -4095.000 4096.000 BIT_MASK 0x1fff FORMAT "%8.3" ECU_ADDRESS 0x600138FC /end MEASUREMENT
/begin MEASUREMENT DINH_nrActvInhReas.FId_ComThrPosnFail "Number of active inhibit reasons for the FIds / Number of active inhibit reasons for FId_ComThrPosnFail" UWORD DINH_ct_Compu 1 100 -4095.000 4096.000 BIT_MASK 0x1fff FORMAT "%8.3" ECU_ADDRESS 0x600138FE /end MEASUREMENT
/begin MEASUREMENT DINH_nrActvInhReas.FId_ComThrVlv "Number of active inhibit reasons for the FIds / Number of active inhibit reasons for FId_ComThrVlv" UWORD DINH_ct_Compu 1 100 -4095.000 4096.000 BIT_MASK 0x1fff FORMAT "%8.3" ECU_ADDRESS 0x60013900 /end MEASUREMENT
/begin MEASUREMENT DINH_nrActvInhReas.FId_ComTrboChrgnErr "Number of active inhibit reasons for the FIds / Number of active inhibit reasons for FId_ComTrboChrgnErr" UWORD DINH_ct_Compu 1 100 -4095.000 4096.000 BIT_MASK 0x1fff FORMAT "%8.3" ECU_ADDRESS 0x60013902 /end MEASUREMENT
/begin MEASUREMENT DINH_nrActvInhReas.FId_ComTrqAccuracySlow "Number of active inhibit reasons for the FIds / Number of active inhibit reasons for FId_ComTrqAccuracySlow" UWORD DINH_ct_Compu 1 100 -4095.000 4096.000 BIT_MASK 0x1fff FORMAT "%8.3" ECU_ADDRESS 0x60013904 /end MEASUREMENT
/begin MEASUREMENT DINH_nrActvInhReas.FId_ComTrqReqFast "Number of active inhibit reasons for the FIds / Number of active inhibit reasons for FId_ComTrqReqFast" UWORD DINH_ct_Compu 1 100 -4095.000 4096.000 BIT_MASK 0x1fff FORMAT "%8.3" ECU_ADDRESS 0x60013906 /end MEASUREMENT
/begin MEASUREMENT DINH_nrActvInhReas.FId_ComTrqReqSlow "Number of active inhibit reasons for the FIds / Number of active inhibit reasons for FId_ComTrqReqSlow" UWORD DINH_ct_Compu 1 100 -4095.000 4096.000 BIT_MASK 0x1fff FORMAT "%8.3" ECU_ADDRESS 0x60013908 /end MEASUREMENT
/begin MEASUREMENT DINH_nrActvInhReas.FId_ComVSAErr "Number of active inhibit reasons for the FIds / Number of active inhibit reasons for FId_ComVSAErr" UWORD DINH_ct_Compu 1 100 -4095.000 4096.000 BIT_MASK 0x1fff FORMAT "%8.3" ECU_ADDRESS 0x6001390A /end MEASUREMENT
/begin MEASUREMENT DINH_nrActvInhReas.FId_ComVSAUnitCfmdErr "Number of active inhibit reasons for the FIds / Number of active inhibit reasons for FId_ComVSAUnitCfmdErr" UWORD DINH_ct_Compu 1 100 -4095.000 4096.000 BIT_MASK 0x1fff FORMAT "%8.3" ECU_ADDRESS 0x6001390C /end MEASUREMENT
/begin MEASUREMENT DINH_nrActvInhReas.FId_ComVSAUnitNotTstd "Number of active inhibit reasons for the FIds / Number of active inhibit reasons for FId_ComVSAUnitNotTstd" UWORD DINH_ct_Compu 1 100 -4095.000 4096.000 BIT_MASK 0x1fff FORMAT "%8.3" ECU_ADDRESS 0x6001390E /end MEASUREMENT
/begin MEASUREMENT DINH_nrActvInhReas.FId_ComVehSpdFlLvl "Number of active inhibit reasons for the FIds / Number of active inhibit reasons for FId_ComVehSpdFlLvl" UWORD DINH_ct_Compu 1 100 -4095.000 4096.000 BIT_MASK 0x1fff FORMAT "%8.3" ECU_ADDRESS 0x60013910 /end MEASUREMENT
/begin MEASUREMENT DINH_nrActvInhReas.FId_ComVehSpdFltChk "Number of active inhibit reasons for the FIds / Number of active inhibit reasons for FId_ComVehSpdFltChk" UWORD DINH_ct_Compu 1 100 -4095.000 4096.000 BIT_MASK 0x1fff FORMAT "%8.3" ECU_ADDRESS 0x60013912 /end MEASUREMENT
/begin MEASUREMENT DINH_nrActvInhReas.FId_ComVehSpdImpsErr "Number of active inhibit reasons for the FIds / Number of active inhibit reasons for FId_ComVehSpdImpsErr" UWORD DINH_ct_Compu 1 100 -4095.000 4096.000 BIT_MASK 0x1fff FORMAT "%8.3" ECU_ADDRESS 0x60013914 /end MEASUREMENT
/begin MEASUREMENT DINH_nrActvInhReas.FId_ComVlvLftCtrl "Number of active inhibit reasons for the FIds / Number of active inhibit reasons for FId_ComVlvLftCtrl" UWORD DINH_ct_Compu 1 100 -4095.000 4096.000 BIT_MASK 0x1fff FORMAT "%8.3" ECU_ADDRESS 0x60013916 /end MEASUREMENT
/begin MEASUREMENT DINH_nrActvInhReas.FId_ComvolEng "Number of active inhibit reasons for the FIds / Number of active inhibit reasons for FId_ComvolEng" UWORD DINH_ct_Compu 1 100 -4095.000 4096.000 BIT_MASK 0x1fff FORMAT "%8.3" ECU_ADDRESS 0x60013918 /end MEASUREMENT
/begin MEASUREMENT DINH_nrActvInhReas.FId_ConvLdCalcLvrPos "Number of active inhibit reasons for the FIds / Number of active inhibit reasons for FId_ConvLdCalcLvrPos" UWORD DINH_ct_Compu 1 100 -4095.000 4096.000 BIT_MASK 0x1fff FORMAT "%8.3" ECU_ADDRESS 0x6001391A /end MEASUREMENT
/begin MEASUREMENT DINH_nrActvInhReas.FId_ConvLdNTrbnCan "Number of active inhibit reasons for the FIds / Number of active inhibit reasons for FId_ConvLdNTrbnCan" UWORD DINH_ct_Compu 1 100 -4095.000 4096.000 BIT_MASK 0x1fff FORMAT "%8.3" ECU_ADDRESS 0x6001391C /end MEASUREMENT
/begin MEASUREMENT DINH_nrActvInhReas.FId_ConvLdOilCoolrPmp "Number of active inhibit reasons for the FIds / Number of active inhibit reasons for FId_ConvLdOilCoolrPmp" UWORD DINH_ct_Compu 1 100 -4095.000 4096.000 BIT_MASK 0x1fff FORMAT "%8.3" ECU_ADDRESS 0x6001391E /end MEASUREMENT
/begin MEASUREMENT DINH_nrActvInhReas.FId_ConvLdOilTemp "Number of active inhibit reasons for the FIds / Number of active inhibit reasons for FId_ConvLdOilTemp" UWORD DINH_ct_Compu 1 100 -4095.000 4096.000 BIT_MASK 0x1fff FORMAT "%8.3" ECU_ADDRESS 0x60013920 /end MEASUREMENT
/begin MEASUREMENT DINH_nrActvInhReas.FId_ConvLdTrqLdCan "Number of active inhibit reasons for the FIds / Number of active inhibit reasons for FId_ConvLdTrqLdCan" UWORD DINH_ct_Compu 1 100 -4095.000 4096.000 BIT_MASK 0x1fff FORMAT "%8.3" ECU_ADDRESS 0x60013922 /end MEASUREMENT
/begin MEASUREMENT DINH_nrActvInhReas.FId_ConvLdVel "Number of active inhibit reasons for the FIds / Number of active inhibit reasons for FId_ConvLdVel" UWORD DINH_ct_Compu 1 100 -4095.000 4096.000 BIT_MASK 0x1fff FORMAT "%8.3" ECU_ADDRESS 0x60013924 /end MEASUREMENT
/begin MEASUREMENT DINH_nrActvInhReas.FId_CooltTVldyTMdl "Number of active inhibit reasons for the FIds / Number of active inhibit reasons for FId_CooltTVldyTMdl" UWORD DINH_ct_Compu 1 100 -4095.000 4096.000 BIT_MASK 0x1fff FORMAT "%8.3" ECU_ADDRESS 0x60013926 /end MEASUREMENT
/begin MEASUREMENT DINH_nrActvInhReas.FId_CptProtnCamsft "Number of active inhibit reasons for the FIds / Number of active inhibit reasons for FId_CptProtnCamsft" UWORD DINH_ct_Compu 1 100 -4095.000 4096.000 BIT_MASK 0x1fff FORMAT "%8.3" ECU_ADDRESS 0x60013928 /end MEASUREMENT
/begin MEASUREMENT DINH_nrActvInhReas.FId_CptProtnExhTempMdl "Number of active inhibit reasons for the FIds / Number of active inhibit reasons for FId_CptProtnExhTempMdl" UWORD DINH_ct_Compu 1 100 -4095.000 4096.000 BIT_MASK 0x1fff FORMAT "%8.3" ECU_ADDRESS 0x6001392A /end MEASUREMENT
/begin MEASUREMENT DINH_nrActvInhReas.FId_CptProtnO2SnsrB1 "Number of active inhibit reasons for the FIds / Number of active inhibit reasons for FId_CptProtnO2SnsrB1" UWORD DINH_ct_Compu 1 100 -4095.000 4096.000 BIT_MASK 0x1fff FORMAT "%8.3" ECU_ADDRESS 0x6001392C /end MEASUREMENT
/begin MEASUREMENT DINH_nrActvInhReas.FId_CptProtnVVeh "Number of active inhibit reasons for the FIds / Number of active inhibit reasons for FId_CptProtnVVeh" UWORD DINH_ct_Compu 1 100 -4095.000 4096.000 BIT_MASK 0x1fff FORMAT "%8.3" ECU_ADDRESS 0x6001392E /end MEASUREMENT
/begin MEASUREMENT DINH_nrActvInhReas.FId_CrCUI1EFRxErr "Number of active inhibit reasons for the FIds / Number of active inhibit reasons for FId_CrCUI1EFRxErr" UWORD DINH_ct_Compu 1 100 -4095.000 4096.000 BIT_MASK 0x1fff FORMAT "%8.3" ECU_ADDRESS 0x60013930 /end MEASUREMENT
/begin MEASUREMENT DINH_nrActvInhReas.FId_CrCUICANRxErr "Number of active inhibit reasons for the FIds / Number of active inhibit reasons for FId_CrCUICANRxErr" UWORD DINH_ct_Compu 1 100 -4095.000 4096.000 BIT_MASK 0x1fff FORMAT "%8.3" ECU_ADDRESS 0x60013932 /end MEASUREMENT
/begin MEASUREMENT DINH_nrActvInhReas.FId_CrCUIFCMRxErr "Number of active inhibit reasons for the FIds / Number of active inhibit reasons for FId_CrCUIFCMRxErr" UWORD DINH_ct_Compu 1 100 -4095.000 4096.000 BIT_MASK 0x1fff FORMAT "%8.3" ECU_ADDRESS 0x60013934 /end MEASUREMENT
/begin MEASUREMENT DINH_nrActvInhReas.FId_CrCUIMETDRxErr "Number of active inhibit reasons for the FIds / Number of active inhibit reasons for FId_CrCUIMETDRxErr" UWORD DINH_ct_Compu 1 100 -4095.000 4096.000 BIT_MASK 0x1fff FORMAT "%8.3" ECU_ADDRESS 0x60013936 /end MEASUREMENT
/begin MEASUREMENT DINH_nrActvInhReas.FId_CrCtlACCRxErr "Number of active inhibit reasons for the FIds / Number of active inhibit reasons for FId_CrCtlACCRxErr" UWORD DINH_ct_Compu 1 100 -4095.000 4096.000 BIT_MASK 0x1fff FORMAT "%8.3" ECU_ADDRESS 0x60013938 /end MEASUREMENT
/begin MEASUREMENT DINH_nrActvInhReas.FId_CrCtlAppSnsrErr "Number of active inhibit reasons for the FIds / Number of active inhibit reasons for FId_CrCtlAppSnsrErr" UWORD DINH_ct_Compu 1 100 -4095.000 4096.000 BIT_MASK 0x1fff FORMAT "%8.3" ECU_ADDRESS 0x6001393A /end MEASUREMENT
/begin MEASUREMENT DINH_nrActvInhReas.FId_CrCtlShutOffEng "Number of active inhibit reasons for the FIds / Number of active inhibit reasons for FId_CrCtlShutOffEng" UWORD DINH_ct_Compu 1 100 -4095.000 4096.000 BIT_MASK 0x1fff FORMAT "%8.3" ECU_ADDRESS 0x6001393C /end MEASUREMENT
/begin MEASUREMENT DINH_nrActvInhReas.FId_CstrPurgGnrlTstrReq "Number of active inhibit reasons for the FIds / Number of active inhibit reasons for FId_CstrPurgGnrlTstrReq" UWORD DINH_ct_Compu 1 100 -4095.000 4096.000 BIT_MASK 0x1fff FORMAT "%8.3" ECU_ADDRESS 0x6001393E /end MEASUREMENT
/begin MEASUREMENT DINH_nrActvInhReas.FId_DAGRS "Number of active inhibit reasons for the FIds / Number of active inhibit reasons for FId_DAGRS" UWORD DINH_ct_Compu 1 100 -4095.000 4096.000 BIT_MASK 0x1fff FORMAT "%8.3" ECU_ADDRESS 0x60013940 /end MEASUREMENT
/begin MEASUREMENT DINH_nrActvInhReas.FId_DELibBrkBstP "Number of active inhibit reasons for the FIds / Number of active inhibit reasons for FId_DELibBrkBstP" UWORD DINH_ct_Compu 1 100 -4095.000 4096.000 BIT_MASK 0x1fff FORMAT "%8.3" ECU_ADDRESS 0x60013942 /end MEASUREMENT
/begin MEASUREMENT DINH_nrActvInhReas.FId_DELibCEngDsT "Number of active inhibit reasons for the FIds / Number of active inhibit reasons for FId_DELibCEngDsT" UWORD DINH_ct_Compu 1 100 -4095.000 4096.000 BIT_MASK 0x1fff FORMAT "%8.3" ECU_ADDRESS 0x60013944 /end MEASUREMENT
/begin MEASUREMENT DINH_nrActvInhReas.FId_DELibCEngUsT "Number of active inhibit reasons for the FIds / Number of active inhibit reasons for FId_DELibCEngUsT" UWORD DINH_ct_Compu 1 100 -4095.000 4096.000 BIT_MASK 0x1fff FORMAT "%8.3" ECU_ADDRESS 0x60013946 /end MEASUREMENT
/begin MEASUREMENT DINH_nrActvInhReas.FId_DELibEngDatEng "Number of active inhibit reasons for the FIds / Number of active inhibit reasons for FId_DELibEngDatEng" UWORD DINH_ct_Compu 1 100 -4095.000 4096.000 BIT_MASK 0x1fff FORMAT "%8.3" ECU_ADDRESS 0x60013948 /end MEASUREMENT
/begin MEASUREMENT DINH_nrActvInhReas.FId_DELibEnvP "Number of active inhibit reasons for the FIds / Number of active inhibit reasons for FId_DELibEnvP" UWORD DINH_ct_Compu 1 100 -4095.000 4096.000 BIT_MASK 0x1fff FORMAT "%8.3" ECU_ADDRESS 0x6001394A /end MEASUREMENT
/begin MEASUREMENT DINH_nrActvInhReas.FId_DELibEnvT "Number of active inhibit reasons for the FIds / Number of active inhibit reasons for FId_DELibEnvT" UWORD DINH_ct_Compu 1 100 -4095.000 4096.000 BIT_MASK 0x1fff FORMAT "%8.3" ECU_ADDRESS 0x6001394C /end MEASUREMENT
/begin MEASUREMENT DINH_nrActvInhReas.FId_DELibFuelT "Number of active inhibit reasons for the FIds / Number of active inhibit reasons for FId_DELibFuelT" UWORD DINH_ct_Compu 1 100 -4095.000 4096.000 BIT_MASK 0x1fff FORMAT "%8.3" ECU_ADDRESS 0x6001394E /end MEASUREMENT
/begin MEASUREMENT DINH_nrActvInhReas.FId_DELibIntkAirT "Number of active inhibit reasons for the FIds / Number of active inhibit reasons for FId_DELibIntkAirT" UWORD DINH_ct_Compu 1 100 -4095.000 4096.000 BIT_MASK 0x1fff FORMAT "%8.3" ECU_ADDRESS 0x60013950 /end MEASUREMENT
/begin MEASUREMENT DINH_nrActvInhReas.FId_DELibNRCat "Number of active inhibit reasons for the FIds / Number of active inhibit reasons for FId_DELibNRCat" UWORD DINH_ct_Compu 1 100 -4095.000 4096.000 BIT_MASK 0x1fff FORMAT "%8.3" ECU_ADDRESS 0x60013952 /end MEASUREMENT
/begin MEASUREMENT DINH_nrActvInhReas.FId_DELibOilP "Number of active inhibit reasons for the FIds / Number of active inhibit reasons for FId_DELibOilP" UWORD DINH_ct_Compu 1 100 -4095.000 4096.000 BIT_MASK 0x1fff FORMAT "%8.3" ECU_ADDRESS 0x60013954 /end MEASUREMENT
/begin MEASUREMENT DINH_nrActvInhReas.FId_DELibOilSwmpT "Number of active inhibit reasons for the FIds / Number of active inhibit reasons for FId_DELibOilSwmpT" UWORD DINH_ct_Compu 1 100 -4095.000 4096.000 BIT_MASK 0x1fff FORMAT "%8.3" ECU_ADDRESS 0x60013956 /end MEASUREMENT
/begin MEASUREMENT DINH_nrActvInhReas.FId_DELibPRelPfilDs "Number of active inhibit reasons for the FIds / Number of active inhibit reasons for FId_DELibPRelPfilDs" UWORD DINH_ct_Compu 1 100 -4095.000 4096.000 BIT_MASK 0x1fff FORMAT "%8.3" ECU_ADDRESS 0x60013958 /end MEASUREMENT
/begin MEASUREMENT DINH_nrActvInhReas.FId_DELibTEGRClrLPDs "Number of active inhibit reasons for the FIds / Number of active inhibit reasons for FId_DELibTEGRClrLPDs" UWORD DINH_ct_Compu 1 100 -4095.000 4096.000 BIT_MASK 0x1fff FORMAT "%8.3" ECU_ADDRESS 0x6001395A /end MEASUREMENT
/begin MEASUREMENT DINH_nrActvInhReas.FId_DEONVEBPEnv "Number of active inhibit reasons for the FIds / Number of active inhibit reasons for FId_DEONVEBPEnv" UWORD DINH_ct_Compu 1 100 -4095.000 4096.000 BIT_MASK 0x1fff FORMAT "%8.3" ECU_ADDRESS 0x6001395C /end MEASUREMENT
/begin MEASUREMENT DINH_nrActvInhReas.FId_DEONVTCCpv1DteskLoLoadStuckClsd "Number of active inhibit reasons for the FIds / Number of active inhibit reasons for FId_DEONVTCCpv1DteskLoLoadStuckClsd" UWORD DINH_ct_Compu 1 100 -4095.000 4096.000 BIT_MASK 0x1fff FORMAT "%8.3" ECU_ADDRESS 0x6001395E /end MEASUREMENT
/begin MEASUREMENT DINH_nrActvInhReas.FId_DEONVTCCpv1DteskLoLoadStuckOpen "Number of active inhibit reasons for the FIds / Number of active inhibit reasons for FId_DEONVTCCpv1DteskLoLoadStuckOpen" UWORD DINH_ct_Compu 1 100 -4095.000 4096.000 BIT_MASK 0x1fff FORMAT "%8.3" ECU_ADDRESS 0x60013960 /end MEASUREMENT
/begin MEASUREMENT DINH_nrActvInhReas.FId_DIUMPRCldStrtMon "Number of active inhibit reasons for the FIds / Number of active inhibit reasons for FId_DIUMPRCldStrtMon" UWORD DINH_ct_Compu 1 100 -4095.000 4096.000 BIT_MASK 0x1fff FORMAT "%8.3" ECU_ADDRESS 0x60013962 /end MEASUREMENT
/begin MEASUREMENT DINH_nrActvInhReas.FId_DIUMPREvapMon "Number of active inhibit reasons for the FIds / Number of active inhibit reasons for FId_DIUMPREvapMon" UWORD DINH_ct_Compu 1 100 -4095.000 4096.000 BIT_MASK 0x1fff FORMAT "%8.3" ECU_ADDRESS 0x60013964 /end MEASUREMENT
/begin MEASUREMENT DINH_nrActvInhReas.FId_DIUMPRGenDenom1 "Number of active inhibit reasons for the FIds / Number of active inhibit reasons for FId_DIUMPRGenDenom1" UWORD DINH_ct_Compu 1 100 -4095.000 4096.000 BIT_MASK 0x1fff FORMAT "%8.3" ECU_ADDRESS 0x60013966 /end MEASUREMENT
/begin MEASUREMENT DINH_nrActvInhReas.FId_DIUMPRGenDenom1PDTC "Number of active inhibit reasons for the FIds / Number of active inhibit reasons for FId_DIUMPRGenDenom1PDTC" UWORD DINH_ct_Compu 1 100 -4095.000 4096.000 BIT_MASK 0x1fff FORMAT "%8.3" ECU_ADDRESS 0x60013968 /end MEASUREMENT
/begin MEASUREMENT DINH_nrActvInhReas.FId_DIUMPRGenDenom2 "Number of active inhibit reasons for the FIds / Number of active inhibit reasons for FId_DIUMPRGenDenom2" UWORD DINH_ct_Compu 1 100 -4095.000 4096.000 BIT_MASK 0x1fff FORMAT "%8.3" ECU_ADDRESS 0x6001396A /end MEASUREMENT
/begin MEASUREMENT DINH_nrActvInhReas.FId_DIUMPRGenDenom3 "Number of active inhibit reasons for the FIds / Number of active inhibit reasons for FId_DIUMPRGenDenom3" UWORD DINH_ct_Compu 1 100 -4095.000 4096.000 BIT_MASK 0x1fff FORMAT "%8.3" ECU_ADDRESS 0x6001396C /end MEASUREMENT
/begin MEASUREMENT DINH_nrActvInhReas.FId_DIUMPRIgn "Number of active inhibit reasons for the FIds / Number of active inhibit reasons for FId_DIUMPRIgn" UWORD DINH_ct_Compu 1 100 -4095.000 4096.000 BIT_MASK 0x1fff FORMAT "%8.3" ECU_ADDRESS 0x6001396E /end MEASUREMENT
/begin MEASUREMENT DINH_nrActvInhReas.FId_DOGov "Number of active inhibit reasons for the FIds / Number of active inhibit reasons for FId_DOGov" UWORD DINH_ct_Compu 1 100 -4095.000 4096.000 BIT_MASK 0x1fff FORMAT "%8.3" ECU_ADDRESS 0x60013970 /end MEASUREMENT
/begin MEASUREMENT DINH_nrActvInhReas.FId_DSMWarmUpCycle "Number of active inhibit reasons for the FIds / Number of active inhibit reasons for FId_DSMWarmUpCycle" UWORD DINH_ct_Compu 1 100 -4095.000 4096.000 BIT_MASK 0x1fff FORMAT "%8.3" ECU_ADDRESS 0x60013972 /end MEASUREMENT
/begin MEASUREMENT DINH_nrActvInhReas.FId_DTESKEBCpv1DteskLoLoadStuckClsd "Number of active inhibit reasons for the FIds / Number of active inhibit reasons for FId_DTESKEBCpv1DteskLoLoadStuckClsd" UWORD DINH_ct_Compu 1 100 -4095.000 4096.000 BIT_MASK 0x1fff FORMAT "%8.3" ECU_ADDRESS 0x60013974 /end MEASUREMENT
/begin MEASUREMENT DINH_nrActvInhReas.FId_DTESKEBCpv1DteskLoLoadStuckOpen "Number of active inhibit reasons for the FIds / Number of active inhibit reasons for FId_DTESKEBCpv1DteskLoLoadStuckOpen" UWORD DINH_ct_Compu 1 100 -4095.000 4096.000 BIT_MASK 0x1fff FORMAT "%8.3" ECU_ADDRESS 0x60013976 /end MEASUREMENT
/begin MEASUREMENT DINH_nrActvInhReas.FId_DTESKEnvCondVld "Number of active inhibit reasons for the FIds / Number of active inhibit reasons for FId_DTESKEnvCondVld" UWORD DINH_ct_Compu 1 100 -4095.000 4096.000 BIT_MASK 0x1fff FORMAT "%8.3" ECU_ADDRESS 0x60013978 /end MEASUREMENT
/begin MEASUREMENT DINH_nrActvInhReas.FId_DTESKFuLvlCondVld "Number of active inhibit reasons for the FIds / Number of active inhibit reasons for FId_DTESKFuLvlCondVld" UWORD DINH_ct_Compu 1 100 -4095.000 4096.000 BIT_MASK 0x1fff FORMAT "%8.3" ECU_ADDRESS 0x6001397A /end MEASUREMENT
/begin MEASUREMENT DINH_nrActvInhReas.FId_DTESKvfz "Number of active inhibit reasons for the FIds / Number of active inhibit reasons for FId_DTESKvfz" UWORD DINH_ct_Compu 1 100 -4095.000 4096.000 BIT_MASK 0x1fff FORMAT "%8.3" ECU_ADDRESS 0x6001397C /end MEASUREMENT
/begin MEASUREMENT DINH_nrActvInhReas.FId_DdskvFraTstd "Number of active inhibit reasons for the FIds / Number of active inhibit reasons for FId_DdskvFraTstd" UWORD DINH_ct_Compu 1 100 -4095.000 4096.000 BIT_MASK 0x1fff FORMAT "%8.3" ECU_ADDRESS 0x6001397E /end MEASUREMENT
/begin MEASUREMENT DINH_nrActvInhReas.FId_DdskvOraTstd "Number of active inhibit reasons for the FIds / Number of active inhibit reasons for FId_DdskvOraTstd" UWORD DINH_ct_Compu 1 100 -4095.000 4096.000 BIT_MASK 0x1fff FORMAT "%8.3" ECU_ADDRESS 0x60013980 /end MEASUREMENT
/begin MEASUREMENT DINH_nrActvInhReas.FId_DewDetTKAMax "Number of active inhibit reasons for the FIds / Number of active inhibit reasons for FId_DewDetTKAMax" UWORD DINH_ct_Compu 1 100 -4095.000 4096.000 BIT_MASK 0x1fff FORMAT "%8.3" ECU_ADDRESS 0x60013982 /end MEASUREMENT
/begin MEASUREMENT DINH_nrActvInhReas.FId_DiagBlkdLine "Number of active inhibit reasons for the FIds / Number of active inhibit reasons for FId_DiagBlkdLine" UWORD DINH_ct_Compu 1 100 -4095.000 4096.000 BIT_MASK 0x1fff FORMAT "%8.3" ECU_ADDRESS 0x60013984 /end MEASUREMENT
/begin MEASUREMENT DINH_nrActvInhReas.FId_DiagCpv1DteskLoLoad "Number of active inhibit reasons for the FIds / Number of active inhibit reasons for FId_DiagCpv1DteskLoLoad" UWORD DINH_ct_Compu 1 100 -4095.000 4096.000 BIT_MASK 0x1fff FORMAT "%8.3" ECU_ADDRESS 0x60013986 /end MEASUREMENT
/begin MEASUREMENT DINH_nrActvInhReas.FId_DkrsaEpmNoSig "Number of active inhibit reasons for the FIds / Number of active inhibit reasons for FId_DkrsaEpmNoSig" UWORD DINH_ct_Compu 1 100 -4095.000 4096.000 BIT_MASK 0x1fff FORMAT "%8.3" ECU_ADDRESS 0x60013988 /end MEASUREMENT
/begin MEASUREMENT DINH_nrActvInhReas.FId_EBBCANErrFrzVal "Number of active inhibit reasons for the FIds / Number of active inhibit reasons for FId_EBBCANErrFrzVal" UWORD DINH_ct_Compu 1 100 -4095.000 4096.000 BIT_MASK 0x1fff FORMAT "%8.3" ECU_ADDRESS 0x6001398A /end MEASUREMENT
/begin MEASUREMENT DINH_nrActvInhReas.FId_EBBCANErrReplVal "Number of active inhibit reasons for the FIds / Number of active inhibit reasons for FId_EBBCANErrReplVal" UWORD DINH_ct_Compu 1 100 -4095.000 4096.000 BIT_MASK 0x1fff FORMAT "%8.3" ECU_ADDRESS 0x6001398C /end MEASUREMENT
/begin MEASUREMENT DINH_nrActvInhReas.FId_EGLZSR "Number of active inhibit reasons for the FIds / Number of active inhibit reasons for FId_EGLZSR" UWORD DINH_ct_Compu 1 100 -4095.000 4096.000 BIT_MASK 0x1fff FORMAT "%8.3" ECU_ADDRESS 0x6001398E /end MEASUREMENT
/begin MEASUREMENT DINH_nrActvInhReas.FId_EGRVlvActrOff "Number of active inhibit reasons for the FIds / Number of active inhibit reasons for FId_EGRVlvActrOff" UWORD DINH_ct_Compu 1 100 -4095.000 4096.000 BIT_MASK 0x1fff FORMAT "%8.3" ECU_ADDRESS 0x60013990 /end MEASUREMENT
/begin MEASUREMENT DINH_nrActvInhReas.FId_EGRVlvCldStrt "Number of active inhibit reasons for the FIds / Number of active inhibit reasons for FId_EGRVlvCldStrt" UWORD DINH_ct_Compu 1 100 -4095.000 4096.000 BIT_MASK 0x1fff FORMAT "%8.3" ECU_ADDRESS 0x60013992 /end MEASUREMENT
/begin MEASUREMENT DINH_nrActvInhReas.FId_EGRVlvClnVrfy "Number of active inhibit reasons for the FIds / Number of active inhibit reasons for FId_EGRVlvClnVrfy" UWORD DINH_ct_Compu 1 100 -4095.000 4096.000 BIT_MASK 0x1fff FORMAT "%8.3" ECU_ADDRESS 0x60013994 /end MEASUREMENT
/begin MEASUREMENT DINH_nrActvInhReas.FId_EGRVlvCtrlErr "Number of active inhibit reasons for the FIds / Number of active inhibit reasons for FId_EGRVlvCtrlErr" UWORD DINH_ct_Compu 1 100 -4095.000 4096.000 BIT_MASK 0x1fff FORMAT "%8.3" ECU_ADDRESS 0x60013996 /end MEASUREMENT
/begin MEASUREMENT DINH_nrActvInhReas.FId_EGRVlvEngTempDef "Number of active inhibit reasons for the FIds / Number of active inhibit reasons for FId_EGRVlvEngTempDef" UWORD DINH_ct_Compu 1 100 -4095.000 4096.000 BIT_MASK 0x1fff FORMAT "%8.3" ECU_ADDRESS 0x60013998 /end MEASUREMENT
/begin MEASUREMENT DINH_nrActvInhReas.FId_EGRVlvFailSafeActv "Number of active inhibit reasons for the FIds / Number of active inhibit reasons for FId_EGRVlvFailSafeActv" UWORD DINH_ct_Compu 1 100 -4095.000 4096.000 BIT_MASK 0x1fff FORMAT "%8.3" ECU_ADDRESS 0x6001399A /end MEASUREMENT
/begin MEASUREMENT DINH_nrActvInhReas.FId_EGRVlvFrzVal "Number of active inhibit reasons for the FIds / Number of active inhibit reasons for FId_EGRVlvFrzVal" UWORD DINH_ct_Compu 1 100 -4095.000 4096.000 BIT_MASK 0x1fff FORMAT "%8.3" ECU_ADDRESS 0x6001399C /end MEASUREMENT
/begin MEASUREMENT DINH_nrActvInhReas.FId_EGRVlvGovOn "Number of active inhibit reasons for the FIds / Number of active inhibit reasons for FId_EGRVlvGovOn" UWORD DINH_ct_Compu 1 100 -4095.000 4096.000 BIT_MASK 0x1fff FORMAT "%8.3" ECU_ADDRESS 0x6001399E /end MEASUREMENT
/begin MEASUREMENT DINH_nrActvInhReas.FId_EGRVlvGovOnCld "Number of active inhibit reasons for the FIds / Number of active inhibit reasons for FId_EGRVlvGovOnCld" UWORD DINH_ct_Compu 1 100 -4095.000 4096.000 BIT_MASK 0x1fff FORMAT "%8.3" ECU_ADDRESS 0x600139A0 /end MEASUREMENT
/begin MEASUREMENT DINH_nrActvInhReas.FId_EGRVlvGovrOnRelsFct "Number of active inhibit reasons for the FIds / Number of active inhibit reasons for FId_EGRVlvGovrOnRelsFct" UWORD DINH_ct_Compu 1 100 -4095.000 4096.000 BIT_MASK 0x1fff FORMAT "%8.3" ECU_ADDRESS 0x600139A2 /end MEASUREMENT
/begin MEASUREMENT DINH_nrActvInhReas.FId_EGRVlvILimn "Number of active inhibit reasons for the FIds / Number of active inhibit reasons for FId_EGRVlvILimn" UWORD DINH_ct_Compu 1 100 -4095.000 4096.000 BIT_MASK 0x1fff FORMAT "%8.3" ECU_ADDRESS 0x600139A4 /end MEASUREMENT
/begin MEASUREMENT DINH_nrActvInhReas.FId_EGRVlvIni "Number of active inhibit reasons for the FIds / Number of active inhibit reasons for FId_EGRVlvIni" UWORD DINH_ct_Compu 1 100 -4095.000 4096.000 BIT_MASK 0x1fff FORMAT "%8.3" ECU_ADDRESS 0x600139A6 /end MEASUREMENT
/begin MEASUREMENT DINH_nrActvInhReas.FId_EGRVlvMon "Number of active inhibit reasons for the FIds / Number of active inhibit reasons for FId_EGRVlvMon" UWORD DINH_ct_Compu 1 100 -4095.000 4096.000 BIT_MASK 0x1fff FORMAT "%8.3" ECU_ADDRESS 0x600139A8 /end MEASUREMENT
/begin MEASUREMENT DINH_nrActvInhReas.FId_EGRVlvOfsLrnInhib "Number of active inhibit reasons for the FIds / Number of active inhibit reasons for FId_EGRVlvOfsLrnInhib" UWORD DINH_ct_Compu 1 100 -4095.000 4096.000 BIT_MASK 0x1fff FORMAT "%8.3" ECU_ADDRESS 0x600139AA /end MEASUREMENT
/begin MEASUREMENT DINH_nrActvInhReas.FId_EGRVlvPhysRng "Number of active inhibit reasons for the FIds / Number of active inhibit reasons for FId_EGRVlvPhysRng" UWORD DINH_ct_Compu 1 100 -4095.000 4096.000 BIT_MASK 0x1fff FORMAT "%8.3" ECU_ADDRESS 0x600139AC /end MEASUREMENT
/begin MEASUREMENT DINH_nrActvInhReas.FId_EGRVlvPsSwtOff "Number of active inhibit reasons for the FIds / Number of active inhibit reasons for FId_EGRVlvPsSwtOff" UWORD DINH_ct_Compu 1 100 -4095.000 4096.000 BIT_MASK 0x1fff FORMAT "%8.3" ECU_ADDRESS 0x600139AE /end MEASUREMENT
/begin MEASUREMENT DINH_nrActvInhReas.FId_EGRVlvPwrStgMonDis "Number of active inhibit reasons for the FIds / Number of active inhibit reasons for FId_EGRVlvPwrStgMonDis" UWORD DINH_ct_Compu 1 100 -4095.000 4096.000 BIT_MASK 0x1fff FORMAT "%8.3" ECU_ADDRESS 0x600139B0 /end MEASUREMENT
/begin MEASUREMENT DINH_nrActvInhReas.FId_EGRVlvRplVal "Number of active inhibit reasons for the FIds / Number of active inhibit reasons for FId_EGRVlvRplVal" UWORD DINH_ct_Compu 1 100 -4095.000 4096.000 BIT_MASK 0x1fff FORMAT "%8.3" ECU_ADDRESS 0x600139B2 /end MEASUREMENT
/begin MEASUREMENT DINH_nrActvInhReas.FId_EGRVlvSSpMon "Number of active inhibit reasons for the FIds / Number of active inhibit reasons for FId_EGRVlvSSpMon" UWORD DINH_ct_Compu 1 100 -4095.000 4096.000 BIT_MASK 0x1fff FORMAT "%8.3" ECU_ADDRESS 0x600139B4 /end MEASUREMENT
/begin MEASUREMENT DINH_nrActvInhReas.FId_EGRVlvSnsrErr "Number of active inhibit reasons for the FIds / Number of active inhibit reasons for FId_EGRVlvSnsrErr" UWORD DINH_ct_Compu 1 100 -4095.000 4096.000 BIT_MASK 0x1fff FORMAT "%8.3" ECU_ADDRESS 0x600139B6 /end MEASUREMENT
/begin MEASUREMENT DINH_nrActvInhReas.FId_EGRVlvTempCmp "Number of active inhibit reasons for the FIds / Number of active inhibit reasons for FId_EGRVlvTempCmp" UWORD DINH_ct_Compu 1 100 -4095.000 4096.000 BIT_MASK 0x1fff FORMAT "%8.3" ECU_ADDRESS 0x600139B8 /end MEASUREMENT
/begin MEASUREMENT DINH_nrActvInhReas.FId_EGRVlvTempMdlEEPErr "Number of active inhibit reasons for the FIds / Number of active inhibit reasons for FId_EGRVlvTempMdlEEPErr" UWORD DINH_ct_Compu 1 100 -4095.000 4096.000 BIT_MASK 0x1fff FORMAT "%8.3" ECU_ADDRESS 0x600139BA /end MEASUREMENT
/begin MEASUREMENT DINH_nrActvInhReas.FId_EGRVlvTmpErrCnt "Number of active inhibit reasons for the FIds / Number of active inhibit reasons for FId_EGRVlvTmpErrCnt" UWORD DINH_ct_Compu 1 100 -4095.000 4096.000 BIT_MASK 0x1fff FORMAT "%8.3" ECU_ADDRESS 0x600139BC /end MEASUREMENT
/begin MEASUREMENT DINH_nrActvInhReas.FId_EGRVlvTrlPtr "Number of active inhibit reasons for the FIds / Number of active inhibit reasons for FId_EGRVlvTrlPtr" UWORD DINH_ct_Compu 1 100 -4095.000 4096.000 BIT_MASK 0x1fff FORMAT "%8.3" ECU_ADDRESS 0x600139BE /end MEASUREMENT
/begin MEASUREMENT DINH_nrActvInhReas.FId_EGRVlv_VehvErr "Number of active inhibit reasons for the FIds / Number of active inhibit reasons for FId_EGRVlv_VehvErr" UWORD DINH_ct_Compu 1 100 -4095.000 4096.000 BIT_MASK 0x1fff FORMAT "%8.3" ECU_ADDRESS 0x600139C0 /end MEASUREMENT
/begin MEASUREMENT DINH_nrActvInhReas.FId_EGRVlviActIEfcLimn "Number of active inhibit reasons for the FIds / Number of active inhibit reasons for FId_EGRVlviActIEfcLimn" UWORD DINH_ct_Compu 1 100 -4095.000 4096.000 BIT_MASK 0x1fff FORMAT "%8.3" ECU_ADDRESS 0x600139C2 /end MEASUREMENT
/begin MEASUREMENT DINH_nrActvInhReas.FId_EGRVlvpDsbcInvld "Number of active inhibit reasons for the FIds / Number of active inhibit reasons for FId_EGRVlvpDsbcInvld" UWORD DINH_ct_Compu 1 100 -4095.000 4096.000 BIT_MASK 0x1fff FORMAT "%8.3" ECU_ADDRESS 0x600139C4 /end MEASUREMENT
/begin MEASUREMENT DINH_nrActvInhReas.FId_EGSDO2OffsRstDsmS1B1 "Number of active inhibit reasons for the FIds / Number of active inhibit reasons for FId_EGSDO2OffsRstDsmS1B1" UWORD DINH_ct_Compu 1 100 -4095.000 4096.000 BIT_MASK 0x1fff FORMAT "%8.3" ECU_ADDRESS 0x600139C6 /end MEASUREMENT
/begin MEASUREMENT DINH_nrActvInhReas.FId_EGSDO2_LamOffsSlowS1 "Number of active inhibit reasons for the FIds / Number of active inhibit reasons for FId_EGSDO2_LamOffsSlowS1" UWORD DINH_ct_Compu 1 100 -4095.000 4096.000 BIT_MASK 0x1fff FORMAT "%8.3" ECU_ADDRESS 0x600139C8 /end MEASUREMENT
/begin MEASUREMENT DINH_nrActvInhReas.FId_EGSDO2_RstFltSuspcnOffsB1 "Number of active inhibit reasons for the FIds / Number of active inhibit reasons for FId_EGSDO2_RstFltSuspcnOffsB1" UWORD DINH_ct_Compu 1 100 -4095.000 4096.000 BIT_MASK 0x1fff FORMAT "%8.3" ECU_ADDRESS 0x600139CA /end MEASUREMENT
/begin MEASUREMENT DINH_nrActvInhReas.FId_EGSDUS2B1DlyEvln "Number of active inhibit reasons for the FIds / Number of active inhibit reasons for FId_EGSDUS2B1DlyEvln" UWORD DINH_ct_Compu 1 100 -4095.000 4096.000 BIT_MASK 0x1fff FORMAT "%8.3" ECU_ADDRESS 0x600139CC /end MEASUREMENT
/begin MEASUREMENT DINH_nrActvInhReas.FId_EGSDUS2B1LtrDly "Number of active inhibit reasons for the FIds / Number of active inhibit reasons for FId_EGSDUS2B1LtrDly" UWORD DINH_ct_Compu 1 100 -4095.000 4096.000 BIT_MASK 0x1fff FORMAT "%8.3" ECU_ADDRESS 0x600139CE /end MEASUREMENT
/begin MEASUREMENT DINH_nrActvInhReas.FId_EGSDUS2B1LtrPT1 "Number of active inhibit reasons for the FIds / Number of active inhibit reasons for FId_EGSDUS2B1LtrPT1" UWORD DINH_ct_Compu 1 100 -4095.000 4096.000 BIT_MASK 0x1fff FORMAT "%8.3" ECU_ADDRESS 0x600139D0 /end MEASUREMENT
/begin MEASUREMENT DINH_nrActvInhReas.FId_EGSDUS2B1PT1Evln "Number of active inhibit reasons for the FIds / Number of active inhibit reasons for FId_EGSDUS2B1PT1Evln" UWORD DINH_ct_Compu 1 100 -4095.000 4096.000 BIT_MASK 0x1fff FORMAT "%8.3" ECU_ADDRESS 0x600139D2 /end MEASUREMENT
/begin MEASUREMENT DINH_nrActvInhReas.FId_EGSDUS2B1RtlDly "Number of active inhibit reasons for the FIds / Number of active inhibit reasons for FId_EGSDUS2B1RtlDly" UWORD DINH_ct_Compu 1 100 -4095.000 4096.000 BIT_MASK 0x1fff FORMAT "%8.3" ECU_ADDRESS 0x600139D4 /end MEASUREMENT
/begin MEASUREMENT DINH_nrActvInhReas.FId_EGSDUS2B1RtlPT1 "Number of active inhibit reasons for the FIds / Number of active inhibit reasons for FId_EGSDUS2B1RtlPT1" UWORD DINH_ct_Compu 1 100 -4095.000 4096.000 BIT_MASK 0x1fff FORMAT "%8.3" ECU_ADDRESS 0x600139D6 /end MEASUREMENT
/begin MEASUREMENT DINH_nrActvInhReas.FId_EGSDUS2B1TarEvln "Number of active inhibit reasons for the FIds / Number of active inhibit reasons for FId_EGSDUS2B1TarEvln" UWORD DINH_ct_Compu 1 100 -4095.000 4096.000 BIT_MASK 0x1fff FORMAT "%8.3" ECU_ADDRESS 0x600139D8 /end MEASUREMENT
/begin MEASUREMENT DINH_nrActvInhReas.FId_EGSDUS2B1TarLean "Number of active inhibit reasons for the FIds / Number of active inhibit reasons for FId_EGSDUS2B1TarLean" UWORD DINH_ct_Compu 1 100 -4095.000 4096.000 BIT_MASK 0x1fff FORMAT "%8.3" ECU_ADDRESS 0x600139DA /end MEASUREMENT
/begin MEASUREMENT DINH_nrActvInhReas.FId_EGSDUS2B1TarRich "Number of active inhibit reasons for the FIds / Number of active inhibit reasons for FId_EGSDUS2B1TarRich" UWORD DINH_ct_Compu 1 100 -4095.000 4096.000 BIT_MASK 0x1fff FORMAT "%8.3" ECU_ADDRESS 0x600139DC /end MEASUREMENT
/begin MEASUREMENT DINH_nrActvInhReas.FId_EGSSigO2S1B1 "Number of active inhibit reasons for the FIds / Number of active inhibit reasons for FId_EGSSigO2S1B1" UWORD DINH_ct_Compu 1 100 -4095.000 4096.000 BIT_MASK 0x1fff FORMAT "%8.3" ECU_ADDRESS 0x600139DE /end MEASUREMENT
/begin MEASUREMENT DINH_nrActvInhReas.FId_ELZSR "Number of active inhibit reasons for the FIds / Number of active inhibit reasons for FId_ELZSR" UWORD DINH_ct_Compu 1 100 -4095.000 4096.000 BIT_MASK 0x1fff FORMAT "%8.3" ECU_ADDRESS 0x600139E0 /end MEASUREMENT
/begin MEASUREMENT DINH_nrActvInhReas.FId_EPBErr "Number of active inhibit reasons for the FIds / Number of active inhibit reasons for FId_EPBErr" UWORD DINH_ct_Compu 1 100 -4095.000 4096.000 BIT_MASK 0x1fff FORMAT "%8.3" ECU_ADDRESS 0x600139E2 /end MEASUREMENT
/begin MEASUREMENT DINH_nrActvInhReas.FId_EPBFrmErr "Number of active inhibit reasons for the FIds / Number of active inhibit reasons for FId_EPBFrmErr" UWORD DINH_ct_Compu 1 100 -4095.000 4096.000 BIT_MASK 0x1fff FORMAT "%8.3" ECU_ADDRESS 0x600139E4 /end MEASUREMENT
/begin MEASUREMENT DINH_nrActvInhReas.FId_EPBFrmErrClth "Number of active inhibit reasons for the FIds / Number of active inhibit reasons for FId_EPBFrmErrClth" UWORD DINH_ct_Compu 1 100 -4095.000 4096.000 BIT_MASK 0x1fff FORMAT "%8.3" ECU_ADDRESS 0x600139E6 /end MEASUREMENT
/begin MEASUREMENT DINH_nrActvInhReas.FId_ETHSCPErrDrvCyc "Number of active inhibit reasons for the FIds / Number of active inhibit reasons for FId_ETHSCPErrDrvCyc" UWORD DINH_ct_Compu 1 100 -4095.000 4096.000 BIT_MASK 0x1fff FORMAT "%8.3" ECU_ADDRESS 0x600139E8 /end MEASUREMENT
/begin MEASUREMENT DINH_nrActvInhReas.FId_EVPComFailr "Number of active inhibit reasons for the FIds / Number of active inhibit reasons for FId_EVPComFailr" UWORD DINH_ct_Compu 1 100 -4095.000 4096.000 BIT_MASK 0x1fff FORMAT "%8.3" ECU_ADDRESS 0x600139EA /end MEASUREMENT
/begin MEASUREMENT DINH_nrActvInhReas.FId_EbsLinErr "Number of active inhibit reasons for the FIds / Number of active inhibit reasons for FId_EbsLinErr" UWORD DINH_ct_Compu 1 100 -4095.000 4096.000 BIT_MASK 0x1fff FORMAT "%8.3" ECU_ADDRESS 0x600139EC /end MEASUREMENT
/begin MEASUREMENT DINH_nrActvInhReas.FId_ElecLdComErr "Number of active inhibit reasons for the FIds / Number of active inhibit reasons for FId_ElecLdComErr" UWORD DINH_ct_Compu 1 100 -4095.000 4096.000 BIT_MASK 0x1fff FORMAT "%8.3" ECU_ADDRESS 0x600139EE /end MEASUREMENT
/begin MEASUREMENT DINH_nrActvInhReas.FId_ElecLdFrzVal "Number of active inhibit reasons for the FIds / Number of active inhibit reasons for FId_ElecLdFrzVal" UWORD DINH_ct_Compu 1 100 -4095.000 4096.000 BIT_MASK 0x1fff FORMAT "%8.3" ECU_ADDRESS 0x600139F0 /end MEASUREMENT
/begin MEASUREMENT DINH_nrActvInhReas.FId_ElecLdHdLiComErr "Number of active inhibit reasons for the FIds / Number of active inhibit reasons for FId_ElecLdHdLiComErr" UWORD DINH_ct_Compu 1 100 -4095.000 4096.000 BIT_MASK 0x1fff FORMAT "%8.3" ECU_ADDRESS 0x600139F2 /end MEASUREMENT
/begin MEASUREMENT DINH_nrActvInhReas.FId_ElecLdRplVal "Number of active inhibit reasons for the FIds / Number of active inhibit reasons for FId_ElecLdRplVal" UWORD DINH_ct_Compu 1 100 -4095.000 4096.000 BIT_MASK 0x1fff FORMAT "%8.3" ECU_ADDRESS 0x600139F4 /end MEASUREMENT
/begin MEASUREMENT DINH_nrActvInhReas.FId_ElecLoadEPSComErr "Number of active inhibit reasons for the FIds / Number of active inhibit reasons for FId_ElecLoadEPSComErr" UWORD DINH_ct_Compu 1 100 -4095.000 4096.000 BIT_MASK 0x1fff FORMAT "%8.3" ECU_ADDRESS 0x600139F6 /end MEASUREMENT
/begin MEASUREMENT DINH_nrActvInhReas.FId_EngBlkTWrn "Number of active inhibit reasons for the FIds / Number of active inhibit reasons for FId_EngBlkTWrn" UWORD DINH_ct_Compu 1 100 -4095.000 4096.000 BIT_MASK 0x1fff FORMAT "%8.3" ECU_ADDRESS 0x600139F8 /end MEASUREMENT
/begin MEASUREMENT DINH_nrActvInhReas.FId_EngCooltTFail "Number of active inhibit reasons for the FIds / Number of active inhibit reasons for FId_EngCooltTFail" UWORD DINH_ct_Compu 1 100 -4095.000 4096.000 BIT_MASK 0x1fff FORMAT "%8.3" ECU_ADDRESS 0x600139FA /end MEASUREMENT
/begin MEASUREMENT DINH_nrActvInhReas.FId_EngDemTqLimnCamsftErr "Number of active inhibit reasons for the FIds / Number of active inhibit reasons for FId_EngDemTqLimnCamsftErr" UWORD DINH_ct_Compu 1 100 -4095.000 4096.000 BIT_MASK 0x1fff FORMAT "%8.3" ECU_ADDRESS 0x600139FC /end MEASUREMENT
/begin MEASUREMENT DINH_nrActvInhReas.FId_EngDemTqLimnErrThmstHeatCtrlCirc "Number of active inhibit reasons for the FIds / Number of active inhibit reasons for FId_EngDemTqLimnErrThmstHeatCtrlCirc" UWORD DINH_ct_Compu 1 100 -4095.000 4096.000 BIT_MASK 0x1fff FORMAT "%8.3" ECU_ADDRESS 0x600139FE /end MEASUREMENT
/begin MEASUREMENT DINH_nrActvInhReas.FId_EngDemTqLimnOilPmp "Number of active inhibit reasons for the FIds / Number of active inhibit reasons for FId_EngDemTqLimnOilPmp" UWORD DINH_ct_Compu 1 100 -4095.000 4096.000 BIT_MASK 0x1fff FORMAT "%8.3" ECU_ADDRESS 0x60013A00 /end MEASUREMENT
/begin MEASUREMENT DINH_nrActvInhReas.FId_EngDemTrqLimErrAPP "Number of active inhibit reasons for the FIds / Number of active inhibit reasons for FId_EngDemTrqLimErrAPP" UWORD DINH_ct_Compu 1 100 -4095.000 4096.000 BIT_MASK 0x1fff FORMAT "%8.3" ECU_ADDRESS 0x60013A02 /end MEASUREMENT
/begin MEASUREMENT DINH_nrActvInhReas.FId_EngIntkAirFail "Number of active inhibit reasons for the FIds / Number of active inhibit reasons for FId_EngIntkAirFail" UWORD DINH_ct_Compu 1 100 -4095.000 4096.000 BIT_MASK 0x1fff FORMAT "%8.3" ECU_ADDRESS 0x60013A04 /end MEASUREMENT
/begin MEASUREMENT DINH_nrActvInhReas.FId_EngPrtErrVehV "Number of active inhibit reasons for the FIds / Number of active inhibit reasons for FId_EngPrtErrVehV" UWORD DINH_ct_Compu 1 100 -4095.000 4096.000 BIT_MASK 0x1fff FORMAT "%8.3" ECU_ADDRESS 0x60013A06 /end MEASUREMENT
/begin MEASUREMENT DINH_nrActvInhReas.FId_EngSpd30DegFail "Number of active inhibit reasons for the FIds / Number of active inhibit reasons for FId_EngSpd30DegFail" UWORD DINH_ct_Compu 1 100 -4095.000 4096.000 BIT_MASK 0x1fff FORMAT "%8.3" ECU_ADDRESS 0x60013A08 /end MEASUREMENT
/begin MEASUREMENT DINH_nrActvInhReas.FId_EngStrtEnaEthAdap "Number of active inhibit reasons for the FIds / Number of active inhibit reasons for FId_EngStrtEnaEthAdap" UWORD DINH_ct_Compu 1 100 -4095.000 4096.000 BIT_MASK 0x1fff FORMAT "%8.3" ECU_ADDRESS 0x60013A0A /end MEASUREMENT
/begin MEASUREMENT DINH_nrActvInhReas.FId_EngStrt_EnaCep "Number of active inhibit reasons for the FIds / Number of active inhibit reasons for FId_EngStrt_EnaCep" UWORD DINH_ct_Compu 1 100 -4095.000 4096.000 BIT_MASK 0x1fff FORMAT "%8.3" ECU_ADDRESS 0x60013A0C /end MEASUREMENT
/begin MEASUREMENT DINH_nrActvInhReas.FId_EngStrt_InjProhb "Number of active inhibit reasons for the FIds / Number of active inhibit reasons for FId_EngStrt_InjProhb" UWORD DINH_ct_Compu 1 100 -4095.000 4096.000 BIT_MASK 0x1fff FORMAT "%8.3" ECU_ADDRESS 0x60013A0E /end MEASUREMENT
/begin MEASUREMENT DINH_nrActvInhReas.FId_EngStrt_VehVInhb "Number of active inhibit reasons for the FIds / Number of active inhibit reasons for FId_EngStrt_VehVInhb" UWORD DINH_ct_Compu 1 100 -4095.000 4096.000 BIT_MASK 0x1fff FORMAT "%8.3" ECU_ADDRESS 0x60013A10 /end MEASUREMENT
/begin MEASUREMENT DINH_nrActvInhReas.FId_EngTqRvsnEnaFlg "Number of active inhibit reasons for the FIds / Number of active inhibit reasons for FId_EngTqRvsnEnaFlg" UWORD DINH_ct_Compu 1 100 -4095.000 4096.000 BIT_MASK 0x1fff FORMAT "%8.3" ECU_ADDRESS 0x60013A12 /end MEASUREMENT
/begin MEASUREMENT DINH_nrActvInhReas.FId_EnvTPrimMod "Number of active inhibit reasons for the FIds / Number of active inhibit reasons for FId_EnvTPrimMod" UWORD DINH_ct_Compu 1 100 -4095.000 4096.000 BIT_MASK 0x1fff FORMAT "%8.3" ECU_ADDRESS 0x60013A14 /end MEASUREMENT
/begin MEASUREMENT DINH_nrActvInhReas.FId_EnvTPrimModIniVal "Number of active inhibit reasons for the FIds / Number of active inhibit reasons for FId_EnvTPrimModIniVal" UWORD DINH_ct_Compu 1 100 -4095.000 4096.000 BIT_MASK 0x1fff FORMAT "%8.3" ECU_ADDRESS 0x60013A16 /end MEASUREMENT
/begin MEASUREMENT DINH_nrActvInhReas.FId_EnvTSensSum "Number of active inhibit reasons for the FIds / Number of active inhibit reasons for FId_EnvTSensSum" UWORD DINH_ct_Compu 1 100 -4095.000 4096.000 BIT_MASK 0x1fff FORMAT "%8.3" ECU_ADDRESS 0x60013A18 /end MEASUREMENT
/begin MEASUREMENT DINH_nrActvInhReas.FId_EnvTtAirFltDs "Number of active inhibit reasons for the FIds / Number of active inhibit reasons for FId_EnvTtAirFltDs" UWORD DINH_ct_Compu 1 100 -4095.000 4096.000 BIT_MASK 0x1fff FORMAT "%8.3" ECU_ADDRESS 0x60013A1A /end MEASUREMENT
/begin MEASUREMENT DINH_nrActvInhReas.FId_EnvTtCEngDsT "Number of active inhibit reasons for the FIds / Number of active inhibit reasons for FId_EnvTtCEngDsT" UWORD DINH_ct_Compu 1 100 -4095.000 4096.000 BIT_MASK 0x1fff FORMAT "%8.3" ECU_ADDRESS 0x60013A1C /end MEASUREMENT
/begin MEASUREMENT DINH_nrActvInhReas.FId_EnvTtIntkMnfld "Number of active inhibit reasons for the FIds / Number of active inhibit reasons for FId_EnvTtIntkMnfld" UWORD DINH_ct_Compu 1 100 -4095.000 4096.000 BIT_MASK 0x1fff FORMAT "%8.3" ECU_ADDRESS 0x60013A1E /end MEASUREMENT
/begin MEASUREMENT DINH_nrActvInhReas.FId_EomCvoAllwd "Number of active inhibit reasons for the FIds / Number of active inhibit reasons for FId_EomCvoAllwd" UWORD DINH_ct_Compu 1 100 -4095.000 4096.000 BIT_MASK 0x1fff FORMAT "%8.3" ECU_ADDRESS 0x60013A20 /end MEASUREMENT
/begin MEASUREMENT DINH_nrActvInhReas.FId_EpmBCr "Number of active inhibit reasons for the FIds / Number of active inhibit reasons for FId_EpmBCr" UWORD DINH_ct_Compu 1 100 -4095.000 4096.000 BIT_MASK 0x1fff FORMAT "%8.3" ECU_ADDRESS 0x60013A22 /end MEASUREMENT
/begin MEASUREMENT DINH_nrActvInhReas.FId_EpmCaSAdapCaSI1 "Number of active inhibit reasons for the FIds / Number of active inhibit reasons for FId_EpmCaSAdapCaSI1" UWORD DINH_ct_Compu 1 100 -4095.000 4096.000 BIT_MASK 0x1fff FORMAT "%8.3" ECU_ADDRESS 0x60013A24 /end MEASUREMENT
/begin MEASUREMENT DINH_nrActvInhReas.FId_EpmCaSAdapRstI1 "Number of active inhibit reasons for the FIds / Number of active inhibit reasons for FId_EpmCaSAdapRstI1" UWORD DINH_ct_Compu 1 100 -4095.000 4096.000 BIT_MASK 0x1fff FORMAT "%8.3" ECU_ADDRESS 0x60013A26 /end MEASUREMENT
/begin MEASUREMENT DINH_nrActvInhReas.FId_EpmCaSDiagI1 "Number of active inhibit reasons for the FIds / Number of active inhibit reasons for FId_EpmCaSDiagI1" UWORD DINH_ct_Compu 1 100 -4095.000 4096.000 BIT_MASK 0x1fff FORMAT "%8.3" ECU_ADDRESS 0x60013A28 /end MEASUREMENT
/begin MEASUREMENT DINH_nrActvInhReas.FId_EpmCaSErrCaSI1 "Number of active inhibit reasons for the FIds / Number of active inhibit reasons for FId_EpmCaSErrCaSI1" UWORD DINH_ct_Compu 1 100 -4095.000 4096.000 BIT_MASK 0x1fff FORMAT "%8.3" ECU_ADDRESS 0x60013A2A /end MEASUREMENT
/begin MEASUREMENT DINH_nrActvInhReas.FId_EpmCaSOfsDiagCaSI1 "Number of active inhibit reasons for the FIds / Number of active inhibit reasons for FId_EpmCaSOfsDiagCaSI1" UWORD DINH_ct_Compu 1 100 -4095.000 4096.000 BIT_MASK 0x1fff FORMAT "%8.3" ECU_ADDRESS 0x60013A2C /end MEASUREMENT
/begin MEASUREMENT DINH_nrActvInhReas.FId_EpmCaSOfsErrCaSI1 "Number of active inhibit reasons for the FIds / Number of active inhibit reasons for FId_EpmCaSOfsErrCaSI1" UWORD DINH_ct_Compu 1 100 -4095.000 4096.000 BIT_MASK 0x1fff FORMAT "%8.3" ECU_ADDRESS 0x60013A2E /end MEASUREMENT
/begin MEASUREMENT DINH_nrActvInhReas.FId_EpmCaSSegI1 "Number of active inhibit reasons for the FIds / Number of active inhibit reasons for FId_EpmCaSSegI1" UWORD DINH_ct_Compu 1 100 -4095.000 4096.000 BIT_MASK 0x1fff FORMAT "%8.3" ECU_ADDRESS 0x60013A30 /end MEASUREMENT
/begin MEASUREMENT DINH_nrActvInhReas.FId_EpmCaSSpdPlausI1 "Number of active inhibit reasons for the FIds / Number of active inhibit reasons for FId_EpmCaSSpdPlausI1" UWORD DINH_ct_Compu 1 100 -4095.000 4096.000 BIT_MASK 0x1fff FORMAT "%8.3" ECU_ADDRESS 0x60013A32 /end MEASUREMENT
/begin MEASUREMENT DINH_nrActvInhReas.FId_EpmCrSDiag "Number of active inhibit reasons for the FIds / Number of active inhibit reasons for FId_EpmCrSDiag" UWORD DINH_ct_Compu 1 100 -4095.000 4096.000 BIT_MASK 0x1fff FORMAT "%8.3" ECU_ADDRESS 0x60013A34 /end MEASUREMENT
/begin MEASUREMENT DINH_nrActvInhReas.FId_EpmCrSDiagVeh "Number of active inhibit reasons for the FIds / Number of active inhibit reasons for FId_EpmCrSDiagVeh" UWORD DINH_ct_Compu 1 100 -4095.000 4096.000 BIT_MASK 0x1fff FORMAT "%8.3" ECU_ADDRESS 0x60013A36 /end MEASUREMENT
/begin MEASUREMENT DINH_nrActvInhReas.FId_EpmCrSErr "Number of active inhibit reasons for the FIds / Number of active inhibit reasons for FId_EpmCrSErr" UWORD DINH_ct_Compu 1 100 -4095.000 4096.000 BIT_MASK 0x1fff FORMAT "%8.3" ECU_ADDRESS 0x60013A38 /end MEASUREMENT
/begin MEASUREMENT DINH_nrActvInhReas.FId_EpmOpMode_ALELock "Number of active inhibit reasons for the FIds / Number of active inhibit reasons for FId_EpmOpMode_ALELock" UWORD DINH_ct_Compu 1 100 -4095.000 4096.000 BIT_MASK 0x1fff FORMAT "%8.3" ECU_ADDRESS 0x60013A3A /end MEASUREMENT
/begin MEASUREMENT DINH_nrActvInhReas.FId_EpmOpMode_DirStLock "Number of active inhibit reasons for the FIds / Number of active inhibit reasons for FId_EpmOpMode_DirStLock" UWORD DINH_ct_Compu 1 100 -4095.000 4096.000 BIT_MASK 0x1fff FORMAT "%8.3" ECU_ADDRESS 0x60013A3C /end MEASUREMENT
/begin MEASUREMENT DINH_nrActvInhReas.FId_EpmRRSCrSFaultCheck "Number of active inhibit reasons for the FIds / Number of active inhibit reasons for FId_EpmRRSCrSFaultCheck" UWORD DINH_ct_Compu 1 100 -4095.000 4096.000 BIT_MASK 0x1fff FORMAT "%8.3" ECU_ADDRESS 0x60013A3E /end MEASUREMENT
/begin MEASUREMENT DINH_nrActvInhReas.FId_EpmRRSDGIFaultCheck "Number of active inhibit reasons for the FIds / Number of active inhibit reasons for FId_EpmRRSDGIFaultCheck" UWORD DINH_ct_Compu 1 100 -4095.000 4096.000 BIT_MASK 0x1fff FORMAT "%8.3" ECU_ADDRESS 0x60013A40 /end MEASUREMENT
/begin MEASUREMENT DINH_nrActvInhReas.FId_EpmRRSRdCheck "Number of active inhibit reasons for the FIds / Number of active inhibit reasons for FId_EpmRRSRdCheck" UWORD DINH_ct_Compu 1 100 -4095.000 4096.000 BIT_MASK 0x1fff FORMAT "%8.3" ECU_ADDRESS 0x60013A42 /end MEASUREMENT
/begin MEASUREMENT DINH_nrActvInhReas.FId_EpmRRSVehVFaultChck "Number of active inhibit reasons for the FIds / Number of active inhibit reasons for FId_EpmRRSVehVFaultChck" UWORD DINH_ct_Compu 1 100 -4095.000 4096.000 BIT_MASK 0x1fff FORMAT "%8.3" ECU_ADDRESS 0x60013A44 /end MEASUREMENT
/begin MEASUREMENT DINH_nrActvInhReas.FId_EpmSynLockCaSSync "Number of active inhibit reasons for the FIds / Number of active inhibit reasons for FId_EpmSynLockCaSSync" UWORD DINH_ct_Compu 1 100 -4095.000 4096.000 BIT_MASK 0x1fff FORMAT "%8.3" ECU_ADDRESS 0x60013A46 /end MEASUREMENT
/begin MEASUREMENT DINH_nrActvInhReas.FId_EpmTmpSuppRvsRotCASI1 "Number of active inhibit reasons for the FIds / Number of active inhibit reasons for FId_EpmTmpSuppRvsRotCASI1" UWORD DINH_ct_Compu 1 100 -4095.000 4096.000 BIT_MASK 0x1fff FORMAT "%8.3" ECU_ADDRESS 0x60013A48 /end MEASUREMENT
/begin MEASUREMENT DINH_nrActvInhReas.FId_EtaEngIdleNonCsers "Number of active inhibit reasons for the FIds / Number of active inhibit reasons for FId_EtaEngIdleNonCsers" UWORD DINH_ct_Compu 1 100 -4095.000 4096.000 BIT_MASK 0x1fff FORMAT "%8.3" ECU_ADDRESS 0x60013A4A /end MEASUREMENT
/begin MEASUREMENT DINH_nrActvInhReas.FId_EtaEngPtlNonCsers "Number of active inhibit reasons for the FIds / Number of active inhibit reasons for FId_EtaEngPtlNonCsers" UWORD DINH_ct_Compu 1 100 -4095.000 4096.000 BIT_MASK 0x1fff FORMAT "%8.3" ECU_ADDRESS 0x60013A4C /end MEASUREMENT
/begin MEASUREMENT DINH_nrActvInhReas.FId_EthnlSnsrErrCdn "Number of active inhibit reasons for the FIds / Number of active inhibit reasons for FId_EthnlSnsrErrCdn" UWORD DINH_ct_Compu 1 100 -4095.000 4096.000 BIT_MASK 0x1fff FORMAT "%8.3" ECU_ADDRESS 0x60013A4E /end MEASUREMENT
/begin MEASUREMENT DINH_nrActvInhReas.FId_EvapActrCcvElecDiag "Number of active inhibit reasons for the FIds / Number of active inhibit reasons for FId_EvapActrCcvElecDiag" UWORD DINH_ct_Compu 1 100 -4095.000 4096.000 BIT_MASK 0x1fff FORMAT "%8.3" ECU_ADDRESS 0x60013A50 /end MEASUREMENT
/begin MEASUREMENT DINH_nrActvInhReas.FId_EvapPSnsrTankPhyRngChk "Number of active inhibit reasons for the FIds / Number of active inhibit reasons for FId_EvapPSnsrTankPhyRngChk" UWORD DINH_ct_Compu 1 100 -4095.000 4096.000 BIT_MASK 0x1fff FORMAT "%8.3" ECU_ADDRESS 0x60013A52 /end MEASUREMENT
/begin MEASUREMENT DINH_nrActvInhReas.FId_FanCtlACClntP "Number of active inhibit reasons for the FIds / Number of active inhibit reasons for FId_FanCtlACClntP" UWORD DINH_ct_Compu 1 100 -4095.000 4096.000 BIT_MASK 0x1fff FORMAT "%8.3" ECU_ADDRESS 0x60013A54 /end MEASUREMENT
/begin MEASUREMENT DINH_nrActvInhReas.FId_FanCtlACGModFail "Number of active inhibit reasons for the FIds / Number of active inhibit reasons for FId_FanCtlACGModFail" UWORD DINH_ct_Compu 1 100 -4095.000 4096.000 BIT_MASK 0x1fff FORMAT "%8.3" ECU_ADDRESS 0x60013A56 /end MEASUREMENT
/begin MEASUREMENT DINH_nrActvInhReas.FId_FanCtlAPP1 "Number of active inhibit reasons for the FIds / Number of active inhibit reasons for FId_FanCtlAPP1" UWORD DINH_ct_Compu 1 100 -4095.000 4096.000 BIT_MASK 0x1fff FORMAT "%8.3" ECU_ADDRESS 0x60013A58 /end MEASUREMENT
/begin MEASUREMENT DINH_nrActvInhReas.FId_FanCtlAPP2 "Number of active inhibit reasons for the FIds / Number of active inhibit reasons for FId_FanCtlAPP2" UWORD DINH_ct_Compu 1 100 -4095.000 4096.000 BIT_MASK 0x1fff FORMAT "%8.3" ECU_ADDRESS 0x60013A5A /end MEASUREMENT
/begin MEASUREMENT DINH_nrActvInhReas.FId_FanCtlAPPSync "Number of active inhibit reasons for the FIds / Number of active inhibit reasons for FId_FanCtlAPPSync" UWORD DINH_ct_Compu 1 100 -4095.000 4096.000 BIT_MASK 0x1fff FORMAT "%8.3" ECU_ADDRESS 0x60013A5C /end MEASUREMENT
/begin MEASUREMENT DINH_nrActvInhReas.FId_FanCtlBlowrU "Number of active inhibit reasons for the FIds / Number of active inhibit reasons for FId_FanCtlBlowrU" UWORD DINH_ct_Compu 1 100 -4095.000 4096.000 BIT_MASK 0x1fff FORMAT "%8.3" ECU_ADDRESS 0x60013A5E /end MEASUREMENT
/begin MEASUREMENT DINH_nrActvInhReas.FId_FanCtlCooltT "Number of active inhibit reasons for the FIds / Number of active inhibit reasons for FId_FanCtlCooltT" UWORD DINH_ct_Compu 1 100 -4095.000 4096.000 BIT_MASK 0x1fff FORMAT "%8.3" ECU_ADDRESS 0x60013A60 /end MEASUREMENT
/begin MEASUREMENT DINH_nrActvInhReas.FId_FanCtlCooltT2 "Number of active inhibit reasons for the FIds / Number of active inhibit reasons for FId_FanCtlCooltT2" UWORD DINH_ct_Compu 1 100 -4095.000 4096.000 BIT_MASK 0x1fff FORMAT "%8.3" ECU_ADDRESS 0x60013A62 /end MEASUREMENT
/begin MEASUREMENT DINH_nrActvInhReas.FId_FanCtlEnvT "Number of active inhibit reasons for the FIds / Number of active inhibit reasons for FId_FanCtlEnvT" UWORD DINH_ct_Compu 1 100 -4095.000 4096.000 BIT_MASK 0x1fff FORMAT "%8.3" ECU_ADDRESS 0x60013A64 /end MEASUREMENT
/begin MEASUREMENT DINH_nrActvInhReas.FId_FanCtlLiSwtInfo "Number of active inhibit reasons for the FIds / Number of active inhibit reasons for FId_FanCtlLiSwtInfo" UWORD DINH_ct_Compu 1 100 -4095.000 4096.000 BIT_MASK 0x1fff FORMAT "%8.3" ECU_ADDRESS 0x60013A66 /end MEASUREMENT
/begin MEASUREMENT DINH_nrActvInhReas.FId_FanCtlSpd "Number of active inhibit reasons for the FIds / Number of active inhibit reasons for FId_FanCtlSpd" UWORD DINH_ct_Compu 1 100 -4095.000 4096.000 BIT_MASK 0x1fff FORMAT "%8.3" ECU_ADDRESS 0x60013A68 /end MEASUREMENT
/begin MEASUREMENT DINH_nrActvInhReas.FId_FanCtlTSnsrErr "Number of active inhibit reasons for the FIds / Number of active inhibit reasons for FId_FanCtlTSnsrErr" UWORD DINH_ct_Compu 1 100 -4095.000 4096.000 BIT_MASK 0x1fff FORMAT "%8.3" ECU_ADDRESS 0x60013A6A /end MEASUREMENT
/begin MEASUREMENT DINH_nrActvInhReas.FId_FanCtlThr1 "Number of active inhibit reasons for the FIds / Number of active inhibit reasons for FId_FanCtlThr1" UWORD DINH_ct_Compu 1 100 -4095.000 4096.000 BIT_MASK 0x1fff FORMAT "%8.3" ECU_ADDRESS 0x60013A6C /end MEASUREMENT
/begin MEASUREMENT DINH_nrActvInhReas.FId_FanCtlThr2 "Number of active inhibit reasons for the FIds / Number of active inhibit reasons for FId_FanCtlThr2" UWORD DINH_ct_Compu 1 100 -4095.000 4096.000 BIT_MASK 0x1fff FORMAT "%8.3" ECU_ADDRESS 0x60013A6E /end MEASUREMENT
/begin MEASUREMENT DINH_nrActvInhReas.FId_FcoReq "Number of active inhibit reasons for the FIds / Number of active inhibit reasons for FId_FcoReq" UWORD DINH_ct_Compu 1 100 -4095.000 4096.000 BIT_MASK 0x1fff FORMAT "%8.3" ECU_ADDRESS 0x60013A70 /end MEASUREMENT
/begin MEASUREMENT DINH_nrActvInhReas.FId_FiMFID_rba_MRly_Diag_Stk "Number of active inhibit reasons for the FIds / Number of active inhibit reasons for FId_FiMFID_rba_MRly_Diag_Stk" UWORD DINH_ct_Compu 1 100 -4095.000 4096.000 BIT_MASK 0x1fff FORMAT "%8.3" ECU_ADDRESS 0x60013A72 /end MEASUREMENT
/begin MEASUREMENT DINH_nrActvInhReas.FId_FlComErr "Number of active inhibit reasons for the FIds / Number of active inhibit reasons for FId_FlComErr" UWORD DINH_ct_Compu 1 100 -4095.000 4096.000 BIT_MASK 0x1fff FORMAT "%8.3" ECU_ADDRESS 0x60013A74 /end MEASUREMENT
/begin MEASUREMENT DINH_nrActvInhReas.FId_FlDevPlauDiagFuSnsr "Number of active inhibit reasons for the FIds / Number of active inhibit reasons for FId_FlDevPlauDiagFuSnsr" UWORD DINH_ct_Compu 1 100 -4095.000 4096.000 BIT_MASK 0x1fff FORMAT "%8.3" ECU_ADDRESS 0x60013A76 /end MEASUREMENT
/begin MEASUREMENT DINH_nrActvInhReas.FId_FlLvlNoSigErr "Number of active inhibit reasons for the FIds / Number of active inhibit reasons for FId_FlLvlNoSigErr" UWORD DINH_ct_Compu 1 100 -4095.000 4096.000 BIT_MASK 0x1fff FORMAT "%8.3" ECU_ADDRESS 0x60013A78 /end MEASUREMENT
/begin MEASUREMENT DINH_nrActvInhReas.FId_FlLvlVehSpdSigErr "Number of active inhibit reasons for the FIds / Number of active inhibit reasons for FId_FlLvlVehSpdSigErr" UWORD DINH_ct_Compu 1 100 -4095.000 4096.000 BIT_MASK 0x1fff FORMAT "%8.3" ECU_ADDRESS 0x60013A7A /end MEASUREMENT
/begin MEASUREMENT DINH_nrActvInhReas.FId_FlLvlVehVErr "Number of active inhibit reasons for the FIds / Number of active inhibit reasons for FId_FlLvlVehVErr" UWORD DINH_ct_Compu 1 100 -4095.000 4096.000 BIT_MASK 0x1fff FORMAT "%8.3" ECU_ADDRESS 0x60013A7C /end MEASUREMENT
/begin MEASUREMENT DINH_nrActvInhReas.FId_FlMALamDynDiag "Number of active inhibit reasons for the FIds / Number of active inhibit reasons for FId_FlMALamDynDiag" UWORD DINH_ct_Compu 1 100 -4095.000 4096.000 BIT_MASK 0x1fff FORMAT "%8.3" ECU_ADDRESS 0x60013A7E /end MEASUREMENT
/begin MEASUREMENT DINH_nrActvInhReas.FId_FlSplGAltLin "Number of active inhibit reasons for the FIds / Number of active inhibit reasons for FId_FlSplGAltLin" UWORD DINH_ct_Compu 1 100 -4095.000 4096.000 BIT_MASK 0x1fff FORMAT "%8.3" ECU_ADDRESS 0x60013A80 /end MEASUREMENT
/begin MEASUREMENT DINH_nrActvInhReas.FId_FlTnkQnt "Number of active inhibit reasons for the FIds / Number of active inhibit reasons for FId_FlTnkQnt" UWORD DINH_ct_Compu 1 100 -4095.000 4096.000 BIT_MASK 0x1fff FORMAT "%8.3" ECU_ADDRESS 0x60013A82 /end MEASUREMENT
/begin MEASUREMENT DINH_nrActvInhReas.FId_FuMixHotFilmErr "Number of active inhibit reasons for the FIds / Number of active inhibit reasons for FId_FuMixHotFilmErr" UWORD DINH_ct_Compu 1 100 -4095.000 4096.000 BIT_MASK 0x1fff FORMAT "%8.3" ECU_ADDRESS 0x60013A84 /end MEASUREMENT
/begin MEASUREMENT DINH_nrActvInhReas.FId_FuMixUegoErrExcl "Number of active inhibit reasons for the FIds / Number of active inhibit reasons for FId_FuMixUegoErrExcl" UWORD DINH_ct_Compu 1 100 -4095.000 4096.000 BIT_MASK 0x1fff FORMAT "%8.3" ECU_ADDRESS 0x60013A86 /end MEASUREMENT
/begin MEASUREMENT DINH_nrActvInhReas.FId_FuPHiRailEthnlSnsrErr "Number of active inhibit reasons for the FIds / Number of active inhibit reasons for FId_FuPHiRailEthnlSnsrErr" UWORD DINH_ct_Compu 1 100 -4095.000 4096.000 BIT_MASK 0x1fff FORMAT "%8.3" ECU_ADDRESS 0x60013A88 /end MEASUREMENT
/begin MEASUREMENT DINH_nrActvInhReas.FId_FuPurg_TEVError "Number of active inhibit reasons for the FIds / Number of active inhibit reasons for FId_FuPurg_TEVError" UWORD DINH_ct_Compu 1 100 -4095.000 4096.000 BIT_MASK 0x1fff FORMAT "%8.3" ECU_ADDRESS 0x60013A8A /end MEASUREMENT
/begin MEASUREMENT DINH_nrActvInhReas.FId_FuSnsrPhyRngErr "Number of active inhibit reasons for the FIds / Number of active inhibit reasons for FId_FuSnsrPhyRngErr" UWORD DINH_ct_Compu 1 100 -4095.000 4096.000 BIT_MASK 0x1fff FORMAT "%8.3" ECU_ADDRESS 0x60013A8C /end MEASUREMENT
/begin MEASUREMENT DINH_nrActvInhReas.FId_GEVCtlAVCAdprCBBNWEErrIntk "Number of active inhibit reasons for the FIds / Number of active inhibit reasons for FId_GEVCtlAVCAdprCBBNWEErrIntk" UWORD DINH_ct_Compu 1 100 -4095.000 4096.000 BIT_MASK 0x1fff FORMAT "%8.3" ECU_ADDRESS 0x60013A8E /end MEASUREMENT
/begin MEASUREMENT DINH_nrActvInhReas.FId_GEVCtlAVCAdprIntkB1 "Number of active inhibit reasons for the FIds / Number of active inhibit reasons for FId_GEVCtlAVCAdprIntkB1" UWORD DINH_ct_Compu 1 100 -4095.000 4096.000 BIT_MASK 0x1fff FORMAT "%8.3" ECU_ADDRESS 0x60013A90 /end MEASUREMENT
/begin MEASUREMENT DINH_nrActvInhReas.FId_GEVCtlAVCAdprNWSEErrIntk "Number of active inhibit reasons for the FIds / Number of active inhibit reasons for FId_GEVCtlAVCAdprNWSEErrIntk" UWORD DINH_ct_Compu 1 100 -4095.000 4096.000 BIT_MASK 0x1fff FORMAT "%8.3" ECU_ADDRESS 0x60013A92 /end MEASUREMENT
/begin MEASUREMENT DINH_nrActvInhReas.FId_GEVCtlAdpnEnaIntk "Number of active inhibit reasons for the FIds / Number of active inhibit reasons for FId_GEVCtlAdpnEnaIntk" UWORD DINH_ct_Compu 1 100 -4095.000 4096.000 BIT_MASK 0x1fff FORMAT "%8.3" ECU_ADDRESS 0x60013A94 /end MEASUREMENT
/begin MEASUREMENT DINH_nrActvInhReas.FId_GEVCtlAdpnEnaShtrpActv "Number of active inhibit reasons for the FIds / Number of active inhibit reasons for FId_GEVCtlAdpnEnaShtrpActv" UWORD DINH_ct_Compu 1 100 -4095.000 4096.000 BIT_MASK 0x1fff FORMAT "%8.3" ECU_ADDRESS 0x60013A96 /end MEASUREMENT
/begin MEASUREMENT DINH_nrActvInhReas.FId_GEVCtlClngIntk "Number of active inhibit reasons for the FIds / Number of active inhibit reasons for FId_GEVCtlClngIntk" UWORD DINH_ct_Compu 1 100 -4095.000 4096.000 BIT_MASK 0x1fff FORMAT "%8.3" ECU_ADDRESS 0x60013A98 /end MEASUREMENT
/begin MEASUREMENT DINH_nrActvInhReas.FId_GEVCtlMinOvlIntk "Number of active inhibit reasons for the FIds / Number of active inhibit reasons for FId_GEVCtlMinOvlIntk" UWORD DINH_ct_Compu 1 100 -4095.000 4096.000 BIT_MASK 0x1fff FORMAT "%8.3" ECU_ADDRESS 0x60013A9A /end MEASUREMENT
/begin MEASUREMENT DINH_nrActvInhReas.FId_GEVCtlPOilSnsr "Number of active inhibit reasons for the FIds / Number of active inhibit reasons for FId_GEVCtlPOilSnsr" UWORD DINH_ct_Compu 1 100 -4095.000 4096.000 BIT_MASK 0x1fff FORMAT "%8.3" ECU_ADDRESS 0x60013A9C /end MEASUREMENT
/begin MEASUREMENT DINH_nrActvInhReas.FId_GEVCtlPhaEnaIntk "Number of active inhibit reasons for the FIds / Number of active inhibit reasons for FId_GEVCtlPhaEnaIntk" UWORD DINH_ct_Compu 1 100 -4095.000 4096.000 BIT_MASK 0x1fff FORMAT "%8.3" ECU_ADDRESS 0x60013A9E /end MEASUREMENT
/begin MEASUREMENT DINH_nrActvInhReas.FId_GEVCtlPhaSpTstrIntk "Number of active inhibit reasons for the FIds / Number of active inhibit reasons for FId_GEVCtlPhaSpTstrIntk" UWORD DINH_ct_Compu 1 100 -4095.000 4096.000 BIT_MASK 0x1fff FORMAT "%8.3" ECU_ADDRESS 0x60013AA0 /end MEASUREMENT
/begin MEASUREMENT DINH_nrActvInhReas.FId_GEVCtlRefAdpnMntChck "Number of active inhibit reasons for the FIds / Number of active inhibit reasons for FId_GEVCtlRefAdpnMntChck" UWORD DINH_ct_Compu 1 100 -4095.000 4096.000 BIT_MASK 0x1fff FORMAT "%8.3" ECU_ADDRESS 0x60013AA2 /end MEASUREMENT
/begin MEASUREMENT DINH_nrActvInhReas.FId_GEVCtlRefAdpnMntChckTstd "Number of active inhibit reasons for the FIds / Number of active inhibit reasons for FId_GEVCtlRefAdpnMntChckTstd" UWORD DINH_ct_Compu 1 100 -4095.000 4096.000 BIT_MASK 0x1fff FORMAT "%8.3" ECU_ADDRESS 0x60013AA4 /end MEASUREMENT
/begin MEASUREMENT DINH_nrActvInhReas.FId_GEVCtlReqRefAdpnTstrIntk "Number of active inhibit reasons for the FIds / Number of active inhibit reasons for FId_GEVCtlReqRefAdpnTstrIntk" UWORD DINH_ct_Compu 1 100 -4095.000 4096.000 BIT_MASK 0x1fff FORMAT "%8.3" ECU_ADDRESS 0x60013AA6 /end MEASUREMENT
/begin MEASUREMENT DINH_nrActvInhReas.FId_GEVCtlReqRefAdpnTstrIntkTstd "Number of active inhibit reasons for the FIds / Number of active inhibit reasons for FId_GEVCtlReqRefAdpnTstrIntkTstd" UWORD DINH_ct_Compu 1 100 -4095.000 4096.000 BIT_MASK 0x1fff FORMAT "%8.3" ECU_ADDRESS 0x60013AA8 /end MEASUREMENT
/begin MEASUREMENT DINH_nrActvInhReas.FId_GEVCtlVlvLftEnaIntk "Number of active inhibit reasons for the FIds / Number of active inhibit reasons for FId_GEVCtlVlvLftEnaIntk" UWORD DINH_ct_Compu 1 100 -4095.000 4096.000 BIT_MASK 0x1fff FORMAT "%8.3" ECU_ADDRESS 0x60013AAA /end MEASUREMENT
/begin MEASUREMENT DINH_nrActvInhReas.FId_GEVCtlVlvOpenClsdIntkB1 "Number of active inhibit reasons for the FIds / Number of active inhibit reasons for FId_GEVCtlVlvOpenClsdIntkB1" UWORD DINH_ct_Compu 1 100 -4095.000 4096.000 BIT_MASK 0x1fff FORMAT "%8.3" ECU_ADDRESS 0x60013AAC /end MEASUREMENT
/begin MEASUREMENT DINH_nrActvInhReas.FId_GEVlvLockPinDiagIntkB1 "Number of active inhibit reasons for the FIds / Number of active inhibit reasons for FId_GEVlvLockPinDiagIntkB1" UWORD DINH_ct_Compu 1 100 -4095.000 4096.000 BIT_MASK 0x1fff FORMAT "%8.3" ECU_ADDRESS 0x60013AAE /end MEASUREMENT
/begin MEASUREMENT DINH_nrActvInhReas.FId_GEVlvPhaDiagEnaCsersIntkB1 "Number of active inhibit reasons for the FIds / Number of active inhibit reasons for FId_GEVlvPhaDiagEnaCsersIntkB1" UWORD DINH_ct_Compu 1 100 -4095.000 4096.000 BIT_MASK 0x1fff FORMAT "%8.3" ECU_ADDRESS 0x60013AB0 /end MEASUREMENT
/begin MEASUREMENT DINH_nrActvInhReas.FId_GEVlvPhaDiagEnaIntkB1 "Number of active inhibit reasons for the FIds / Number of active inhibit reasons for FId_GEVlvPhaDiagEnaIntkB1" UWORD DINH_ct_Compu 1 100 -4095.000 4096.000 BIT_MASK 0x1fff FORMAT "%8.3" ECU_ADDRESS 0x60013AB2 /end MEASUREMENT
/begin MEASUREMENT DINH_nrActvInhReas.FId_GEVlvPhaPsIntkB1 "Number of active inhibit reasons for the FIds / Number of active inhibit reasons for FId_GEVlvPhaPsIntkB1" UWORD DINH_ct_Compu 1 100 -4095.000 4096.000 BIT_MASK 0x1fff FORMAT "%8.3" ECU_ADDRESS 0x60013AB4 /end MEASUREMENT
/begin MEASUREMENT DINH_nrActvInhReas.FId_GbxAnNeutPosnErr "Number of active inhibit reasons for the FIds / Number of active inhibit reasons for FId_GbxAnNeutPosnErr" UWORD DINH_ct_Compu 1 100 -4095.000 4096.000 BIT_MASK 0x1fff FORMAT "%8.3" ECU_ADDRESS 0x60013AB6 /end MEASUREMENT
/begin MEASUREMENT DINH_nrActvInhReas.FId_GbxCANDigPlausErr "Number of active inhibit reasons for the FIds / Number of active inhibit reasons for FId_GbxCANDigPlausErr" UWORD DINH_ct_Compu 1 100 -4095.000 4096.000 BIT_MASK 0x1fff FORMAT "%8.3" ECU_ADDRESS 0x60013AB8 /end MEASUREMENT
/begin MEASUREMENT DINH_nrActvInhReas.FId_GbxCANNeutSigErr "Number of active inhibit reasons for the FIds / Number of active inhibit reasons for FId_GbxCANNeutSigErr" UWORD DINH_ct_Compu 1 100 -4095.000 4096.000 BIT_MASK 0x1fff FORMAT "%8.3" ECU_ADDRESS 0x60013ABA /end MEASUREMENT
/begin MEASUREMENT DINH_nrActvInhReas.FId_GbxPNPosSig "Number of active inhibit reasons for the FIds / Number of active inhibit reasons for FId_GbxPNPosSig" UWORD DINH_ct_Compu 1 100 -4095.000 4096.000 BIT_MASK 0x1fff FORMAT "%8.3" ECU_ADDRESS 0x60013ABC /end MEASUREMENT
/begin MEASUREMENT DINH_nrActvInhReas.FId_GbxPNPosnComErr "Number of active inhibit reasons for the FIds / Number of active inhibit reasons for FId_GbxPNPosnComErr" UWORD DINH_ct_Compu 1 100 -4095.000 4096.000 BIT_MASK 0x1fff FORMAT "%8.3" ECU_ADDRESS 0x60013ABE /end MEASUREMENT
/begin MEASUREMENT DINH_nrActvInhReas.FId_GbxPNPosnDiagDrvCdnRels "Number of active inhibit reasons for the FIds / Number of active inhibit reasons for FId_GbxPNPosnDiagDrvCdnRels" UWORD DINH_ct_Compu 1 100 -4095.000 4096.000 BIT_MASK 0x1fff FORMAT "%8.3" ECU_ADDRESS 0x60013AC0 /end MEASUREMENT
/begin MEASUREMENT DINH_nrActvInhReas.FId_GbxPNPosnDiagDrvCodnHealRels "Number of active inhibit reasons for the FIds / Number of active inhibit reasons for FId_GbxPNPosnDiagDrvCodnHealRels" UWORD DINH_ct_Compu 1 100 -4095.000 4096.000 BIT_MASK 0x1fff FORMAT "%8.3" ECU_ADDRESS 0x60013AC2 /end MEASUREMENT
/begin MEASUREMENT DINH_nrActvInhReas.FId_GbxPNPosnDiagPlausyRels "Number of active inhibit reasons for the FIds / Number of active inhibit reasons for FId_GbxPNPosnDiagPlausyRels" UWORD DINH_ct_Compu 1 100 -4095.000 4096.000 BIT_MASK 0x1fff FORMAT "%8.3" ECU_ADDRESS 0x60013AC4 /end MEASUREMENT
/begin MEASUREMENT DINH_nrActvInhReas.FId_GbxPNPosnSubsVal "Number of active inhibit reasons for the FIds / Number of active inhibit reasons for FId_GbxPNPosnSubsVal" UWORD DINH_ct_Compu 1 100 -4095.000 4096.000 BIT_MASK 0x1fff FORMAT "%8.3" ECU_ADDRESS 0x60013AC6 /end MEASUREMENT
/begin MEASUREMENT DINH_nrActvInhReas.FId_GbxRvsSwtStk "Number of active inhibit reasons for the FIds / Number of active inhibit reasons for FId_GbxRvsSwtStk" UWORD DINH_ct_Compu 1 100 -4095.000 4096.000 BIT_MASK 0x1fff FORMAT "%8.3" ECU_ADDRESS 0x60013AC8 /end MEASUREMENT
/begin MEASUREMENT DINH_nrActvInhReas.FId_GbxSnsrSplyUErr "Number of active inhibit reasons for the FIds / Number of active inhibit reasons for FId_GbxSnsrSplyUErr" UWORD DINH_ct_Compu 1 100 -4095.000 4096.000 BIT_MASK 0x1fff FORMAT "%8.3" ECU_ADDRESS 0x60013ACA /end MEASUREMENT
/begin MEASUREMENT DINH_nrActvInhReas.FId_GbxSpstReqOk "Number of active inhibit reasons for the FIds / Number of active inhibit reasons for FId_GbxSpstReqOk" UWORD DINH_ct_Compu 1 100 -4095.000 4096.000 BIT_MASK 0x1fff FORMAT "%8.3" ECU_ADDRESS 0x60013ACC /end MEASUREMENT
/begin MEASUREMENT DINH_nrActvInhReas.FId_GlbDaLSumvXPtd "Number of active inhibit reasons for the FIds / Number of active inhibit reasons for FId_GlbDaLSumvXPtd" UWORD DINH_ct_Compu 1 100 -4095.000 4096.000 BIT_MASK 0x1fff FORMAT "%8.3" ECU_ADDRESS 0x60013ACE /end MEASUREMENT
/begin MEASUREMENT DINH_nrActvInhReas.FId_GslThrVlvSnsrDiagB1 "Number of active inhibit reasons for the FIds / Number of active inhibit reasons for FId_GslThrVlvSnsrDiagB1" UWORD DINH_ct_Compu 1 100 -4095.000 4096.000 BIT_MASK 0x1fff FORMAT "%8.3" ECU_ADDRESS 0x60013AD0 /end MEASUREMENT
/begin MEASUREMENT DINH_nrActvInhReas.FId_HEGOS2B1DElec "Number of active inhibit reasons for the FIds / Number of active inhibit reasons for FId_HEGOS2B1DElec" UWORD DINH_ct_Compu 1 100 -4095.000 4096.000 BIT_MASK 0x1fff FORMAT "%8.3" ECU_ADDRESS 0x60013AD2 /end MEASUREMENT
/begin MEASUREMENT DINH_nrActvInhReas.FId_HEGOS2B1DHtg "Number of active inhibit reasons for the FIds / Number of active inhibit reasons for FId_HEGOS2B1DHtg" UWORD DINH_ct_Compu 1 100 -4095.000 4096.000 BIT_MASK 0x1fff FORMAT "%8.3" ECU_ADDRESS 0x60013AD4 /end MEASUREMENT
/begin MEASUREMENT DINH_nrActvInhReas.FId_HEGOS2B1Htg "Number of active inhibit reasons for the FIds / Number of active inhibit reasons for FId_HEGOS2B1Htg" UWORD DINH_ct_Compu 1 100 -4095.000 4096.000 BIT_MASK 0x1fff FORMAT "%8.3" ECU_ADDRESS 0x60013AD6 /end MEASUREMENT
/begin MEASUREMENT DINH_nrActvInhReas.FId_HEGOS2B1HtrPsSt "Number of active inhibit reasons for the FIds / Number of active inhibit reasons for FId_HEGOS2B1HtrPsSt" UWORD DINH_ct_Compu 1 100 -4095.000 4096.000 BIT_MASK 0x1fff FORMAT "%8.3" ECU_ADDRESS 0x60013AD8 /end MEASUREMENT
/begin MEASUREMENT DINH_nrActvInhReas.FId_HEGOS2B1InVld "Number of active inhibit reasons for the FIds / Number of active inhibit reasons for FId_HEGOS2B1InVld" UWORD DINH_ct_Compu 1 100 -4095.000 4096.000 BIT_MASK 0x1fff FORMAT "%8.3" ECU_ADDRESS 0x60013ADA /end MEASUREMENT
/begin MEASUREMENT DINH_nrActvInhReas.FId_HEGOS2B1LSPsDiaDi "Number of active inhibit reasons for the FIds / Number of active inhibit reasons for FId_HEGOS2B1LSPsDiaDi" UWORD DINH_ct_Compu 1 100 -4095.000 4096.000 BIT_MASK 0x1fff FORMAT "%8.3" ECU_ADDRESS 0x60013ADC /end MEASUREMENT
/begin MEASUREMENT DINH_nrActvInhReas.FId_HLSDemBrkFlt "Number of active inhibit reasons for the FIds / Number of active inhibit reasons for FId_HLSDemBrkFlt" UWORD DINH_ct_Compu 1 100 -4095.000 4096.000 BIT_MASK 0x1fff FORMAT "%8.3" ECU_ADDRESS 0x60013ADE /end MEASUREMENT
/begin MEASUREMENT DINH_nrActvInhReas.FId_HLSDemErr1 "Number of active inhibit reasons for the FIds / Number of active inhibit reasons for FId_HLSDemErr1" UWORD DINH_ct_Compu 1 100 -4095.000 4096.000 BIT_MASK 0x1fff FORMAT "%8.3" ECU_ADDRESS 0x60013AE0 /end MEASUREMENT
/begin MEASUREMENT DINH_nrActvInhReas.FId_HLSDemErr2 "Number of active inhibit reasons for the FIds / Number of active inhibit reasons for FId_HLSDemErr2" UWORD DINH_ct_Compu 1 100 -4095.000 4096.000 BIT_MASK 0x1fff FORMAT "%8.3" ECU_ADDRESS 0x60013AE2 /end MEASUREMENT
/begin MEASUREMENT DINH_nrActvInhReas.FId_HLSDemIntkAirTemp "Number of active inhibit reasons for the FIds / Number of active inhibit reasons for FId_HLSDemIntkAirTemp" UWORD DINH_ct_Compu 1 100 -4095.000 4096.000 BIT_MASK 0x1fff FORMAT "%8.3" ECU_ADDRESS 0x60013AE4 /end MEASUREMENT
/begin MEASUREMENT DINH_nrActvInhReas.FId_HLSDemMotTemp "Number of active inhibit reasons for the FIds / Number of active inhibit reasons for FId_HLSDemMotTemp" UWORD DINH_ct_Compu 1 100 -4095.000 4096.000 BIT_MASK 0x1fff FORMAT "%8.3" ECU_ADDRESS 0x60013AE6 /end MEASUREMENT
/begin MEASUREMENT DINH_nrActvInhReas.FId_HLSDemMstCyldpVld "Number of active inhibit reasons for the FIds / Number of active inhibit reasons for FId_HLSDemMstCyldpVld" UWORD DINH_ct_Compu 1 100 -4095.000 4096.000 BIT_MASK 0x1fff FORMAT "%8.3" ECU_ADDRESS 0x60013AE8 /end MEASUREMENT
/begin MEASUREMENT DINH_nrActvInhReas.FId_HLSDemSpdClthGearAccrSigErr "Number of active inhibit reasons for the FIds / Number of active inhibit reasons for FId_HLSDemSpdClthGearAccrSigErr" UWORD DINH_ct_Compu 1 100 -4095.000 4096.000 BIT_MASK 0x1fff FORMAT "%8.3" ECU_ADDRESS 0x60013AEA /end MEASUREMENT
/begin MEASUREMENT DINH_nrActvInhReas.FId_HLSDem_DrvOffSuprt "Number of active inhibit reasons for the FIds / Number of active inhibit reasons for FId_HLSDem_DrvOffSuprt" UWORD DINH_ct_Compu 1 100 -4095.000 4096.000 BIT_MASK 0x1fff FORMAT "%8.3" ECU_ADDRESS 0x60013AEC /end MEASUREMENT
/begin MEASUREMENT DINH_nrActvInhReas.FId_HLSDem_DrvOffSuprtBrkHldSys "Number of active inhibit reasons for the FIds / Number of active inhibit reasons for FId_HLSDem_DrvOffSuprtBrkHldSys" UWORD DINH_ct_Compu 1 100 -4095.000 4096.000 BIT_MASK 0x1fff FORMAT "%8.3" ECU_ADDRESS 0x60013AEE /end MEASUREMENT
/begin MEASUREMENT DINH_nrActvInhReas.FId_HLSDem_DrvOffSuprtLAS "Number of active inhibit reasons for the FIds / Number of active inhibit reasons for FId_HLSDem_DrvOffSuprtLAS" UWORD DINH_ct_Compu 1 100 -4095.000 4096.000 BIT_MASK 0x1fff FORMAT "%8.3" ECU_ADDRESS 0x60013AF0 /end MEASUREMENT
/begin MEASUREMENT DINH_nrActvInhReas.FId_HLSDem_PModeActv "Number of active inhibit reasons for the FIds / Number of active inhibit reasons for FId_HLSDem_PModeActv" UWORD DINH_ct_Compu 1 100 -4095.000 4096.000 BIT_MASK 0x1fff FORMAT "%8.3" ECU_ADDRESS 0x60013AF2 /end MEASUREMENT
/begin MEASUREMENT DINH_nrActvInhReas.FId_HLSDem_TModeActv "Number of active inhibit reasons for the FIds / Number of active inhibit reasons for FId_HLSDem_TModeActv" UWORD DINH_ct_Compu 1 100 -4095.000 4096.000 BIT_MASK 0x1fff FORMAT "%8.3" ECU_ADDRESS 0x60013AF4 /end MEASUREMENT
/begin MEASUREMENT DINH_nrActvInhReas.FId_HLSDem_TraSubFcn "Number of active inhibit reasons for the FIds / Number of active inhibit reasons for FId_HLSDem_TraSubFcn" UWORD DINH_ct_Compu 1 100 -4095.000 4096.000 BIT_MASK 0x1fff FORMAT "%8.3" ECU_ADDRESS 0x60013AF6 /end MEASUREMENT
/begin MEASUREMENT DINH_nrActvInhReas.FId_HLSDem_nMaxLimErr1 "Number of active inhibit reasons for the FIds / Number of active inhibit reasons for FId_HLSDem_nMaxLimErr1" UWORD DINH_ct_Compu 1 100 -4095.000 4096.000 BIT_MASK 0x1fff FORMAT "%8.3" ECU_ADDRESS 0x60013AF8 /end MEASUREMENT
/begin MEASUREMENT DINH_nrActvInhReas.FId_HLSDem_nMaxLimErr2 "Number of active inhibit reasons for the FIds / Number of active inhibit reasons for FId_HLSDem_nMaxLimErr2" UWORD DINH_ct_Compu 1 100 -4095.000 4096.000 BIT_MASK 0x1fff FORMAT "%8.3" ECU_ADDRESS 0x60013AFA /end MEASUREMENT
/begin MEASUREMENT DINH_nrActvInhReas.FId_HLSDem_nMaxLimErr3 "Number of active inhibit reasons for the FIds / Number of active inhibit reasons for FId_HLSDem_nMaxLimErr3" UWORD DINH_ct_Compu 1 100 -4095.000 4096.000 BIT_MASK 0x1fff FORMAT "%8.3" ECU_ADDRESS 0x60013AFC /end MEASUREMENT
/begin MEASUREMENT DINH_nrActvInhReas.FId_HLSDem_nMaxVErr "Number of active inhibit reasons for the FIds / Number of active inhibit reasons for FId_HLSDem_nMaxVErr" UWORD DINH_ct_Compu 1 100 -4095.000 4096.000 BIT_MASK 0x1fff FORMAT "%8.3" ECU_ADDRESS 0x60013AFE /end MEASUREMENT
/begin MEASUREMENT DINH_nrActvInhReas.FId_I14229APP "Number of active inhibit reasons for the FIds / Number of active inhibit reasons for FId_I14229APP" UWORD DINH_ct_Compu 1 100 -4095.000 4096.000 BIT_MASK 0x1fff FORMAT "%8.3" ECU_ADDRESS 0x60013B00 /end MEASUREMENT
/begin MEASUREMENT DINH_nrActvInhReas.FId_I14229CANErr "Number of active inhibit reasons for the FIds / Number of active inhibit reasons for FId_I14229CANErr" UWORD DINH_ct_Compu 1 100 -4095.000 4096.000 BIT_MASK 0x1fff FORMAT "%8.3" ECU_ADDRESS 0x60013B02 /end MEASUREMENT
/begin MEASUREMENT DINH_nrActvInhReas.FId_I14229FlLvlFltComErr "Number of active inhibit reasons for the FIds / Number of active inhibit reasons for FId_I14229FlLvlFltComErr" UWORD DINH_ct_Compu 1 100 -4095.000 4096.000 BIT_MASK 0x1fff FORMAT "%8.3" ECU_ADDRESS 0x60013B04 /end MEASUREMENT
/begin MEASUREMENT DINH_nrActvInhReas.FId_I14229VTCErr "Number of active inhibit reasons for the FIds / Number of active inhibit reasons for FId_I14229VTCErr" UWORD DINH_ct_Compu 1 100 -4095.000 4096.000 BIT_MASK 0x1fff FORMAT "%8.3" ECU_ADDRESS 0x60013B06 /end MEASUREMENT
/begin MEASUREMENT DINH_nrActvInhReas.FId_IMGISABComErr "Number of active inhibit reasons for the FIds / Number of active inhibit reasons for FId_IMGISABComErr" UWORD DINH_ct_Compu 1 100 -4095.000 4096.000 BIT_MASK 0x1fff FORMAT "%8.3" ECU_ADDRESS 0x60013B08 /end MEASUREMENT
/begin MEASUREMENT DINH_nrActvInhReas.FId_InhbLamDynS1B1 "Number of active inhibit reasons for the FIds / Number of active inhibit reasons for FId_InhbLamDynS1B1" UWORD DINH_ct_Compu 1 100 -4095.000 4096.000 BIT_MASK 0x1fff FORMAT "%8.3" ECU_ADDRESS 0x60013B0A /end MEASUREMENT
/begin MEASUREMENT DINH_nrActvInhReas.FId_InhbnBlkdLineDiag "Number of active inhibit reasons for the FIds / Number of active inhibit reasons for FId_InhbnBlkdLineDiag" UWORD DINH_ct_Compu 1 100 -4095.000 4096.000 BIT_MASK 0x1fff FORMAT "%8.3" ECU_ADDRESS 0x60013B0C /end MEASUREMENT
/begin MEASUREMENT DINH_nrActvInhReas.FId_InhibitAlways "Number of active inhibit reasons for the FIds / Number of active inhibit reasons for FId_InhibitAlways" UWORD DINH_ct_Compu 1 100 -4095.000 4096.000 BIT_MASK 0x1fff FORMAT "%8.3" ECU_ADDRESS 0x60013B0E /end MEASUREMENT
/begin MEASUREMENT DINH_nrActvInhReas.FId_InhibitNever "Number of active inhibit reasons for the FIds / Number of active inhibit reasons for FId_InhibitNever" UWORD DINH_ct_Compu 1 100 -4095.000 4096.000 BIT_MASK 0x1fff FORMAT "%8.3" ECU_ADDRESS 0x60013B10 /end MEASUREMENT
/begin MEASUREMENT DINH_nrActvInhReas.FId_InjSysMulInjDiagErr "Number of active inhibit reasons for the FIds / Number of active inhibit reasons for FId_InjSysMulInjDiagErr" UWORD DINH_ct_Compu 1 100 -4095.000 4096.000 BIT_MASK 0x1fff FORMAT "%8.3" ECU_ADDRESS 0x60013B12 /end MEASUREMENT
/begin MEASUREMENT DINH_nrActvInhReas.FId_InjVlvPs_Bank1OnlyErr "Number of active inhibit reasons for the FIds / Number of active inhibit reasons for FId_InjVlvPs_Bank1OnlyErr" UWORD DINH_ct_Compu 1 100 -4095.000 4096.000 BIT_MASK 0x1fff FORMAT "%8.3" ECU_ADDRESS 0x60013B14 /end MEASUREMENT
/begin MEASUREMENT DINH_nrActvInhReas.FId_InjVlvPs_Bank1Tested "Number of active inhibit reasons for the FIds / Number of active inhibit reasons for FId_InjVlvPs_Bank1Tested" UWORD DINH_ct_Compu 1 100 -4095.000 4096.000 BIT_MASK 0x1fff FORMAT "%8.3" ECU_ADDRESS 0x60013B16 /end MEASUREMENT
/begin MEASUREMENT DINH_nrActvInhReas.FId_InjVlvPs_Bank2OnlyErr "Number of active inhibit reasons for the FIds / Number of active inhibit reasons for FId_InjVlvPs_Bank2OnlyErr" UWORD DINH_ct_Compu 1 100 -4095.000 4096.000 BIT_MASK 0x1fff FORMAT "%8.3" ECU_ADDRESS 0x60013B18 /end MEASUREMENT
/begin MEASUREMENT DINH_nrActvInhReas.FId_InjVlvPs_Bank2Tested "Number of active inhibit reasons for the FIds / Number of active inhibit reasons for FId_InjVlvPs_Bank2Tested" UWORD DINH_ct_Compu 1 100 -4095.000 4096.000 BIT_MASK 0x1fff FORMAT "%8.3" ECU_ADDRESS 0x60013B1A /end MEASUREMENT
/begin MEASUREMENT DINH_nrActvInhReas.FId_InjVlvPs_Bank3OnlyErr "Number of active inhibit reasons for the FIds / Number of active inhibit reasons for FId_InjVlvPs_Bank3OnlyErr" UWORD DINH_ct_Compu 1 100 -4095.000 4096.000 BIT_MASK 0x1fff FORMAT "%8.3" ECU_ADDRESS 0x60013B1C /end MEASUREMENT
/begin MEASUREMENT DINH_nrActvInhReas.FId_InjVlvPs_Bank3Tested "Number of active inhibit reasons for the FIds / Number of active inhibit reasons for FId_InjVlvPs_Bank3Tested" UWORD DINH_ct_Compu 1 100 -4095.000 4096.000 BIT_MASK 0x1fff FORMAT "%8.3" ECU_ADDRESS 0x60013B1E /end MEASUREMENT
/begin MEASUREMENT DINH_nrActvInhReas.FId_IntkAirTAirFltDsCrssChk "Number of active inhibit reasons for the FIds / Number of active inhibit reasons for FId_IntkAirTAirFltDsCrssChk" UWORD DINH_ct_Compu 1 100 -4095.000 4096.000 BIT_MASK 0x1fff FORMAT "%8.3" ECU_ADDRESS 0x60013B20 /end MEASUREMENT
/begin MEASUREMENT DINH_nrActvInhReas.FId_IntkAirTAirFltDsPlausChk "Number of active inhibit reasons for the FIds / Number of active inhibit reasons for FId_IntkAirTAirFltDsPlausChk" UWORD DINH_ct_Compu 1 100 -4095.000 4096.000 BIT_MASK 0x1fff FORMAT "%8.3" ECU_ADDRESS 0x60013B22 /end MEASUREMENT
/begin MEASUREMENT DINH_nrActvInhReas.FId_IntkAirTIntkMnfldCrssChk "Number of active inhibit reasons for the FIds / Number of active inhibit reasons for FId_IntkAirTIntkMnfldCrssChk" UWORD DINH_ct_Compu 1 100 -4095.000 4096.000 BIT_MASK 0x1fff FORMAT "%8.3" ECU_ADDRESS 0x60013B24 /end MEASUREMENT
/begin MEASUREMENT DINH_nrActvInhReas.FId_IntkAirTIntkMnfldPlausChk "Number of active inhibit reasons for the FIds / Number of active inhibit reasons for FId_IntkAirTIntkMnfldPlausChk" UWORD DINH_ct_Compu 1 100 -4095.000 4096.000 BIT_MASK 0x1fff FORMAT "%8.3" ECU_ADDRESS 0x60013B26 /end MEASUREMENT
/begin MEASUREMENT DINH_nrActvInhReas.FId_IntkAirTIntkMnfldRepl "Number of active inhibit reasons for the FIds / Number of active inhibit reasons for FId_IntkAirTIntkMnfldRepl" UWORD DINH_ct_Compu 1 100 -4095.000 4096.000 BIT_MASK 0x1fff FORMAT "%8.3" ECU_ADDRESS 0x60013B28 /end MEASUREMENT
/begin MEASUREMENT DINH_nrActvInhReas.FId_IntkAirTSnsr1Elec "Number of active inhibit reasons for the FIds / Number of active inhibit reasons for FId_IntkAirTSnsr1Elec" UWORD DINH_ct_Compu 1 100 -4095.000 4096.000 BIT_MASK 0x1fff FORMAT "%8.3" ECU_ADDRESS 0x60013B2A /end MEASUREMENT
/begin MEASUREMENT DINH_nrActvInhReas.FId_IntkAirTSnsr1PRC "Number of active inhibit reasons for the FIds / Number of active inhibit reasons for FId_IntkAirTSnsr1PRC" UWORD DINH_ct_Compu 1 100 -4095.000 4096.000 BIT_MASK 0x1fff FORMAT "%8.3" ECU_ADDRESS 0x60013B2C /end MEASUREMENT
/begin MEASUREMENT DINH_nrActvInhReas.FId_IntkAirTSnsr1Sum "Number of active inhibit reasons for the FIds / Number of active inhibit reasons for FId_IntkAirTSnsr1Sum" UWORD DINH_ct_Compu 1 100 -4095.000 4096.000 BIT_MASK 0x1fff FORMAT "%8.3" ECU_ADDRESS 0x60013B2E /end MEASUREMENT
/begin MEASUREMENT DINH_nrActvInhReas.FId_IntkAirTSnsr2Elec "Number of active inhibit reasons for the FIds / Number of active inhibit reasons for FId_IntkAirTSnsr2Elec" UWORD DINH_ct_Compu 1 100 -4095.000 4096.000 BIT_MASK 0x1fff FORMAT "%8.3" ECU_ADDRESS 0x60013B30 /end MEASUREMENT
/begin MEASUREMENT DINH_nrActvInhReas.FId_IntkAirTSnsr2PRC "Number of active inhibit reasons for the FIds / Number of active inhibit reasons for FId_IntkAirTSnsr2PRC" UWORD DINH_ct_Compu 1 100 -4095.000 4096.000 BIT_MASK 0x1fff FORMAT "%8.3" ECU_ADDRESS 0x60013B32 /end MEASUREMENT
/begin MEASUREMENT DINH_nrActvInhReas.FId_IntkAirTSnsr2Sum "Number of active inhibit reasons for the FIds / Number of active inhibit reasons for FId_IntkAirTSnsr2Sum" UWORD DINH_ct_Compu 1 100 -4095.000 4096.000 BIT_MASK 0x1fff FORMAT "%8.3" ECU_ADDRESS 0x60013B34 /end MEASUREMENT
/begin MEASUREMENT DINH_nrActvInhReas.FId_IntkArTempENGB "Number of active inhibit reasons for the FIds / Number of active inhibit reasons for FId_IntkArTempENGB" UWORD DINH_ct_Compu 1 100 -4095.000 4096.000 BIT_MASK 0x1fff FORMAT "%8.3" ECU_ADDRESS 0x60013B36 /end MEASUREMENT
/begin MEASUREMENT DINH_nrActvInhReas.FId_LIGovDfrstI "Number of active inhibit reasons for the FIds / Number of active inhibit reasons for FId_LIGovDfrstI" UWORD DINH_ct_Compu 1 100 -4095.000 4096.000 BIT_MASK 0x1fff FORMAT "%8.3" ECU_ADDRESS 0x60013B38 /end MEASUREMENT
/begin MEASUREMENT DINH_nrActvInhReas.FId_LIGovUndrBrk "Number of active inhibit reasons for the FIds / Number of active inhibit reasons for FId_LIGovUndrBrk" UWORD DINH_ct_Compu 1 100 -4095.000 4096.000 BIT_MASK 0x1fff FORMAT "%8.3" ECU_ADDRESS 0x60013B3A /end MEASUREMENT
/begin MEASUREMENT DINH_nrActvInhReas.FId_LINDCDCRxErr "Number of active inhibit reasons for the FIds / Number of active inhibit reasons for FId_LINDCDCRxErr" UWORD DINH_ct_Compu 1 100 -4095.000 4096.000 BIT_MASK 0x1fff FORMAT "%8.3" ECU_ADDRESS 0x60013B3C /end MEASUREMENT
/begin MEASUREMENT DINH_nrActvInhReas.FId_LLimAppSnsrErr "Number of active inhibit reasons for the FIds / Number of active inhibit reasons for FId_LLimAppSnsrErr" UWORD DINH_ct_Compu 1 100 -4095.000 4096.000 BIT_MASK 0x1fff FORMAT "%8.3" ECU_ADDRESS 0x60013B3E /end MEASUREMENT
/begin MEASUREMENT DINH_nrActvInhReas.FId_LLimAppSnsrSyncErr "Number of active inhibit reasons for the FIds / Number of active inhibit reasons for FId_LLimAppSnsrSyncErr" UWORD DINH_ct_Compu 1 100 -4095.000 4096.000 BIT_MASK 0x1fff FORMAT "%8.3" ECU_ADDRESS 0x60013B40 /end MEASUREMENT
/begin MEASUREMENT DINH_nrActvInhReas.FId_LLimMTVehSpdSnsrErr "Number of active inhibit reasons for the FIds / Number of active inhibit reasons for FId_LLimMTVehSpdSnsrErr" UWORD DINH_ct_Compu 1 100 -4095.000 4096.000 BIT_MASK 0x1fff FORMAT "%8.3" ECU_ADDRESS 0x60013B42 /end MEASUREMENT
/begin MEASUREMENT DINH_nrActvInhReas.FId_LLimShutOffEng "Number of active inhibit reasons for the FIds / Number of active inhibit reasons for FId_LLimShutOffEng" UWORD DINH_ct_Compu 1 100 -4095.000 4096.000 BIT_MASK 0x1fff FORMAT "%8.3" ECU_ADDRESS 0x60013B44 /end MEASUREMENT
/begin MEASUREMENT DINH_nrActvInhReas.FId_LRSEBMisf "Number of active inhibit reasons for the FIds / Number of active inhibit reasons for FId_LRSEBMisf" UWORD DINH_ct_Compu 1 100 -4095.000 4096.000 BIT_MASK 0x1fff FORMAT "%8.3" ECU_ADDRESS 0x60013B46 /end MEASUREMENT
/begin MEASUREMENT DINH_nrActvInhReas.FId_LZSR "Number of active inhibit reasons for the FIds / Number of active inhibit reasons for FId_LZSR" UWORD DINH_ct_Compu 1 100 -4095.000 4096.000 BIT_MASK 0x1fff FORMAT "%8.3" ECU_ADDRESS 0x60013B48 /end MEASUREMENT
/begin MEASUREMENT DINH_nrActvInhReas.FId_LeakToMnfld "Number of active inhibit reasons for the FIds / Number of active inhibit reasons for FId_LeakToMnfld" UWORD DINH_ct_Compu 1 100 -4095.000 4096.000 BIT_MASK 0x1fff FORMAT "%8.3" ECU_ADDRESS 0x60013B4A /end MEASUREMENT
/begin MEASUREMENT DINH_nrActvInhReas.FId_LeakToMnfldTstd "Number of active inhibit reasons for the FIds / Number of active inhibit reasons for FId_LeakToMnfldTstd" UWORD DINH_ct_Compu 1 100 -4095.000 4096.000 BIT_MASK 0x1fff FORMAT "%8.3" ECU_ADDRESS 0x60013B4C /end MEASUREMENT
/begin MEASUREMENT DINH_nrActvInhReas.FId_LimpHomPsErrInjtr "Number of active inhibit reasons for the FIds / Number of active inhibit reasons for FId_LimpHomPsErrInjtr" UWORD DINH_ct_Compu 1 100 -4095.000 4096.000 BIT_MASK 0x1fff FORMAT "%8.3" ECU_ADDRESS 0x60013B4E /end MEASUREMENT
/begin MEASUREMENT DINH_nrActvInhReas.FId_LinACGUnitCfmdErr "Number of active inhibit reasons for the FIds / Number of active inhibit reasons for FId_LinACGUnitCfmdErr" UWORD DINH_ct_Compu 1 100 -4095.000 4096.000 BIT_MASK 0x1fff FORMAT "%8.3" ECU_ADDRESS 0x60013B50 /end MEASUREMENT
/begin MEASUREMENT DINH_nrActvInhReas.FId_LinACGUnitNotTstd "Number of active inhibit reasons for the FIds / Number of active inhibit reasons for FId_LinACGUnitNotTstd" UWORD DINH_ct_Compu 1 100 -4095.000 4096.000 BIT_MASK 0x1fff FORMAT "%8.3" ECU_ADDRESS 0x60013B52 /end MEASUREMENT
/begin MEASUREMENT DINH_nrActvInhReas.FId_LinAEVUnitCfmdErr "Number of active inhibit reasons for the FIds / Number of active inhibit reasons for FId_LinAEVUnitCfmdErr" UWORD DINH_ct_Compu 1 100 -4095.000 4096.000 BIT_MASK 0x1fff FORMAT "%8.3" ECU_ADDRESS 0x60013B54 /end MEASUREMENT
/begin MEASUREMENT DINH_nrActvInhReas.FId_LinAEVUnitNotTstd "Number of active inhibit reasons for the FIds / Number of active inhibit reasons for FId_LinAEVUnitNotTstd" UWORD DINH_ct_Compu 1 100 -4095.000 4096.000 BIT_MASK 0x1fff FORMAT "%8.3" ECU_ADDRESS 0x60013B56 /end MEASUREMENT
/begin MEASUREMENT DINH_nrActvInhReas.FId_LinEBSUnitCfmdErr "Number of active inhibit reasons for the FIds / Number of active inhibit reasons for FId_LinEBSUnitCfmdErr" UWORD DINH_ct_Compu 1 100 -4095.000 4096.000 BIT_MASK 0x1fff FORMAT "%8.3" ECU_ADDRESS 0x60013B58 /end MEASUREMENT
/begin MEASUREMENT DINH_nrActvInhReas.FId_LinEBSUnitNotTstd "Number of active inhibit reasons for the FIds / Number of active inhibit reasons for FId_LinEBSUnitNotTstd" UWORD DINH_ct_Compu 1 100 -4095.000 4096.000 BIT_MASK 0x1fff FORMAT "%8.3" ECU_ADDRESS 0x60013B5A /end MEASUREMENT
/begin MEASUREMENT DINH_nrActvInhReas.FId_LowPresOilP "Number of active inhibit reasons for the FIds / Number of active inhibit reasons for FId_LowPresOilP" UWORD DINH_ct_Compu 1 100 -4095.000 4096.000 BIT_MASK 0x1fff FORMAT "%8.3" ECU_ADDRESS 0x60013B5C /end MEASUREMENT
/begin MEASUREMENT DINH_nrActvInhReas.FId_MFlowAirCrkcsSubVal "Number of active inhibit reasons for the FIds / Number of active inhibit reasons for FId_MFlowAirCrkcsSubVal" UWORD DINH_ct_Compu 1 100 -4095.000 4096.000 BIT_MASK 0x1fff FORMAT "%8.3" ECU_ADDRESS 0x60013B5E /end MEASUREMENT
/begin MEASUREMENT DINH_nrActvInhReas.FId_MFuOilMax "Number of active inhibit reasons for the FIds / Number of active inhibit reasons for FId_MFuOilMax" UWORD DINH_ct_Compu 1 100 -4095.000 4096.000 BIT_MASK 0x1fff FORMAT "%8.3" ECU_ADDRESS 0x60013B60 /end MEASUREMENT
/begin MEASUREMENT DINH_nrActvInhReas.FId_MaiLoadSnsr "Number of active inhibit reasons for the FIds / Number of active inhibit reasons for FId_MaiLoadSnsr" UWORD DINH_ct_Compu 1 100 -4095.000 4096.000 BIT_MASK 0x1fff FORMAT "%8.3" ECU_ADDRESS 0x60013B62 /end MEASUREMENT
/begin MEASUREMENT DINH_nrActvInhReas.FId_MaiShaftFailr "Number of active inhibit reasons for the FIds / Number of active inhibit reasons for FId_MaiShaftFailr" UWORD DINH_ct_Compu 1 100 -4095.000 4096.000 BIT_MASK 0x1fff FORMAT "%8.3" ECU_ADDRESS 0x60013B64 /end MEASUREMENT
/begin MEASUREMENT DINH_nrActvInhReas.FId_MfPsDia1 "Number of active inhibit reasons for the FIds / Number of active inhibit reasons for FId_MfPsDia1" UWORD DINH_ct_Compu 1 100 -4095.000 4096.000 BIT_MASK 0x1fff FORMAT "%8.3" ECU_ADDRESS 0x60013B66 /end MEASUREMENT
/begin MEASUREMENT DINH_nrActvInhReas.FId_MisfDetDnAdpn "Number of active inhibit reasons for the FIds / Number of active inhibit reasons for FId_MisfDetDnAdpn" UWORD DINH_ct_Compu 1 100 -4095.000 4096.000 BIT_MASK 0x1fff FORMAT "%8.3" ECU_ADDRESS 0x60013B68 /end MEASUREMENT
/begin MEASUREMENT DINH_nrActvInhReas.FId_MisfDetDnAdpnPlaus "Number of active inhibit reasons for the FIds / Number of active inhibit reasons for FId_MisfDetDnAdpnPlaus" UWORD DINH_ct_Compu 1 100 -4095.000 4096.000 BIT_MASK 0x1fff FORMAT "%8.3" ECU_ADDRESS 0x60013B6A /end MEASUREMENT
/begin MEASUREMENT DINH_nrActvInhReas.FId_MisfDetEnvP "Number of active inhibit reasons for the FIds / Number of active inhibit reasons for FId_MisfDetEnvP" UWORD DINH_ct_Compu 1 100 -4095.000 4096.000 BIT_MASK 0x1fff FORMAT "%8.3" ECU_ADDRESS 0x60013B6C /end MEASUREMENT
/begin MEASUREMENT DINH_nrActvInhReas.FId_MisfDetSegTiAdpnFco "Number of active inhibit reasons for the FIds / Number of active inhibit reasons for FId_MisfDetSegTiAdpnFco" UWORD DINH_ct_Compu 1 100 -4095.000 4096.000 BIT_MASK 0x1fff FORMAT "%8.3" ECU_ADDRESS 0x60013B6E /end MEASUREMENT
/begin MEASUREMENT DINH_nrActvInhReas.FId_MisfDetShtrpAct "Number of active inhibit reasons for the FIds / Number of active inhibit reasons for FId_MisfDetShtrpAct" UWORD DINH_ct_Compu 1 100 -4095.000 4096.000 BIT_MASK 0x1fff FORMAT "%8.3" ECU_ADDRESS 0x60013B70 /end MEASUREMENT
/begin MEASUREMENT DINH_nrActvInhReas.FId_MisfDetStc "Number of active inhibit reasons for the FIds / Number of active inhibit reasons for FId_MisfDetStc" UWORD DINH_ct_Compu 1 100 -4095.000 4096.000 BIT_MASK 0x1fff FORMAT "%8.3" ECU_ADDRESS 0x60013B72 /end MEASUREMENT
/begin MEASUREMENT DINH_nrActvInhReas.FId_MisfDetV "Number of active inhibit reasons for the FIds / Number of active inhibit reasons for FId_MisfDetV" UWORD DINH_ct_Compu 1 100 -4095.000 4096.000 BIT_MASK 0x1fff FORMAT "%8.3" ECU_ADDRESS 0x60013B74 /end MEASUREMENT
/begin MEASUREMENT DINH_nrActvInhReas.FId_MisfDetVWhlFrntLe "Number of active inhibit reasons for the FIds / Number of active inhibit reasons for FId_MisfDetVWhlFrntLe" UWORD DINH_ct_Compu 1 100 -4095.000 4096.000 BIT_MASK 0x1fff FORMAT "%8.3" ECU_ADDRESS 0x60013B76 /end MEASUREMENT
/begin MEASUREMENT DINH_nrActvInhReas.FId_MisfDetVWhlFrntRi "Number of active inhibit reasons for the FIds / Number of active inhibit reasons for FId_MisfDetVWhlFrntRi" UWORD DINH_ct_Compu 1 100 -4095.000 4096.000 BIT_MASK 0x1fff FORMAT "%8.3" ECU_ADDRESS 0x60013B78 /end MEASUREMENT
/begin MEASUREMENT DINH_nrActvInhReas.FId_MisfDetVWhlReLe "Number of active inhibit reasons for the FIds / Number of active inhibit reasons for FId_MisfDetVWhlReLe" UWORD DINH_ct_Compu 1 100 -4095.000 4096.000 BIT_MASK 0x1fff FORMAT "%8.3" ECU_ADDRESS 0x60013B7A /end MEASUREMENT
/begin MEASUREMENT DINH_nrActvInhReas.FId_MisfDetVWhlReRi "Number of active inhibit reasons for the FIds / Number of active inhibit reasons for FId_MisfDetVWhlReRi" UWORD DINH_ct_Compu 1 100 -4095.000 4096.000 BIT_MASK 0x1fff FORMAT "%8.3" ECU_ADDRESS 0x60013B7C /end MEASUREMENT
/begin MEASUREMENT DINH_nrActvInhReas.FId_NLimVehHalt "Number of active inhibit reasons for the FIds / Number of active inhibit reasons for FId_NLimVehHalt" UWORD DINH_ct_Compu 1 100 -4095.000 4096.000 BIT_MASK 0x1fff FORMAT "%8.3" ECU_ADDRESS 0x60013B7E /end MEASUREMENT
/begin MEASUREMENT DINH_nrActvInhReas.FId_NSHTDAmbT "Number of active inhibit reasons for the FIds / Number of active inhibit reasons for FId_NSHTDAmbT" UWORD DINH_ct_Compu 1 100 -4095.000 4096.000 BIT_MASK 0x1fff FORMAT "%8.3" ECU_ADDRESS 0x60013B80 /end MEASUREMENT
/begin MEASUREMENT DINH_nrActvInhReas.FId_NSHTDEngT "Number of active inhibit reasons for the FIds / Number of active inhibit reasons for FId_NSHTDEngT" UWORD DINH_ct_Compu 1 100 -4095.000 4096.000 BIT_MASK 0x1fff FORMAT "%8.3" ECU_ADDRESS 0x60013B82 /end MEASUREMENT
/begin MEASUREMENT DINH_nrActvInhReas.FId_NSHTILimHiAltiLoIdleSp "Number of active inhibit reasons for the FIds / Number of active inhibit reasons for FId_NSHTILimHiAltiLoIdleSp" UWORD DINH_ct_Compu 1 100 -4095.000 4096.000 BIT_MASK 0x1fff FORMAT "%8.3" ECU_ADDRESS 0x60013B84 /end MEASUREMENT
/begin MEASUREMENT DINH_nrActvInhReas.FId_NeutPosnFailr "Number of active inhibit reasons for the FIds / Number of active inhibit reasons for FId_NeutPosnFailr" UWORD DINH_ct_Compu 1 100 -4095.000 4096.000 BIT_MASK 0x1fff FORMAT "%8.3" ECU_ADDRESS 0x60013B86 /end MEASUREMENT
/begin MEASUREMENT DINH_nrActvInhReas.FId_O2StorgMdlMD "Number of active inhibit reasons for the FIds / Number of active inhibit reasons for FId_O2StorgMdlMD" UWORD DINH_ct_Compu 1 100 -4095.000 4096.000 BIT_MASK 0x1fff FORMAT "%8.3" ECU_ADDRESS 0x60013B88 /end MEASUREMENT
/begin MEASUREMENT DINH_nrActvInhReas.FId_OilCmbdSen_LvlDfctHW "Number of active inhibit reasons for the FIds / Number of active inhibit reasons for FId_OilCmbdSen_LvlDfctHW" UWORD DINH_ct_Compu 1 100 -4095.000 4096.000 BIT_MASK 0x1fff FORMAT "%8.3" ECU_ADDRESS 0x60013B8A /end MEASUREMENT
/begin MEASUREMENT DINH_nrActvInhReas.FId_OilPCtrlVlvNpl "Number of active inhibit reasons for the FIds / Number of active inhibit reasons for FId_OilPCtrlVlvNpl" UWORD DINH_ct_Compu 1 100 -4095.000 4096.000 BIT_MASK 0x1fff FORMAT "%8.3" ECU_ADDRESS 0x60013B8C /end MEASUREMENT
/begin MEASUREMENT DINH_nrActvInhReas.FId_OilPFrzVal "Number of active inhibit reasons for the FIds / Number of active inhibit reasons for FId_OilPFrzVal" UWORD DINH_ct_Compu 1 100 -4095.000 4096.000 BIT_MASK 0x1fff FORMAT "%8.3" ECU_ADDRESS 0x60013B8E /end MEASUREMENT
/begin MEASUREMENT DINH_nrActvInhReas.FId_OilPPlaus "Number of active inhibit reasons for the FIds / Number of active inhibit reasons for FId_OilPPlaus" UWORD DINH_ct_Compu 1 100 -4095.000 4096.000 BIT_MASK 0x1fff FORMAT "%8.3" ECU_ADDRESS 0x60013B90 /end MEASUREMENT
/begin MEASUREMENT DINH_nrActvInhReas.FId_OilPPlausAftRun "Number of active inhibit reasons for the FIds / Number of active inhibit reasons for FId_OilPPlausAftRun" UWORD DINH_ct_Compu 1 100 -4095.000 4096.000 BIT_MASK 0x1fff FORMAT "%8.3" ECU_ADDRESS 0x60013B92 /end MEASUREMENT
/begin MEASUREMENT DINH_nrActvInhReas.FId_OilPPlausMax "Number of active inhibit reasons for the FIds / Number of active inhibit reasons for FId_OilPPlausMax" UWORD DINH_ct_Compu 1 100 -4095.000 4096.000 BIT_MASK 0x1fff FORMAT "%8.3" ECU_ADDRESS 0x60013B94 /end MEASUREMENT
/begin MEASUREMENT DINH_nrActvInhReas.FId_OilPPlausMin "Number of active inhibit reasons for the FIds / Number of active inhibit reasons for FId_OilPPlausMin" UWORD DINH_ct_Compu 1 100 -4095.000 4096.000 BIT_MASK 0x1fff FORMAT "%8.3" ECU_ADDRESS 0x60013B96 /end MEASUREMENT
/begin MEASUREMENT DINH_nrActvInhReas.FId_OilPPlausT15 "Number of active inhibit reasons for the FIds / Number of active inhibit reasons for FId_OilPPlausT15" UWORD DINH_ct_Compu 1 100 -4095.000 4096.000 BIT_MASK 0x1fff FORMAT "%8.3" ECU_ADDRESS 0x60013B98 /end MEASUREMENT
/begin MEASUREMENT DINH_nrActvInhReas.FId_OilPRplVal "Number of active inhibit reasons for the FIds / Number of active inhibit reasons for FId_OilPRplVal" UWORD DINH_ct_Compu 1 100 -4095.000 4096.000 BIT_MASK 0x1fff FORMAT "%8.3" ECU_ADDRESS 0x60013B9A /end MEASUREMENT
/begin MEASUREMENT DINH_nrActvInhReas.FId_OilPSnsrErr "Number of active inhibit reasons for the FIds / Number of active inhibit reasons for FId_OilPSnsrErr" UWORD DINH_ct_Compu 1 100 -4095.000 4096.000 BIT_MASK 0x1fff FORMAT "%8.3" ECU_ADDRESS 0x60013B9C /end MEASUREMENT
/begin MEASUREMENT DINH_nrActvInhReas.FId_OilPSwmpSRC "Number of active inhibit reasons for the FIds / Number of active inhibit reasons for FId_OilPSwmpSRC" UWORD DINH_ct_Compu 1 100 -4095.000 4096.000 BIT_MASK 0x1fff FORMAT "%8.3" ECU_ADDRESS 0x60013B9E /end MEASUREMENT
/begin MEASUREMENT DINH_nrActvInhReas.FId_OilSwmpTCEngDsTWrmUp "Number of active inhibit reasons for the FIds / Number of active inhibit reasons for FId_OilSwmpTCEngDsTWrmUp" UWORD DINH_ct_Compu 1 100 -4095.000 4096.000 BIT_MASK 0x1fff FORMAT "%8.3" ECU_ADDRESS 0x60013BA0 /end MEASUREMENT
/begin MEASUREMENT DINH_nrActvInhReas.FId_OilSwmpT_B_tospg "Number of active inhibit reasons for the FIds / Number of active inhibit reasons for FId_OilSwmpT_B_tospg" UWORD DINH_ct_Compu 1 100 -4095.000 4096.000 BIT_MASK 0x1fff FORMAT "%8.3" ECU_ADDRESS 0x60013BA2 /end MEASUREMENT
/begin MEASUREMENT DINH_nrActvInhReas.FId_OilSwmpT_B_tospgg "Number of active inhibit reasons for the FIds / Number of active inhibit reasons for FId_OilSwmpT_B_tospgg" UWORD DINH_ct_Compu 1 100 -4095.000 4096.000 BIT_MASK 0x1fff FORMAT "%8.3" ECU_ADDRESS 0x60013BA4 /end MEASUREMENT
/begin MEASUREMENT DINH_nrActvInhReas.FId_OilSwmpT_CmbdSnsrErr "Number of active inhibit reasons for the FIds / Number of active inhibit reasons for FId_OilSwmpT_CmbdSnsrErr" UWORD DINH_ct_Compu 1 100 -4095.000 4096.000 BIT_MASK 0x1fff FORMAT "%8.3" ECU_ADDRESS 0x60013BA6 /end MEASUREMENT
/begin MEASUREMENT DINH_nrActvInhReas.FId_OilSwmpT_CmbdSnsrTiTErr "Number of active inhibit reasons for the FIds / Number of active inhibit reasons for FId_OilSwmpT_CmbdSnsrTiTErr" UWORD DINH_ct_Compu 1 100 -4095.000 4096.000 BIT_MASK 0x1fff FORMAT "%8.3" ECU_ADDRESS 0x60013BA8 /end MEASUREMENT
/begin MEASUREMENT DINH_nrActvInhReas.FId_OilSwmpT_EnvT "Number of active inhibit reasons for the FIds / Number of active inhibit reasons for FId_OilSwmpT_EnvT" UWORD DINH_ct_Compu 1 100 -4095.000 4096.000 BIT_MASK 0x1fff FORMAT "%8.3" ECU_ADDRESS 0x60013BAA /end MEASUREMENT
/begin MEASUREMENT DINH_nrActvInhReas.FId_OilSwmpT_TSnsrErr "Number of active inhibit reasons for the FIds / Number of active inhibit reasons for FId_OilSwmpT_TSnsrErr" UWORD DINH_ct_Compu 1 100 -4095.000 4096.000 BIT_MASK 0x1fff FORMAT "%8.3" ECU_ADDRESS 0x60013BAC /end MEASUREMENT
/begin MEASUREMENT DINH_nrActvInhReas.FId_PEnvMeasVld "Number of active inhibit reasons for the FIds / Number of active inhibit reasons for FId_PEnvMeasVld" UWORD DINH_ct_Compu 1 100 -4095.000 4096.000 BIT_MASK 0x1fff FORMAT "%8.3" ECU_ADDRESS 0x60013BAE /end MEASUREMENT
/begin MEASUREMENT DINH_nrActvInhReas.FId_PEnvModel "Number of active inhibit reasons for the FIds / Number of active inhibit reasons for FId_PEnvModel" UWORD DINH_ct_Compu 1 100 -4095.000 4096.000 BIT_MASK 0x1fff FORMAT "%8.3" ECU_ADDRESS 0x60013BB0 /end MEASUREMENT
/begin MEASUREMENT DINH_nrActvInhReas.FId_PEnvPlausDiagVDD "Number of active inhibit reasons for the FIds / Number of active inhibit reasons for FId_PEnvPlausDiagVDD" UWORD DINH_ct_Compu 1 100 -4095.000 4096.000 BIT_MASK 0x1fff FORMAT "%8.3" ECU_ADDRESS 0x60013BB2 /end MEASUREMENT
/begin MEASUREMENT DINH_nrActvInhReas.FId_PEnvRawVldVDD "Number of active inhibit reasons for the FIds / Number of active inhibit reasons for FId_PEnvRawVldVDD" UWORD DINH_ct_Compu 1 100 -4095.000 4096.000 BIT_MASK 0x1fff FORMAT "%8.3" ECU_ADDRESS 0x60013BB4 /end MEASUREMENT
/begin MEASUREMENT DINH_nrActvInhReas.FId_PEnvRefSnsr "Number of active inhibit reasons for the FIds / Number of active inhibit reasons for FId_PEnvRefSnsr" UWORD DINH_ct_Compu 1 100 -4095.000 4096.000 BIT_MASK 0x1fff FORMAT "%8.3" ECU_ADDRESS 0x60013BB6 /end MEASUREMENT
/begin MEASUREMENT DINH_nrActvInhReas.FId_PEnvSigRngVld "Number of active inhibit reasons for the FIds / Number of active inhibit reasons for FId_PEnvSigRngVld" UWORD DINH_ct_Compu 1 100 -4095.000 4096.000 BIT_MASK 0x1fff FORMAT "%8.3" ECU_ADDRESS 0x60013BB8 /end MEASUREMENT
/begin MEASUREMENT DINH_nrActvInhReas.FId_PEnvSnsrPlausVDD "Number of active inhibit reasons for the FIds / Number of active inhibit reasons for FId_PEnvSnsrPlausVDD" UWORD DINH_ct_Compu 1 100 -4095.000 4096.000 BIT_MASK 0x1fff FORMAT "%8.3" ECU_ADDRESS 0x60013BBA /end MEASUREMENT
/begin MEASUREMENT DINH_nrActvInhReas.FId_PEnvVldVDD "Number of active inhibit reasons for the FIds / Number of active inhibit reasons for FId_PEnvVldVDD" UWORD DINH_ct_Compu 1 100 -4095.000 4096.000 BIT_MASK 0x1fff FORMAT "%8.3" ECU_ADDRESS 0x60013BBC /end MEASUREMENT
/begin MEASUREMENT DINH_nrActvInhReas.FId_PIDA6SigSrcErr "Number of active inhibit reasons for the FIds / Number of active inhibit reasons for FId_PIDA6SigSrcErr" UWORD DINH_ct_Compu 1 100 -4095.000 4096.000 BIT_MASK 0x1fff FORMAT "%8.3" ECU_ADDRESS 0x60013BBE /end MEASUREMENT
/begin MEASUREMENT DINH_nrActvInhReas.FId_PIntkMnfldPlaus "Number of active inhibit reasons for the FIds / Number of active inhibit reasons for FId_PIntkMnfldPlaus" UWORD DINH_ct_Compu 1 100 -4095.000 4096.000 BIT_MASK 0x1fff FORMAT "%8.3" ECU_ADDRESS 0x60013BC0 /end MEASUREMENT
/begin MEASUREMENT DINH_nrActvInhReas.FId_PIntkVUsElecDiagB1 "Number of active inhibit reasons for the FIds / Number of active inhibit reasons for FId_PIntkVUsElecDiagB1" UWORD DINH_ct_Compu 1 100 -4095.000 4096.000 BIT_MASK 0x1fff FORMAT "%8.3" ECU_ADDRESS 0x60013BC2 /end MEASUREMENT
/begin MEASUREMENT DINH_nrActvInhReas.FId_PSPCtlDisbl "Number of active inhibit reasons for the FIds / Number of active inhibit reasons for FId_PSPCtlDisbl" UWORD DINH_ct_Compu 1 100 -4095.000 4096.000 BIT_MASK 0x1fff FORMAT "%8.3" ECU_ADDRESS 0x60013BC4 /end MEASUREMENT
/begin MEASUREMENT DINH_nrActvInhReas.FId_PSPCtlIntkAirVapLock "Number of active inhibit reasons for the FIds / Number of active inhibit reasons for FId_PSPCtlIntkAirVapLock" UWORD DINH_ct_Compu 1 100 -4095.000 4096.000 BIT_MASK 0x1fff FORMAT "%8.3" ECU_ADDRESS 0x60013BC6 /end MEASUREMENT
/begin MEASUREMENT DINH_nrActvInhReas.FId_PSPCtlPreRun "Number of active inhibit reasons for the FIds / Number of active inhibit reasons for FId_PSPCtlPreRun" UWORD DINH_ct_Compu 1 100 -4095.000 4096.000 BIT_MASK 0x1fff FORMAT "%8.3" ECU_ADDRESS 0x60013BC8 /end MEASUREMENT
/begin MEASUREMENT DINH_nrActvInhReas.FId_PSPCtlVapLock "Number of active inhibit reasons for the FIds / Number of active inhibit reasons for FId_PSPCtlVapLock" UWORD DINH_ct_Compu 1 100 -4095.000 4096.000 BIT_MASK 0x1fff FORMAT "%8.3" ECU_ADDRESS 0x60013BCA /end MEASUREMENT
/begin MEASUREMENT DINH_nrActvInhReas.FId_PSPDiagDisbl "Number of active inhibit reasons for the FIds / Number of active inhibit reasons for FId_PSPDiagDisbl" UWORD DINH_ct_Compu 1 100 -4095.000 4096.000 BIT_MASK 0x1fff FORMAT "%8.3" ECU_ADDRESS 0x60013BCC /end MEASUREMENT
/begin MEASUREMENT DINH_nrActvInhReas.FId_PTGripConv "Number of active inhibit reasons for the FIds / Number of active inhibit reasons for FId_PTGripConv" UWORD DINH_ct_Compu 1 100 -4095.000 4096.000 BIT_MASK 0x1fff FORMAT "%8.3" ECU_ADDRESS 0x60013BCE /end MEASUREMENT
/begin MEASUREMENT DINH_nrActvInhReas.FId_PTGripConvStrt "Number of active inhibit reasons for the FIds / Number of active inhibit reasons for FId_PTGripConvStrt" UWORD DINH_ct_Compu 1 100 -4095.000 4096.000 BIT_MASK 0x1fff FORMAT "%8.3" ECU_ADDRESS 0x60013BD0 /end MEASUREMENT
/begin MEASUREMENT DINH_nrActvInhReas.FId_PTGripMnlClth "Number of active inhibit reasons for the FIds / Number of active inhibit reasons for FId_PTGripMnlClth" UWORD DINH_ct_Compu 1 100 -4095.000 4096.000 BIT_MASK 0x1fff FORMAT "%8.3" ECU_ADDRESS 0x60013BD2 /end MEASUREMENT
/begin MEASUREMENT DINH_nrActvInhReas.FId_PTGripMnlClthStrt "Number of active inhibit reasons for the FIds / Number of active inhibit reasons for FId_PTGripMnlClthStrt" UWORD DINH_ct_Compu 1 100 -4095.000 4096.000 BIT_MASK 0x1fff FORMAT "%8.3" ECU_ADDRESS 0x60013BD4 /end MEASUREMENT
/begin MEASUREMENT DINH_nrActvInhReas.FId_PTTrqRatCANPtd "Number of active inhibit reasons for the FIds / Number of active inhibit reasons for FId_PTTrqRatCANPtd" UWORD DINH_ct_Compu 1 100 -4095.000 4096.000 BIT_MASK 0x1fff FORMAT "%8.3" ECU_ADDRESS 0x60013BD6 /end MEASUREMENT
/begin MEASUREMENT DINH_nrActvInhReas.FId_PThrVlVUsVldB1 "Number of active inhibit reasons for the FIds / Number of active inhibit reasons for FId_PThrVlVUsVldB1" UWORD DINH_ct_Compu 1 100 -4095.000 4096.000 BIT_MASK 0x1fff FORMAT "%8.3" ECU_ADDRESS 0x60013BD8 /end MEASUREMENT
/begin MEASUREMENT DINH_nrActvInhReas.FId_PThrVlvUsMeasdVldB1 "Number of active inhibit reasons for the FIds / Number of active inhibit reasons for FId_PThrVlvUsMeasdVldB1" UWORD DINH_ct_Compu 1 100 -4095.000 4096.000 BIT_MASK 0x1fff FORMAT "%8.3" ECU_ADDRESS 0x60013BDA /end MEASUREMENT
/begin MEASUREMENT DINH_nrActvInhReas.FId_P_VSE11_Diag "Number of active inhibit reasons for the FIds / Number of active inhibit reasons for FId_P_VSE11_Diag" UWORD DINH_ct_Compu 1 100 -4095.000 4096.000 BIT_MASK 0x1fff FORMAT "%8.3" ECU_ADDRESS 0x60013BDC /end MEASUREMENT
/begin MEASUREMENT DINH_nrActvInhReas.FId_PrmId03_FltRdnS1B1 "Number of active inhibit reasons for the FIds / Number of active inhibit reasons for FId_PrmId03_FltRdnS1B1" UWORD DINH_ct_Compu 1 100 -4095.000 4096.000 BIT_MASK 0x1fff FORMAT "%8.3" ECU_ADDRESS 0x60013BDE /end MEASUREMENT
/begin MEASUREMENT DINH_nrActvInhReas.FId_PrmId03_FltUegoS1B1 "Number of active inhibit reasons for the FIds / Number of active inhibit reasons for FId_PrmId03_FltUegoS1B1" UWORD DINH_ct_Compu 1 100 -4095.000 4096.000 BIT_MASK 0x1fff FORMAT "%8.3" ECU_ADDRESS 0x60013BE0 /end MEASUREMENT
/begin MEASUREMENT DINH_nrActvInhReas.FId_RevLck "Number of active inhibit reasons for the FIds / Number of active inhibit reasons for FId_RevLck" UWORD DINH_ct_Compu 1 100 -4095.000 4096.000 BIT_MASK 0x1fff FORMAT "%8.3" ECU_ADDRESS 0x60013BE2 /end MEASUREMENT
/begin MEASUREMENT DINH_nrActvInhReas.FId_RstAdpnPIntkMnfldAfs "Number of active inhibit reasons for the FIds / Number of active inhibit reasons for FId_RstAdpnPIntkMnfldAfs" UWORD DINH_ct_Compu 1 100 -4095.000 4096.000 BIT_MASK 0x1fff FORMAT "%8.3" ECU_ADDRESS 0x60013BE4 /end MEASUREMENT
/begin MEASUREMENT DINH_nrActvInhReas.FId_RvsPosnFailr "Number of active inhibit reasons for the FIds / Number of active inhibit reasons for FId_RvsPosnFailr" UWORD DINH_ct_Compu 1 100 -4095.000 4096.000 BIT_MASK 0x1fff FORMAT "%8.3" ECU_ADDRESS 0x60013BE6 /end MEASUREMENT
/begin MEASUREMENT DINH_nrActvInhReas.FId_SSEEPBRelease "Number of active inhibit reasons for the FIds / Number of active inhibit reasons for FId_SSEEPBRelease" UWORD DINH_ct_Compu 1 100 -4095.000 4096.000 BIT_MASK 0x1fff FORMAT "%8.3" ECU_ADDRESS 0x60013BE8 /end MEASUREMENT
/begin MEASUREMENT DINH_nrActvInhReas.FId_SSEFCANPRelease "Number of active inhibit reasons for the FIds / Number of active inhibit reasons for FId_SSEFCANPRelease" UWORD DINH_ct_Compu 1 100 -4095.000 4096.000 BIT_MASK 0x1fff FORMAT "%8.3" ECU_ADDRESS 0x60013BEA /end MEASUREMENT
/begin MEASUREMENT DINH_nrActvInhReas.FId_SSEPTCANPRelease "Number of active inhibit reasons for the FIds / Number of active inhibit reasons for FId_SSEPTCANPRelease" UWORD DINH_ct_Compu 1 100 -4095.000 4096.000 BIT_MASK 0x1fff FORMAT "%8.3" ECU_ADDRESS 0x60013BEC /end MEASUREMENT
/begin MEASUREMENT DINH_nrActvInhReas.FId_SSEStartRelease "Number of active inhibit reasons for the FIds / Number of active inhibit reasons for FId_SSEStartRelease" UWORD DINH_ct_Compu 1 100 -4095.000 4096.000 BIT_MASK 0x1fff FORMAT "%8.3" ECU_ADDRESS 0x60013BEE /end MEASUREMENT
/begin MEASUREMENT DINH_nrActvInhReas.FId_SSEStartReleaseMTCl10 "Number of active inhibit reasons for the FIds / Number of active inhibit reasons for FId_SSEStartReleaseMTCl10" UWORD DINH_ct_Compu 1 100 -4095.000 4096.000 BIT_MASK 0x1fff FORMAT "%8.3" ECU_ADDRESS 0x60013BF0 /end MEASUREMENT
/begin MEASUREMENT DINH_nrActvInhReas.FId_SSEStartReleaseMTCl100 "Number of active inhibit reasons for the FIds / Number of active inhibit reasons for FId_SSEStartReleaseMTCl100" UWORD DINH_ct_Compu 1 100 -4095.000 4096.000 BIT_MASK 0x1fff FORMAT "%8.3" ECU_ADDRESS 0x60013BF2 /end MEASUREMENT
/begin MEASUREMENT DINH_nrActvInhReas.FId_SSEStartReleaseMTCl20 "Number of active inhibit reasons for the FIds / Number of active inhibit reasons for FId_SSEStartReleaseMTCl20" UWORD DINH_ct_Compu 1 100 -4095.000 4096.000 BIT_MASK 0x1fff FORMAT "%8.3" ECU_ADDRESS 0x60013BF4 /end MEASUREMENT
/begin MEASUREMENT DINH_nrActvInhReas.FId_SSEStartReleaseMTCl90 "Number of active inhibit reasons for the FIds / Number of active inhibit reasons for FId_SSEStartReleaseMTCl90" UWORD DINH_ct_Compu 1 100 -4095.000 4096.000 BIT_MASK 0x1fff FORMAT "%8.3" ECU_ADDRESS 0x60013BF6 /end MEASUREMENT
/begin MEASUREMENT DINH_nrActvInhReas.FId_SSEStartRequest "Number of active inhibit reasons for the FIds / Number of active inhibit reasons for FId_SSEStartRequest" UWORD DINH_ct_Compu 1 100 -4095.000 4096.000 BIT_MASK 0x1fff FORMAT "%8.3" ECU_ADDRESS 0x60013BF8 /end MEASUREMENT
/begin MEASUREMENT DINH_nrActvInhReas.FId_SSEStopRelease "Number of active inhibit reasons for the FIds / Number of active inhibit reasons for FId_SSEStopRelease" UWORD DINH_ct_Compu 1 100 -4095.000 4096.000 BIT_MASK 0x1fff FORMAT "%8.3" ECU_ADDRESS 0x60013BFA /end MEASUREMENT
/begin MEASUREMENT DINH_nrActvInhReas.FId_SSEStrtStopRelease "Number of active inhibit reasons for the FIds / Number of active inhibit reasons for FId_SSEStrtStopRelease" UWORD DINH_ct_Compu 1 100 -4095.000 4096.000 BIT_MASK 0x1fff FORMAT "%8.3" ECU_ADDRESS 0x60013BFC /end MEASUREMENT
/begin MEASUREMENT DINH_nrActvInhReas.FId_SSESysOff "Number of active inhibit reasons for the FIds / Number of active inhibit reasons for FId_SSESysOff" UWORD DINH_ct_Compu 1 100 -4095.000 4096.000 BIT_MASK 0x1fff FORMAT "%8.3" ECU_ADDRESS 0x60013BFE /end MEASUREMENT
/begin MEASUREMENT DINH_nrActvInhReas.FId_SSEUI2DCSysFailr "Number of active inhibit reasons for the FIds / Number of active inhibit reasons for FId_SSEUI2DCSysFailr" UWORD DINH_ct_Compu 1 100 -4095.000 4096.000 BIT_MASK 0x1fff FORMAT "%8.3" ECU_ADDRESS 0x60013C00 /end MEASUREMENT
/begin MEASUREMENT DINH_nrActvInhReas.FId_SSEUIBCANErr "Number of active inhibit reasons for the FIds / Number of active inhibit reasons for FId_SSEUIBCANErr" UWORD DINH_ct_Compu 1 100 -4095.000 4096.000 BIT_MASK 0x1fff FORMAT "%8.3" ECU_ADDRESS 0x60013C02 /end MEASUREMENT
/begin MEASUREMENT DINH_nrActvInhReas.FId_SSEUISysFail "Number of active inhibit reasons for the FIds / Number of active inhibit reasons for FId_SSEUISysFail" UWORD DINH_ct_Compu 1 100 -4095.000 4096.000 BIT_MASK 0x1fff FORMAT "%8.3" ECU_ADDRESS 0x60013C04 /end MEASUREMENT
/begin MEASUREMENT DINH_nrActvInhReas.FId_SiaEEPErr "Number of active inhibit reasons for the FIds / Number of active inhibit reasons for FId_SiaEEPErr" UWORD DINH_ct_Compu 1 100 -4095.000 4096.000 BIT_MASK 0x1fff FORMAT "%8.3" ECU_ADDRESS 0x60013C06 /end MEASUREMENT
/begin MEASUREMENT DINH_nrActvInhReas.FId_SnglWhlErrDiagEna "Number of active inhibit reasons for the FIds / Number of active inhibit reasons for FId_SnglWhlErrDiagEna" UWORD DINH_ct_Compu 1 100 -4095.000 4096.000 BIT_MASK 0x1fff FORMAT "%8.3" ECU_ADDRESS 0x60013C08 /end MEASUREMENT
/begin MEASUREMENT DINH_nrActvInhReas.FId_StrtCtlAutoCrkModeCdn "Number of active inhibit reasons for the FIds / Number of active inhibit reasons for FId_StrtCtlAutoCrkModeCdn" UWORD DINH_ct_Compu 1 100 -4095.000 4096.000 BIT_MASK 0x1fff FORMAT "%8.3" ECU_ADDRESS 0x60013C0A /end MEASUREMENT
/begin MEASUREMENT DINH_nrActvInhReas.FId_StrtCtlComEngStrtErr "Number of active inhibit reasons for the FIds / Number of active inhibit reasons for FId_StrtCtlComEngStrtErr" UWORD DINH_ct_Compu 1 100 -4095.000 4096.000 BIT_MASK 0x1fff FORMAT "%8.3" ECU_ADDRESS 0x60013C0C /end MEASUREMENT
/begin MEASUREMENT DINH_nrActvInhReas.FId_StrtCtlNPCdnCncl "Number of active inhibit reasons for the FIds / Number of active inhibit reasons for FId_StrtCtlNPCdnCncl" UWORD DINH_ct_Compu 1 100 -4095.000 4096.000 BIT_MASK 0x1fff FORMAT "%8.3" ECU_ADDRESS 0x60013C0E /end MEASUREMENT
/begin MEASUREMENT DINH_nrActvInhReas.FId_StrtCtlNoCpuFailr "Number of active inhibit reasons for the FIds / Number of active inhibit reasons for FId_StrtCtlNoCpuFailr" UWORD DINH_ct_Compu 1 100 -4095.000 4096.000 BIT_MASK 0x1fff FORMAT "%8.3" ECU_ADDRESS 0x60013C10 /end MEASUREMENT
/begin MEASUREMENT DINH_nrActvInhReas.FId_StrtCtlNoFailCanLine "Number of active inhibit reasons for the FIds / Number of active inhibit reasons for FId_StrtCtlNoFailCanLine" UWORD DINH_ct_Compu 1 100 -4095.000 4096.000 BIT_MASK 0x1fff FORMAT "%8.3" ECU_ADDRESS 0x60013C12 /end MEASUREMENT
/begin MEASUREMENT DINH_nrActvInhReas.FId_StrtCtlNoFailPTCanLine "Number of active inhibit reasons for the FIds / Number of active inhibit reasons for FId_StrtCtlNoFailPTCanLine" UWORD DINH_ct_Compu 1 100 -4095.000 4096.000 BIT_MASK 0x1fff FORMAT "%8.3" ECU_ADDRESS 0x60013C14 /end MEASUREMENT
/begin MEASUREMENT DINH_nrActvInhReas.FId_StrtCtlPNPosnSubsVal "Number of active inhibit reasons for the FIds / Number of active inhibit reasons for FId_StrtCtlPNPosnSubsVal" UWORD DINH_ct_Compu 1 100 -4095.000 4096.000 BIT_MASK 0x1fff FORMAT "%8.3" ECU_ADDRESS 0x60013C16 /end MEASUREMENT
/begin MEASUREMENT DINH_nrActvInhReas.FId_StrtCtlSTMFailr "Number of active inhibit reasons for the FIds / Number of active inhibit reasons for FId_StrtCtlSTMFailr" UWORD DINH_ct_Compu 1 100 -4095.000 4096.000 BIT_MASK 0x1fff FORMAT "%8.3" ECU_ADDRESS 0x60013C18 /end MEASUREMENT
/begin MEASUREMENT DINH_nrActvInhReas.FId_StrtErrShaft "Number of active inhibit reasons for the FIds / Number of active inhibit reasons for FId_StrtErrShaft" UWORD DINH_ct_Compu 1 100 -4095.000 4096.000 BIT_MASK 0x1fff FORMAT "%8.3" ECU_ADDRESS 0x60013C1A /end MEASUREMENT
/begin MEASUREMENT DINH_nrActvInhReas.FId_SumErrHndlg "Number of active inhibit reasons for the FIds / Number of active inhibit reasons for FId_SumErrHndlg" UWORD DINH_ct_Compu 1 100 -4095.000 4096.000 BIT_MASK 0x1fff FORMAT "%8.3" ECU_ADDRESS 0x60013C1C /end MEASUREMENT
/begin MEASUREMENT DINH_nrActvInhReas.FId_SysDiagComErr "Number of active inhibit reasons for the FIds / Number of active inhibit reasons for FId_SysDiagComErr" UWORD DINH_ct_Compu 1 100 -4095.000 4096.000 BIT_MASK 0x1fff FORMAT "%8.3" ECU_ADDRESS 0x60013C1E /end MEASUREMENT
/begin MEASUREMENT DINH_nrActvInhReas.FId_SysDiagModInhbErr "Number of active inhibit reasons for the FIds / Number of active inhibit reasons for FId_SysDiagModInhbErr" UWORD DINH_ct_Compu 1 100 -4095.000 4096.000 BIT_MASK 0x1fff FORMAT "%8.3" ECU_ADDRESS 0x60013C20 /end MEASUREMENT
/begin MEASUREMENT DINH_nrActvInhReas.FId_TOSPM "Number of active inhibit reasons for the FIds / Number of active inhibit reasons for FId_TOSPM" UWORD DINH_ct_Compu 1 100 -4095.000 4096.000 BIT_MASK 0x1fff FORMAT "%8.3" ECU_ADDRESS 0x60013C22 /end MEASUREMENT
/begin MEASUREMENT DINH_nrActvInhReas.FId_TWCCILck "Number of active inhibit reasons for the FIds / Number of active inhibit reasons for FId_TWCCILck" UWORD DINH_ct_Compu 1 100 -4095.000 4096.000 BIT_MASK 0x1fff FORMAT "%8.3" ECU_ADDRESS 0x60013C24 /end MEASUREMENT
/begin MEASUREMENT DINH_nrActvInhReas.FId_TWCCILckExtd "Number of active inhibit reasons for the FIds / Number of active inhibit reasons for FId_TWCCILckExtd" UWORD DINH_ct_Compu 1 100 -4095.000 4096.000 BIT_MASK 0x1fff FORMAT "%8.3" ECU_ADDRESS 0x60013C26 /end MEASUREMENT
/begin MEASUREMENT DINH_nrActvInhReas.FId_TWCCIRstB1 "Number of active inhibit reasons for the FIds / Number of active inhibit reasons for FId_TWCCIRstB1" UWORD DINH_ct_Compu 1 100 -4095.000 4096.000 BIT_MASK 0x1fff FORMAT "%8.3" ECU_ADDRESS 0x60013C28 /end MEASUREMENT
/begin MEASUREMENT DINH_nrActvInhReas.FId_TWCCIRstDSMClearB1 "Number of active inhibit reasons for the FIds / Number of active inhibit reasons for FId_TWCCIRstDSMClearB1" UWORD DINH_ct_Compu 1 100 -4095.000 4096.000 BIT_MASK 0x1fff FORMAT "%8.3" ECU_ADDRESS 0x60013C2A /end MEASUREMENT
/begin MEASUREMENT DINH_nrActvInhReas.FId_TWCCLsuB1 "Number of active inhibit reasons for the FIds / Number of active inhibit reasons for FId_TWCCLsuB1" UWORD DINH_ct_Compu 1 100 -4095.000 4096.000 BIT_MASK 0x1fff FORMAT "%8.3" ECU_ADDRESS 0x60013C2C /end MEASUREMENT
/begin MEASUREMENT DINH_nrActvInhReas.FId_TWCCLsuCyc "Number of active inhibit reasons for the FIds / Number of active inhibit reasons for FId_TWCCLsuCyc" UWORD DINH_ct_Compu 1 100 -4095.000 4096.000 BIT_MASK 0x1fff FORMAT "%8.3" ECU_ADDRESS 0x60013C2E /end MEASUREMENT
/begin MEASUREMENT DINH_nrActvInhReas.FId_TWCCLsuDynB1 "Number of active inhibit reasons for the FIds / Number of active inhibit reasons for FId_TWCCLsuDynB1" UWORD DINH_ct_Compu 1 100 -4095.000 4096.000 BIT_MASK 0x1fff FORMAT "%8.3" ECU_ADDRESS 0x60013C30 /end MEASUREMENT
/begin MEASUREMENT DINH_nrActvInhReas.FId_TWCCMisfDetn "Number of active inhibit reasons for the FIds / Number of active inhibit reasons for FId_TWCCMisfDetn" UWORD DINH_ct_Compu 1 100 -4095.000 4096.000 BIT_MASK 0x1fff FORMAT "%8.3" ECU_ADDRESS 0x60013C32 /end MEASUREMENT
/begin MEASUREMENT DINH_nrActvInhReas.FId_TWCDPriCatParB1 "Number of active inhibit reasons for the FIds / Number of active inhibit reasons for FId_TWCDPriCatParB1" UWORD DINH_ct_Compu 1 100 -4095.000 4096.000 BIT_MASK 0x1fff FORMAT "%8.3" ECU_ADDRESS 0x60013C34 /end MEASUREMENT
/begin MEASUREMENT DINH_nrActvInhReas.FId_TWCDPriCatVldnB1 "Number of active inhibit reasons for the FIds / Number of active inhibit reasons for FId_TWCDPriCatVldnB1" UWORD DINH_ct_Compu 1 100 -4095.000 4096.000 BIT_MASK 0x1fff FORMAT "%8.3" ECU_ADDRESS 0x60013C36 /end MEASUREMENT
/begin MEASUREMENT DINH_nrActvInhReas.FId_TankPCpv1DteskLoLoadStuckClsd "Number of active inhibit reasons for the FIds / Number of active inhibit reasons for FId_TankPCpv1DteskLoLoadStuckClsd" UWORD DINH_ct_Compu 1 100 -4095.000 4096.000 BIT_MASK 0x1fff FORMAT "%8.3" ECU_ADDRESS 0x60013C38 /end MEASUREMENT
/begin MEASUREMENT DINH_nrActvInhReas.FId_TankPCpv1DteskLoLoadStuckOpen "Number of active inhibit reasons for the FIds / Number of active inhibit reasons for FId_TankPCpv1DteskLoLoadStuckOpen" UWORD DINH_ct_Compu 1 100 -4095.000 4096.000 BIT_MASK 0x1fff FORMAT "%8.3" ECU_ADDRESS 0x60013C3A /end MEASUREMENT
/begin MEASUREMENT DINH_nrActvInhReas.FId_TankPSnsrElecChkVld "Number of active inhibit reasons for the FIds / Number of active inhibit reasons for FId_TankPSnsrElecChkVld" UWORD DINH_ct_Compu 1 100 -4095.000 4096.000 BIT_MASK 0x1fff FORMAT "%8.3" ECU_ADDRESS 0x60013C3C /end MEASUREMENT
/begin MEASUREMENT DINH_nrActvInhReas.FId_ThrVlvMon "Number of active inhibit reasons for the FIds / Number of active inhibit reasons for FId_ThrVlvMon" UWORD DINH_ct_Compu 1 100 -4095.000 4096.000 BIT_MASK 0x1fff FORMAT "%8.3" ECU_ADDRESS 0x60013C3E /end MEASUREMENT
/begin MEASUREMENT DINH_nrActvInhReas.FId_ThrVlvOffsLrnPrmsB1 "Number of active inhibit reasons for the FIds / Number of active inhibit reasons for FId_ThrVlvOffsLrnPrmsB1" UWORD DINH_ct_Compu 1 100 -4095.000 4096.000 BIT_MASK 0x1fff FORMAT "%8.3" ECU_ADDRESS 0x60013C40 /end MEASUREMENT
/begin MEASUREMENT DINH_nrActvInhReas.FId_TiOffTBasdChkFast "Number of active inhibit reasons for the FIds / Number of active inhibit reasons for FId_TiOffTBasdChkFast" UWORD DINH_ct_Compu 1 100 -4095.000 4096.000 BIT_MASK 0x1fff FORMAT "%8.3" ECU_ADDRESS 0x60013C42 /end MEASUREMENT
/begin MEASUREMENT DINH_nrActvInhReas.FId_TiOffTBasdChkSlow "Number of active inhibit reasons for the FIds / Number of active inhibit reasons for FId_TiOffTBasdChkSlow" UWORD DINH_ct_Compu 1 100 -4095.000 4096.000 BIT_MASK 0x1fff FORMAT "%8.3" ECU_ADDRESS 0x60013C44 /end MEASUREMENT
/begin MEASUREMENT DINH_nrActvInhReas.FId_TiOffVdClk "Number of active inhibit reasons for the FIds / Number of active inhibit reasons for FId_TiOffVdClk" UWORD DINH_ct_Compu 1 100 -4095.000 4096.000 BIT_MASK 0x1fff FORMAT "%8.3" ECU_ADDRESS 0x60013C46 /end MEASUREMENT
/begin MEASUREMENT DINH_nrActvInhReas.FId_TqDecelOffsInhb "Number of active inhibit reasons for the FIds / Number of active inhibit reasons for FId_TqDecelOffsInhb" UWORD DINH_ct_Compu 1 100 -4095.000 4096.000 BIT_MASK 0x1fff FORMAT "%8.3" ECU_ADDRESS 0x60013C48 /end MEASUREMENT
/begin MEASUREMENT DINH_nrActvInhReas.FId_TraAddAirCANPtd "Number of active inhibit reasons for the FIds / Number of active inhibit reasons for FId_TraAddAirCANPtd" UWORD DINH_ct_Compu 1 100 -4095.000 4096.000 BIT_MASK 0x1fff FORMAT "%8.3" ECU_ADDRESS 0x60013C4A /end MEASUREMENT
/begin MEASUREMENT DINH_nrActvInhReas.FId_TraAddClntCANPtd "Number of active inhibit reasons for the FIds / Number of active inhibit reasons for FId_TraAddClntCANPtd" UWORD DINH_ct_Compu 1 100 -4095.000 4096.000 BIT_MASK 0x1fff FORMAT "%8.3" ECU_ADDRESS 0x60013C4C /end MEASUREMENT
/begin MEASUREMENT DINH_nrActvInhReas.FId_TraFwdRvsCluInfo "Number of active inhibit reasons for the FIds / Number of active inhibit reasons for FId_TraFwdRvsCluInfo" UWORD DINH_ct_Compu 1 100 -4095.000 4096.000 BIT_MASK 0x1fff FORMAT "%8.3" ECU_ADDRESS 0x60013C4E /end MEASUREMENT
/begin MEASUREMENT DINH_nrActvInhReas.FId_TraGbxNPos "Number of active inhibit reasons for the FIds / Number of active inhibit reasons for FId_TraGbxNPos" UWORD DINH_ct_Compu 1 100 -4095.000 4096.000 BIT_MASK 0x1fff FORMAT "%8.3" ECU_ADDRESS 0x60013C50 /end MEASUREMENT
/begin MEASUREMENT DINH_nrActvInhReas.FId_TraGearInfoCanCom "Number of active inhibit reasons for the FIds / Number of active inhibit reasons for FId_TraGearInfoCanCom" UWORD DINH_ct_Compu 1 100 -4095.000 4096.000 BIT_MASK 0x1fff FORMAT "%8.3" ECU_ADDRESS 0x60013C52 /end MEASUREMENT
/begin MEASUREMENT DINH_nrActvInhReas.FId_TraGearInfoDet "Number of active inhibit reasons for the FIds / Number of active inhibit reasons for FId_TraGearInfoDet" UWORD DINH_ct_Compu 1 100 -4095.000 4096.000 BIT_MASK 0x1fff FORMAT "%8.3" ECU_ADDRESS 0x60013C54 /end MEASUREMENT
/begin MEASUREMENT DINH_nrActvInhReas.FId_TraGearInfoGearShftActv "Number of active inhibit reasons for the FIds / Number of active inhibit reasons for FId_TraGearInfoGearShftActv" UWORD DINH_ct_Compu 1 100 -4095.000 4096.000 BIT_MASK 0x1fff FORMAT "%8.3" ECU_ADDRESS 0x60013C56 /end MEASUREMENT
/begin MEASUREMENT DINH_nrActvInhReas.FId_TraGearInfoInfoCan "Number of active inhibit reasons for the FIds / Number of active inhibit reasons for FId_TraGearInfoInfoCan" UWORD DINH_ct_Compu 1 100 -4095.000 4096.000 BIT_MASK 0x1fff FORMAT "%8.3" ECU_ADDRESS 0x60013C58 /end MEASUREMENT
/begin MEASUREMENT DINH_nrActvInhReas.FId_TraGearInfoLevPos "Number of active inhibit reasons for the FIds / Number of active inhibit reasons for FId_TraGearInfoLevPos" UWORD DINH_ct_Compu 1 100 -4095.000 4096.000 BIT_MASK 0x1fff FORMAT "%8.3" ECU_ADDRESS 0x60013C5A /end MEASUREMENT
/begin MEASUREMENT DINH_nrActvInhReas.FId_TraGearInfoLoRng "Number of active inhibit reasons for the FIds / Number of active inhibit reasons for FId_TraGearInfoLoRng" UWORD DINH_ct_Compu 1 100 -4095.000 4096.000 BIT_MASK 0x1fff FORMAT "%8.3" ECU_ADDRESS 0x60013C5C /end MEASUREMENT
/begin MEASUREMENT DINH_nrActvInhReas.FId_TraGearInfoRTra "Number of active inhibit reasons for the FIds / Number of active inhibit reasons for FId_TraGearInfoRTra" UWORD DINH_ct_Compu 1 100 -4095.000 4096.000 BIT_MASK 0x1fff FORMAT "%8.3" ECU_ADDRESS 0x60013C5E /end MEASUREMENT
/begin MEASUREMENT DINH_nrActvInhReas.FId_TraGearInfoRevGear "Number of active inhibit reasons for the FIds / Number of active inhibit reasons for FId_TraGearInfoRevGear" UWORD DINH_ct_Compu 1 100 -4095.000 4096.000 BIT_MASK 0x1fff FORMAT "%8.3" ECU_ADDRESS 0x60013C60 /end MEASUREMENT
/begin MEASUREMENT DINH_nrActvInhReas.FId_TraGearReq "Number of active inhibit reasons for the FIds / Number of active inhibit reasons for FId_TraGearReq" UWORD DINH_ct_Compu 1 100 -4095.000 4096.000 BIT_MASK 0x1fff FORMAT "%8.3" ECU_ADDRESS 0x60013C62 /end MEASUREMENT
/begin MEASUREMENT DINH_nrActvInhReas.FId_TraNoShftIdctr "Number of active inhibit reasons for the FIds / Number of active inhibit reasons for FId_TraNoShftIdctr" UWORD DINH_ct_Compu 1 100 -4095.000 4096.000 BIT_MASK 0x1fff FORMAT "%8.3" ECU_ADDRESS 0x60013C64 /end MEASUREMENT
/begin MEASUREMENT DINH_nrActvInhReas.FId_TraPrtGearCANPtd "Number of active inhibit reasons for the FIds / Number of active inhibit reasons for FId_TraPrtGearCANPtd" UWORD DINH_ct_Compu 1 100 -4095.000 4096.000 BIT_MASK 0x1fff FORMAT "%8.3" ECU_ADDRESS 0x60013C66 /end MEASUREMENT
/begin MEASUREMENT DINH_nrActvInhReas.FId_TraPrtGearIndpdtProblem "Number of active inhibit reasons for the FIds / Number of active inhibit reasons for FId_TraPrtGearIndpdtProblem" UWORD DINH_ct_Compu 1 100 -4095.000 4096.000 BIT_MASK 0x1fff FORMAT "%8.3" ECU_ADDRESS 0x60013C68 /end MEASUREMENT
/begin MEASUREMENT DINH_nrActvInhReas.FId_TraRPosn "Number of active inhibit reasons for the FIds / Number of active inhibit reasons for FId_TraRPosn" UWORD DINH_ct_Compu 1 100 -4095.000 4096.000 BIT_MASK 0x1fff FORMAT "%8.3" ECU_ADDRESS 0x60013C6A /end MEASUREMENT
/begin MEASUREMENT DINH_nrActvInhReas.FId_TraRtnIntfcASTIntv "Number of active inhibit reasons for the FIds / Number of active inhibit reasons for FId_TraRtnIntfcASTIntv" UWORD DINH_ct_Compu 1 100 -4095.000 4096.000 BIT_MASK 0x1fff FORMAT "%8.3" ECU_ADDRESS 0x60013C6C /end MEASUREMENT
/begin MEASUREMENT DINH_nrActvInhReas.FId_TraRtnIntfcIdlSetP "Number of active inhibit reasons for the FIds / Number of active inhibit reasons for FId_TraRtnIntfcIdlSetP" UWORD DINH_ct_Compu 1 100 -4095.000 4096.000 BIT_MASK 0x1fff FORMAT "%8.3" ECU_ADDRESS 0x60013C6E /end MEASUREMENT
/begin MEASUREMENT DINH_nrActvInhReas.FId_TraRtnIntfcNMaxCan "Number of active inhibit reasons for the FIds / Number of active inhibit reasons for FId_TraRtnIntfcNMaxCan" UWORD DINH_ct_Compu 1 100 -4095.000 4096.000 BIT_MASK 0x1fff FORMAT "%8.3" ECU_ADDRESS 0x60013C70 /end MEASUREMENT
/begin MEASUREMENT DINH_nrActvInhReas.FId_TraRtnIntfcNMaxVel "Number of active inhibit reasons for the FIds / Number of active inhibit reasons for FId_TraRtnIntfcNMaxVel" UWORD DINH_ct_Compu 1 100 -4095.000 4096.000 BIT_MASK 0x1fff FORMAT "%8.3" ECU_ADDRESS 0x60013C72 /end MEASUREMENT
/begin MEASUREMENT DINH_nrActvInhReas.FId_TraTrqRedLmpHmeDec "Number of active inhibit reasons for the FIds / Number of active inhibit reasons for FId_TraTrqRedLmpHmeDec" UWORD DINH_ct_Compu 1 100 -4095.000 4096.000 BIT_MASK 0x1fff FORMAT "%8.3" ECU_ADDRESS 0x60013C74 /end MEASUREMENT
/begin MEASUREMENT DINH_nrActvInhReas.FId_TraTrqRedLmpHmeInc "Number of active inhibit reasons for the FIds / Number of active inhibit reasons for FId_TraTrqRedLmpHmeInc" UWORD DINH_ct_Compu 1 100 -4095.000 4096.000 BIT_MASK 0x1fff FORMAT "%8.3" ECU_ADDRESS 0x60013C76 /end MEASUREMENT
/begin MEASUREMENT DINH_nrActvInhReas.FId_TraTrqRedPTCanErr "Number of active inhibit reasons for the FIds / Number of active inhibit reasons for FId_TraTrqRedPTCanErr" UWORD DINH_ct_Compu 1 100 -4095.000 4096.000 BIT_MASK 0x1fff FORMAT "%8.3" ECU_ADDRESS 0x60013C78 /end MEASUREMENT
/begin MEASUREMENT DINH_nrActvInhReas.FId_TraTrqRedTIIntvDes "Number of active inhibit reasons for the FIds / Number of active inhibit reasons for FId_TraTrqRedTIIntvDes" UWORD DINH_ct_Compu 1 100 -4095.000 4096.000 BIT_MASK 0x1fff FORMAT "%8.3" ECU_ADDRESS 0x60013C7A /end MEASUREMENT
/begin MEASUREMENT DINH_nrActvInhReas.FId_TraTrqRedTIIntvLead "Number of active inhibit reasons for the FIds / Number of active inhibit reasons for FId_TraTrqRedTIIntvLead" UWORD DINH_ct_Compu 1 100 -4095.000 4096.000 BIT_MASK 0x1fff FORMAT "%8.3" ECU_ADDRESS 0x60013C7C /end MEASUREMENT
/begin MEASUREMENT DINH_nrActvInhReas.FId_TraTrqRedTSCIntvDes "Number of active inhibit reasons for the FIds / Number of active inhibit reasons for FId_TraTrqRedTSCIntvDes" UWORD DINH_ct_Compu 1 100 -4095.000 4096.000 BIT_MASK 0x1fff FORMAT "%8.3" ECU_ADDRESS 0x60013C7E /end MEASUREMENT
/begin MEASUREMENT DINH_nrActvInhReas.FId_TraTrqRedTSCIntvLead "Number of active inhibit reasons for the FIds / Number of active inhibit reasons for FId_TraTrqRedTSCIntvLead" UWORD DINH_ct_Compu 1 100 -4095.000 4096.000 BIT_MASK 0x1fff FORMAT "%8.3" ECU_ADDRESS 0x60013C80 /end MEASUREMENT
/begin MEASUREMENT DINH_nrActvInhReas.FId_TraTrsmTypHw "Number of active inhibit reasons for the FIds / Number of active inhibit reasons for FId_TraTrsmTypHw" UWORD DINH_ct_Compu 1 100 -4095.000 4096.000 BIT_MASK 0x1fff FORMAT "%8.3" ECU_ADDRESS 0x60013C82 /end MEASUREMENT
/begin MEASUREMENT DINH_nrActvInhReas.FId_TranIdleDes "Number of active inhibit reasons for the FIds / Number of active inhibit reasons for FId_TranIdleDes" UWORD DINH_ct_Compu 1 100 -4095.000 4096.000 BIT_MASK 0x1fff FORMAT "%8.3" ECU_ADDRESS 0x60013C84 /end MEASUREMENT
/begin MEASUREMENT DINH_nrActvInhReas.FId_UEGOHeatgUpRglS1B1 "Number of active inhibit reasons for the FIds / Number of active inhibit reasons for FId_UEGOHeatgUpRglS1B1" UWORD DINH_ct_Compu 1 100 -4095.000 4096.000 BIT_MASK 0x1fff FORMAT "%8.3" ECU_ADDRESS 0x60013C86 /end MEASUREMENT
/begin MEASUREMENT DINH_nrActvInhReas.FId_UEGOHeatrCtrlS1B1 "Number of active inhibit reasons for the FIds / Number of active inhibit reasons for FId_UEGOHeatrCtrlS1B1" UWORD DINH_ct_Compu 1 100 -4095.000 4096.000 BIT_MASK 0x1fff FORMAT "%8.3" ECU_ADDRESS 0x60013C88 /end MEASUREMENT
/begin MEASUREMENT DINH_nrActvInhReas.FId_UEGOHeatrPrfmncDiagRelsS1B1 "Number of active inhibit reasons for the FIds / Number of active inhibit reasons for FId_UEGOHeatrPrfmncDiagRelsS1B1" UWORD DINH_ct_Compu 1 100 -4095.000 4096.000 BIT_MASK 0x1fff FORMAT "%8.3" ECU_ADDRESS 0x60013C8A /end MEASUREMENT
/begin MEASUREMENT DINH_nrActvInhReas.FId_UEGOHeatrPwrStgDiagRelsS1B1 "Number of active inhibit reasons for the FIds / Number of active inhibit reasons for FId_UEGOHeatrPwrStgDiagRelsS1B1" UWORD DINH_ct_Compu 1 100 -4095.000 4096.000 BIT_MASK 0x1fff FORMAT "%8.3" ECU_ADDRESS 0x60013C8C /end MEASUREMENT
/begin MEASUREMENT DINH_nrActvInhReas.FId_UEGOModCtrlRelsS1B1 "Number of active inhibit reasons for the FIds / Number of active inhibit reasons for FId_UEGOModCtrlRelsS1B1" UWORD DINH_ct_Compu 1 100 -4095.000 4096.000 BIT_MASK 0x1fff FORMAT "%8.3" ECU_ADDRESS 0x60013C8E /end MEASUREMENT
/begin MEASUREMENT DINH_nrActvInhReas.FId_UEGOStrtDiagInhRprtErrS1B1 "Number of active inhibit reasons for the FIds / Number of active inhibit reasons for FId_UEGOStrtDiagInhRprtErrS1B1" UWORD DINH_ct_Compu 1 100 -4095.000 4096.000 BIT_MASK 0x1fff FORMAT "%8.3" ECU_ADDRESS 0x60013C90 /end MEASUREMENT
/begin MEASUREMENT DINH_nrActvInhReas.FId_UEGOStrtDiagRelsS1B1 "Number of active inhibit reasons for the FIds / Number of active inhibit reasons for FId_UEGOStrtDiagRelsS1B1" UWORD DINH_ct_Compu 1 100 -4095.000 4096.000 BIT_MASK 0x1fff FORMAT "%8.3" ECU_ADDRESS 0x60013C92 /end MEASUREMENT
/begin MEASUREMENT DINH_nrActvInhReas.FId_UEGOTCeramicRelsS1B1 "Number of active inhibit reasons for the FIds / Number of active inhibit reasons for FId_UEGOTCeramicRelsS1B1" UWORD DINH_ct_Compu 1 100 -4095.000 4096.000 BIT_MASK 0x1fff FORMAT "%8.3" ECU_ADDRESS 0x60013C94 /end MEASUREMENT
/begin MEASUREMENT DINH_nrActvInhReas.FId_UegoDiagRelsBattSplyOk "Number of active inhibit reasons for the FIds / Number of active inhibit reasons for FId_UegoDiagRelsBattSplyOk" UWORD DINH_ct_Compu 1 100 -4095.000 4096.000 BIT_MASK 0x1fff FORMAT "%8.3" ECU_ADDRESS 0x60013C96 /end MEASUREMENT
/begin MEASUREMENT DINH_nrActvInhReas.FId_UegoDiagSigEcuAsicS1B1 "Number of active inhibit reasons for the FIds / Number of active inhibit reasons for FId_UegoDiagSigEcuAsicS1B1" UWORD DINH_ct_Compu 1 100 -4095.000 4096.000 BIT_MASK 0x1fff FORMAT "%8.3" ECU_ADDRESS 0x60013C98 /end MEASUREMENT
/begin MEASUREMENT DINH_nrActvInhReas.FId_UegoDiagSigEcuComS1B1 "Number of active inhibit reasons for the FIds / Number of active inhibit reasons for FId_UegoDiagSigEcuComS1B1" UWORD DINH_ct_Compu 1 100 -4095.000 4096.000 BIT_MASK 0x1fff FORMAT "%8.3" ECU_ADDRESS 0x60013C9A /end MEASUREMENT
/begin MEASUREMENT DINH_nrActvInhReas.FId_UegoDiagSigOperPlausS1B1 "Number of active inhibit reasons for the FIds / Number of active inhibit reasons for FId_UegoDiagSigOperPlausS1B1" UWORD DINH_ct_Compu 1 100 -4095.000 4096.000 BIT_MASK 0x1fff FORMAT "%8.3" ECU_ADDRESS 0x60013C9C /end MEASUREMENT
/begin MEASUREMENT DINH_nrActvInhReas.FId_UegoDiagSigSnsrS1B1 "Number of active inhibit reasons for the FIds / Number of active inhibit reasons for FId_UegoDiagSigSnsrS1B1" UWORD DINH_ct_Compu 1 100 -4095.000 4096.000 BIT_MASK 0x1fff FORMAT "%8.3" ECU_ADDRESS 0x60013C9E /end MEASUREMENT
/begin MEASUREMENT DINH_nrActvInhReas.FId_UegoDiagSigWireOlS1B1 "Number of active inhibit reasons for the FIds / Number of active inhibit reasons for FId_UegoDiagSigWireOlS1B1" UWORD DINH_ct_Compu 1 100 -4095.000 4096.000 BIT_MASK 0x1fff FORMAT "%8.3" ECU_ADDRESS 0x60013CA0 /end MEASUREMENT
/begin MEASUREMENT DINH_nrActvInhReas.FId_UegoDiagSigWireScS1B1 "Number of active inhibit reasons for the FIds / Number of active inhibit reasons for FId_UegoDiagSigWireScS1B1" UWORD DINH_ct_Compu 1 100 -4095.000 4096.000 BIT_MASK 0x1fff FORMAT "%8.3" ECU_ADDRESS 0x60013CA2 /end MEASUREMENT
/begin MEASUREMENT DINH_nrActvInhReas.FId_UegoDiagSigWireScTstdS1B1 "Number of active inhibit reasons for the FIds / Number of active inhibit reasons for FId_UegoDiagSigWireScTstdS1B1" UWORD DINH_ct_Compu 1 100 -4095.000 4096.000 BIT_MASK 0x1fff FORMAT "%8.3" ECU_ADDRESS 0x60013CA4 /end MEASUREMENT
/begin MEASUREMENT DINH_nrActvInhReas.FId_UegoInhbOperRelsS1B1 "Number of active inhibit reasons for the FIds / Number of active inhibit reasons for FId_UegoInhbOperRelsS1B1" UWORD DINH_ct_Compu 1 100 -4095.000 4096.000 BIT_MASK 0x1fff FORMAT "%8.3" ECU_ADDRESS 0x60013CA6 /end MEASUREMENT
/begin MEASUREMENT DINH_nrActvInhReas.FId_UegoO2HiPrcsnS1B1 "Number of active inhibit reasons for the FIds / Number of active inhibit reasons for FId_UegoO2HiPrcsnS1B1" UWORD DINH_ct_Compu 1 100 -4095.000 4096.000 BIT_MASK 0x1fff FORMAT "%8.3" ECU_ADDRESS 0x60013CA8 /end MEASUREMENT
/begin MEASUREMENT DINH_nrActvInhReas.FId_UegoO2PlausErrS1B1 "Number of active inhibit reasons for the FIds / Number of active inhibit reasons for FId_UegoO2PlausErrS1B1" UWORD DINH_ct_Compu 1 100 -4095.000 4096.000 BIT_MASK 0x1fff FORMAT "%8.3" ECU_ADDRESS 0x60013CAA /end MEASUREMENT
/begin MEASUREMENT DINH_nrActvInhReas.FId_UegoO2VldS1B1 "Number of active inhibit reasons for the FIds / Number of active inhibit reasons for FId_UegoO2VldS1B1" UWORD DINH_ct_Compu 1 100 -4095.000 4096.000 BIT_MASK 0x1fff FORMAT "%8.3" ECU_ADDRESS 0x60013CAC /end MEASUREMENT
/begin MEASUREMENT DINH_nrActvInhReas.FId_UegoOperPlausBattSplyOk "Number of active inhibit reasons for the FIds / Number of active inhibit reasons for FId_UegoOperPlausBattSplyOk" UWORD DINH_ct_Compu 1 100 -4095.000 4096.000 BIT_MASK 0x1fff FORMAT "%8.3" ECU_ADDRESS 0x60013CAE /end MEASUREMENT
/begin MEASUREMENT DINH_nrActvInhReas.FId_UegoPlausErrHndlg "Number of active inhibit reasons for the FIds / Number of active inhibit reasons for FId_UegoPlausErrHndlg" UWORD DINH_ct_Compu 1 100 -4095.000 4096.000 BIT_MASK 0x1fff FORMAT "%8.3" ECU_ADDRESS 0x60013CB0 /end MEASUREMENT
/begin MEASUREMENT DINH_nrActvInhReas.FId_VMSIDCSRmpShOff "Number of active inhibit reasons for the FIds / Number of active inhibit reasons for FId_VMSIDCSRmpShOff" UWORD DINH_ct_Compu 1 100 -4095.000 4096.000 BIT_MASK 0x1fff FORMAT "%8.3" ECU_ADDRESS 0x60013CB2 /end MEASUREMENT
/begin MEASUREMENT DINH_nrActvInhReas.FId_VMSIDCSShOff "Number of active inhibit reasons for the FIds / Number of active inhibit reasons for FId_VMSIDCSShOff" UWORD DINH_ct_Compu 1 100 -4095.000 4096.000 BIT_MASK 0x1fff FORMAT "%8.3" ECU_ADDRESS 0x60013CB4 /end MEASUREMENT
/begin MEASUREMENT DINH_nrActvInhReas.FId_VMSITCSRmpShOff "Number of active inhibit reasons for the FIds / Number of active inhibit reasons for FId_VMSITCSRmpShOff" UWORD DINH_ct_Compu 1 100 -4095.000 4096.000 BIT_MASK 0x1fff FORMAT "%8.3" ECU_ADDRESS 0x60013CB6 /end MEASUREMENT
/begin MEASUREMENT DINH_nrActvInhReas.FId_VMSITCSShOff "Number of active inhibit reasons for the FIds / Number of active inhibit reasons for FId_VMSITCSShOff" UWORD DINH_ct_Compu 1 100 -4095.000 4096.000 BIT_MASK 0x1fff FORMAT "%8.3" ECU_ADDRESS 0x60013CB8 /end MEASUREMENT
/begin MEASUREMENT DINH_nrActvInhReas.FId_VSACANErr "Number of active inhibit reasons for the FIds / Number of active inhibit reasons for FId_VSACANErr" UWORD DINH_ct_Compu 1 100 -4095.000 4096.000 BIT_MASK 0x1fff FORMAT "%8.3" ECU_ADDRESS 0x60013CBA /end MEASUREMENT
/begin MEASUREMENT DINH_nrActvInhReas.FId_VehStcACGFailr "Number of active inhibit reasons for the FIds / Number of active inhibit reasons for FId_VehStcACGFailr" UWORD DINH_ct_Compu 1 100 -4095.000 4096.000 BIT_MASK 0x1fff FORMAT "%8.3" ECU_ADDRESS 0x60013CBC /end MEASUREMENT
/begin MEASUREMENT DINH_nrActvInhReas.FId_VehStcBattMngFailr "Number of active inhibit reasons for the FIds / Number of active inhibit reasons for FId_VehStcBattMngFailr" UWORD DINH_ct_Compu 1 100 -4095.000 4096.000 BIT_MASK 0x1fff FORMAT "%8.3" ECU_ADDRESS 0x60013CBE /end MEASUREMENT
/begin MEASUREMENT DINH_nrActvInhReas.FId_VehStcDCDCFailr "Number of active inhibit reasons for the FIds / Number of active inhibit reasons for FId_VehStcDCDCFailr" UWORD DINH_ct_Compu 1 100 -4095.000 4096.000 BIT_MASK 0x1fff FORMAT "%8.3" ECU_ADDRESS 0x60013CC0 /end MEASUREMENT
/begin MEASUREMENT DINH_nrActvInhReas.FId_VehStcEBSFailr "Number of active inhibit reasons for the FIds / Number of active inhibit reasons for FId_VehStcEBSFailr" UWORD DINH_ct_Compu 1 100 -4095.000 4096.000 BIT_MASK 0x1fff FORMAT "%8.3" ECU_ADDRESS 0x60013CC2 /end MEASUREMENT
/begin MEASUREMENT DINH_nrActvInhReas.FId_VehStcMisf "Number of active inhibit reasons for the FIds / Number of active inhibit reasons for FId_VehStcMisf" UWORD DINH_ct_Compu 1 100 -4095.000 4096.000 BIT_MASK 0x1fff FORMAT "%8.3" ECU_ADDRESS 0x60013CC4 /end MEASUREMENT
/begin MEASUREMENT DINH_nrActvInhReas.FId_VehStcMtrComFailr "Number of active inhibit reasons for the FIds / Number of active inhibit reasons for FId_VehStcMtrComFailr" UWORD DINH_ct_Compu 1 100 -4095.000 4096.000 BIT_MASK 0x1fff FORMAT "%8.3" ECU_ADDRESS 0x60013CC6 /end MEASUREMENT
/begin MEASUREMENT DINH_nrActvInhReas.FId_VehStcNVMFailr "Number of active inhibit reasons for the FIds / Number of active inhibit reasons for FId_VehStcNVMFailr" UWORD DINH_ct_Compu 1 100 -4095.000 4096.000 BIT_MASK 0x1fff FORMAT "%8.3" ECU_ADDRESS 0x60013CC8 /end MEASUREMENT
/begin MEASUREMENT DINH_nrActvInhReas.FId_VehVCANFrzVal "Number of active inhibit reasons for the FIds / Number of active inhibit reasons for FId_VehVCANFrzVal" UWORD DINH_ct_Compu 1 100 -4095.000 4096.000 BIT_MASK 0x1fff FORMAT "%8.3" ECU_ADDRESS 0x60013CCA /end MEASUREMENT
/begin MEASUREMENT DINH_nrActvInhReas.FId_VehVCANReplVal "Number of active inhibit reasons for the FIds / Number of active inhibit reasons for FId_VehVCANReplVal" UWORD DINH_ct_Compu 1 100 -4095.000 4096.000 BIT_MASK 0x1fff FORMAT "%8.3" ECU_ADDRESS 0x60013CCC /end MEASUREMENT
/begin MEASUREMENT DINH_nrActvInhReas.FId_VehVCanSafeFrzVal "Number of active inhibit reasons for the FIds / Number of active inhibit reasons for FId_VehVCanSafeFrzVal" UWORD DINH_ct_Compu 1 100 -4095.000 4096.000 BIT_MASK 0x1fff FORMAT "%8.3" ECU_ADDRESS 0x60013CCE /end MEASUREMENT
/begin MEASUREMENT DINH_nrActvInhReas.FId_VehVCanSafeReplVal "Number of active inhibit reasons for the FIds / Number of active inhibit reasons for FId_VehVCanSafeReplVal" UWORD DINH_ct_Compu 1 100 -4095.000 4096.000 BIT_MASK 0x1fff FORMAT "%8.3" ECU_ADDRESS 0x60013CD0 /end MEASUREMENT
/begin MEASUREMENT DINH_nrActvInhReas.FId_VehVCom "Number of active inhibit reasons for the FIds / Number of active inhibit reasons for FId_VehVCom" UWORD DINH_ct_Compu 1 100 -4095.000 4096.000 BIT_MASK 0x1fff FORMAT "%8.3" ECU_ADDRESS 0x60013CD2 /end MEASUREMENT
/begin MEASUREMENT DINH_nrActvInhReas.FId_VehVExcdLim "Number of active inhibit reasons for the FIds / Number of active inhibit reasons for FId_VehVExcdLim" UWORD DINH_ct_Compu 1 100 -4095.000 4096.000 BIT_MASK 0x1fff FORMAT "%8.3" ECU_ADDRESS 0x60013CD4 /end MEASUREMENT
/begin MEASUREMENT DINH_nrActvInhReas.FId_VehVFrzVal "Number of active inhibit reasons for the FIds / Number of active inhibit reasons for FId_VehVFrzVal" UWORD DINH_ct_Compu 1 100 -4095.000 4096.000 BIT_MASK 0x1fff FORMAT "%8.3" ECU_ADDRESS 0x60013CD6 /end MEASUREMENT
/begin MEASUREMENT DINH_nrActvInhReas.FId_VehVNCSnsrElecFailr "Number of active inhibit reasons for the FIds / Number of active inhibit reasons for FId_VehVNCSnsrElecFailr" UWORD DINH_ct_Compu 1 100 -4095.000 4096.000 BIT_MASK 0x1fff FORMAT "%8.3" ECU_ADDRESS 0x60013CD8 /end MEASUREMENT
/begin MEASUREMENT DINH_nrActvInhReas.FId_VehVOBDFrzVal "Number of active inhibit reasons for the FIds / Number of active inhibit reasons for FId_VehVOBDFrzVal" UWORD DINH_ct_Compu 1 100 -4095.000 4096.000 BIT_MASK 0x1fff FORMAT "%8.3" ECU_ADDRESS 0x60013CDA /end MEASUREMENT
/begin MEASUREMENT DINH_nrActvInhReas.FId_VehVOBDReplVal "Number of active inhibit reasons for the FIds / Number of active inhibit reasons for FId_VehVOBDReplVal" UWORD DINH_ct_Compu 1 100 -4095.000 4096.000 BIT_MASK 0x1fff FORMAT "%8.3" ECU_ADDRESS 0x60013CDC /end MEASUREMENT
/begin MEASUREMENT DINH_nrActvInhReas.FId_VehVOutCanErr "Number of active inhibit reasons for the FIds / Number of active inhibit reasons for FId_VehVOutCanErr" UWORD DINH_ct_Compu 1 100 -4095.000 4096.000 BIT_MASK 0x1fff FORMAT "%8.3" ECU_ADDRESS 0x60013CDE /end MEASUREMENT
/begin MEASUREMENT DINH_nrActvInhReas.FId_VehVPWMFrzVal "Number of active inhibit reasons for the FIds / Number of active inhibit reasons for FId_VehVPWMFrzVal" UWORD DINH_ct_Compu 1 100 -4095.000 4096.000 BIT_MASK 0x1fff FORMAT "%8.3" ECU_ADDRESS 0x60013CE0 /end MEASUREMENT
/begin MEASUREMENT DINH_nrActvInhReas.FId_VehVPWMReplVal "Number of active inhibit reasons for the FIds / Number of active inhibit reasons for FId_VehVPWMReplVal" UWORD DINH_ct_Compu 1 100 -4095.000 4096.000 BIT_MASK 0x1fff FORMAT "%8.3" ECU_ADDRESS 0x60013CE2 /end MEASUREMENT
/begin MEASUREMENT DINH_nrActvInhReas.FId_VehVPhysRng "Number of active inhibit reasons for the FIds / Number of active inhibit reasons for FId_VehVPhysRng" UWORD DINH_ct_Compu 1 100 -4095.000 4096.000 BIT_MASK 0x1fff FORMAT "%8.3" ECU_ADDRESS 0x60013CE4 /end MEASUREMENT
/begin MEASUREMENT DINH_nrActvInhReas.FId_VehVPlaus "Number of active inhibit reasons for the FIds / Number of active inhibit reasons for FId_VehVPlaus" UWORD DINH_ct_Compu 1 100 -4095.000 4096.000 BIT_MASK 0x1fff FORMAT "%8.3" ECU_ADDRESS 0x60013CE6 /end MEASUREMENT
/begin MEASUREMENT DINH_nrActvInhReas.FId_VehVPlausCan "Number of active inhibit reasons for the FIds / Number of active inhibit reasons for FId_VehVPlausCan" UWORD DINH_ct_Compu 1 100 -4095.000 4096.000 BIT_MASK 0x1fff FORMAT "%8.3" ECU_ADDRESS 0x60013CE8 /end MEASUREMENT
/begin MEASUREMENT DINH_nrActvInhReas.FId_VehVPlausFco "Number of active inhibit reasons for the FIds / Number of active inhibit reasons for FId_VehVPlausFco" UWORD DINH_ct_Compu 1 100 -4095.000 4096.000 BIT_MASK 0x1fff FORMAT "%8.3" ECU_ADDRESS 0x60013CEA /end MEASUREMENT
/begin MEASUREMENT DINH_nrActvInhReas.FId_VehVPlausPwr "Number of active inhibit reasons for the FIds / Number of active inhibit reasons for FId_VehVPlausPwr" UWORD DINH_ct_Compu 1 100 -4095.000 4096.000 BIT_MASK 0x1fff FORMAT "%8.3" ECU_ADDRESS 0x60013CEC /end MEASUREMENT
/begin MEASUREMENT DINH_nrActvInhReas.FId_VehVPlausV2N "Number of active inhibit reasons for the FIds / Number of active inhibit reasons for FId_VehVPlausV2N" UWORD DINH_ct_Compu 1 100 -4095.000 4096.000 BIT_MASK 0x1fff FORMAT "%8.3" ECU_ADDRESS 0x60013CEE /end MEASUREMENT
/begin MEASUREMENT DINH_nrActvInhReas.FId_VehVReplVal "Number of active inhibit reasons for the FIds / Number of active inhibit reasons for FId_VehVReplVal" UWORD DINH_ct_Compu 1 100 -4095.000 4096.000 BIT_MASK 0x1fff FORMAT "%8.3" ECU_ADDRESS 0x60013CF0 /end MEASUREMENT
/begin MEASUREMENT DINH_nrActvInhReas.FId_VehVSigCan "Number of active inhibit reasons for the FIds / Number of active inhibit reasons for FId_VehVSigCan" UWORD DINH_ct_Compu 1 100 -4095.000 4096.000 BIT_MASK 0x1fff FORMAT "%8.3" ECU_ADDRESS 0x60013CF2 /end MEASUREMENT
/begin MEASUREMENT DINH_nrActvInhReas.FId_VehVSigCanSafe "Number of active inhibit reasons for the FIds / Number of active inhibit reasons for FId_VehVSigCanSafe" UWORD DINH_ct_Compu 1 100 -4095.000 4096.000 BIT_MASK 0x1fff FORMAT "%8.3" ECU_ADDRESS 0x60013CF4 /end MEASUREMENT
/begin MEASUREMENT DINH_nrActvInhReas.FId_VehVSngWhlCanFrzVal "Number of active inhibit reasons for the FIds / Number of active inhibit reasons for FId_VehVSngWhlCanFrzVal" UWORD DINH_ct_Compu 1 100 -4095.000 4096.000 BIT_MASK 0x1fff FORMAT "%8.3" ECU_ADDRESS 0x60013CF6 /end MEASUREMENT
/begin MEASUREMENT DINH_nrActvInhReas.FId_VehVSngWhlCanReplVal "Number of active inhibit reasons for the FIds / Number of active inhibit reasons for FId_VehVSngWhlCanReplVal" UWORD DINH_ct_Compu 1 100 -4095.000 4096.000 BIT_MASK 0x1fff FORMAT "%8.3" ECU_ADDRESS 0x60013CF8 /end MEASUREMENT
/begin MEASUREMENT DINH_nrActvInhReas.FId_VehVSnsrARngHi "Number of active inhibit reasons for the FIds / Number of active inhibit reasons for FId_VehVSnsrARngHi" UWORD DINH_ct_Compu 1 100 -4095.000 4096.000 BIT_MASK 0x1fff FORMAT "%8.3" ECU_ADDRESS 0x60013CFA /end MEASUREMENT
/begin MEASUREMENT DINH_nrActvInhReas.FId_VehVSnsrBRngHi "Number of active inhibit reasons for the FIds / Number of active inhibit reasons for FId_VehVSnsrBRngHi" UWORD DINH_ct_Compu 1 100 -4095.000 4096.000 BIT_MASK 0x1fff FORMAT "%8.3" ECU_ADDRESS 0x60013CFC /end MEASUREMENT
/begin MEASUREMENT DINH_nrActvInhReas.FId_VehVSpdRtyDiag "Number of active inhibit reasons for the FIds / Number of active inhibit reasons for FId_VehVSpdRtyDiag" UWORD DINH_ct_Compu 1 100 -4095.000 4096.000 BIT_MASK 0x1fff FORMAT "%8.3" ECU_ADDRESS 0x60013CFE /end MEASUREMENT
/begin MEASUREMENT DINH_nrActvInhReas.FId_VehVSpdSnsrAElecFailr "Number of active inhibit reasons for the FIds / Number of active inhibit reasons for FId_VehVSpdSnsrAElecFailr" UWORD DINH_ct_Compu 1 100 -4095.000 4096.000 BIT_MASK 0x1fff FORMAT "%8.3" ECU_ADDRESS 0x60013D00 /end MEASUREMENT
/begin MEASUREMENT DINH_nrActvInhReas.FId_VehVSpdSnsrBElecFailr "Number of active inhibit reasons for the FIds / Number of active inhibit reasons for FId_VehVSpdSnsrBElecFailr" UWORD DINH_ct_Compu 1 100 -4095.000 4096.000 BIT_MASK 0x1fff FORMAT "%8.3" ECU_ADDRESS 0x60013D02 /end MEASUREMENT
/begin MEASUREMENT DINH_nrActvInhReas.FId_VehVvFLWhlSpd "Number of active inhibit reasons for the FIds / Number of active inhibit reasons for FId_VehVvFLWhlSpd" UWORD DINH_ct_Compu 1 100 -4095.000 4096.000 BIT_MASK 0x1fff FORMAT "%8.3" ECU_ADDRESS 0x60013D04 /end MEASUREMENT
/begin MEASUREMENT DINH_nrActvInhReas.FId_VehVvFRWhlSpd "Number of active inhibit reasons for the FIds / Number of active inhibit reasons for FId_VehVvFRWhlSpd" UWORD DINH_ct_Compu 1 100 -4095.000 4096.000 BIT_MASK 0x1fff FORMAT "%8.3" ECU_ADDRESS 0x60013D06 /end MEASUREMENT
/begin MEASUREMENT DINH_nrActvInhReas.FId_VehVvRLWhlSpd "Number of active inhibit reasons for the FIds / Number of active inhibit reasons for FId_VehVvRLWhlSpd" UWORD DINH_ct_Compu 1 100 -4095.000 4096.000 BIT_MASK 0x1fff FORMAT "%8.3" ECU_ADDRESS 0x60013D08 /end MEASUREMENT
/begin MEASUREMENT DINH_nrActvInhReas.FId_VehVvRRWhlSpd "Number of active inhibit reasons for the FIds / Number of active inhibit reasons for FId_VehVvRRWhlSpd" UWORD DINH_ct_Compu 1 100 -4095.000 4096.000 BIT_MASK 0x1fff FORMAT "%8.3" ECU_ADDRESS 0x60013D0A /end MEASUREMENT
/begin MEASUREMENT DINH_nrActvInhReas.FId_VldtLamDynS1B1 "Number of active inhibit reasons for the FIds / Number of active inhibit reasons for FId_VldtLamDynS1B1" UWORD DINH_ct_Compu 1 100 -4095.000 4096.000 BIT_MASK 0x1fff FORMAT "%8.3" ECU_ADDRESS 0x60013D0C /end MEASUREMENT
/begin MEASUREMENT DINH_nrActvInhReas.FId_VlvLftFbIntkOilPSnsr11SRC "Number of active inhibit reasons for the FIds / Number of active inhibit reasons for FId_VlvLftFbIntkOilPSnsr11SRC" UWORD DINH_ct_Compu 1 100 -4095.000 4096.000 BIT_MASK 0x1fff FORMAT "%8.3" ECU_ADDRESS 0x60013D0E /end MEASUREMENT
/begin MEASUREMENT DINH_nrActvInhReas.FId_VlvLftFbSwtIntk11Diag "Number of active inhibit reasons for the FIds / Number of active inhibit reasons for FId_VlvLftFbSwtIntk11Diag" UWORD DINH_ct_Compu 1 100 -4095.000 4096.000 BIT_MASK 0x1fff FORMAT "%8.3" ECU_ADDRESS 0x60013D10 /end MEASUREMENT
/begin MEASUREMENT DINH_nrActvInhReas.FId_ZGLZSR "Number of active inhibit reasons for the FIds / Number of active inhibit reasons for FId_ZGLZSR" UWORD DINH_ct_Compu 1 100 -4095.000 4096.000 BIT_MASK 0x1fff FORMAT "%8.3" ECU_ADDRESS 0x60013D12 /end MEASUREMENT
/begin MEASUREMENT DINH_nrActvInhReas.FId_airIntkFltSnsrKnkPrtnIgn "Number of active inhibit reasons for the FIds / Number of active inhibit reasons for FId_airIntkFltSnsrKnkPrtnIgn" UWORD DINH_ct_Compu 1 100 -4095.000 4096.000 BIT_MASK 0x1fff FORMAT "%8.3" ECU_ADDRESS 0x60013D14 /end MEASUREMENT
/begin MEASUREMENT DINH_nrActvInhReas.FId_ctrladpncvo "Number of active inhibit reasons for the FIds / Number of active inhibit reasons for FId_ctrladpncvo" UWORD DINH_ct_Compu 1 100 -4095.000 4096.000 BIT_MASK 0x1fff FORMAT "%8.3" ECU_ADDRESS 0x60013D16 /end MEASUREMENT
/begin MEASUREMENT DINH_nrActvInhReas.FId_stChkChgnSys "Number of active inhibit reasons for the FIds / Number of active inhibit reasons for FId_stChkChgnSys" UWORD DINH_ct_Compu 1 100 -4095.000 4096.000 BIT_MASK 0x1fff FORMAT "%8.3" ECU_ADDRESS 0x60013D18 /end MEASUREMENT
/begin MEASUREMENT DINH_nrActvInhReas.FId_stChkChgnSys2DC "Number of active inhibit reasons for the FIds / Number of active inhibit reasons for FId_stChkChgnSys2DC" UWORD DINH_ct_Compu 1 100 -4095.000 4096.000 BIT_MASK 0x1fff FORMAT "%8.3" ECU_ADDRESS 0x60013D1A /end MEASUREMENT
/begin MEASUREMENT DINH_nrActvInhReas.FId_tFltSnsrKnkPrtnIgn "Number of active inhibit reasons for the FIds / Number of active inhibit reasons for FId_tFltSnsrKnkPrtnIgn" UWORD DINH_ct_Compu 1 100 -4095.000 4096.000 BIT_MASK 0x1fff FORMAT "%8.3" ECU_ADDRESS 0x60013D1C /end MEASUREMENT
/begin MEASUREMENT DINH_stClctFId_mp "Collected states of all function identifiers, if the bit is 1 the FId is inhibited" UWORD DFC_OneToOne 1 100 0.00 65535.00 FORMAT "%8.2" ARRAY_SIZE 61 ECU_ADDRESS 0x70009D76 /end MEASUREMENT
/begin MEASUREMENT DINH_stFId.FId_Unused "Inhibit Status of FIds / " UWORD DFC_OneToOne 1 100 0.00 65535.00 FORMAT "%8.2" ECU_ADDRESS 0x6001358C /end MEASUREMENT
/begin MEASUREMENT DINH_stFId.FID_AFRA "Inhibit Status of FIds / Status of function identifier FID_AFRA" UWORD DFC_OneToOne 1 100 0.00 65535.00 FORMAT "%8.2" ECU_ADDRESS 0x6001358E /end MEASUREMENT
/begin MEASUREMENT DINH_stFId.FID_AORA "Inhibit Status of FIds / Status of function identifier FID_AORA" UWORD DFC_OneToOne 1 100 0.00 65535.00 FORMAT "%8.2" ECU_ADDRESS 0x60013590 /end MEASUREMENT
/begin MEASUREMENT DINH_stFId.FID_ATEH "Inhibit Status of FIds / Status of function identifier FID_ATEH" UWORD DFC_OneToOne 1 100 0.00 65535.00 FORMAT "%8.2" ECU_ADDRESS 0x60013592 /end MEASUREMENT
/begin MEASUREMENT DINH_stFId.FID_ATEL "Inhibit Status of FIds / Status of function identifier FID_ATEL" UWORD DFC_OneToOne 1 100 0.00 65535.00 FORMAT "%8.2" ECU_ADDRESS 0x60013594 /end MEASUREMENT
/begin MEASUREMENT DINH_stFId.FID_ATEN "Inhibit Status of FIds / Status of function identifier FID_ATEN" UWORD DFC_OneToOne 1 100 0.00 65535.00 FORMAT "%8.2" ECU_ADDRESS 0x60013596 /end MEASUREMENT
/begin MEASUREMENT DINH_stFId.FID_ATLDI "Inhibit Status of FIds / Status of function identifier FID_ATLDI" UWORD DFC_OneToOne 1 100 0.00 65535.00 FORMAT "%8.2" ECU_ADDRESS 0x60013598 /end MEASUREMENT
/begin MEASUREMENT DINH_stFId.FID_ATLDO "Inhibit Status of FIds / Status of function identifier FID_ATLDO" UWORD DFC_OneToOne 1 100 0.00 65535.00 FORMAT "%8.2" ECU_ADDRESS 0x6001359A /end MEASUREMENT
/begin MEASUREMENT DINH_stFId.FID_BEONV "Inhibit Status of FIds / Status of function identifier FID_BEONV" UWORD DFC_OneToOne 1 100 0.00 65535.00 FORMAT "%8.2" ECU_ADDRESS 0x6001359C /end MEASUREMENT
/begin MEASUREMENT DINH_stFId.FId_EGSDCmnSeg1B1Parl "Inhibit Status of FIds / Status of function identifier FId_EGSDCmnSeg1B1Parl" UWORD DFC_OneToOne 1 100 0.00 65535.00 FORMAT "%8.2" ECU_ADDRESS 0x6001359E /end MEASUREMENT
/begin MEASUREMENT DINH_stFId.FID_BAGRA "Inhibit Status of FIds / Status of function identifier FID_BAGRA" UWORD DFC_OneToOne 1 100 0.00 65535.00 FORMAT "%8.2" ECU_ADDRESS 0x600135A0 /end MEASUREMENT
/begin MEASUREMENT DINH_stFId.FID_BAGRASD "Inhibit Status of FIds / Status of function identifier FID_BAGRASD" UWORD DFC_OneToOne 1 100 0.00 65535.00 FORMAT "%8.2" ECU_ADDRESS 0x600135A2 /end MEASUREMENT
/begin MEASUREMENT DINH_stFId.FID_BDSTOF "Inhibit Status of FIds / Status of function identifier FID_BDSTOF" UWORD DFC_OneToOne 1 100 0.00 65535.00 FORMAT "%8.2" ECU_ADDRESS 0x600135A4 /end MEASUREMENT
/begin MEASUREMENT DINH_stFId.FID_BFVDFRM "Inhibit Status of FIds / Status of function identifier FID_BFVDFRM" UWORD DFC_OneToOne 1 100 0.00 65535.00 FORMAT "%8.2" ECU_ADDRESS 0x600135A6 /end MEASUREMENT
/begin MEASUREMENT DINH_stFId.FID_BHOM "Inhibit Status of FIds / Status of function identifier FID_BHOM" UWORD DFC_OneToOne 1 100 0.00 65535.00 FORMAT "%8.2" ECU_ADDRESS 0x600135A8 /end MEASUREMENT
/begin MEASUREMENT DINH_stFId.FID_BLLRH "Inhibit Status of FIds / Status of function identifier FID_BLLRH" UWORD DFC_OneToOne 1 100 0.00 65535.00 FORMAT "%8.2" ECU_ADDRESS 0x600135AA /end MEASUREMENT
/begin MEASUREMENT DINH_stFId.FID_BLLRKH "Inhibit Status of FIds / Status of function identifier FID_BLLRKH" UWORD DFC_OneToOne 1 100 0.00 65535.00 FORMAT "%8.2" ECU_ADDRESS 0x600135AC /end MEASUREMENT
/begin MEASUREMENT DINH_stFId.FID_BPLSU "Inhibit Status of FIds / Status of function identifier FID_BPLSU" UWORD DFC_OneToOne 1 100 0.00 65535.00 FORMAT "%8.2" ECU_ADDRESS 0x600135AE /end MEASUREMENT
/begin MEASUREMENT DINH_stFId.FID_FRAMBAVMB "Inhibit Status of FIds / Status of function identifier FID_FRAMBAVMB" UWORD DFC_OneToOne 1 100 0.00 65535.00 FORMAT "%8.2" ECU_ADDRESS 0x600135B0 /end MEASUREMENT
/begin MEASUREMENT DINH_stFId.FId_CatHeatgColdStrtReq "Inhibit Status of FIds / Status of function identifier FId_CatHeatgColdStrtReq" UWORD DFC_OneToOne 1 100 0.00 65535.00 FORMAT "%8.2" ECU_ADDRESS 0x600135B2 /end MEASUREMENT
/begin MEASUREMENT DINH_stFId.FId_CatHeatgWrmReq "Inhibit Status of FIds / Status of function identifier FId_CatHeatgWrmReq" UWORD DFC_OneToOne 1 100 0.00 65535.00 FORMAT "%8.2" ECU_ADDRESS 0x600135B4 /end MEASUREMENT
/begin MEASUREMENT DINH_stFId.FId_DSMBDEPHSpOpMode "Inhibit Status of FIds / Status of function identifier FId_DSMBDEPHSpOpMode" UWORD DFC_OneToOne 1 100 0.00 65535.00 FORMAT "%8.2" ECU_ADDRESS 0x600135B6 /end MEASUREMENT
/begin MEASUREMENT DINH_stFId.FId_EGRVlvCoord "Inhibit Status of FIds / Status of function identifier FId_EGRVlvCoord" UWORD DFC_OneToOne 1 100 0.00 65535.00 FORMAT "%8.2" ECU_ADDRESS 0x600135B8 /end MEASUREMENT
/begin MEASUREMENT DINH_stFId.FId_EGSDO2FuTrmB1 "Inhibit Status of FIds / Status of function identifier FId_EGSDO2FuTrmB1" UWORD DFC_OneToOne 1 100 0.00 65535.00 FORMAT "%8.2" ECU_ADDRESS 0x600135BA /end MEASUREMENT
/begin MEASUREMENT DINH_stFId.FId_EGSDO2SnsrMntdRelsS1B1 "Inhibit Status of FIds / Status of function identifier FId_EGSDO2SnsrMntdRelsS1B1" UWORD DFC_OneToOne 1 100 0.00 65535.00 FORMAT "%8.2" ECU_ADDRESS 0x600135BC /end MEASUREMENT
/begin MEASUREMENT DINH_stFId.FId_EGSDO2_LamOffsFastS1B1 "Inhibit Status of FIds / Status of function identifier FId_EGSDO2_LamOffsFastS1B1" UWORD DFC_OneToOne 1 100 0.00 65535.00 FORMAT "%8.2" ECU_ADDRESS 0x600135BE /end MEASUREMENT
/begin MEASUREMENT DINH_stFId.FId_MisfDetDnAdpnNv "Inhibit Status of FIds / Status of function identifier FId_MisfDetDnAdpnNv" UWORD DFC_OneToOne 1 100 0.00 65535.00 FORMAT "%8.2" ECU_ADDRESS 0x600135C0 /end MEASUREMENT
/begin MEASUREMENT DINH_stFId.FId_bascadpncvo "Inhibit Status of FIds / Status of function identifier FId_bascadpncvo" UWORD DFC_OneToOne 1 100 0.00 65535.00 FORMAT "%8.2" ECU_ADDRESS 0x600135C2 /end MEASUREMENT
/begin MEASUREMENT DINH_stFId.FID_AGRS "Inhibit Status of FIds / Status of function identifier FID_AGRS" UWORD DFC_OneToOne 1 100 0.00 65535.00 FORMAT "%8.2" ECU_ADDRESS 0x600135C4 /end MEASUREMENT
/begin MEASUREMENT DINH_stFId.FID_BBAGR "Inhibit Status of FIds / Status of function identifier FID_BBAGR" UWORD DFC_OneToOne 1 100 0.00 65535.00 FORMAT "%8.2" ECU_ADDRESS 0x600135C6 /end MEASUREMENT
/begin MEASUREMENT DINH_stFId.FID_BBAGRA "Inhibit Status of FIds / Status of function identifier FID_BBAGRA" UWORD DFC_OneToOne 1 100 0.00 65535.00 FORMAT "%8.2" ECU_ADDRESS 0x600135C8 /end MEASUREMENT
/begin MEASUREMENT DINH_stFId.FID_BGFKMS "Inhibit Status of FIds / Status of function identifier FID_BGFKMS" UWORD DFC_OneToOne 1 100 0.00 65535.00 FORMAT "%8.2" ECU_ADDRESS 0x600135CA /end MEASUREMENT
/begin MEASUREMENT DINH_stFId.FID_BGMSDKS "Inhibit Status of FIds / Status of function identifier FID_BGMSDKS" UWORD DFC_OneToOne 1 100 0.00 65535.00 FORMAT "%8.2" ECU_ADDRESS 0x600135CC /end MEASUREMENT
/begin MEASUREMENT DINH_stFId.FID_CAGRSUS "Inhibit Status of FIds / Status of function identifier FID_CAGRSUS" UWORD DFC_OneToOne 1 100 0.00 65535.00 FORMAT "%8.2" ECU_ADDRESS 0x600135CE /end MEASUREMENT
/begin MEASUREMENT DINH_stFId.FID_CBGTFUELM "Inhibit Status of FIds / Status of function identifier FID_CBGTFUELM" UWORD DFC_OneToOne 1 100 0.00 65535.00 FORMAT "%8.2" ECU_ADDRESS 0x600135D0 /end MEASUREMENT
/begin MEASUREMENT DINH_stFId.FID_CBGTHDEV "Inhibit Status of FIds / Status of function identifier FID_CBGTHDEV" UWORD DFC_OneToOne 1 100 0.00 65535.00 FORMAT "%8.2" ECU_ADDRESS 0x600135D2 /end MEASUREMENT
/begin MEASUREMENT DINH_stFId.FID_CDESVF "Inhibit Status of FIds / Status of function identifier FID_CDESVF" UWORD DFC_OneToOne 1 100 0.00 65535.00 FORMAT "%8.2" ECU_ADDRESS 0x600135D4 /end MEASUREMENT
/begin MEASUREMENT DINH_stFId.FID_CDETHS "Inhibit Status of FIds / Status of function identifier FID_CDETHS" UWORD DFC_OneToOne 1 100 0.00 65535.00 FORMAT "%8.2" ECU_ADDRESS 0x600135D6 /end MEASUREMENT
/begin MEASUREMENT DINH_stFId.FID_CDRCTSTRT "Inhibit Status of FIds / Status of function identifier FID_CDRCTSTRT" UWORD DFC_OneToOne 1 100 0.00 65535.00 FORMAT "%8.2" ECU_ADDRESS 0x600135D8 /end MEASUREMENT
/begin MEASUREMENT DINH_stFId.FID_CDSKV "Inhibit Status of FIds / Status of function identifier FID_CDSKV" UWORD DFC_OneToOne 1 100 0.00 65535.00 FORMAT "%8.2" ECU_ADDRESS 0x600135DA /end MEASUREMENT
/begin MEASUREMENT DINH_stFId.FID_CDSKVRNO "Inhibit Status of FIds / Status of function identifier FID_CDSKVRNO" UWORD DFC_OneToOne 1 100 0.00 65535.00 FORMAT "%8.2" ECU_ADDRESS 0x600135DC /end MEASUREMENT
/begin MEASUREMENT DINH_stFId.FID_CDSKVRPO "Inhibit Status of FIds / Status of function identifier FID_CDSKVRPO" UWORD DFC_OneToOne 1 100 0.00 65535.00 FORMAT "%8.2" ECU_ADDRESS 0x600135DE /end MEASUREMENT
/begin MEASUREMENT DINH_stFId.FID_CDSKVRaty "Inhibit Status of FIds / Status of function identifier FID_CDSKVRaty" UWORD DFC_OneToOne 1 100 0.00 65535.00 FORMAT "%8.2" ECU_ADDRESS 0x600135E0 /end MEASUREMENT
/begin MEASUREMENT DINH_stFId.FID_CDSKVRng "Inhibit Status of FIds / Status of function identifier FID_CDSKVRng" UWORD DFC_OneToOne 1 100 0.00 65535.00 FORMAT "%8.2" ECU_ADDRESS 0x600135E2 /end MEASUREMENT
/begin MEASUREMENT DINH_stFId.FID_CDSKVS "Inhibit Status of FIds / Status of function identifier FID_CDSKVS" UWORD DFC_OneToOne 1 100 0.00 65535.00 FORMAT "%8.2" ECU_ADDRESS 0x600135E4 /end MEASUREMENT
/begin MEASUREMENT DINH_stFId.FID_CDSTR "Inhibit Status of FIds / Status of function identifier FID_CDSTR" UWORD DFC_OneToOne 1 100 0.00 65535.00 FORMAT "%8.2" ECU_ADDRESS 0x600135E6 /end MEASUREMENT
/begin MEASUREMENT DINH_stFId.FID_CDSTTI "Inhibit Status of FIds / Status of function identifier FID_CDSTTI" UWORD DFC_OneToOne 1 100 0.00 65535.00 FORMAT "%8.2" ECU_ADDRESS 0x600135E8 /end MEASUREMENT
/begin MEASUREMENT DINH_stFId.FID_CETHG "Inhibit Status of FIds / Status of function identifier FID_CETHG" UWORD DFC_OneToOne 1 100 0.00 65535.00 FORMAT "%8.2" ECU_ADDRESS 0x600135EA /end MEASUREMENT
/begin MEASUREMENT DINH_stFId.FID_CETHSPLnpl "Inhibit Status of FIds / Status of function identifier FID_CETHSPLnpl" UWORD DFC_OneToOne 1 100 0.00 65535.00 FORMAT "%8.2" ECU_ADDRESS 0x600135EC /end MEASUREMENT
/begin MEASUREMENT DINH_stFId.FID_CETHSTPLnpl "Inhibit Status of FIds / Status of function identifier FID_CETHSTPLnpl" UWORD DFC_OneToOne 1 100 0.00 65535.00 FORMAT "%8.2" ECU_ADDRESS 0x600135EE /end MEASUREMENT
/begin MEASUREMENT DINH_stFId.FID_CETKHL "Inhibit Status of FIds / Status of function identifier FID_CETKHL" UWORD DFC_OneToOne 1 100 0.00 65535.00 FORMAT "%8.2" ECU_ADDRESS 0x600135F0 /end MEASUREMENT
/begin MEASUREMENT DINH_stFId.FID_CETKHT "Inhibit Status of FIds / Status of function identifier FID_CETKHT" UWORD DFC_OneToOne 1 100 0.00 65535.00 FORMAT "%8.2" ECU_ADDRESS 0x600135F2 /end MEASUREMENT
/begin MEASUREMENT DINH_stFId.FID_CGDISTRT "Inhibit Status of FIds / Status of function identifier FID_CGDISTRT" UWORD DFC_OneToOne 1 100 0.00 65535.00 FORMAT "%8.2" ECU_ADDRESS 0x600135F4 /end MEASUREMENT
/begin MEASUREMENT DINH_stFId.FID_CGLSRDP "Inhibit Status of FIds / Status of function identifier FID_CGLSRDP" UWORD DFC_OneToOne 1 100 0.00 65535.00 FORMAT "%8.2" ECU_ADDRESS 0x600135F6 /end MEASUREMENT
/begin MEASUREMENT DINH_stFId.FID_CHDR "Inhibit Status of FIds / Status of function identifier FID_CHDR" UWORD DFC_OneToOne 1 100 0.00 65535.00 FORMAT "%8.2" ECU_ADDRESS 0x600135F8 /end MEASUREMENT
/begin MEASUREMENT DINH_stFId.FID_CHDRKH "Inhibit Status of FIds / Status of function identifier FID_CHDRKH" UWORD DFC_OneToOne 1 100 0.00 65535.00 FORMAT "%8.2" ECU_ADDRESS 0x600135FA /end MEASUREMENT
/begin MEASUREMENT DINH_stFId.FID_CHDRPL "Inhibit Status of FIds / Status of function identifier FID_CHDRPL" UWORD DFC_OneToOne 1 100 0.00 65535.00 FORMAT "%8.2" ECU_ADDRESS 0x600135FC /end MEASUREMENT
/begin MEASUREMENT DINH_stFId.FID_CLLKHV "Inhibit Status of FIds / Status of function identifier FID_CLLKHV" UWORD DFC_OneToOne 1 100 0.00 65535.00 FORMAT "%8.2" ECU_ADDRESS 0x600135FE /end MEASUREMENT
/begin MEASUREMENT DINH_stFId.FID_CLLRHV "Inhibit Status of FIds / Status of function identifier FID_CLLRHV" UWORD DFC_OneToOne 1 100 0.00 65535.00 FORMAT "%8.2" ECU_ADDRESS 0x60013600 /end MEASUREMENT
/begin MEASUREMENT DINH_stFId.FID_CLZSRDP "Inhibit Status of FIds / Status of function identifier FID_CLZSRDP" UWORD DFC_OneToOne 1 100 0.00 65535.00 FORMAT "%8.2" ECU_ADDRESS 0x60013602 /end MEASUREMENT
/begin MEASUREMENT DINH_stFId.FID_CLZSRHP "Inhibit Status of FIds / Status of function identifier FID_CLZSRHP" UWORD DFC_OneToOne 1 100 0.00 65535.00 FORMAT "%8.2" ECU_ADDRESS 0x60013604 /end MEASUREMENT
/begin MEASUREMENT DINH_stFId.FID_CNLHP "Inhibit Status of FIds / Status of function identifier FID_CNLHP" UWORD DFC_OneToOne 1 100 0.00 65535.00 FORMAT "%8.2" ECU_ADDRESS 0x60013606 /end MEASUREMENT
/begin MEASUREMENT DINH_stFId.FID_CNLHP2 "Inhibit Status of FIds / Status of function identifier FID_CNLHP2" UWORD DFC_OneToOne 1 100 0.00 65535.00 FORMAT "%8.2" ECU_ADDRESS 0x60013608 /end MEASUREMENT
/begin MEASUREMENT DINH_stFId.FID_CNLKO2 "Inhibit Status of FIds / Status of function identifier FID_CNLKO2" UWORD DFC_OneToOne 1 100 0.00 65535.00 FORMAT "%8.2" ECU_ADDRESS 0x6001360A /end MEASUREMENT
/begin MEASUREMENT DINH_stFId.FID_CNLKO3 "Inhibit Status of FIds / Status of function identifier FID_CNLKO3" UWORD DFC_OneToOne 1 100 0.00 65535.00 FORMAT "%8.2" ECU_ADDRESS 0x6001360C /end MEASUREMENT
/begin MEASUREMENT DINH_stFId.FID_CNLLP "Inhibit Status of FIds / Status of function identifier FID_CNLLP" UWORD DFC_OneToOne 1 100 0.00 65535.00 FORMAT "%8.2" ECU_ADDRESS 0x6001360E /end MEASUREMENT
/begin MEASUREMENT DINH_stFId.FID_CNLPL "Inhibit Status of FIds / Status of function identifier FID_CNLPL" UWORD DFC_OneToOne 1 100 0.00 65535.00 FORMAT "%8.2" ECU_ADDRESS 0x60013610 /end MEASUREMENT
/begin MEASUREMENT DINH_stFId.FID_CNLPS "Inhibit Status of FIds / Status of function identifier FID_CNLPS" UWORD DFC_OneToOne 1 100 0.00 65535.00 FORMAT "%8.2" ECU_ADDRESS 0x60013612 /end MEASUREMENT
/begin MEASUREMENT DINH_stFId.FID_CNSAD "Inhibit Status of FIds / Status of function identifier FID_CNSAD" UWORD DFC_OneToOne 1 100 0.00 65535.00 FORMAT "%8.2" ECU_ADDRESS 0x60013614 /end MEASUREMENT
/begin MEASUREMENT DINH_stFId.FID_CNSAD2 "Inhibit Status of FIds / Status of function identifier FID_CNSAD2" UWORD DFC_OneToOne 1 100 0.00 65535.00 FORMAT "%8.2" ECU_ADDRESS 0x60013616 /end MEASUREMENT
/begin MEASUREMENT DINH_stFId.FID_CPSRB "Inhibit Status of FIds / Status of function identifier FID_CPSRB" UWORD DFC_OneToOne 1 100 0.00 65535.00 FORMAT "%8.2" ECU_ADDRESS 0x60013618 /end MEASUREMENT
/begin MEASUREMENT DINH_stFId.FID_CPSRP "Inhibit Status of FIds / Status of function identifier FID_CPSRP" UWORD DFC_OneToOne 1 100 0.00 65535.00 FORMAT "%8.2" ECU_ADDRESS 0x6001361A /end MEASUREMENT
/begin MEASUREMENT DINH_stFId.FID_CSTHDR "Inhibit Status of FIds / Status of function identifier FID_CSTHDR" UWORD DFC_OneToOne 1 100 0.00 65535.00 FORMAT "%8.2" ECU_ADDRESS 0x6001361C /end MEASUREMENT
/begin MEASUREMENT DINH_stFId.FID_CSTRTCTL "Inhibit Status of FIds / Status of function identifier FID_CSTRTCTL" UWORD DFC_OneToOne 1 100 0.00 65535.00 FORMAT "%8.2" ECU_ADDRESS 0x6001361E /end MEASUREMENT
/begin MEASUREMENT DINH_stFId.FID_CTESF "Inhibit Status of FIds / Status of function identifier FID_CTESF" UWORD DFC_OneToOne 1 100 0.00 65535.00 FORMAT "%8.2" ECU_ADDRESS 0x60013620 /end MEASUREMENT
/begin MEASUREMENT DINH_stFId.FID_CTESG "Inhibit Status of FIds / Status of function identifier FID_CTESG" UWORD DFC_OneToOne 1 100 0.00 65535.00 FORMAT "%8.2" ECU_ADDRESS 0x60013622 /end MEASUREMENT
/begin MEASUREMENT DINH_stFId.FID_CTHIPSTRT "Inhibit Status of FIds / Status of function identifier FID_CTHIPSTRT" UWORD DFC_OneToOne 1 100 0.00 65535.00 FORMAT "%8.2" ECU_ADDRESS 0x60013624 /end MEASUREMENT
/begin MEASUREMENT DINH_stFId.FID_CTKACS "Inhibit Status of FIds / Status of function identifier FID_CTKACS" UWORD DFC_OneToOne 1 100 0.00 65535.00 FORMAT "%8.2" ECU_ADDRESS 0x60013626 /end MEASUREMENT
/begin MEASUREMENT DINH_stFId.FID_CTMSV "Inhibit Status of FIds / Status of function identifier FID_CTMSV" UWORD DFC_OneToOne 1 100 0.00 65535.00 FORMAT "%8.2" ECU_ADDRESS 0x60013628 /end MEASUREMENT
/begin MEASUREMENT DINH_stFId.FID_CTOSP "Inhibit Status of FIds / Status of function identifier FID_CTOSP" UWORD DFC_OneToOne 1 100 0.00 65535.00 FORMAT "%8.2" ECU_ADDRESS 0x6001362A /end MEASUREMENT
/begin MEASUREMENT DINH_stFId.FID_DHFERR "Inhibit Status of FIds / Status of function identifier FID_DHFERR" UWORD DFC_OneToOne 1 100 0.00 65535.00 FORMAT "%8.2" ECU_ADDRESS 0x6001362C /end MEASUREMENT
/begin MEASUREMENT DINH_stFId.FID_DKRSA "Inhibit Status of FIds / Status of function identifier FID_DKRSA" UWORD DFC_OneToOne 1 100 0.00 65535.00 FORMAT "%8.2" ECU_ADDRESS 0x6001362E /end MEASUREMENT
/begin MEASUREMENT DINH_stFId.FID_DLLRBandEndTst "Inhibit Status of FIds / Status of function identifier FID_DLLRBandEndTst" UWORD DFC_OneToOne 1 100 0.00 65535.00 FORMAT "%8.2" ECU_ADDRESS 0x60013630 /end MEASUREMENT
/begin MEASUREMENT DINH_stFId.FID_DLLRShrtTrpSpdRmp "Inhibit Status of FIds / Status of function identifier FID_DLLRShrtTrpSpdRmp" UWORD DFC_OneToOne 1 100 0.00 65535.00 FORMAT "%8.2" ECU_ADDRESS 0x60013632 /end MEASUREMENT
/begin MEASUREMENT DINH_stFId.FID_FEDKAHB "Inhibit Status of FIds / Status of function identifier FID_FEDKAHB" UWORD DFC_OneToOne 1 100 0.00 65535.00 FORMAT "%8.2" ECU_ADDRESS 0x60013634 /end MEASUREMENT
/begin MEASUREMENT DINH_stFId.FID_FEDKAPB "Inhibit Status of FIds / Status of function identifier FID_FEDKAPB" UWORD DFC_OneToOne 1 100 0.00 65535.00 FORMAT "%8.2" ECU_ADDRESS 0x60013636 /end MEASUREMENT
/begin MEASUREMENT DINH_stFId.FID_FEDSSB "Inhibit Status of FIds / Status of function identifier FID_FEDSSB" UWORD DFC_OneToOne 1 100 0.00 65535.00 FORMAT "%8.2" ECU_ADDRESS 0x60013638 /end MEASUREMENT
/begin MEASUREMENT DINH_stFId.FID_FOFSTP "Inhibit Status of FIds / Status of function identifier FID_FOFSTP" UWORD DFC_OneToOne 1 100 0.00 65535.00 FORMAT "%8.2" ECU_ADDRESS 0x6001363A /end MEASUREMENT
/begin MEASUREMENT DINH_stFId.FID_FONSTP "Inhibit Status of FIds / Status of function identifier FID_FONSTP" UWORD DFC_OneToOne 1 100 0.00 65535.00 FORMAT "%8.2" ECU_ADDRESS 0x6001363C /end MEASUREMENT
/begin MEASUREMENT DINH_stFId.FID_FUEDK "Inhibit Status of FIds / Status of function identifier FID_FUEDK" UWORD DFC_OneToOne 1 100 0.00 65535.00 FORMAT "%8.2" ECU_ADDRESS 0x6001363E /end MEASUREMENT
/begin MEASUREMENT DINH_stFId.FID_FVLRA "Inhibit Status of FIds / Status of function identifier FID_FVLRA" UWORD DFC_OneToOne 1 100 0.00 65535.00 FORMAT "%8.2" ECU_ADDRESS 0x60013640 /end MEASUREMENT
/begin MEASUREMENT DINH_stFId.FID_KRREGact "Inhibit Status of FIds / Status of function identifier FID_KRREGact" UWORD DFC_OneToOne 1 100 0.00 65535.00 FORMAT "%8.2" ECU_ADDRESS 0x60013642 /end MEASUREMENT
/begin FUNCTION DINH "30000.27.0_1.0.0Diagnostic Inhibit Handler"
 /begin LOC_MEASUREMENT DINH_nrActvInhReas.FId_ComPBSensFail DINH_nrActvInhReas.FId_ComPCU DINH_nrActvInhReas.FId_ComPCUMon DINH_nrActvInhReas.FId_ComPosActnSpdLimrFctReq DINH_nrActvInhReas.FId_ComSRS DINH_nrActvInhReas.FId_ComSRSA DINH_nrActvInhReas.FId_ComSRSAMon DINH_nrActvInhReas.FId_ComSRSB DINH_nrActvInhReas.FId_ComSRSBMon DINH_nrActvInhReas.FId_ComSRSMon DINH_nrActvInhReas.FId_ComSRSUnitCfmdErr DINH_nrActvInhReas.FId_ComSRSUnitNotTstd DINH_nrActvInhReas.FId_ComSTFlt DINH_nrActvInhReas.FId_ComSpdLimrDevActvn DINH_nrActvInhReas.FId_ComTCU01 DINH_nrActvInhReas.FId_ComTCU02 DINH_nrActvInhReas.FId_ComTCU1 DINH_nrActvInhReas.FId_ComTCU11 DINH_nrActvInhReas.FId_ComTCU12 DINH_nrActvInhReas.FId_ComTCU13 DINH_nrActvInhReas.FId_ComTCU14 DINH_nrActvInhReas.FId_ComTCU2 DINH_nrActvInhReas.FId_ComTCU3 DINH_nrActvInhReas.FId_ComTCU4 DINH_nrActvInhReas.FId_ComTCUGear DINH_nrActvInhReas.FId_ComTarGearDwnShift DINH_nrActvInhReas.FId_ComTarGearUpShift DINH_nrActvInhReas.FId_ComThrPosnFail DINH_nrActvInhReas.FId_ComThrVlv DINH_nrActvInhReas.FId_ComTrboChrgnErr DINH_nrActvInhReas.FId_ComTrqAccuracySlow DINH_nrActvInhReas.FId_ComTrqReqFast DINH_nrActvInhReas.FId_ComTrqReqSlow DINH_nrActvInhReas.FId_ComVSAErr DINH_nrActvInhReas.FId_ComVSAUnitCfmdErr DINH_nrActvInhReas.FId_ComVSAUnitNotTstd DINH_nrActvInhReas.FId_ComVehSpdFlLvl DINH_nrActvInhReas.FId_ComVehSpdFltChk DINH_nrActvInhReas.FId_ComVehSpdImpsErr DINH_nrActvInhReas.FId_ComVlvLftCtrl DINH_nrActvInhReas.FId_ComvolEng DINH_nrActvInhReas.FId_ConvLdCalcLvrPos DINH_nrActvInhReas.FId_ConvLdNTrbnCan DINH_nrActvInhReas.FId_ConvLdOilCoolrPmp DINH_nrActvInhReas.FId_ConvLdOilTemp DINH_nrActvInhReas.FId_ConvLdTrqLdCan DINH_nrActvInhReas.FId_ConvLdVel DINH_nrActvInhReas.FId_CooltTVldyTMdl DINH_nrActvInhReas.FId_CptProtnCamsft DINH_nrActvInhReas.FId_CptProtnExhTempMdl DINH_nrActvInhReas.FId_CptProtnO2SnsrB1 DINH_nrActvInhReas.FId_CptProtnVVeh DINH_nrActvInhReas.FId_CrCUI1EFRxErr DINH_nrActvInhReas.FId_CrCUICANRxErr DINH_nrActvInhReas.FId_CrCUIFCMRxErr DINH_nrActvInhReas.FId_CrCUIMETDRxErr DINH_nrActvInhReas.FId_CrCtlACCRxErr DINH_nrActvInhReas.FId_CrCtlAppSnsrErr DINH_nrActvInhReas.FId_CrCtlShutOffEng DINH_nrActvInhReas.FId_CstrPurgGnrlTstrReq DINH_nrActvInhReas.FId_DAGRS DINH_nrActvInhReas.FId_DELibBrkBstP DINH_nrActvInhReas.FId_DELibCEngDsT DINH_nrActvInhReas.FId_DELibCEngUsT DINH_nrActvInhReas.FId_DELibEngDatEng DINH_nrActvInhReas.FId_DELibEnvP DINH_nrActvInhReas.FId_DELibEnvT DINH_nrActvInhReas.FId_DELibFuelT DINH_nrActvInhReas.FId_DELibIntkAirT DINH_nrActvInhReas.FId_DELibNRCat DINH_nrActvInhReas.FId_DELibOilP DINH_nrActvInhReas.FId_DELibOilSwmpT DINH_nrActvInhReas.FId_DELibPRelPfilDs DINH_nrActvInhReas.FId_DELibTEGRClrLPDs DINH_nrActvInhReas.FId_DEONVEBPEnv DINH_nrActvInhReas.FId_DEONVTCCpv1DteskLoLoadStuckClsd DINH_nrActvInhReas.FId_DEONVTCCpv1DteskLoLoadStuckOpen DINH_nrActvInhReas.FId_DIUMPRCldStrtMon DINH_nrActvInhReas.FId_DIUMPREvapMon DINH_nrActvInhReas.FId_DIUMPRGenDenom1 DINH_nrActvInhReas.FId_DIUMPRGenDenom1PDTC DINH_nrActvInhReas.FId_DIUMPRGenDenom2 DINH_nrActvInhReas.FId_DIUMPRGenDenom3 DINH_nrActvInhReas.FId_DIUMPRIgn DINH_nrActvInhReas.FId_DOGov DINH_nrActvInhReas.FId_DSMWarmUpCycle DINH_nrActvInhReas.FId_DTESKEBCpv1DteskLoLoadStuckClsd DINH_nrActvInhReas.FId_DTESKEBCpv1DteskLoLoadStuckOpen DINH_nrActvInhReas.FId_DTESKEnvCondVld DINH_nrActvInhReas.FId_DTESKFuLvlCondVld DINH_nrActvInhReas.FId_DTESKvfz DINH_nrActvInhReas.FId_DdskvFraTstd DINH_nrActvInhReas.FId_DdskvOraTstd DINH_nrActvInhReas.FId_DewDetTKAMax DINH_nrActvInhReas.FId_DiagBlkdLine DINH_nrActvInhReas.FId_DiagCpv1DteskLoLoad DINH_nrActvInhReas.FId_DkrsaEpmNoSig DINH_nrActvInhReas.FId_EBBCANErrFrzVal DINH_nrActvInhReas.FId_EBBCANErrReplVal DINH_nrActvInhReas.FId_EGLZSR DINH_nrActvInhReas.FId_EGRVlvActrOff DINH_nrActvInhReas.FId_EGRVlvCldStrt DINH_nrActvInhReas.FId_EGRVlvClnVrfy DINH_nrActvInhReas.FId_EGRVlvCtrlErr DINH_nrActvInhReas.FId_EGRVlvEngTempDef DINH_nrActvInhReas.FId_EGRVlvFailSafeActv DINH_nrActvInhReas.FId_EGRVlvFrzVal DINH_nrActvInhReas.FId_EGRVlvGovOn DINH_nrActvInhReas.FId_EGRVlvGovOnCld DINH_nrActvInhReas.FId_EGRVlvGovrOnRelsFct DINH_nrActvInhReas.FId_EGRVlvILimn DINH_nrActvInhReas.FId_EGRVlvIni DINH_nrActvInhReas.FId_EGRVlvMon DINH_nrActvInhReas.FId_EGRVlvOfsLrnInhib DINH_nrActvInhReas.FId_EGRVlvPhysRng DINH_nrActvInhReas.FId_EGRVlvPsSwtOff DINH_nrActvInhReas.FId_EGRVlvPwrStgMonDis DINH_nrActvInhReas.FId_EGRVlvRplVal DINH_nrActvInhReas.FId_EGRVlvSSpMon DINH_nrActvInhReas.FId_EGRVlvSnsrErr DINH_nrActvInhReas.FId_EGRVlvTempCmp DINH_nrActvInhReas.FId_EGRVlvTempMdlEEPErr DINH_nrActvInhReas.FId_EGRVlvTmpErrCnt DINH_nrActvInhReas.FId_EGRVlvTrlPtr DINH_nrActvInhReas.FId_EGRVlv_VehvErr DINH_nrActvInhReas.FId_EGRVlviActIEfcLimn DINH_nrActvInhReas.FId_EGRVlvpDsbcInvld DINH_nrActvInhReas.FId_EGSDO2OffsRstDsmS1B1 DINH_nrActvInhReas.FId_EGSDO2_LamOffsSlowS1 DINH_nrActvInhReas.FId_EGSDO2_RstFltSuspcnOffsB1 DINH_nrActvInhReas.FId_EGSDUS2B1DlyEvln DINH_nrActvInhReas.FId_EGSDUS2B1LtrDly DINH_nrActvInhReas.FId_EGSDUS2B1LtrPT1 DINH_nrActvInhReas.FId_EGSDUS2B1PT1Evln DINH_nrActvInhReas.FId_EGSDUS2B1RtlDly DINH_nrActvInhReas.FId_EGSDUS2B1RtlPT1 DINH_nrActvInhReas.FId_EGSDUS2B1TarEvln DINH_nrActvInhReas.FId_EGSDUS2B1TarLean DINH_nrActvInhReas.FId_EGSDUS2B1TarRich DINH_nrActvInhReas.FId_EGSSigO2S1B1 DINH_nrActvInhReas.FId_ELZSR DINH_nrActvInhReas.FId_EPBErr DINH_nrActvInhReas.FId_EPBFrmErr DINH_nrActvInhReas.FId_EPBFrmErrClth DINH_nrActvInhReas.FId_ETHSCPErrDrvCyc DINH_nrActvInhReas.FId_EVPComFailr DINH_nrActvInhReas.FId_EbsLinErr DINH_nrActvInhReas.FId_ElecLdComErr DINH_nrActvInhReas.FId_ElecLdFrzVal DINH_nrActvInhReas.FId_ElecLdHdLiComErr DINH_nrActvInhReas.FId_ElecLdRplVal DINH_nrActvInhReas.FId_ElecLoadEPSComErr DINH_nrActvInhReas.FId_EngBlkTWrn DINH_nrActvInhReas.FId_EngCooltTFail DINH_nrActvInhReas.FId_EngDemTqLimnCamsftErr DINH_nrActvInhReas.FId_EngDemTqLimnErrThmstHeatCtrlCirc DINH_nrActvInhReas.FId_EngDemTqLimnOilPmp DINH_nrActvInhReas.FId_EngDemTrqLimErrAPP DINH_nrActvInhReas.FId_EngIntkAirFail DINH_nrActvInhReas.FId_EngPrtErrVehV DINH_nrActvInhReas.FId_EngSpd30DegFail DINH_nrActvInhReas.FId_EngStrtEnaEthAdap DINH_nrActvInhReas.FId_EngStrt_EnaCep DINH_nrActvInhReas.FId_EngStrt_InjProhb DINH_nrActvInhReas.FId_EngStrt_VehVInhb DINH_nrActvInhReas.FId_EngTqRvsnEnaFlg DINH_nrActvInhReas.FId_EnvTPrimMod DINH_nrActvInhReas.FId_EnvTPrimModIniVal DINH_nrActvInhReas.FId_EnvTSensSum DINH_nrActvInhReas.FId_EnvTtAirFltDs DINH_nrActvInhReas.FId_EnvTtCEngDsT DINH_nrActvInhReas.FId_EnvTtIntkMnfld DINH_nrActvInhReas.FId_EomCvoAllwd DINH_nrActvInhReas.FId_EpmBCr DINH_nrActvInhReas.FId_EpmCaSAdapCaSI1 DINH_nrActvInhReas.FId_EpmCaSAdapRstI1 DINH_nrActvInhReas.FId_EpmCaSDiagI1 DINH_nrActvInhReas.FId_EpmCaSErrCaSI1 DINH_nrActvInhReas.FId_EpmCaSOfsDiagCaSI1 DINH_nrActvInhReas.FId_EpmCaSOfsErrCaSI1 DINH_nrActvInhReas.FId_EpmCaSSegI1 DINH_nrActvInhReas.FId_EpmCaSSpdPlausI1 DINH_nrActvInhReas.FId_EpmCrSDiag DINH_nrActvInhReas.FId_EpmCrSDiagVeh DINH_nrActvInhReas.FId_EpmCrSErr DINH_nrActvInhReas.FId_EpmOpMode_ALELock DINH_nrActvInhReas.FId_EpmOpMode_DirStLock DINH_nrActvInhReas.FId_EpmRRSCrSFaultCheck DINH_nrActvInhReas.FId_EpmRRSDGIFaultCheck DINH_nrActvInhReas.FId_EpmRRSRdCheck DINH_nrActvInhReas.FId_EpmRRSVehVFaultChck DINH_nrActvInhReas.FId_EpmSynLockCaSSync DINH_nrActvInhReas.FId_EpmTmpSuppRvsRotCASI1 DINH_nrActvInhReas.FId_EtaEngIdleNonCsers DINH_nrActvInhReas.FId_EtaEngPtlNonCsers DINH_nrActvInhReas.FId_EthnlSnsrErrCdn DINH_nrActvInhReas.FId_EvapActrCcvElecDiag DINH_nrActvInhReas.FId_EvapPSnsrTankPhyRngChk DINH_nrActvInhReas.FId_FanCtlACClntP DINH_nrActvInhReas.FId_FanCtlACGModFail DINH_nrActvInhReas.FId_FanCtlAPP1 DINH_nrActvInhReas.FId_FanCtlAPP2 DINH_nrActvInhReas.FId_FanCtlAPPSync DINH_nrActvInhReas.FId_FanCtlBlowrU DINH_nrActvInhReas.FId_FanCtlCooltT DINH_nrActvInhReas.FId_FanCtlCooltT2 DINH_nrActvInhReas.FId_FanCtlEnvT DINH_nrActvInhReas.FId_FanCtlLiSwtInfo DINH_nrActvInhReas.FId_FanCtlSpd DINH_nrActvInhReas.FId_FanCtlTSnsrErr DINH_nrActvInhReas.FId_FanCtlThr1 DINH_nrActvInhReas.FId_FanCtlThr2 DINH_nrActvInhReas.FId_FcoReq DINH_nrActvInhReas.FId_FiMFID_rba_MRly_Diag_Stk DINH_nrActvInhReas.FId_FlComErr DINH_nrActvInhReas.FId_FlDevPlauDiagFuSnsr DINH_nrActvInhReas.FId_FlLvlNoSigErr DINH_nrActvInhReas.FId_FlLvlVehSpdSigErr DINH_nrActvInhReas.FId_FlLvlVehVErr DINH_nrActvInhReas.FId_FlMALamDynDiag DINH_nrActvInhReas.FId_FlSplGAltLin DINH_nrActvInhReas.FId_FlTnkQnt DINH_nrActvInhReas.FId_FuMixHotFilmErr DINH_nrActvInhReas.FId_FuMixUegoErrExcl DINH_nrActvInhReas.FId_FuPHiRailEthnlSnsrErr DINH_nrActvInhReas.FId_FuPurg_TEVError DINH_nrActvInhReas.FId_FuSnsrPhyRngErr DINH_nrActvInhReas.FId_GEVCtlAVCAdprCBBNWEErrIntk DINH_nrActvInhReas.FId_GEVCtlAVCAdprIntkB1 DINH_nrActvInhReas.FId_GEVCtlAVCAdprNWSEErrIntk DINH_nrActvInhReas.FId_GEVCtlAdpnEnaIntk DINH_nrActvInhReas.FId_GEVCtlAdpnEnaShtrpActv DINH_nrActvInhReas.FId_GEVCtlClngIntk DINH_nrActvInhReas.FId_GEVCtlMinOvlIntk DINH_nrActvInhReas.FId_GEVCtlPOilSnsr DINH_nrActvInhReas.FId_GEVCtlPhaEnaIntk DINH_nrActvInhReas.FId_GEVCtlPhaSpTstrIntk DINH_nrActvInhReas.FId_GEVCtlRefAdpnMntChck DINH_nrActvInhReas.FId_GEVCtlRefAdpnMntChckTstd DINH_nrActvInhReas.FId_GEVCtlReqRefAdpnTstrIntk DINH_nrActvInhReas.FId_GEVCtlReqRefAdpnTstrIntkTstd DINH_nrActvInhReas.FId_GEVCtlVlvLftEnaIntk DINH_nrActvInhReas.FId_GEVCtlVlvOpenClsdIntkB1 DINH_nrActvInhReas.FId_GEVlvLockPinDiagIntkB1 DINH_nrActvInhReas.FId_GEVlvPhaDiagEnaCsersIntkB1 DINH_nrActvInhReas.FId_GEVlvPhaDiagEnaIntkB1 DINH_nrActvInhReas.FId_GEVlvPhaPsIntkB1 DINH_nrActvInhReas.FId_GbxAnNeutPosnErr DINH_nrActvInhReas.FId_GbxCANDigPlausErr DINH_nrActvInhReas.FId_GbxCANNeutSigErr DINH_nrActvInhReas.FId_GbxPNPosSig DINH_nrActvInhReas.FId_GbxPNPosnComErr DINH_nrActvInhReas.FId_GbxPNPosnDiagDrvCdnRels DINH_nrActvInhReas.FId_GbxPNPosnDiagDrvCodnHealRels DINH_nrActvInhReas.FId_GbxPNPosnDiagPlausyRels DINH_nrActvInhReas.FId_GbxPNPosnSubsVal DINH_nrActvInhReas.FId_GbxRvsSwtStk DINH_nrActvInhReas.FId_GbxSnsrSplyUErr DINH_nrActvInhReas.FId_GbxSpstReqOk DINH_nrActvInhReas.FId_GlbDaLSumvXPtd DINH_nrActvInhReas.FId_GslThrVlvSnsrDiagB1 DINH_nrActvInhReas.FId_HEGOS2B1DElec DINH_nrActvInhReas.FId_HEGOS2B1DHtg DINH_nrActvInhReas.FId_HEGOS2B1Htg DINH_nrActvInhReas.FId_HEGOS2B1HtrPsSt DINH_nrActvInhReas.FId_HEGOS2B1InVld DINH_nrActvInhReas.FId_HEGOS2B1LSPsDiaDi DINH_nrActvInhReas.FId_HLSDemBrkFlt DINH_nrActvInhReas.FId_HLSDemErr1 DINH_nrActvInhReas.FId_HLSDemErr2 DINH_nrActvInhReas.FId_HLSDemIntkAirTemp DINH_nrActvInhReas.FId_HLSDemMotTemp DINH_nrActvInhReas.FId_HLSDemMstCyldpVld DINH_nrActvInhReas.FId_HLSDemSpdClthGearAccrSigErr DINH_nrActvInhReas.FId_HLSDem_DrvOffSuprt DINH_nrActvInhReas.FId_HLSDem_DrvOffSuprtBrkHldSys DINH_nrActvInhReas.FId_HLSDem_DrvOffSuprtLAS DINH_nrActvInhReas.FId_HLSDem_PModeActv DINH_nrActvInhReas.FId_HLSDem_TModeActv DINH_nrActvInhReas.FId_HLSDem_TraSubFcn DINH_nrActvInhReas.FId_HLSDem_nMaxLimErr1 DINH_nrActvInhReas.FId_HLSDem_nMaxLimErr2 DINH_nrActvInhReas.FId_HLSDem_nMaxLimErr3 DINH_nrActvInhReas.FId_HLSDem_nMaxVErr DINH_nrActvInhReas.FId_I14229APP DINH_nrActvInhReas.FId_I14229CANErr DINH_nrActvInhReas.FId_I14229FlLvlFltComErr DINH_nrActvInhReas.FId_I14229VTCErr DINH_nrActvInhReas.FId_IMGISABComErr DINH_nrActvInhReas.FId_InhbLamDynS1B1 DINH_nrActvInhReas.FId_InhbnBlkdLineDiag DINH_nrActvInhReas.FId_InhibitAlways DINH_nrActvInhReas.FId_InhibitNever DINH_nrActvInhReas.FId_InjSysMulInjDiagErr DINH_nrActvInhReas.FId_InjVlvPs_Bank1OnlyErr DINH_nrActvInhReas.FId_InjVlvPs_Bank1Tested DINH_nrActvInhReas.FId_InjVlvPs_Bank2OnlyErr DINH_nrActvInhReas.FId_InjVlvPs_Bank2Tested DINH_nrActvInhReas.FId_InjVlvPs_Bank3OnlyErr DINH_nrActvInhReas.FId_InjVlvPs_Bank3Tested DINH_nrActvInhReas.FId_IntkAirTAirFltDsCrssChk DINH_nrActvInhReas.FId_IntkAirTAirFltDsPlausChk DINH_nrActvInhReas.FId_IntkAirTIntkMnfldCrssChk DINH_nrActvInhReas.FId_IntkAirTIntkMnfldPlausChk DINH_nrActvInhReas.FId_IntkAirTIntkMnfldRepl DINH_nrActvInhReas.FId_IntkAirTSnsr1Elec DINH_nrActvInhReas.FId_IntkAirTSnsr1PRC DINH_nrActvInhReas.FId_IntkAirTSnsr1Sum DINH_nrActvInhReas.FId_IntkAirTSnsr2Elec DINH_nrActvInhReas.FId_IntkAirTSnsr2PRC DINH_nrActvInhReas.FId_IntkAirTSnsr2Sum DINH_nrActvInhReas.FId_IntkArTempENGB DINH_nrActvInhReas.FId_LIGovDfrstI DINH_nrActvInhReas.FId_LIGovUndrBrk DINH_nrActvInhReas.FId_LINDCDCRxErr DINH_nrActvInhReas.FId_LLimAppSnsrErr DINH_nrActvInhReas.FId_LLimAppSnsrSyncErr DINH_nrActvInhReas.FId_LLimMTVehSpdSnsrErr DINH_nrActvInhReas.FId_LLimShutOffEng DINH_nrActvInhReas.FId_LRSEBMisf DINH_nrActvInhReas.FId_LZSR DINH_nrActvInhReas.FId_LeakToMnfld DINH_nrActvInhReas.FId_LeakToMnfldTstd DINH_nrActvInhReas.FId_LimpHomPsErrInjtr DINH_nrActvInhReas.FId_LinACGUnitCfmdErr DINH_nrActvInhReas.FId_LinACGUnitNotTstd DINH_nrActvInhReas.FId_LinAEVUnitCfmdErr DINH_nrActvInhReas.FId_LinAEVUnitNotTstd DINH_nrActvInhReas.FId_LinEBSUnitCfmdErr DINH_nrActvInhReas.FId_LinEBSUnitNotTstd DINH_nrActvInhReas.FId_LowPresOilP DINH_nrActvInhReas.FId_MFlowAirCrkcsSubVal DINH_nrActvInhReas.FId_MFuOilMax DINH_nrActvInhReas.FId_MaiLoadSnsr DINH_nrActvInhReas.FId_MaiShaftFailr DINH_nrActvInhReas.FId_MfPsDia1 DINH_nrActvInhReas.FId_MisfDetDnAdpn DINH_nrActvInhReas.FId_MisfDetDnAdpnPlaus DINH_nrActvInhReas.FId_MisfDetEnvP DINH_nrActvInhReas.FId_MisfDetSegTiAdpnFco DINH_nrActvInhReas.FId_MisfDetShtrpAct DINH_nrActvInhReas.FId_MisfDetStc DINH_nrActvInhReas.FId_MisfDetV DINH_nrActvInhReas.FId_MisfDetVWhlFrntLe DINH_nrActvInhReas.FId_MisfDetVWhlFrntRi DINH_nrActvInhReas.FId_MisfDetVWhlReLe DINH_nrActvInhReas.FId_MisfDetVWhlReRi DINH_nrActvInhReas.FId_NLimVehHalt DINH_nrActvInhReas.FId_NSHTDAmbT DINH_nrActvInhReas.FId_NSHTDEngT DINH_nrActvInhReas.FId_NSHTILimHiAltiLoIdleSp DINH_nrActvInhReas.FId_NeutPosnFailr DINH_nrActvInhReas.FId_O2StorgMdlMD DINH_nrActvInhReas.FId_OilCmbdSen_LvlDfctHW DINH_nrActvInhReas.FId_OilPCtrlVlvNpl DINH_nrActvInhReas.FId_OilPFrzVal DINH_nrActvInhReas.FId_OilPPlaus DINH_nrActvInhReas.FId_OilPPlausAftRun DINH_nrActvInhReas.FId_OilPPlausMax DINH_nrActvInhReas.FId_OilPPlausMin DINH_nrActvInhReas.FId_OilPPlausT15 DINH_nrActvInhReas.FId_OilPRplVal DINH_nrActvInhReas.FId_OilPSnsrErr DINH_nrActvInhReas.FId_OilPSwmpSRC DINH_nrActvInhReas.FId_OilSwmpTCEngDsTWrmUp DINH_nrActvInhReas.FId_OilSwmpT_B_tospg DINH_nrActvInhReas.FId_OilSwmpT_B_tospgg DINH_nrActvInhReas.FId_OilSwmpT_CmbdSnsrErr DINH_nrActvInhReas.FId_OilSwmpT_CmbdSnsrTiTErr DINH_nrActvInhReas.FId_OilSwmpT_EnvT DINH_nrActvInhReas.FId_OilSwmpT_TSnsrErr DINH_nrActvInhReas.FId_PEnvMeasVld DINH_nrActvInhReas.FId_PEnvModel DINH_nrActvInhReas.FId_PEnvPlausDiagVDD DINH_nrActvInhReas.FId_PEnvRawVldVDD DINH_nrActvInhReas.FId_PEnvRefSnsr DINH_nrActvInhReas.FId_PEnvSigRngVld DINH_nrActvInhReas.FId_PEnvSnsrPlausVDD DINH_nrActvInhReas.FId_PEnvVldVDD DINH_nrActvInhReas.FId_PIDA6SigSrcErr DINH_nrActvInhReas.FId_PIntkMnfldPlaus DINH_nrActvInhReas.FId_PIntkVUsElecDiagB1 DINH_nrActvInhReas.FId_PSPCtlDisbl DINH_nrActvInhReas.FId_PSPCtlIntkAirVapLock DINH_nrActvInhReas.FId_PSPCtlPreRun DINH_nrActvInhReas.FId_PSPCtlVapLock DINH_nrActvInhReas.FId_PSPDiagDisbl DINH_nrActvInhReas.FId_PTGripConv DINH_nrActvInhReas.FId_PTGripConvStrt DINH_nrActvInhReas.FId_PTGripMnlClth DINH_nrActvInhReas.FId_PTGripMnlClthStrt DINH_nrActvInhReas.FId_PTTrqRatCANPtd DINH_nrActvInhReas.FId_PThrVlVUsVldB1 DINH_nrActvInhReas.FId_PThrVlvUsMeasdVldB1 DINH_nrActvInhReas.FId_P_VSE11_Diag DINH_nrActvInhReas.FId_PrmId03_FltRdnS1B1 DINH_nrActvInhReas.FId_PrmId03_FltUegoS1B1 DINH_nrActvInhReas.FId_RevLck DINH_nrActvInhReas.FId_RstAdpnPIntkMnfldAfs DINH_nrActvInhReas.FId_RvsPosnFailr DINH_nrActvInhReas.FId_SSEEPBRelease DINH_nrActvInhReas.FId_SSEFCANPRelease DINH_nrActvInhReas.FId_SSEPTCANPRelease DINH_nrActvInhReas.FId_SSEStartRelease DINH_nrActvInhReas.FId_SSEStartReleaseMTCl10 DINH_nrActvInhReas.FId_SSEStartReleaseMTCl100 DINH_nrActvInhReas.FId_SSEStartReleaseMTCl20 DINH_nrActvInhReas.FId_SSEStartReleaseMTCl90 DINH_nrActvInhReas.FId_SSEStartRequest DINH_nrActvInhReas.FId_SSEStopRelease DINH_nrActvInhReas.FId_SSEStrtStopRelease DINH_nrActvInhReas.FId_SSESysOff DINH_nrActvInhReas.FId_SSEUI2DCSysFailr DINH_nrActvInhReas.FId_SSEUIBCANErr DINH_nrActvInhReas.FId_SSEUISysFail DINH_nrActvInhReas.FId_SiaEEPErr DINH_nrActvInhReas.FId_SnglWhlErrDiagEna DINH_nrActvInhReas.FId_StrtCtlAutoCrkModeCdn DINH_nrActvInhReas.FId_StrtCtlComEngStrtErr DINH_nrActvInhReas.FId_StrtCtlNPCdnCncl DINH_nrActvInhReas.FId_StrtCtlNoCpuFailr DINH_nrActvInhReas.FId_StrtCtlNoFailCanLine DINH_nrActvInhReas.FId_StrtCtlNoFailPTCanLine DINH_nrActvInhReas.FId_StrtCtlPNPosnSubsVal DINH_nrActvInhReas.FId_StrtCtlSTMFailr DINH_nrActvInhReas.FId_StrtErrShaft DINH_nrActvInhReas.FId_SumErrHndlg DINH_nrActvInhReas.FId_SysDiagComErr DINH_nrActvInhReas.FId_SysDiagModInhbErr DINH_nrActvInhReas.FId_TOSPM DINH_nrActvInhReas.FId_TWCCILck DINH_nrActvInhReas.FId_TWCCILckExtd DINH_nrActvInhReas.FId_TWCCIRstB1 DINH_nrActvInhReas.FId_TWCCIRstDSMClearB1 DINH_nrActvInhReas.FId_TWCCLsuB1 DINH_nrActvInhReas.FId_TWCCLsuCyc DINH_nrActvInhReas.FId_TWCCLsuDynB1 DINH_nrActvInhReas.FId_TWCCMisfDetn DINH_nrActvInhReas.FId_TWCDPriCatParB1 DINH_nrActvInhReas.FId_TWCDPriCatVldnB1 DINH_nrActvInhReas.FId_TankPCpv1DteskLoLoadStuckClsd DINH_nrActvInhReas.FId_TankPCpv1DteskLoLoadStuckOpen DINH_nrActvInhReas.FId_TankPSnsrElecChkVld DINH_nrActvInhReas.FId_ThrVlvMon DINH_nrActvInhReas.FId_ThrVlvOffsLrnPrmsB1 DINH_nrActvInhReas.FId_TiOffTBasdChkFast DINH_nrActvInhReas.FId_TiOffTBasdChkSlow DINH_nrActvInhReas.FId_TiOffVdClk DINH_nrActvInhReas.FId_TqDecelOffsInhb DINH_nrActvInhReas.FId_TraAddAirCANPtd DINH_nrActvInhReas.FId_TraAddClntCANPtd DINH_nrActvInhReas.FId_TraFwdRvsCluInfo DINH_nrActvInhReas.FId_TraGbxNPos DINH_nrActvInhReas.FId_TraGearInfoCanCom DINH_nrActvInhReas.FId_TraGearInfoDet DINH_nrActvInhReas.FId_TraGearInfoGearShftActv DINH_nrActvInhReas.FId_TraGearInfoInfoCan DINH_nrActvInhReas.FId_TraGearInfoLevPos DINH_nrActvInhReas.FId_TraGearInfoLoRng DINH_nrActvInhReas.FId_TraGearInfoRTra DINH_nrActvInhReas.FId_TraGearInfoRevGear DINH_nrActvInhReas.FId_TraGearReq DINH_nrActvInhReas.FId_TraNoShftIdctr DINH_nrActvInhReas.FId_TraPrtGearCANPtd DINH_nrActvInhReas.FId_TraPrtGearIndpdtProblem DINH_nrActvInhReas.FId_TraRPosn DINH_nrActvInhReas.FId_TraRtnIntfcASTIntv DINH_nrActvInhReas.FId_TraRtnIntfcIdlSetP DINH_nrActvInhReas.FId_TraRtnIntfcNMaxCan DINH_nrActvInhReas.FId_TraRtnIntfcNMaxVel DINH_nrActvInhReas.FId_TraTrqRedLmpHmeDec DINH_nrActvInhReas.FId_TraTrqRedLmpHmeInc DINH_nrActvInhReas.FId_TraTrqRedPTCanErr DINH_nrActvInhReas.FId_TraTrqRedTIIntvDes DINH_nrActvInhReas.FId_TraTrqRedTIIntvLead DINH_nrActvInhReas.FId_TraTrqRedTSCIntvDes DINH_nrActvInhReas.FId_TraTrqRedTSCIntvLead DINH_nrActvInhReas.FId_TraTrsmTypHw DINH_nrActvInhReas.FId_TranIdleDes DINH_nrActvInhReas.FId_UEGOHeatgUpRglS1B1 DINH_nrActvInhReas.FId_UEGOHeatrCtrlS1B1 DINH_nrActvInhReas.FId_UEGOHeatrPrfmncDiagRelsS1B1 DINH_nrActvInhReas.FId_UEGOHeatrPwrStgDiagRelsS1B1 DINH_nrActvInhReas.FId_UEGOModCtrlRelsS1B1 DINH_nrActvInhReas.FId_UEGOStrtDiagInhRprtErrS1B1 DINH_nrActvInhReas.FId_UEGOStrtDiagRelsS1B1 DINH_nrActvInhReas.FId_UEGOTCeramicRelsS1B1 DINH_nrActvInhReas.FId_UegoDiagRelsBattSplyOk DINH_nrActvInhReas.FId_UegoDiagSigEcuAsicS1B1 DINH_nrActvInhReas.FId_UegoDiagSigEcuComS1B1 DINH_nrActvInhReas.FId_UegoDiagSigOperPlausS1B1 DINH_nrActvInhReas.FId_UegoDiagSigSnsrS1B1 DINH_nrActvInhReas.FId_UegoDiagSigWireOlS1B1 DINH_nrActvInhReas.FId_UegoDiagSigWireScS1B1 DINH_nrActvInhReas.FId_UegoDiagSigWireScTstdS1B1 DINH_nrActvInhReas.FId_UegoInhbOperRelsS1B1 DINH_nrActvInhReas.FId_UegoO2HiPrcsnS1B1 DINH_nrActvInhReas.FId_UegoO2PlausErrS1B1 DINH_nrActvInhReas.FId_UegoO2VldS1B1 DINH_nrActvInhReas.FId_UegoOperPlausBattSplyOk DINH_nrActvInhReas.FId_UegoPlausErrHndlg DINH_nrActvInhReas.FId_VMSIDCSRmpShOff DINH_nrActvInhReas.FId_VMSIDCSShOff DINH_nrActvInhReas.FId_VMSITCSRmpShOff DINH_nrActvInhReas.FId_VMSITCSShOff DINH_nrActvInhReas.FId_VSACANErr DINH_nrActvInhReas.FId_VehStcACGFailr DINH_nrActvInhReas.FId_VehStcBattMngFailr DINH_nrActvInhReas.FId_VehStcDCDCFailr DINH_nrActvInhReas.FId_VehStcEBSFailr DINH_nrActvInhReas.FId_VehStcMisf DINH_nrActvInhReas.FId_VehStcMtrComFailr DINH_nrActvInhReas.FId_VehStcNVMFailr DINH_nrActvInhReas.FId_VehVCANFrzVal DINH_nrActvInhReas.FId_VehVCANReplVal DINH_nrActvInhReas.FId_VehVCanSafeFrzVal DINH_nrActvInhReas.FId_VehVCanSafeReplVal DINH_nrActvInhReas.FId_VehVCom DINH_nrActvInhReas.FId_VehVExcdLim DINH_nrActvInhReas.FId_VehVFrzVal DINH_nrActvInhReas.FId_VehVNCSnsrElecFailr DINH_nrActvInhReas.FId_VehVOBDFrzVal DINH_nrActvInhReas.FId_VehVOBDReplVal DINH_nrActvInhReas.FId_VehVOutCanErr DINH_nrActvInhReas.FId_VehVPWMFrzVal DINH_nrActvInhReas.FId_VehVPWMReplVal DINH_nrActvInhReas.FId_VehVPhysRng DINH_nrActvInhReas.FId_VehVPlaus DINH_nrActvInhReas.FId_VehVPlausCan DINH_nrActvInhReas.FId_VehVPlausFco DINH_nrActvInhReas.FId_VehVPlausPwr DINH_nrActvInhReas.FId_VehVPlausV2N DINH_nrActvInhReas.FId_VehVReplVal DINH_nrActvInhReas.FId_VehVSigCan DINH_nrActvInhReas.FId_VehVSigCanSafe DINH_nrActvInhReas.FId_VehVSngWhlCanFrzVal DINH_nrActvInhReas.FId_VehVSngWhlCanReplVal DINH_nrActvInhReas.FId_VehVSnsrARngHi DINH_nrActvInhReas.FId_VehVSnsrBRngHi DINH_nrActvInhReas.FId_VehVSpdRtyDiag DINH_nrActvInhReas.FId_VehVSpdSnsrAElecFailr DINH_nrActvInhReas.FId_VehVSpdSnsrBElecFailr DINH_nrActvInhReas.FId_VehVvFLWhlSpd DINH_nrActvInhReas.FId_VehVvFRWhlSpd DINH_nrActvInhReas.FId_VehVvRLWhlSpd DINH_nrActvInhReas.FId_VehVvRRWhlSpd DINH_nrActvInhReas.FId_VldtLamDynS1B1 DINH_nrActvInhReas.FId_VlvLftFbIntkOilPSnsr11SRC DINH_nrActvInhReas.FId_VlvLftFbSwtIntk11Diag DINH_nrActvInhReas.FId_ZGLZSR DINH_nrActvInhReas.FId_airIntkFltSnsrKnkPrtnIgn DINH_nrActvInhReas.FId_ctrladpncvo DINH_nrActvInhReas.FId_stChkChgnSys DINH_nrActvInhReas.FId_stChkChgnSys2DC DINH_nrActvInhReas.FId_tFltSnsrKnkPrtnIgn DINH_stClctFId_mp DINH_stFId.FId_Unused DINH_stFId.FID_AFRA DINH_stFId.FID_AORA DINH_stFId.FID_ATEH DINH_stFId.FID_ATEL DINH_stFId.FID_ATEN DINH_stFId.FID_ATLDI DINH_stFId.FID_ATLDO DINH_stFId.FID_BEONV DINH_stFId.FId_EGSDCmnSeg1B1Parl DINH_stFId.FID_BAGRA DINH_stFId.FID_BAGRASD DINH_stFId.FID_BDSTOF DINH_stFId.FID_BFVDFRM DINH_stFId.FID_BHOM DINH_stFId.FID_BLLRH DINH_stFId.FID_BLLRKH DINH_stFId.FID_BPLSU DINH_stFId.FID_FRAMBAVMB DINH_stFId.FId_CatHeatgColdStrtReq DINH_stFId.FId_CatHeatgWrmReq DINH_stFId.FId_DSMBDEPHSpOpMode DINH_stFId.FId_EGRVlvCoord DINH_stFId.FId_EGSDO2FuTrmB1 DINH_stFId.FId_EGSDO2SnsrMntdRelsS1B1 DINH_stFId.FId_EGSDO2_LamOffsFastS1B1 DINH_stFId.FId_MisfDetDnAdpnNv DINH_stFId.FId_bascadpncvo DINH_stFId.FID_AGRS DINH_stFId.FID_BBAGR DINH_stFId.FID_BBAGRA DINH_stFId.FID_BGFKMS DINH_stFId.FID_BGMSDKS DINH_stFId.FID_CAGRSUS DINH_stFId.FID_CBGTFUELM DINH_stFId.FID_CBGTHDEV DINH_stFId.FID_CDESVF DINH_stFId.FID_CDETHS DINH_stFId.FID_CDRCTSTRT DINH_stFId.FID_CDSKV DINH_stFId.FID_CDSKVRNO DINH_stFId.FID_CDSKVRPO DINH_stFId.FID_CDSKVRaty DINH_stFId.FID_CDSKVRng DINH_stFId.FID_CDSKVS DINH_stFId.FID_CDSTR DINH_stFId.FID_CDSTTI DINH_stFId.FID_CETHG DINH_stFId.FID_CETHSPLnpl DINH_stFId.FID_CETHSTPLnpl DINH_stFId.FID_CETKHL DINH_stFId.FID_CETKHT DINH_stFId.FID_CGDISTRT DINH_stFId.FID_CGLSRDP DINH_stFId.FID_CHDR DINH_stFId.FID_CHDRKH DINH_stFId.FID_CHDRPL DINH_stFId.FID_CLLKHV DINH_stFId.FID_CLLRHV DINH_stFId.FID_CLZSRDP DINH_stFId.FID_CLZSRHP DINH_stFId.FID_CNLHP DINH_stFId.FID_CNLHP2 DINH_stFId.FID_CNLKO2 DINH_stFId.FID_CNLKO3 DINH_stFId.FID_CNLLP DINH_stFId.FID_CNLPL DINH_stFId.FID_CNLPS DINH_stFId.FID_CNSAD DINH_stFId.FID_CNSAD2 DINH_stFId.FID_CPSRB DINH_stFId.FID_CPSRP DINH_stFId.FID_CSTHDR DINH_stFId.FID_CSTRTCTL DINH_stFId.FID_CTESF DINH_stFId.FID_CTESG DINH_stFId.FID_CTHIPSTRT DINH_stFId.FID_CTKACS DINH_stFId.FID_CTMSV DINH_stFId.FID_CTOSP DINH_stFId.FID_DHFERR DINH_stFId.FID_DKRSA DINH_stFId.FID_DLLRBandEndTst DINH_stFId.FID_DLLRShrtTrpSpdRmp DINH_stFId.FID_FEDKAHB DINH_stFId.FID_FEDKAPB DINH_stFId.FID_FEDSSB DINH_stFId.FID_FOFSTP DINH_stFId.FID_FONSTP DINH_stFId.FID_FUEDK DINH_stFId.FID_FVLRA DINH_stFId.FID_KRREGact /end LOC_MEASUREMENT
 FUNCTION_VERSION "30000.27.0_1.0.0" /end FUNCTION
/begin COMPU_METHOD DFC_OneToOne "" RAT_FUNC "%6.2" "-" COEFFS 0 1 0 0 0 1 /end COMPU_METHOD
/begin COMPU_METHOD DINH_ct_Compu "" RAT_FUNC "%6.0" "" COEFFS 0 -1 4096 0 0 1 /end COMPU_METHOD
/end MODULE
/end PROJECT
