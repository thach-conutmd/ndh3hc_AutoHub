ASAP2_VERSION 1 60
/begin PROJECT MG1CS022 "MG1CS022"
/begin HEADER "" VERSION "MG1CS022_62XSC_V036_TPROT" PROJECT_NO MG1CS022 /end HEADER
/begin MODULE DIM ""
/begin MOD_COMMON "" BYTE_ORDER MSB_LAST ALIGNMENT_BYTE 1 ALIGNMENT_WORD 2 ALIGNMENT_LONG 4 ALIGNMENT_INT64 4 ALIGNMENT_FLOAT32_IEEE 4 ALIGNMENT_FLOAT64_IEEE 4 DATA_SIZE 32 /end MOD_COMMON
/begin CHARACTERISTIC DFC_CtlMsk.DFC_Unused_C "Behaviour control mask / " VALUE 0x804D8CC0 Val_Wu16 65535.00 DFES_OneToOne 0.00 65535.00 FORMAT "%8.2" READ_ONLY /end CHARACTERISTIC
/begin CHARACTERISTIC DFC_CtlMsk.DFC_AAVEmax_C "Behaviour control mask / Behaviour control masks of check DFC_AAVEmax" VALUE 0x804D8CC2 Val_Wu16 65535.00 DFES_OneToOne 0.00 65535.00 FORMAT "%8.2" /end CHARACTERISTIC
/begin CHARACTERISTIC DFC_CtlMsk.DFC_AAVEmin_C "Behaviour control mask / Behaviour control masks of check DFC_AAVEmin" VALUE 0x804D8CC4 Val_Wu16 65535.00 DFES_OneToOne 0.00 65535.00 FORMAT "%8.2" /end CHARACTERISTIC
/begin CHARACTERISTIC DFC_CtlMsk.DFC_AAVEsig_C "Behaviour control mask / Behaviour control masks of check DFC_AAVEsig" VALUE 0x804D8CC6 Val_Wu16 65535.00 DFES_OneToOne 0.00 65535.00 FORMAT "%8.2" /end CHARACTERISTIC
/begin CHARACTERISTIC DFC_CtlMsk.DFC_AltIOACGFailr_C "Behaviour control mask / Behaviour control masks of check DFC_AltIOACGFailr" VALUE 0x804D8CC8 Val_Wu16 65535.00 DFES_OneToOne 0.00 65535.00 FORMAT "%8.2" /end CHARACTERISTIC
/begin CHARACTERISTIC DFC_CtlMsk.DFC_AltIOACGHiVltg_C "Behaviour control mask / Behaviour control masks of check DFC_AltIOACGHiVltg" VALUE 0x804D8CCA Val_Wu16 65535.00 DFES_OneToOne 0.00 65535.00 FORMAT "%8.2" /end CHARACTERISTIC
/begin CHARACTERISTIC DFC_CtlMsk.DFC_AltIOACGLoVltg_C "Behaviour control mask / Behaviour control masks of check DFC_AltIOACGLoVltg" VALUE 0x804D8CCC Val_Wu16 65535.00 DFES_OneToOne 0.00 65535.00 FORMAT "%8.2" /end CHARACTERISTIC
/begin CHARACTERISTIC DFC_CtlMsk.DFC_AltIOACGTHi_C "Behaviour control mask / Behaviour control masks of check DFC_AltIOACGTHi" VALUE 0x804D8CCE Val_Wu16 65535.00 DFES_OneToOne 0.00 65535.00 FORMAT "%8.2" /end CHARACTERISTIC
/begin CHARACTERISTIC DFC_CtlMsk.DFC_AltIODConnACG_C "Behaviour control mask / Behaviour control masks of check DFC_AltIODConnACG" VALUE 0x804D8CD0 Val_Wu16 65535.00 DFES_OneToOne 0.00 65535.00 FORMAT "%8.2" /end CHARACTERISTIC
/begin CHARACTERISTIC DFC_CtlMsk.DFC_BGOELWAF_C "Behaviour control mask / Behaviour control masks of check DFC_BGOELWAF" VALUE 0x804D8CD2 Val_Wu16 65535.00 DFES_OneToOne 0.00 65535.00 FORMAT "%8.2" /end CHARACTERISTIC
/begin CHARACTERISTIC DFC_CtlMsk.DFC_BattUHiFailr_C "Behaviour control mask / Behaviour control masks of check DFC_BattUHiFailr" VALUE 0x804D8CD4 Val_Wu16 65535.00 DFES_OneToOne 0.00 65535.00 FORMAT "%8.2" /end CHARACTERISTIC
/begin CHARACTERISTIC DFC_CtlMsk.DFC_BattULoFailr_C "Behaviour control mask / Behaviour control masks of check DFC_BattULoFailr" VALUE 0x804D8CD6 Val_Wu16 65535.00 DFES_OneToOne 0.00 65535.00 FORMAT "%8.2" /end CHARACTERISTIC
/begin CHARACTERISTIC DFC_CtlMsk.DFC_BrkBstPDriftHiErr_C "Behaviour control mask / Behaviour control masks of check DFC_BrkBstPDriftHiErr" VALUE 0x804D8CD8 Val_Wu16 65535.00 DFES_OneToOne 0.00 65535.00 FORMAT "%8.2" /end CHARACTERISTIC
/begin CHARACTERISTIC DFC_CtlMsk.DFC_BrkBstPDriftLoErr_C "Behaviour control mask / Behaviour control masks of check DFC_BrkBstPDriftLoErr" VALUE 0x804D8CDA Val_Wu16 65535.00 DFES_OneToOne 0.00 65535.00 FORMAT "%8.2" /end CHARACTERISTIC
/begin CHARACTERISTIC DFC_CtlMsk.DFC_BrkBstPSnsrStuck_C "Behaviour control mask / Behaviour control masks of check DFC_BrkBstPSnsrStuck" VALUE 0x804D8CDC Val_Wu16 65535.00 DFES_OneToOne 0.00 65535.00 FORMAT "%8.2" /end CHARACTERISTIC
/begin CHARACTERISTIC DFC_CtlMsk.DFC_BrkMnSwtContOn_C "Behaviour control mask / Behaviour control masks of check DFC_BrkMnSwtContOn" VALUE 0x804D8CDE Val_Wu16 65535.00 DFES_OneToOne 0.00 65535.00 FORMAT "%8.2" /end CHARACTERISTIC
/begin CHARACTERISTIC DFC_CtlMsk.DFC_BrkMnSwtNotStp_C "Behaviour control mask / Behaviour control masks of check DFC_BrkMnSwtNotStp" VALUE 0x804D8CE0 Val_Wu16 65535.00 DFES_OneToOne 0.00 65535.00 FORMAT "%8.2" /end CHARACTERISTIC
/begin CHARACTERISTIC DFC_CtlMsk.DFC_BrkNpl_C "Behaviour control mask / Behaviour control masks of check DFC_BrkNpl" VALUE 0x804D8CE2 Val_Wu16 65535.00 DFES_OneToOne 0.00 65535.00 FORMAT "%8.2" /end CHARACTERISTIC
/begin CHARACTERISTIC DFC_CtlMsk.DFC_BrkRdntSwtContOn_C "Behaviour control mask / Behaviour control masks of check DFC_BrkRdntSwtContOn" VALUE 0x804D8CE4 Val_Wu16 65535.00 DFES_OneToOne 0.00 65535.00 FORMAT "%8.2" /end CHARACTERISTIC
/begin CHARACTERISTIC DFC_CtlMsk.DFC_BrkRdntSwtNotStp_C "Behaviour control mask / Behaviour control masks of check DFC_BrkRdntSwtNotStp" VALUE 0x804D8CE6 Val_Wu16 65535.00 DFES_OneToOne 0.00 65535.00 FORMAT "%8.2" /end CHARACTERISTIC
/begin CHARACTERISTIC DFC_CtlMsk.DFC_Clth3ONStuck_C "Behaviour control mask / Behaviour control masks of check DFC_Clth3ONStuck" VALUE 0x804D8CE8 Val_Wu16 65535.00 DFES_OneToOne 0.00 65535.00 FORMAT "%8.2" /end CHARACTERISTIC
/begin CHARACTERISTIC DFC_CtlMsk.DFC_Clth4OFFStuck_C "Behaviour control mask / Behaviour control masks of check DFC_Clth4OFFStuck" VALUE 0x804D8CEA Val_Wu16 65535.00 DFES_OneToOne 0.00 65535.00 FORMAT "%8.2" /end CHARACTERISTIC
/begin CHARACTERISTIC DFC_CtlMsk.DFC_ClthOFFStuck_C "Behaviour control mask / Behaviour control masks of check DFC_ClthOFFStuck" VALUE 0x804D8CEC Val_Wu16 65535.00 DFES_OneToOne 0.00 65535.00 FORMAT "%8.2" /end CHARACTERISTIC
/begin CHARACTERISTIC DFC_CtlMsk.DFC_ClthONStuck_C "Behaviour control mask / Behaviour control masks of check DFC_ClthONStuck" VALUE 0x804D8CEE Val_Wu16 65535.00 DFES_OneToOne 0.00 65535.00 FORMAT "%8.2" /end CHARACTERISTIC
/begin CHARACTERISTIC DFC_CtlMsk.DFC_ClthStkFailInfo_C "Behaviour control mask / Behaviour control masks of check DFC_ClthStkFailInfo" VALUE 0x804D8CF0 Val_Wu16 65535.00 DFES_OneToOne 0.00 65535.00 FORMAT "%8.2" /end CHARACTERISTIC
/begin CHARACTERISTIC DFC_CtlMsk.DFC_ComACFailInfo_C "Behaviour control mask / Behaviour control masks of check DFC_ComACFailInfo" VALUE 0x804D8CF2 Val_Wu16 65535.00 DFES_OneToOne 0.00 65535.00 FORMAT "%8.2" /end CHARACTERISTIC
/begin CHARACTERISTIC DFC_CtlMsk.DFC_ComATFTValErr_C "Behaviour control mask / Behaviour control masks of check DFC_ComATFTValErr" VALUE 0x804D8CF4 Val_Wu16 65535.00 DFES_OneToOne 0.00 65535.00 FORMAT "%8.2" /end CHARACTERISTIC
/begin CHARACTERISTIC DFC_CtlMsk.DFC_ComATMILReq_C "Behaviour control mask / Behaviour control masks of check DFC_ComATMILReq" VALUE 0x804D8CF6 Val_Wu16 65535.00 DFES_OneToOne 0.00 65535.00 FORMAT "%8.2" /end CHARACTERISTIC
/begin CHARACTERISTIC DFC_CtlMsk.DFC_ComAYCAChksum_C "Behaviour control mask / Behaviour control masks of check DFC_ComAYCAChksum" VALUE 0x804D8CF8 Val_Wu16 65535.00 DFES_OneToOne 0.00 65535.00 FORMAT "%8.2" /end CHARACTERISTIC
/begin CHARACTERISTIC DFC_CtlMsk.DFC_ComAYCARingCnt_C "Behaviour control mask / Behaviour control masks of check DFC_ComAYCARingCnt" VALUE 0x804D8CFA Val_Wu16 65535.00 DFES_OneToOne 0.00 65535.00 FORMAT "%8.2" /end CHARACTERISTIC
/begin CHARACTERISTIC DFC_CtlMsk.DFC_ComAYCATOut_C "Behaviour control mask / Behaviour control masks of check DFC_ComAYCATOut" VALUE 0x804D8CFC Val_Wu16 65535.00 DFES_OneToOne 0.00 65535.00 FORMAT "%8.2" /end CHARACTERISTIC
/begin CHARACTERISTIC DFC_CtlMsk.DFC_ComAYCDChkSum_C "Behaviour control mask / Behaviour control masks of check DFC_ComAYCDChkSum" VALUE 0x804D8CFE Val_Wu16 65535.00 DFES_OneToOne 0.00 65535.00 FORMAT "%8.2" /end CHARACTERISTIC
/begin CHARACTERISTIC DFC_CtlMsk.DFC_ComAYCDTOut_C "Behaviour control mask / Behaviour control masks of check DFC_ComAYCDTOut" VALUE 0x804D8D00 Val_Wu16 65535.00 DFES_OneToOne 0.00 65535.00 FORMAT "%8.2" /end CHARACTERISTIC
/begin CHARACTERISTIC DFC_CtlMsk.DFC_ComAYCFChksum_C "Behaviour control mask / Behaviour control masks of check DFC_ComAYCFChksum" VALUE 0x804D8D02 Val_Wu16 65535.00 DFES_OneToOne 0.00 65535.00 FORMAT "%8.2" /end CHARACTERISTIC
/begin CHARACTERISTIC DFC_CtlMsk.DFC_ComAYCFRingCnt_C "Behaviour control mask / Behaviour control masks of check DFC_ComAYCFRingCnt" VALUE 0x804D8D04 Val_Wu16 65535.00 DFES_OneToOne 0.00 65535.00 FORMAT "%8.2" /end CHARACTERISTIC
/begin CHARACTERISTIC DFC_CtlMsk.DFC_ComAYCFTOut_C "Behaviour control mask / Behaviour control masks of check DFC_ComAYCFTOut" VALUE 0x804D8D06 Val_Wu16 65535.00 DFES_OneToOne 0.00 65535.00 FORMAT "%8.2" /end CHARACTERISTIC
/begin CHARACTERISTIC DFC_CtlMsk.DFC_ComAYCGChksum_C "Behaviour control mask / Behaviour control masks of check DFC_ComAYCGChksum" VALUE 0x804D8D08 Val_Wu16 65535.00 DFES_OneToOne 0.00 65535.00 FORMAT "%8.2" /end CHARACTERISTIC
/begin CHARACTERISTIC DFC_CtlMsk.DFC_ComAYCGRingCnt_C "Behaviour control mask / Behaviour control masks of check DFC_ComAYCGRingCnt" VALUE 0x804D8D0A Val_Wu16 65535.00 DFES_OneToOne 0.00 65535.00 FORMAT "%8.2" /end CHARACTERISTIC
/begin CHARACTERISTIC DFC_CtlMsk.DFC_ComAYCGTOut_C "Behaviour control mask / Behaviour control masks of check DFC_ComAYCGTOut" VALUE 0x804D8D0C Val_Wu16 65535.00 DFES_OneToOne 0.00 65535.00 FORMAT "%8.2" /end CHARACTERISTIC
/begin CHARACTERISTIC DFC_CtlMsk.DFC_ComAYCIChkSum_C "Behaviour control mask / Behaviour control masks of check DFC_ComAYCIChkSum" VALUE 0x804D8D0E Val_Wu16 65535.00 DFES_OneToOne 0.00 65535.00 FORMAT "%8.2" /end CHARACTERISTIC
/begin CHARACTERISTIC DFC_CtlMsk.DFC_ComAYCIRingCnt_C "Behaviour control mask / Behaviour control masks of check DFC_ComAYCIRingCnt" VALUE 0x804D8D10 Val_Wu16 65535.00 DFES_OneToOne 0.00 65535.00 FORMAT "%8.2" /end CHARACTERISTIC
/begin CHARACTERISTIC DFC_CtlMsk.DFC_ComAYCITOut_C "Behaviour control mask / Behaviour control masks of check DFC_ComAYCITOut" VALUE 0x804D8D12 Val_Wu16 65535.00 DFES_OneToOne 0.00 65535.00 FORMAT "%8.2" /end CHARACTERISTIC
/begin CHARACTERISTIC DFC_CtlMsk.DFC_ComBCM1ChkSum_C "Behaviour control mask / Behaviour control masks of check DFC_ComBCM1ChkSum" VALUE 0x804D8D14 Val_Wu16 65535.00 DFES_OneToOne 0.00 65535.00 FORMAT "%8.2" /end CHARACTERISTIC
/begin CHARACTERISTIC DFC_CtlMsk.DFC_ComBCM1RingCnt_C "Behaviour control mask / Behaviour control masks of check DFC_ComBCM1RingCnt" VALUE 0x804D8D16 Val_Wu16 65535.00 DFES_OneToOne 0.00 65535.00 FORMAT "%8.2" /end CHARACTERISTIC
/begin CHARACTERISTIC DFC_CtlMsk.DFC_ComBCM1TOut_C "Behaviour control mask / Behaviour control masks of check DFC_ComBCM1TOut" VALUE 0x804D8D18 Val_Wu16 65535.00 DFES_OneToOne 0.00 65535.00 FORMAT "%8.2" /end CHARACTERISTIC
/begin CHARACTERISTIC DFC_CtlMsk.DFC_ComCANABusOffErr_C "Behaviour control mask / Behaviour control masks of check DFC_ComCANABusOffErr" VALUE 0x804D8D1A Val_Wu16 65535.00 DFES_OneToOne 0.00 65535.00 FORMAT "%8.2" /end CHARACTERISTIC
/begin CHARACTERISTIC DFC_CtlMsk.DFC_ComCANBBusOffErr_C "Behaviour control mask / Behaviour control masks of check DFC_ComCANBBusOffErr" VALUE 0x804D8D1C Val_Wu16 65535.00 DFES_OneToOne 0.00 65535.00 FORMAT "%8.2" /end CHARACTERISTIC
/begin CHARACTERISTIC DFC_CtlMsk.DFC_ComCANCBusOffErr_C "Behaviour control mask / Behaviour control masks of check DFC_ComCANCBusOffErr" VALUE 0x804D8D1E Val_Wu16 65535.00 DFES_OneToOne 0.00 65535.00 FORMAT "%8.2" /end CHARACTERISTIC
/begin CHARACTERISTIC DFC_CtlMsk.DFC_ComCGW1ChkSum_C "Behaviour control mask / Behaviour control masks of check DFC_ComCGW1ChkSum" VALUE 0x804D8D20 Val_Wu16 65535.00 DFES_OneToOne 0.00 65535.00 FORMAT "%8.2" /end CHARACTERISTIC
/begin CHARACTERISTIC DFC_CtlMsk.DFC_ComCGW1RingCnt_C "Behaviour control mask / Behaviour control masks of check DFC_ComCGW1RingCnt" VALUE 0x804D8D22 Val_Wu16 65535.00 DFES_OneToOne 0.00 65535.00 FORMAT "%8.2" /end CHARACTERISTIC
/begin CHARACTERISTIC DFC_CtlMsk.DFC_ComCGW1TOut_C "Behaviour control mask / Behaviour control masks of check DFC_ComCGW1TOut" VALUE 0x804D8D24 Val_Wu16 65535.00 DFES_OneToOne 0.00 65535.00 FORMAT "%8.2" /end CHARACTERISTIC
/begin CHARACTERISTIC DFC_CtlMsk.DFC_ComConvBoostErr_C "Behaviour control mask / Behaviour control masks of check DFC_ComConvBoostErr" VALUE 0x804D8D26 Val_Wu16 65535.00 DFES_OneToOne 0.00 65535.00 FORMAT "%8.2" /end CHARACTERISTIC
/begin CHARACTERISTIC DFC_CtlMsk.DFC_ComConvSlipErr_C "Behaviour control mask / Behaviour control masks of check DFC_ComConvSlipErr" VALUE 0x804D8D28 Val_Wu16 65535.00 DFES_OneToOne 0.00 65535.00 FORMAT "%8.2" /end CHARACTERISTIC
/begin CHARACTERISTIC DFC_CtlMsk.DFC_ComDCDCPrfmncErr_C "Behaviour control mask / Behaviour control masks of check DFC_ComDCDCPrfmncErr" VALUE 0x804D8D2A Val_Wu16 65535.00 DFES_OneToOne 0.00 65535.00 FORMAT "%8.2" /end CHARACTERISTIC
/begin CHARACTERISTIC DFC_CtlMsk.DFC_ComDCDCTempWarn_C "Behaviour control mask / Behaviour control masks of check DFC_ComDCDCTempWarn" VALUE 0x804D8D2C Val_Wu16 65535.00 DFES_OneToOne 0.00 65535.00 FORMAT "%8.2" /end CHARACTERISTIC
/begin CHARACTERISTIC DFC_CtlMsk.DFC_ComEAT10Chksum_C "Behaviour control mask / Behaviour control masks of check DFC_ComEAT10Chksum" VALUE 0x804D8D2E Val_Wu16 65535.00 DFES_OneToOne 0.00 65535.00 FORMAT "%8.2" /end CHARACTERISTIC
/begin CHARACTERISTIC DFC_CtlMsk.DFC_ComEAT10RingCnt_C "Behaviour control mask / Behaviour control masks of check DFC_ComEAT10RingCnt" VALUE 0x804D8D30 Val_Wu16 65535.00 DFES_OneToOne 0.00 65535.00 FORMAT "%8.2" /end CHARACTERISTIC
/begin CHARACTERISTIC DFC_CtlMsk.DFC_ComEAT10TOut_C "Behaviour control mask / Behaviour control masks of check DFC_ComEAT10TOut" VALUE 0x804D8D32 Val_Wu16 65535.00 DFES_OneToOne 0.00 65535.00 FORMAT "%8.2" /end CHARACTERISTIC
/begin CHARACTERISTIC DFC_CtlMsk.DFC_ComEAT11ChkSum_C "Behaviour control mask / Behaviour control masks of check DFC_ComEAT11ChkSum" VALUE 0x804D8D34 Val_Wu16 65535.00 DFES_OneToOne 0.00 65535.00 FORMAT "%8.2" /end CHARACTERISTIC
/begin CHARACTERISTIC DFC_CtlMsk.DFC_ComEAT11RingCnt_C "Behaviour control mask / Behaviour control masks of check DFC_ComEAT11RingCnt" VALUE 0x804D8D36 Val_Wu16 65535.00 DFES_OneToOne 0.00 65535.00 FORMAT "%8.2" /end CHARACTERISTIC
/begin CHARACTERISTIC DFC_CtlMsk.DFC_ComEAT11TOut_C "Behaviour control mask / Behaviour control masks of check DFC_ComEAT11TOut" VALUE 0x804D8D38 Val_Wu16 65535.00 DFES_OneToOne 0.00 65535.00 FORMAT "%8.2" /end CHARACTERISTIC
/begin CHARACTERISTIC DFC_CtlMsk.DFC_ComEAT12ChkSum_C "Behaviour control mask / Behaviour control masks of check DFC_ComEAT12ChkSum" VALUE 0x804D8D3A Val_Wu16 65535.00 DFES_OneToOne 0.00 65535.00 FORMAT "%8.2" /end CHARACTERISTIC
/begin CHARACTERISTIC DFC_CtlMsk.DFC_ComEAT12RingCnt_C "Behaviour control mask / Behaviour control masks of check DFC_ComEAT12RingCnt" VALUE 0x804D8D3C Val_Wu16 65535.00 DFES_OneToOne 0.00 65535.00 FORMAT "%8.2" /end CHARACTERISTIC
/begin CHARACTERISTIC DFC_CtlMsk.DFC_ComEAT12TOut_C "Behaviour control mask / Behaviour control masks of check DFC_ComEAT12TOut" VALUE 0x804D8D3E Val_Wu16 65535.00 DFES_OneToOne 0.00 65535.00 FORMAT "%8.2" /end CHARACTERISTIC
/begin CHARACTERISTIC DFC_CtlMsk.DFC_ComEAT13ChkSum_C "Behaviour control mask / Behaviour control masks of check DFC_ComEAT13ChkSum" VALUE 0x804D8D40 Val_Wu16 65535.00 DFES_OneToOne 0.00 65535.00 FORMAT "%8.2" /end CHARACTERISTIC
/begin CHARACTERISTIC DFC_CtlMsk.DFC_ComEAT13RingCnt_C "Behaviour control mask / Behaviour control masks of check DFC_ComEAT13RingCnt" VALUE 0x804D8D42 Val_Wu16 65535.00 DFES_OneToOne 0.00 65535.00 FORMAT "%8.2" /end CHARACTERISTIC
/begin CHARACTERISTIC DFC_CtlMsk.DFC_ComEAT13TOut_C "Behaviour control mask / Behaviour control masks of check DFC_ComEAT13TOut" VALUE 0x804D8D44 Val_Wu16 65535.00 DFES_OneToOne 0.00 65535.00 FORMAT "%8.2" /end CHARACTERISTIC
/begin CHARACTERISTIC DFC_CtlMsk.DFC_ComEAT1Chksum_C "Behaviour control mask / Behaviour control masks of check DFC_ComEAT1Chksum" VALUE 0x804D8D46 Val_Wu16 65535.00 DFES_OneToOne 0.00 65535.00 FORMAT "%8.2" /end CHARACTERISTIC
/begin CHARACTERISTIC DFC_CtlMsk.DFC_ComEAT1RingCnt_C "Behaviour control mask / Behaviour control masks of check DFC_ComEAT1RingCnt" VALUE 0x804D8D48 Val_Wu16 65535.00 DFES_OneToOne 0.00 65535.00 FORMAT "%8.2" /end CHARACTERISTIC
/begin CHARACTERISTIC DFC_CtlMsk.DFC_ComEAT1TOut_C "Behaviour control mask / Behaviour control masks of check DFC_ComEAT1TOut" VALUE 0x804D8D4A Val_Wu16 65535.00 DFES_OneToOne 0.00 65535.00 FORMAT "%8.2" /end CHARACTERISTIC
/begin CHARACTERISTIC DFC_CtlMsk.DFC_ComEAT2ChkSum_C "Behaviour control mask / Behaviour control masks of check DFC_ComEAT2ChkSum" VALUE 0x804D8D4C Val_Wu16 65535.00 DFES_OneToOne 0.00 65535.00 FORMAT "%8.2" /end CHARACTERISTIC
/begin CHARACTERISTIC DFC_CtlMsk.DFC_ComEAT2RingCnt_C "Behaviour control mask / Behaviour control masks of check DFC_ComEAT2RingCnt" VALUE 0x804D8D4E Val_Wu16 65535.00 DFES_OneToOne 0.00 65535.00 FORMAT "%8.2" /end CHARACTERISTIC
/begin CHARACTERISTIC DFC_CtlMsk.DFC_ComEAT2TOut_C "Behaviour control mask / Behaviour control masks of check DFC_ComEAT2TOut" VALUE 0x804D8D50 Val_Wu16 65535.00 DFES_OneToOne 0.00 65535.00 FORMAT "%8.2" /end CHARACTERISTIC
/begin CHARACTERISTIC DFC_CtlMsk.DFC_ComEAT4ChkSum_C "Behaviour control mask / Behaviour control masks of check DFC_ComEAT4ChkSum" VALUE 0x804D8D52 Val_Wu16 65535.00 DFES_OneToOne 0.00 65535.00 FORMAT "%8.2" /end CHARACTERISTIC
/begin CHARACTERISTIC DFC_CtlMsk.DFC_ComEAT4RingCnt_C "Behaviour control mask / Behaviour control masks of check DFC_ComEAT4RingCnt" VALUE 0x804D8D54 Val_Wu16 65535.00 DFES_OneToOne 0.00 65535.00 FORMAT "%8.2" /end CHARACTERISTIC
/begin CHARACTERISTIC DFC_CtlMsk.DFC_ComEAT4TOut_C "Behaviour control mask / Behaviour control masks of check DFC_ComEAT4TOut" VALUE 0x804D8D56 Val_Wu16 65535.00 DFES_OneToOne 0.00 65535.00 FORMAT "%8.2" /end CHARACTERISTIC
/begin CHARACTERISTIC DFC_CtlMsk.DFC_ComEAT6Chksum_C "Behaviour control mask / Behaviour control masks of check DFC_ComEAT6Chksum" VALUE 0x804D8D58 Val_Wu16 65535.00 DFES_OneToOne 0.00 65535.00 FORMAT "%8.2" /end CHARACTERISTIC
/begin CHARACTERISTIC DFC_CtlMsk.DFC_ComEAT6RingCnt_C "Behaviour control mask / Behaviour control masks of check DFC_ComEAT6RingCnt" VALUE 0x804D8D5A Val_Wu16 65535.00 DFES_OneToOne 0.00 65535.00 FORMAT "%8.2" /end CHARACTERISTIC
/begin CHARACTERISTIC DFC_CtlMsk.DFC_ComEAT6TOut_C "Behaviour control mask / Behaviour control masks of check DFC_ComEAT6TOut" VALUE 0x804D8D5C Val_Wu16 65535.00 DFES_OneToOne 0.00 65535.00 FORMAT "%8.2" /end CHARACTERISTIC
/begin CHARACTERISTIC DFC_CtlMsk.DFC_ComEAT7Chksum_C "Behaviour control mask / Behaviour control masks of check DFC_ComEAT7Chksum" VALUE 0x804D8D5E Val_Wu16 65535.00 DFES_OneToOne 0.00 65535.00 FORMAT "%8.2" /end CHARACTERISTIC
/begin CHARACTERISTIC DFC_CtlMsk.DFC_ComEAT7RingCnt_C "Behaviour control mask / Behaviour control masks of check DFC_ComEAT7RingCnt" VALUE 0x804D8D60 Val_Wu16 65535.00 DFES_OneToOne 0.00 65535.00 FORMAT "%8.2" /end CHARACTERISTIC
/begin CHARACTERISTIC DFC_CtlMsk.DFC_ComEAT7TOut_C "Behaviour control mask / Behaviour control masks of check DFC_ComEAT7TOut" VALUE 0x804D8D62 Val_Wu16 65535.00 DFES_OneToOne 0.00 65535.00 FORMAT "%8.2" /end CHARACTERISTIC
/begin CHARACTERISTIC DFC_CtlMsk.DFC_ComEAT8Chksum_C "Behaviour control mask / Behaviour control masks of check DFC_ComEAT8Chksum" VALUE 0x804D8D64 Val_Wu16 65535.00 DFES_OneToOne 0.00 65535.00 FORMAT "%8.2" /end CHARACTERISTIC
/begin CHARACTERISTIC DFC_CtlMsk.DFC_ComEAT8RingCnt_C "Behaviour control mask / Behaviour control masks of check DFC_ComEAT8RingCnt" VALUE 0x804D8D66 Val_Wu16 65535.00 DFES_OneToOne 0.00 65535.00 FORMAT "%8.2" /end CHARACTERISTIC
/begin CHARACTERISTIC DFC_CtlMsk.DFC_ComEAT8TOut_C "Behaviour control mask / Behaviour control masks of check DFC_ComEAT8TOut" VALUE 0x804D8D68 Val_Wu16 65535.00 DFES_OneToOne 0.00 65535.00 FORMAT "%8.2" /end CHARACTERISTIC
/begin CHARACTERISTIC DFC_CtlMsk.DFC_ComEATAChksum_C "Behaviour control mask / Behaviour control masks of check DFC_ComEATAChksum" VALUE 0x804D8D6A Val_Wu16 65535.00 DFES_OneToOne 0.00 65535.00 FORMAT "%8.2" /end CHARACTERISTIC
/begin CHARACTERISTIC DFC_CtlMsk.DFC_ComEATARingCnt_C "Behaviour control mask / Behaviour control masks of check DFC_ComEATARingCnt" VALUE 0x804D8D6C Val_Wu16 65535.00 DFES_OneToOne 0.00 65535.00 FORMAT "%8.2" /end CHARACTERISTIC
/begin CHARACTERISTIC DFC_CtlMsk.DFC_ComEATATOut_C "Behaviour control mask / Behaviour control masks of check DFC_ComEATATOut" VALUE 0x804D8D6E Val_Wu16 65535.00 DFES_OneToOne 0.00 65535.00 FORMAT "%8.2" /end CHARACTERISTIC
/begin CHARACTERISTIC DFC_CtlMsk.DFC_ComEATBChkSum_C "Behaviour control mask / Behaviour control masks of check DFC_ComEATBChkSum" VALUE 0x804D8D70 Val_Wu16 65535.00 DFES_OneToOne 0.00 65535.00 FORMAT "%8.2" /end CHARACTERISTIC
/begin CHARACTERISTIC DFC_CtlMsk.DFC_ComEATBRingCnt_C "Behaviour control mask / Behaviour control masks of check DFC_ComEATBRingCnt" VALUE 0x804D8D72 Val_Wu16 65535.00 DFES_OneToOne 0.00 65535.00 FORMAT "%8.2" /end CHARACTERISTIC
/begin CHARACTERISTIC DFC_CtlMsk.DFC_ComEATBTOut_C "Behaviour control mask / Behaviour control masks of check DFC_ComEATBTOut" VALUE 0x804D8D74 Val_Wu16 65535.00 DFES_OneToOne 0.00 65535.00 FORMAT "%8.2" /end CHARACTERISTIC
/begin CHARACTERISTIC DFC_CtlMsk.DFC_ComEATCChksum_C "Behaviour control mask / Behaviour control masks of check DFC_ComEATCChksum" VALUE 0x804D8D76 Val_Wu16 65535.00 DFES_OneToOne 0.00 65535.00 FORMAT "%8.2" /end CHARACTERISTIC
/begin CHARACTERISTIC DFC_CtlMsk.DFC_ComEATCRingCnt_C "Behaviour control mask / Behaviour control masks of check DFC_ComEATCRingCnt" VALUE 0x804D8D78 Val_Wu16 65535.00 DFES_OneToOne 0.00 65535.00 FORMAT "%8.2" /end CHARACTERISTIC
/begin CHARACTERISTIC DFC_CtlMsk.DFC_ComEATCTOut_C "Behaviour control mask / Behaviour control masks of check DFC_ComEATCTOut" VALUE 0x804D8D7A Val_Wu16 65535.00 DFES_OneToOne 0.00 65535.00 FORMAT "%8.2" /end CHARACTERISTIC
/begin CHARACTERISTIC DFC_CtlMsk.DFC_ComEPBBChkSum_C "Behaviour control mask / Behaviour control masks of check DFC_ComEPBBChkSum" VALUE 0x804D8D7C Val_Wu16 65535.00 DFES_OneToOne 0.00 65535.00 FORMAT "%8.2" /end CHARACTERISTIC
/begin CHARACTERISTIC DFC_CtlMsk.DFC_ComEPBBRingCnt_C "Behaviour control mask / Behaviour control masks of check DFC_ComEPBBRingCnt" VALUE 0x804D8D7E Val_Wu16 65535.00 DFES_OneToOne 0.00 65535.00 FORMAT "%8.2" /end CHARACTERISTIC
/begin CHARACTERISTIC DFC_CtlMsk.DFC_ComEPBBTOut_C "Behaviour control mask / Behaviour control masks of check DFC_ComEPBBTOut" VALUE 0x804D8D80 Val_Wu16 65535.00 DFES_OneToOne 0.00 65535.00 FORMAT "%8.2" /end CHARACTERISTIC
/begin CHARACTERISTIC DFC_CtlMsk.DFC_ComEPBChksum_C "Behaviour control mask / Behaviour control masks of check DFC_ComEPBChksum" VALUE 0x804D8D82 Val_Wu16 65535.00 DFES_OneToOne 0.00 65535.00 FORMAT "%8.2" /end CHARACTERISTIC
/begin CHARACTERISTIC DFC_CtlMsk.DFC_ComEPBTOut_C "Behaviour control mask / Behaviour control masks of check DFC_ComEPBTOut" VALUE 0x804D8D84 Val_Wu16 65535.00 DFES_OneToOne 0.00 65535.00 FORMAT "%8.2" /end CHARACTERISTIC
/begin CHARACTERISTIC DFC_CtlMsk.DFC_ComEPBctRing_C "Behaviour control mask / Behaviour control masks of check DFC_ComEPBctRing" VALUE 0x804D8D86 Val_Wu16 65535.00 DFES_OneToOne 0.00 65535.00 FORMAT "%8.2" /end CHARACTERISTIC
/begin CHARACTERISTIC DFC_CtlMsk.DFC_ComEPS1Chksum_C "Behaviour control mask / Behaviour control masks of check DFC_ComEPS1Chksum" VALUE 0x804D8D88 Val_Wu16 65535.00 DFES_OneToOne 0.00 65535.00 FORMAT "%8.2" /end CHARACTERISTIC
/begin CHARACTERISTIC DFC_CtlMsk.DFC_ComEPS1RingCnt_C "Behaviour control mask / Behaviour control masks of check DFC_ComEPS1RingCnt" VALUE 0x804D8D8A Val_Wu16 65535.00 DFES_OneToOne 0.00 65535.00 FORMAT "%8.2" /end CHARACTERISTIC
/begin CHARACTERISTIC DFC_CtlMsk.DFC_ComEPS1TOut_C "Behaviour control mask / Behaviour control masks of check DFC_ComEPS1TOut" VALUE 0x804D8D8C Val_Wu16 65535.00 DFES_OneToOne 0.00 65535.00 FORMAT "%8.2" /end CHARACTERISTIC
/begin CHARACTERISTIC DFC_CtlMsk.DFC_ComEngCanRxErr_C "Behaviour control mask / Behaviour control masks of check DFC_ComEngCanRxErr" VALUE 0x804D8D8E Val_Wu16 65535.00 DFES_OneToOne 0.00 65535.00 FORMAT "%8.2" /end CHARACTERISTIC
/begin CHARACTERISTIC DFC_CtlMsk.DFC_ComGrvySnsrErr_C "Behaviour control mask / Behaviour control masks of check DFC_ComGrvySnsrErr" VALUE 0x804D8D90 Val_Wu16 65535.00 DFES_OneToOne 0.00 65535.00 FORMAT "%8.2" /end CHARACTERISTIC
/begin CHARACTERISTIC DFC_CtlMsk.DFC_ComGwIMG1ChkSum_C "Behaviour control mask / Behaviour control masks of check DFC_ComGwIMG1ChkSum" VALUE 0x804D8D92 Val_Wu16 65535.00 DFES_OneToOne 0.00 65535.00 FORMAT "%8.2" /end CHARACTERISTIC
/begin CHARACTERISTIC DFC_CtlMsk.DFC_ComGwIMG1RingCnt_C "Behaviour control mask / Behaviour control masks of check DFC_ComGwIMG1RingCnt" VALUE 0x804D8D94 Val_Wu16 65535.00 DFES_OneToOne 0.00 65535.00 FORMAT "%8.2" /end CHARACTERISTIC
/begin CHARACTERISTIC DFC_CtlMsk.DFC_ComGwIMG1TOut_C "Behaviour control mask / Behaviour control masks of check DFC_ComGwIMG1TOut" VALUE 0x804D8D96 Val_Wu16 65535.00 DFES_OneToOne 0.00 65535.00 FORMAT "%8.2" /end CHARACTERISTIC
/begin CHARACTERISTIC DFC_CtlMsk.DFC_ComGwIMG3ChkSum_C "Behaviour control mask / Behaviour control masks of check DFC_ComGwIMG3ChkSum" VALUE 0x804D8D98 Val_Wu16 65535.00 DFES_OneToOne 0.00 65535.00 FORMAT "%8.2" /end CHARACTERISTIC
/begin CHARACTERISTIC DFC_CtlMsk.DFC_ComGwIMG3RingCnt_C "Behaviour control mask / Behaviour control masks of check DFC_ComGwIMG3RingCnt" VALUE 0x804D8D9A Val_Wu16 65535.00 DFES_OneToOne 0.00 65535.00 FORMAT "%8.2" /end CHARACTERISTIC
/begin CHARACTERISTIC DFC_CtlMsk.DFC_ComGwIMG3TOut_C "Behaviour control mask / Behaviour control masks of check DFC_ComGwIMG3TOut" VALUE 0x804D8D9C Val_Wu16 65535.00 DFES_OneToOne 0.00 65535.00 FORMAT "%8.2" /end CHARACTERISTIC
/begin CHARACTERISTIC DFC_CtlMsk.DFC_ComGwIMG4ChkSum_C "Behaviour control mask / Behaviour control masks of check DFC_ComGwIMG4ChkSum" VALUE 0x804D8D9E Val_Wu16 65535.00 DFES_OneToOne 0.00 65535.00 FORMAT "%8.2" /end CHARACTERISTIC
/begin CHARACTERISTIC DFC_CtlMsk.DFC_ComGwIMG4RingCnt_C "Behaviour control mask / Behaviour control masks of check DFC_ComGwIMG4RingCnt" VALUE 0x804D8DA0 Val_Wu16 65535.00 DFES_OneToOne 0.00 65535.00 FORMAT "%8.2" /end CHARACTERISTIC
/begin CHARACTERISTIC DFC_CtlMsk.DFC_ComGwIMG4TOut_C "Behaviour control mask / Behaviour control masks of check DFC_ComGwIMG4TOut" VALUE 0x804D8DA2 Val_Wu16 65535.00 DFES_OneToOne 0.00 65535.00 FORMAT "%8.2" /end CHARACTERISTIC
/begin CHARACTERISTIC DFC_CtlMsk.DFC_ComGwIMG5ChkSum_C "Behaviour control mask / Behaviour control masks of check DFC_ComGwIMG5ChkSum" VALUE 0x804D8DA4 Val_Wu16 65535.00 DFES_OneToOne 0.00 65535.00 FORMAT "%8.2" /end CHARACTERISTIC
/begin CHARACTERISTIC DFC_CtlMsk.DFC_ComGwIMG5RingCnt_C "Behaviour control mask / Behaviour control masks of check DFC_ComGwIMG5RingCnt" VALUE 0x804D8DA6 Val_Wu16 65535.00 DFES_OneToOne 0.00 65535.00 FORMAT "%8.2" /end CHARACTERISTIC
/begin CHARACTERISTIC DFC_CtlMsk.DFC_ComGwIMG5TOut_C "Behaviour control mask / Behaviour control masks of check DFC_ComGwIMG5TOut" VALUE 0x804D8DA8 Val_Wu16 65535.00 DFES_OneToOne 0.00 65535.00 FORMAT "%8.2" /end CHARACTERISTIC
/begin CHARACTERISTIC DFC_CtlMsk.DFC_ComGwIMG6ChkSum_C "Behaviour control mask / Behaviour control masks of check DFC_ComGwIMG6ChkSum" VALUE 0x804D8DAA Val_Wu16 65535.00 DFES_OneToOne 0.00 65535.00 FORMAT "%8.2" /end CHARACTERISTIC
/begin CHARACTERISTIC DFC_CtlMsk.DFC_ComGwIMG6RingCnt_C "Behaviour control mask / Behaviour control masks of check DFC_ComGwIMG6RingCnt" VALUE 0x804D8DAC Val_Wu16 65535.00 DFES_OneToOne 0.00 65535.00 FORMAT "%8.2" /end CHARACTERISTIC
/begin CHARACTERISTIC DFC_CtlMsk.DFC_ComGwIMG6TOut_C "Behaviour control mask / Behaviour control masks of check DFC_ComGwIMG6TOut" VALUE 0x804D8DAE Val_Wu16 65535.00 DFES_OneToOne 0.00 65535.00 FORMAT "%8.2" /end CHARACTERISTIC
/begin CHARACTERISTIC DFC_CtlMsk.DFC_ComIDASBChksum_C "Behaviour control mask / Behaviour control masks of check DFC_ComIDASBChksum" VALUE 0x804D8DB0 Val_Wu16 65535.00 DFES_OneToOne 0.00 65535.00 FORMAT "%8.2" /end CHARACTERISTIC
/begin CHARACTERISTIC DFC_CtlMsk.DFC_ComIDASBRingCnt_C "Behaviour control mask / Behaviour control masks of check DFC_ComIDASBRingCnt" VALUE 0x804D8DB2 Val_Wu16 65535.00 DFES_OneToOne 0.00 65535.00 FORMAT "%8.2" /end CHARACTERISTIC
/begin CHARACTERISTIC DFC_CtlMsk.DFC_ComIDASBTOut_C "Behaviour control mask / Behaviour control masks of check DFC_ComIDASBTOut" VALUE 0x804D8DB4 Val_Wu16 65535.00 DFES_OneToOne 0.00 65535.00 FORMAT "%8.2" /end CHARACTERISTIC
/begin CHARACTERISTIC DFC_CtlMsk.DFC_ComIMGMILReq_C "Behaviour control mask / Behaviour control masks of check DFC_ComIMGMILReq" VALUE 0x804D8DB6 Val_Wu16 65535.00 DFES_OneToOne 0.00 65535.00 FORMAT "%8.2" /end CHARACTERISTIC
/begin CHARACTERISTIC DFC_CtlMsk.DFC_ComISSPrms_C "Behaviour control mask / Behaviour control masks of check DFC_ComISSPrms" VALUE 0x804D8DB8 Val_Wu16 65535.00 DFES_OneToOne 0.00 65535.00 FORMAT "%8.2" /end CHARACTERISTIC
/begin CHARACTERISTIC DFC_CtlMsk.DFC_ComMETAChksum_C "Behaviour control mask / Behaviour control masks of check DFC_ComMETAChksum" VALUE 0x804D8DBA Val_Wu16 65535.00 DFES_OneToOne 0.00 65535.00 FORMAT "%8.2" /end CHARACTERISTIC
/begin CHARACTERISTIC DFC_CtlMsk.DFC_ComMETAChksumPstDrv_C "Behaviour control mask / Behaviour control masks of check DFC_ComMETAChksumPstDrv" VALUE 0x804D8DBC Val_Wu16 65535.00 DFES_OneToOne 0.00 65535.00 FORMAT "%8.2" /end CHARACTERISTIC
/begin CHARACTERISTIC DFC_CtlMsk.DFC_ComMETARingCnt_C "Behaviour control mask / Behaviour control masks of check DFC_ComMETARingCnt" VALUE 0x804D8DBE Val_Wu16 65535.00 DFES_OneToOne 0.00 65535.00 FORMAT "%8.2" /end CHARACTERISTIC
/begin CHARACTERISTIC DFC_CtlMsk.DFC_ComMETARingCntPstDrv_C "Behaviour control mask / Behaviour control masks of check DFC_ComMETARingCntPstDrv" VALUE 0x804D8DC0 Val_Wu16 65535.00 DFES_OneToOne 0.00 65535.00 FORMAT "%8.2" /end CHARACTERISTIC
/begin CHARACTERISTIC DFC_CtlMsk.DFC_ComMETATOut_C "Behaviour control mask / Behaviour control masks of check DFC_ComMETATOut" VALUE 0x804D8DC2 Val_Wu16 65535.00 DFES_OneToOne 0.00 65535.00 FORMAT "%8.2" /end CHARACTERISTIC
/begin CHARACTERISTIC DFC_CtlMsk.DFC_ComMETATOutPstDrv_C "Behaviour control mask / Behaviour control masks of check DFC_ComMETATOutPstDrv" VALUE 0x804D8DC4 Val_Wu16 65535.00 DFES_OneToOne 0.00 65535.00 FORMAT "%8.2" /end CHARACTERISTIC
/begin CHARACTERISTIC DFC_CtlMsk.DFC_ComMETCChksum_C "Behaviour control mask / Behaviour control masks of check DFC_ComMETCChksum" VALUE 0x804D8DC6 Val_Wu16 65535.00 DFES_OneToOne 0.00 65535.00 FORMAT "%8.2" /end CHARACTERISTIC
/begin CHARACTERISTIC DFC_CtlMsk.DFC_ComMETCRingCnt_C "Behaviour control mask / Behaviour control masks of check DFC_ComMETCRingCnt" VALUE 0x804D8DC8 Val_Wu16 65535.00 DFES_OneToOne 0.00 65535.00 FORMAT "%8.2" /end CHARACTERISTIC
/begin CHARACTERISTIC DFC_CtlMsk.DFC_ComMETCTOut_C "Behaviour control mask / Behaviour control masks of check DFC_ComMETCTOut" VALUE 0x804D8DCA Val_Wu16 65535.00 DFES_OneToOne 0.00 65535.00 FORMAT "%8.2" /end CHARACTERISTIC
/begin CHARACTERISTIC DFC_CtlMsk.DFC_ComMETDChksum_C "Behaviour control mask / Behaviour control masks of check DFC_ComMETDChksum" VALUE 0x804D8DCC Val_Wu16 65535.00 DFES_OneToOne 0.00 65535.00 FORMAT "%8.2" /end CHARACTERISTIC
/begin CHARACTERISTIC DFC_CtlMsk.DFC_ComMETDRingCnt_C "Behaviour control mask / Behaviour control masks of check DFC_ComMETDRingCnt" VALUE 0x804D8DCE Val_Wu16 65535.00 DFES_OneToOne 0.00 65535.00 FORMAT "%8.2" /end CHARACTERISTIC
/begin CHARACTERISTIC DFC_CtlMsk.DFC_ComMETDTOut_C "Behaviour control mask / Behaviour control masks of check DFC_ComMETDTOut" VALUE 0x804D8DD0 Val_Wu16 65535.00 DFES_OneToOne 0.00 65535.00 FORMAT "%8.2" /end CHARACTERISTIC
/begin CHARACTERISTIC DFC_CtlMsk.DFC_ComMETE2Chksum_C "Behaviour control mask / Behaviour control masks of check DFC_ComMETE2Chksum" VALUE 0x804D8DD2 Val_Wu16 65535.00 DFES_OneToOne 0.00 65535.00 FORMAT "%8.2" /end CHARACTERISTIC
/begin CHARACTERISTIC DFC_CtlMsk.DFC_ComMETE2RingCnt_C "Behaviour control mask / Behaviour control masks of check DFC_ComMETE2RingCnt" VALUE 0x804D8DD4 Val_Wu16 65535.00 DFES_OneToOne 0.00 65535.00 FORMAT "%8.2" /end CHARACTERISTIC
/begin CHARACTERISTIC DFC_CtlMsk.DFC_ComMETE2TOut_C "Behaviour control mask / Behaviour control masks of check DFC_ComMETE2TOut" VALUE 0x804D8DD6 Val_Wu16 65535.00 DFES_OneToOne 0.00 65535.00 FORMAT "%8.2" /end CHARACTERISTIC
/begin CHARACTERISTIC DFC_CtlMsk.DFC_ComMETFChksum_C "Behaviour control mask / Behaviour control masks of check DFC_ComMETFChksum" VALUE 0x804D8DD8 Val_Wu16 65535.00 DFES_OneToOne 0.00 65535.00 FORMAT "%8.2" /end CHARACTERISTIC
/begin CHARACTERISTIC DFC_CtlMsk.DFC_ComMETFRingCnt_C "Behaviour control mask / Behaviour control masks of check DFC_ComMETFRingCnt" VALUE 0x804D8DDA Val_Wu16 65535.00 DFES_OneToOne 0.00 65535.00 FORMAT "%8.2" /end CHARACTERISTIC
/begin CHARACTERISTIC DFC_CtlMsk.DFC_ComMETFTOut_C "Behaviour control mask / Behaviour control masks of check DFC_ComMETFTOut" VALUE 0x804D8DDC Val_Wu16 65535.00 DFES_OneToOne 0.00 65535.00 FORMAT "%8.2" /end CHARACTERISTIC
/begin CHARACTERISTIC DFC_CtlMsk.DFC_ComMETGChksum_C "Behaviour control mask / Behaviour control masks of check DFC_ComMETGChksum" VALUE 0x804D8DDE Val_Wu16 65535.00 DFES_OneToOne 0.00 65535.00 FORMAT "%8.2" /end CHARACTERISTIC
/begin CHARACTERISTIC DFC_CtlMsk.DFC_ComMETGRingCnt_C "Behaviour control mask / Behaviour control masks of check DFC_ComMETGRingCnt" VALUE 0x804D8DE0 Val_Wu16 65535.00 DFES_OneToOne 0.00 65535.00 FORMAT "%8.2" /end CHARACTERISTIC
/begin CHARACTERISTIC DFC_CtlMsk.DFC_ComMETGTOut_C "Behaviour control mask / Behaviour control masks of check DFC_ComMETGTOut" VALUE 0x804D8DE2 Val_Wu16 65535.00 DFES_OneToOne 0.00 65535.00 FORMAT "%8.2" /end CHARACTERISTIC
/begin CHARACTERISTIC DFC_CtlMsk.DFC_ComMETH2Chksum_C "Behaviour control mask / Behaviour control masks of check DFC_ComMETH2Chksum" VALUE 0x804D8DE4 Val_Wu16 65535.00 DFES_OneToOne 0.00 65535.00 FORMAT "%8.2" /end CHARACTERISTIC
/begin CHARACTERISTIC DFC_CtlMsk.DFC_ComMETH2RingCnt_C "Behaviour control mask / Behaviour control masks of check DFC_ComMETH2RingCnt" VALUE 0x804D8DE6 Val_Wu16 65535.00 DFES_OneToOne 0.00 65535.00 FORMAT "%8.2" /end CHARACTERISTIC
/begin CHARACTERISTIC DFC_CtlMsk.DFC_ComMETH2TOut_C "Behaviour control mask / Behaviour control masks of check DFC_ComMETH2TOut" VALUE 0x804D8DE8 Val_Wu16 65535.00 DFES_OneToOne 0.00 65535.00 FORMAT "%8.2" /end CHARACTERISTIC
/begin CHARACTERISTIC DFC_CtlMsk.DFC_ComMETHChksum_C "Behaviour control mask / Behaviour control masks of check DFC_ComMETHChksum" VALUE 0x804D8DEA Val_Wu16 65535.00 DFES_OneToOne 0.00 65535.00 FORMAT "%8.2" /end CHARACTERISTIC
/begin CHARACTERISTIC DFC_CtlMsk.DFC_ComMETHRingCnt_C "Behaviour control mask / Behaviour control masks of check DFC_ComMETHRingCnt" VALUE 0x804D8DEC Val_Wu16 65535.00 DFES_OneToOne 0.00 65535.00 FORMAT "%8.2" /end CHARACTERISTIC
/begin CHARACTERISTIC DFC_CtlMsk.DFC_ComMETHTOut_C "Behaviour control mask / Behaviour control masks of check DFC_ComMETHTOut" VALUE 0x804D8DEE Val_Wu16 65535.00 DFES_OneToOne 0.00 65535.00 FORMAT "%8.2" /end CHARACTERISTIC
/begin CHARACTERISTIC DFC_CtlMsk.DFC_ComMETIChksum_C "Behaviour control mask / Behaviour control masks of check DFC_ComMETIChksum" VALUE 0x804D8DF0 Val_Wu16 65535.00 DFES_OneToOne 0.00 65535.00 FORMAT "%8.2" /end CHARACTERISTIC
/begin CHARACTERISTIC DFC_CtlMsk.DFC_ComMETIRingCnt_C "Behaviour control mask / Behaviour control masks of check DFC_ComMETIRingCnt" VALUE 0x804D8DF2 Val_Wu16 65535.00 DFES_OneToOne 0.00 65535.00 FORMAT "%8.2" /end CHARACTERISTIC
/begin CHARACTERISTIC DFC_CtlMsk.DFC_ComMETITOut_C "Behaviour control mask / Behaviour control masks of check DFC_ComMETITOut" VALUE 0x804D8DF4 Val_Wu16 65535.00 DFES_OneToOne 0.00 65535.00 FORMAT "%8.2" /end CHARACTERISTIC
/begin CHARACTERISTIC DFC_CtlMsk.DFC_ComMETKChksum_C "Behaviour control mask / Behaviour control masks of check DFC_ComMETKChksum" VALUE 0x804D8DF6 Val_Wu16 65535.00 DFES_OneToOne 0.00 65535.00 FORMAT "%8.2" /end CHARACTERISTIC
/begin CHARACTERISTIC DFC_CtlMsk.DFC_ComMETKRingCnt_C "Behaviour control mask / Behaviour control masks of check DFC_ComMETKRingCnt" VALUE 0x804D8DF8 Val_Wu16 65535.00 DFES_OneToOne 0.00 65535.00 FORMAT "%8.2" /end CHARACTERISTIC
/begin CHARACTERISTIC DFC_CtlMsk.DFC_ComMETKTOut_C "Behaviour control mask / Behaviour control masks of check DFC_ComMETKTOut" VALUE 0x804D8DFA Val_Wu16 65535.00 DFES_OneToOne 0.00 65535.00 FORMAT "%8.2" /end CHARACTERISTIC
/begin CHARACTERISTIC DFC_CtlMsk.DFC_ComMETLChksum_C "Behaviour control mask / Behaviour control masks of check DFC_ComMETLChksum" VALUE 0x804D8DFC Val_Wu16 65535.00 DFES_OneToOne 0.00 65535.00 FORMAT "%8.2" /end CHARACTERISTIC
/begin CHARACTERISTIC DFC_CtlMsk.DFC_ComMETLRingCnt_C "Behaviour control mask / Behaviour control masks of check DFC_ComMETLRingCnt" VALUE 0x804D8DFE Val_Wu16 65535.00 DFES_OneToOne 0.00 65535.00 FORMAT "%8.2" /end CHARACTERISTIC
/begin CHARACTERISTIC DFC_CtlMsk.DFC_ComMETLTOut_C "Behaviour control mask / Behaviour control masks of check DFC_ComMETLTOut" VALUE 0x804D8E00 Val_Wu16 65535.00 DFES_OneToOne 0.00 65535.00 FORMAT "%8.2" /end CHARACTERISTIC
/begin CHARACTERISTIC DFC_CtlMsk.DFC_ComMETMChksum_C "Behaviour control mask / Behaviour control masks of check DFC_ComMETMChksum" VALUE 0x804D8E02 Val_Wu16 65535.00 DFES_OneToOne 0.00 65535.00 FORMAT "%8.2" /end CHARACTERISTIC
/begin CHARACTERISTIC DFC_CtlMsk.DFC_ComMETMRingCnt_C "Behaviour control mask / Behaviour control masks of check DFC_ComMETMRingCnt" VALUE 0x804D8E04 Val_Wu16 65535.00 DFES_OneToOne 0.00 65535.00 FORMAT "%8.2" /end CHARACTERISTIC
/begin CHARACTERISTIC DFC_CtlMsk.DFC_ComMETMTOut_C "Behaviour control mask / Behaviour control masks of check DFC_ComMETMTOut" VALUE 0x804D8E06 Val_Wu16 65535.00 DFES_OneToOne 0.00 65535.00 FORMAT "%8.2" /end CHARACTERISTIC
/begin CHARACTERISTIC DFC_CtlMsk.DFC_ComMETNChksum_C "Behaviour control mask / Behaviour control masks of check DFC_ComMETNChksum" VALUE 0x804D8E08 Val_Wu16 65535.00 DFES_OneToOne 0.00 65535.00 FORMAT "%8.2" /end CHARACTERISTIC
/begin CHARACTERISTIC DFC_CtlMsk.DFC_ComMETNRingCnt_C "Behaviour control mask / Behaviour control masks of check DFC_ComMETNRingCnt" VALUE 0x804D8E0A Val_Wu16 65535.00 DFES_OneToOne 0.00 65535.00 FORMAT "%8.2" /end CHARACTERISTIC
/begin CHARACTERISTIC DFC_CtlMsk.DFC_ComMETNTOut_C "Behaviour control mask / Behaviour control masks of check DFC_ComMETNTOut" VALUE 0x804D8E0C Val_Wu16 65535.00 DFES_OneToOne 0.00 65535.00 FORMAT "%8.2" /end CHARACTERISTIC
/begin CHARACTERISTIC DFC_CtlMsk.DFC_ComMtrCom_C "Behaviour control mask / Behaviour control masks of check DFC_ComMtrCom" VALUE 0x804D8E0E Val_Wu16 65535.00 DFES_OneToOne 0.00 65535.00 FORMAT "%8.2" /end CHARACTERISTIC
/begin CHARACTERISTIC DFC_CtlMsk.DFC_ComPCUChkSum_C "Behaviour control mask / Behaviour control masks of check DFC_ComPCUChkSum" VALUE 0x804D8E10 Val_Wu16 65535.00 DFES_OneToOne 0.00 65535.00 FORMAT "%8.2" /end CHARACTERISTIC
/begin CHARACTERISTIC DFC_CtlMsk.DFC_ComPCURingCnt_C "Behaviour control mask / Behaviour control masks of check DFC_ComPCURingCnt" VALUE 0x804D8E12 Val_Wu16 65535.00 DFES_OneToOne 0.00 65535.00 FORMAT "%8.2" /end CHARACTERISTIC
/begin CHARACTERISTIC DFC_CtlMsk.DFC_ComPCUTOut_C "Behaviour control mask / Behaviour control masks of check DFC_ComPCUTOut" VALUE 0x804D8E14 Val_Wu16 65535.00 DFES_OneToOne 0.00 65535.00 FORMAT "%8.2" /end CHARACTERISTIC
/begin CHARACTERISTIC DFC_CtlMsk.DFC_ComSRSAChksum_C "Behaviour control mask / Behaviour control masks of check DFC_ComSRSAChksum" VALUE 0x804D8E16 Val_Wu16 65535.00 DFES_OneToOne 0.00 65535.00 FORMAT "%8.2" /end CHARACTERISTIC
/begin CHARACTERISTIC DFC_CtlMsk.DFC_ComSRSARingCnt_C "Behaviour control mask / Behaviour control masks of check DFC_ComSRSARingCnt" VALUE 0x804D8E18 Val_Wu16 65535.00 DFES_OneToOne 0.00 65535.00 FORMAT "%8.2" /end CHARACTERISTIC
/begin CHARACTERISTIC DFC_CtlMsk.DFC_ComSRSATOut_C "Behaviour control mask / Behaviour control masks of check DFC_ComSRSATOut" VALUE 0x804D8E1A Val_Wu16 65535.00 DFES_OneToOne 0.00 65535.00 FORMAT "%8.2" /end CHARACTERISTIC
/begin CHARACTERISTIC DFC_CtlMsk.DFC_ComSRSBChksum_C "Behaviour control mask / Behaviour control masks of check DFC_ComSRSBChksum" VALUE 0x804D8E1C Val_Wu16 65535.00 DFES_OneToOne 0.00 65535.00 FORMAT "%8.2" /end CHARACTERISTIC
/begin CHARACTERISTIC DFC_CtlMsk.DFC_ComSRSBRingCnt_C "Behaviour control mask / Behaviour control masks of check DFC_ComSRSBRingCnt" VALUE 0x804D8E1E Val_Wu16 65535.00 DFES_OneToOne 0.00 65535.00 FORMAT "%8.2" /end CHARACTERISTIC
/begin CHARACTERISTIC DFC_CtlMsk.DFC_ComSRSBTOut_C "Behaviour control mask / Behaviour control masks of check DFC_ComSRSBTOut" VALUE 0x804D8E20 Val_Wu16 65535.00 DFES_OneToOne 0.00 65535.00 FORMAT "%8.2" /end CHARACTERISTIC
/begin CHARACTERISTIC DFC_CtlMsk.DFC_ComSRSChksum_C "Behaviour control mask / Behaviour control masks of check DFC_ComSRSChksum" VALUE 0x804D8E22 Val_Wu16 65535.00 DFES_OneToOne 0.00 65535.00 FORMAT "%8.2" /end CHARACTERISTIC
/begin CHARACTERISTIC DFC_CtlMsk.DFC_ComSRSErr_C "Behaviour control mask / Behaviour control masks of check DFC_ComSRSErr" VALUE 0x804D8E24 Val_Wu16 65535.00 DFES_OneToOne 0.00 65535.00 FORMAT "%8.2" /end CHARACTERISTIC
/begin CHARACTERISTIC DFC_CtlMsk.DFC_ComSRSRingCnt_C "Behaviour control mask / Behaviour control masks of check DFC_ComSRSRingCnt" VALUE 0x804D8E26 Val_Wu16 65535.00 DFES_OneToOne 0.00 65535.00 FORMAT "%8.2" /end CHARACTERISTIC
/begin CHARACTERISTIC DFC_CtlMsk.DFC_ComSRSTOut_C "Behaviour control mask / Behaviour control masks of check DFC_ComSRSTOut" VALUE 0x804D8E28 Val_Wu16 65535.00 DFES_OneToOne 0.00 65535.00 FORMAT "%8.2" /end CHARACTERISTIC
/begin CHARACTERISTIC DFC_CtlMsk.DFC_ComVehSpdPndFltTCU_C "Behaviour control mask / Behaviour control masks of check DFC_ComVehSpdPndFltTCU" VALUE 0x804D8E2A Val_Wu16 65535.00 DFES_OneToOne 0.00 65535.00 FORMAT "%8.2" /end CHARACTERISTIC
/begin CHARACTERISTIC DFC_CtlMsk.DFC_EbsChartcCurrErr_C "Behaviour control mask / Behaviour control masks of check DFC_EbsChartcCurrErr" VALUE 0x804D8E2C Val_Wu16 65535.00 DFES_OneToOne 0.00 65535.00 FORMAT "%8.2" /end CHARACTERISTIC
/begin CHARACTERISTIC DFC_CtlMsk.DFC_EbsSelfDiagErr_C "Behaviour control mask / Behaviour control masks of check DFC_EbsSelfDiagErr" VALUE 0x804D8E2E Val_Wu16 65535.00 DFES_OneToOne 0.00 65535.00 FORMAT "%8.2" /end CHARACTERISTIC
/begin CHARACTERISTIC DFC_CtlMsk.DFC_GEVlvPhaCsersIntkB1_C "Behaviour control mask / Behaviour control masks of check DFC_GEVlvPhaCsersIntkB1" VALUE 0x804D8E30 Val_Wu16 65535.00 DFES_OneToOne 0.00 65535.00 FORMAT "%8.2" /end CHARACTERISTIC
/begin CHARACTERISTIC DFC_CtlMsk.DFC_GEVlvPhaPsOpenLoadIntkB1_C "Behaviour control mask / Behaviour control masks of check DFC_GEVlvPhaPsOpenLoadIntkB1" VALUE 0x804D8E32 Val_Wu16 65535.00 DFES_OneToOne 0.00 65535.00 FORMAT "%8.2" /end CHARACTERISTIC
/begin CHARACTERISTIC DFC_CtlMsk.DFC_GEVlvPhaPsShoToBattIntkB1_C "Behaviour control mask / Behaviour control masks of check DFC_GEVlvPhaPsShoToBattIntkB1" VALUE 0x804D8E34 Val_Wu16 65535.00 DFES_OneToOne 0.00 65535.00 FORMAT "%8.2" /end CHARACTERISTIC
/begin CHARACTERISTIC DFC_CtlMsk.DFC_GEVlvPhaPsShoToGndIntkB1_C "Behaviour control mask / Behaviour control masks of check DFC_GEVlvPhaPsShoToGndIntkB1" VALUE 0x804D8E36 Val_Wu16 65535.00 DFES_OneToOne 0.00 65535.00 FORMAT "%8.2" /end CHARACTERISTIC
/begin CHARACTERISTIC DFC_CtlMsk.DFC_GbxCANDigPlausErr_C "Behaviour control mask / Behaviour control masks of check DFC_GbxCANDigPlausErr" VALUE 0x804D8E38 Val_Wu16 65535.00 DFES_OneToOne 0.00 65535.00 FORMAT "%8.2" /end CHARACTERISTIC
/begin CHARACTERISTIC DFC_CtlMsk.DFC_GbxNPos1SRCMax_C "Behaviour control mask / Behaviour control masks of check DFC_GbxNPos1SRCMax" VALUE 0x804D8E3A Val_Wu16 65535.00 DFES_OneToOne 0.00 65535.00 FORMAT "%8.2" /end CHARACTERISTIC
/begin CHARACTERISTIC DFC_CtlMsk.DFC_GbxNPos1SRCMin_C "Behaviour control mask / Behaviour control masks of check DFC_GbxNPos1SRCMin" VALUE 0x804D8E3C Val_Wu16 65535.00 DFES_OneToOne 0.00 65535.00 FORMAT "%8.2" /end CHARACTERISTIC
/begin CHARACTERISTIC DFC_CtlMsk.DFC_GbxNPos2SRCMax_C "Behaviour control mask / Behaviour control masks of check DFC_GbxNPos2SRCMax" VALUE 0x804D8E3E Val_Wu16 65535.00 DFES_OneToOne 0.00 65535.00 FORMAT "%8.2" /end CHARACTERISTIC
/begin CHARACTERISTIC DFC_CtlMsk.DFC_GbxNPos2SRCMin_C "Behaviour control mask / Behaviour control masks of check DFC_GbxNPos2SRCMin" VALUE 0x804D8E40 Val_Wu16 65535.00 DFES_OneToOne 0.00 65535.00 FORMAT "%8.2" /end CHARACTERISTIC
/begin CHARACTERISTIC DFC_CtlMsk.DFC_GbxNPosAlvChk_C "Behaviour control mask / Behaviour control masks of check DFC_GbxNPosAlvChk" VALUE 0x804D8E42 Val_Wu16 65535.00 DFES_OneToOne 0.00 65535.00 FORMAT "%8.2" /end CHARACTERISTIC
/begin CHARACTERISTIC DFC_CtlMsk.DFC_GbxNPosSyncErr_C "Behaviour control mask / Behaviour control masks of check DFC_GbxNPosSyncErr" VALUE 0x804D8E44 Val_Wu16 65535.00 DFES_OneToOne 0.00 65535.00 FORMAT "%8.2" /end CHARACTERISTIC
/begin CHARACTERISTIC DFC_CtlMsk.DFC_HEGOS2B1HtrPsMax_C "Behaviour control mask / Behaviour control masks of check DFC_HEGOS2B1HtrPsMax" VALUE 0x804D8E46 Val_Wu16 65535.00 DFES_OneToOne 0.00 65535.00 FORMAT "%8.2" /end CHARACTERISTIC
/begin CHARACTERISTIC DFC_CtlMsk.DFC_HEGOS2B1HtrPsMin_C "Behaviour control mask / Behaviour control masks of check DFC_HEGOS2B1HtrPsMin" VALUE 0x804D8E48 Val_Wu16 65535.00 DFES_OneToOne 0.00 65535.00 FORMAT "%8.2" /end CHARACTERISTIC
/begin CHARACTERISTIC DFC_CtlMsk.DFC_HEGOS2B1HtrPsSig_C "Behaviour control mask / Behaviour control masks of check DFC_HEGOS2B1HtrPsSig" VALUE 0x804D8E4A Val_Wu16 65535.00 DFES_OneToOne 0.00 65535.00 FORMAT "%8.2" /end CHARACTERISTIC
/begin CHARACTERISTIC DFC_CtlMsk.DFC_LinCSErrACG_C "Behaviour control mask / Behaviour control masks of check DFC_LinCSErrACG" VALUE 0x804D8E4C Val_Wu16 65535.00 DFES_OneToOne 0.00 65535.00 FORMAT "%8.2" /end CHARACTERISTIC
/begin CHARACTERISTIC DFC_CtlMsk.DFC_LinCSErrAEV_C "Behaviour control mask / Behaviour control masks of check DFC_LinCSErrAEV" VALUE 0x804D8E4E Val_Wu16 65535.00 DFES_OneToOne 0.00 65535.00 FORMAT "%8.2" /end CHARACTERISTIC
/begin CHARACTERISTIC DFC_CtlMsk.DFC_LinCSErrDCDC_C "Behaviour control mask / Behaviour control masks of check DFC_LinCSErrDCDC" VALUE 0x804D8E50 Val_Wu16 65535.00 DFES_OneToOne 0.00 65535.00 FORMAT "%8.2" /end CHARACTERISTIC
/begin CHARACTERISTIC DFC_CtlMsk.DFC_LinCSErrEBS_C "Behaviour control mask / Behaviour control masks of check DFC_LinCSErrEBS" VALUE 0x804D8E52 Val_Wu16 65535.00 DFES_OneToOne 0.00 65535.00 FORMAT "%8.2" /end CHARACTERISTIC
/begin CHARACTERISTIC DFC_CtlMsk.DFC_LinHdrTimeoutErrACG_C "Behaviour control mask / Behaviour control masks of check DFC_LinHdrTimeoutErrACG" VALUE 0x804D8E54 Val_Wu16 65535.00 DFES_OneToOne 0.00 65535.00 FORMAT "%8.2" /end CHARACTERISTIC
/begin CHARACTERISTIC DFC_CtlMsk.DFC_LinHdrTimeoutErrAEV_C "Behaviour control mask / Behaviour control masks of check DFC_LinHdrTimeoutErrAEV" VALUE 0x804D8E56 Val_Wu16 65535.00 DFES_OneToOne 0.00 65535.00 FORMAT "%8.2" /end CHARACTERISTIC
/begin CHARACTERISTIC DFC_CtlMsk.DFC_LinHdrTimeoutErrDCDC_C "Behaviour control mask / Behaviour control masks of check DFC_LinHdrTimeoutErrDCDC" VALUE 0x804D8E58 Val_Wu16 65535.00 DFES_OneToOne 0.00 65535.00 FORMAT "%8.2" /end CHARACTERISTIC
/begin CHARACTERISTIC DFC_CtlMsk.DFC_LinHdrTimeoutErrEBS_C "Behaviour control mask / Behaviour control masks of check DFC_LinHdrTimeoutErrEBS" VALUE 0x804D8E5A Val_Wu16 65535.00 DFES_OneToOne 0.00 65535.00 FORMAT "%8.2" /end CHARACTERISTIC
/begin CHARACTERISTIC DFC_CtlMsk.DFC_LinMsgTimeoutErrACG_C "Behaviour control mask / Behaviour control masks of check DFC_LinMsgTimeoutErrACG" VALUE 0x804D8E5C Val_Wu16 65535.00 DFES_OneToOne 0.00 65535.00 FORMAT "%8.2" /end CHARACTERISTIC
/begin CHARACTERISTIC DFC_CtlMsk.DFC_LinMsgTimeoutErrAEV_C "Behaviour control mask / Behaviour control masks of check DFC_LinMsgTimeoutErrAEV" VALUE 0x804D8E5E Val_Wu16 65535.00 DFES_OneToOne 0.00 65535.00 FORMAT "%8.2" /end CHARACTERISTIC
/begin CHARACTERISTIC DFC_CtlMsk.DFC_LinMsgTimeoutErrDCDC_C "Behaviour control mask / Behaviour control masks of check DFC_LinMsgTimeoutErrDCDC" VALUE 0x804D8E60 Val_Wu16 65535.00 DFES_OneToOne 0.00 65535.00 FORMAT "%8.2" /end CHARACTERISTIC
/begin CHARACTERISTIC DFC_CtlMsk.DFC_LinMsgTimeoutErrEBS_C "Behaviour control mask / Behaviour control masks of check DFC_LinMsgTimeoutErrEBS" VALUE 0x804D8E62 Val_Wu16 65535.00 DFES_OneToOne 0.00 65535.00 FORMAT "%8.2" /end CHARACTERISTIC
/begin CHARACTERISTIC DFC_CtlMsk.DFC_LinNoStrtComErr_C "Behaviour control mask / Behaviour control masks of check DFC_LinNoStrtComErr" VALUE 0x804D8E64 Val_Wu16 65535.00 DFES_OneToOne 0.00 65535.00 FORMAT "%8.2" /end CHARACTERISTIC
/begin CHARACTERISTIC DFC_CtlMsk.DFC_LowPresOilP_C "Behaviour control mask / Behaviour control masks of check DFC_LowPresOilP" VALUE 0x804D8E66 Val_Wu16 65535.00 DFES_OneToOne 0.00 65535.00 FORMAT "%8.2" /end CHARACTERISTIC
/begin CHARACTERISTIC DFC_CtlMsk.DFC_MisfDetVWhlFrntLeOORHi_C "Behaviour control mask / Behaviour control masks of check DFC_MisfDetVWhlFrntLeOORHi" VALUE 0x804D8E68 Val_Wu16 65535.00 DFES_OneToOne 0.00 65535.00 FORMAT "%8.2" /end CHARACTERISTIC
/begin CHARACTERISTIC DFC_CtlMsk.DFC_MisfDetVWhlFrntLeRatyHi_C "Behaviour control mask / Behaviour control masks of check DFC_MisfDetVWhlFrntLeRatyHi" VALUE 0x804D8E6A Val_Wu16 65535.00 DFES_OneToOne 0.00 65535.00 FORMAT "%8.2" /end CHARACTERISTIC
/begin CHARACTERISTIC DFC_CtlMsk.DFC_MisfDetVWhlFrntLeRatyLo_C "Behaviour control mask / Behaviour control masks of check DFC_MisfDetVWhlFrntLeRatyLo" VALUE 0x804D8E6C Val_Wu16 65535.00 DFES_OneToOne 0.00 65535.00 FORMAT "%8.2" /end CHARACTERISTIC
/begin CHARACTERISTIC DFC_CtlMsk.DFC_MisfDetVWhlFrntLeStuck_C "Behaviour control mask / Behaviour control masks of check DFC_MisfDetVWhlFrntLeStuck" VALUE 0x804D8E6E Val_Wu16 65535.00 DFES_OneToOne 0.00 65535.00 FORMAT "%8.2" /end CHARACTERISTIC
/begin CHARACTERISTIC DFC_CtlMsk.DFC_MisfDetVWhlFrntRiOORHi_C "Behaviour control mask / Behaviour control masks of check DFC_MisfDetVWhlFrntRiOORHi" VALUE 0x804D8E70 Val_Wu16 65535.00 DFES_OneToOne 0.00 65535.00 FORMAT "%8.2" /end CHARACTERISTIC
/begin CHARACTERISTIC DFC_CtlMsk.DFC_MisfDetVWhlFrntRiRatyHi_C "Behaviour control mask / Behaviour control masks of check DFC_MisfDetVWhlFrntRiRatyHi" VALUE 0x804D8E72 Val_Wu16 65535.00 DFES_OneToOne 0.00 65535.00 FORMAT "%8.2" /end CHARACTERISTIC
/begin CHARACTERISTIC DFC_CtlMsk.DFC_MisfDetVWhlFrntRiRatyLo_C "Behaviour control mask / Behaviour control masks of check DFC_MisfDetVWhlFrntRiRatyLo" VALUE 0x804D8E74 Val_Wu16 65535.00 DFES_OneToOne 0.00 65535.00 FORMAT "%8.2" /end CHARACTERISTIC
/begin CHARACTERISTIC DFC_CtlMsk.DFC_MisfDetVWhlFrntRiStuck_C "Behaviour control mask / Behaviour control masks of check DFC_MisfDetVWhlFrntRiStuck" VALUE 0x804D8E76 Val_Wu16 65535.00 DFES_OneToOne 0.00 65535.00 FORMAT "%8.2" /end CHARACTERISTIC
/begin CHARACTERISTIC DFC_CtlMsk.DFC_MisfDetVWhlReLeOORHi_C "Behaviour control mask / Behaviour control masks of check DFC_MisfDetVWhlReLeOORHi" VALUE 0x804D8E78 Val_Wu16 65535.00 DFES_OneToOne 0.00 65535.00 FORMAT "%8.2" /end CHARACTERISTIC
/begin CHARACTERISTIC DFC_CtlMsk.DFC_MisfDetVWhlReLeRatyHi_C "Behaviour control mask / Behaviour control masks of check DFC_MisfDetVWhlReLeRatyHi" VALUE 0x804D8E7A Val_Wu16 65535.00 DFES_OneToOne 0.00 65535.00 FORMAT "%8.2" /end CHARACTERISTIC
/begin CHARACTERISTIC DFC_CtlMsk.DFC_MisfDetVWhlReLeRatyLo_C "Behaviour control mask / Behaviour control masks of check DFC_MisfDetVWhlReLeRatyLo" VALUE 0x804D8E7C Val_Wu16 65535.00 DFES_OneToOne 0.00 65535.00 FORMAT "%8.2" /end CHARACTERISTIC
/begin CHARACTERISTIC DFC_CtlMsk.DFC_MisfDetVWhlReLeStuck_C "Behaviour control mask / Behaviour control masks of check DFC_MisfDetVWhlReLeStuck" VALUE 0x804D8E7E Val_Wu16 65535.00 DFES_OneToOne 0.00 65535.00 FORMAT "%8.2" /end CHARACTERISTIC
/begin CHARACTERISTIC DFC_CtlMsk.DFC_MisfDetVWhlReRiOORHi_C "Behaviour control mask / Behaviour control masks of check DFC_MisfDetVWhlReRiOORHi" VALUE 0x804D8E80 Val_Wu16 65535.00 DFES_OneToOne 0.00 65535.00 FORMAT "%8.2" /end CHARACTERISTIC
/begin CHARACTERISTIC DFC_CtlMsk.DFC_MisfDetVWhlReRiRatyHi_C "Behaviour control mask / Behaviour control masks of check DFC_MisfDetVWhlReRiRatyHi" VALUE 0x804D8E82 Val_Wu16 65535.00 DFES_OneToOne 0.00 65535.00 FORMAT "%8.2" /end CHARACTERISTIC
/begin CHARACTERISTIC DFC_CtlMsk.DFC_MisfDetVWhlReRiRatyLo_C "Behaviour control mask / Behaviour control masks of check DFC_MisfDetVWhlReRiRatyLo" VALUE 0x804D8E84 Val_Wu16 65535.00 DFES_OneToOne 0.00 65535.00 FORMAT "%8.2" /end CHARACTERISTIC
/begin CHARACTERISTIC DFC_CtlMsk.DFC_MisfDetVWhlReRiStuck_C "Behaviour control mask / Behaviour control masks of check DFC_MisfDetVWhlReRiStuck" VALUE 0x804D8E86 Val_Wu16 65535.00 DFES_OneToOne 0.00 65535.00 FORMAT "%8.2" /end CHARACTERISTIC
/begin CHARACTERISTIC DFC_CtlMsk.DFC_MisfDetdVWhlFrntLePlaus_C "Behaviour control mask / Behaviour control masks of check DFC_MisfDetdVWhlFrntLePlaus" VALUE 0x804D8E88 Val_Wu16 65535.00 DFES_OneToOne 0.00 65535.00 FORMAT "%8.2" /end CHARACTERISTIC
/begin CHARACTERISTIC DFC_CtlMsk.DFC_MisfDetdVWhlFrntRiPlaus_C "Behaviour control mask / Behaviour control masks of check DFC_MisfDetdVWhlFrntRiPlaus" VALUE 0x804D8E8A Val_Wu16 65535.00 DFES_OneToOne 0.00 65535.00 FORMAT "%8.2" /end CHARACTERISTIC
/begin CHARACTERISTIC DFC_CtlMsk.DFC_MisfDetdVWhlReLePlaus_C "Behaviour control mask / Behaviour control masks of check DFC_MisfDetdVWhlReLePlaus" VALUE 0x804D8E8C Val_Wu16 65535.00 DFES_OneToOne 0.00 65535.00 FORMAT "%8.2" /end CHARACTERISTIC
/begin CHARACTERISTIC DFC_CtlMsk.DFC_MisfDetdVWhlReRiPlaus_C "Behaviour control mask / Behaviour control masks of check DFC_MisfDetdVWhlReRiPlaus" VALUE 0x804D8E8E Val_Wu16 65535.00 DFES_OneToOne 0.00 65535.00 FORMAT "%8.2" /end CHARACTERISTIC
/begin CHARACTERISTIC DFC_CtlMsk.DFC_PEnvSigRngMax_C "Behaviour control mask / Behaviour control masks of check DFC_PEnvSigRngMax" VALUE 0x804D8E90 Val_Wu16 65535.00 DFES_OneToOne 0.00 65535.00 FORMAT "%8.2" /end CHARACTERISTIC
/begin CHARACTERISTIC DFC_CtlMsk.DFC_PEnvSigRngMin_C "Behaviour control mask / Behaviour control masks of check DFC_PEnvSigRngMin" VALUE 0x804D8E92 Val_Wu16 65535.00 DFES_OneToOne 0.00 65535.00 FORMAT "%8.2" /end CHARACTERISTIC
/begin CHARACTERISTIC DFC_CtlMsk.DFC_StmFault_C "Behaviour control mask / Behaviour control masks of check DFC_StmFault" VALUE 0x804D8E94 Val_Wu16 65535.00 DFES_OneToOne 0.00 65535.00 FORMAT "%8.2" /end CHARACTERISTIC
/begin CHARACTERISTIC DFC_CtlMsk.DFC_StrtCtOffPth_C "Behaviour control mask / Behaviour control masks of check DFC_StrtCtOffPth" VALUE 0x804D8E96 Val_Wu16 65535.00 DFES_OneToOne 0.00 65535.00 FORMAT "%8.2" /end CHARACTERISTIC
/begin CHARACTERISTIC DFC_CtlMsk.DFC_StrtCtlErr_C "Behaviour control mask / Behaviour control masks of check DFC_StrtCtlErr" VALUE 0x804D8E98 Val_Wu16 65535.00 DFES_OneToOne 0.00 65535.00 FORMAT "%8.2" /end CHARACTERISTIC
/begin CHARACTERISTIC DFC_CtlMsk.DFC_StrtFault_C "Behaviour control mask / Behaviour control masks of check DFC_StrtFault" VALUE 0x804D8E9A Val_Wu16 65535.00 DFES_OneToOne 0.00 65535.00 FORMAT "%8.2" /end CHARACTERISTIC
/begin CHARACTERISTIC DFC_CtlMsk.DFC_StrtLckJudg1_C "Behaviour control mask / Behaviour control masks of check DFC_StrtLckJudg1" VALUE 0x804D8E9C Val_Wu16 65535.00 DFES_OneToOne 0.00 65535.00 FORMAT "%8.2" /end CHARACTERISTIC
/begin CHARACTERISTIC DFC_CtlMsk.DFC_StrtLckJudg2_C "Behaviour control mask / Behaviour control masks of check DFC_StrtLckJudg2" VALUE 0x804D8E9E Val_Wu16 65535.00 DFES_OneToOne 0.00 65535.00 FORMAT "%8.2" /end CHARACTERISTIC
/begin CHARACTERISTIC DFC_CtlMsk.DFC_StrtOL_C "Behaviour control mask / Behaviour control masks of check DFC_StrtOL" VALUE 0x804D8EA0 Val_Wu16 65535.00 DFES_OneToOne 0.00 65535.00 FORMAT "%8.2" /end CHARACTERISTIC
/begin CHARACTERISTIC DFC_CtlMsk.DFC_StrtOL2_C "Behaviour control mask / Behaviour control masks of check DFC_StrtOL2" VALUE 0x804D8EA2 Val_Wu16 65535.00 DFES_OneToOne 0.00 65535.00 FORMAT "%8.2" /end CHARACTERISTIC
/begin CHARACTERISTIC DFC_CtlMsk.DFC_StrtSCB_C "Behaviour control mask / Behaviour control masks of check DFC_StrtSCB" VALUE 0x804D8EA4 Val_Wu16 65535.00 DFES_OneToOne 0.00 65535.00 FORMAT "%8.2" /end CHARACTERISTIC
/begin CHARACTERISTIC DFC_CtlMsk.DFC_StrtSCB2_C "Behaviour control mask / Behaviour control masks of check DFC_StrtSCB2" VALUE 0x804D8EA6 Val_Wu16 65535.00 DFES_OneToOne 0.00 65535.00 FORMAT "%8.2" /end CHARACTERISTIC
/begin CHARACTERISTIC DFC_CtlMsk.DFC_StrtSCG_C "Behaviour control mask / Behaviour control masks of check DFC_StrtSCG" VALUE 0x804D8EA8 Val_Wu16 65535.00 DFES_OneToOne 0.00 65535.00 FORMAT "%8.2" /end CHARACTERISTIC
/begin CHARACTERISTIC DFC_CtlMsk.DFC_StrtSCG2_C "Behaviour control mask / Behaviour control masks of check DFC_StrtSCG2" VALUE 0x804D8EAA Val_Wu16 65535.00 DFES_OneToOne 0.00 65535.00 FORMAT "%8.2" /end CHARACTERISTIC
/begin CHARACTERISTIC DFC_CtlMsk.DFC_StrtStkRly1_C "Behaviour control mask / Behaviour control masks of check DFC_StrtStkRly1" VALUE 0x804D8EAC Val_Wu16 65535.00 DFES_OneToOne 0.00 65535.00 FORMAT "%8.2" /end CHARACTERISTIC
/begin CHARACTERISTIC DFC_CtlMsk.DFC_StrtStkRly2_C "Behaviour control mask / Behaviour control masks of check DFC_StrtStkRly2" VALUE 0x804D8EAE Val_Wu16 65535.00 DFES_OneToOne 0.00 65535.00 FORMAT "%8.2" /end CHARACTERISTIC
/begin CHARACTERISTIC DFC_CtlMsk.DFC_TEVEmax_C "Behaviour control mask / Behaviour control masks of check DFC_TEVEmax" VALUE 0x804D8EB0 Val_Wu16 65535.00 DFES_OneToOne 0.00 65535.00 FORMAT "%8.2" /end CHARACTERISTIC
/begin CHARACTERISTIC DFC_CtlMsk.DFC_TEVEmin_C "Behaviour control mask / Behaviour control masks of check DFC_TEVEmin" VALUE 0x804D8EB2 Val_Wu16 65535.00 DFES_OneToOne 0.00 65535.00 FORMAT "%8.2" /end CHARACTERISTIC
/begin CHARACTERISTIC DFC_CtlMsk.DFC_TEVEsig_C "Behaviour control mask / Behaviour control masks of check DFC_TEVEsig" VALUE 0x804D8EB4 Val_Wu16 65535.00 DFES_OneToOne 0.00 65535.00 FORMAT "%8.2" /end CHARACTERISTIC
/begin CHARACTERISTIC DFC_CtlMsk.DFC_UegoHeatrPrfmncLoS1B1_C "Behaviour control mask / Behaviour control masks of check DFC_UegoHeatrPrfmncLoS1B1" VALUE 0x804D8EB6 Val_Wu16 65535.00 DFES_OneToOne 0.00 65535.00 FORMAT "%8.2" /end CHARACTERISTIC
/begin CHARACTERISTIC DFC_CtlMsk.DFC_VehVAllPlaus_C "Behaviour control mask / Behaviour control masks of check DFC_VehVAllPlaus" VALUE 0x804D8EB8 Val_Wu16 65535.00 DFES_OneToOne 0.00 65535.00 FORMAT "%8.2" /end CHARACTERISTIC
/begin CHARACTERISTIC DFC_CtlMsk.DFC_VehVNCSnsrElecFailr_C "Behaviour control mask / Behaviour control masks of check DFC_VehVNCSnsrElecFailr" VALUE 0x804D8EBA Val_Wu16 65535.00 DFES_OneToOne 0.00 65535.00 FORMAT "%8.2" /end CHARACTERISTIC
/begin CHARACTERISTIC DFC_CtlMsk.DFC_VehVPlausCan_C "Behaviour control mask / Behaviour control masks of check DFC_VehVPlausCan" VALUE 0x804D8EBC Val_Wu16 65535.00 DFES_OneToOne 0.00 65535.00 FORMAT "%8.2" /end CHARACTERISTIC
/begin CHARACTERISTIC DFC_CtlMsk.DFC_VehVPlausFco_C "Behaviour control mask / Behaviour control masks of check DFC_VehVPlausFco" VALUE 0x804D8EBE Val_Wu16 65535.00 DFES_OneToOne 0.00 65535.00 FORMAT "%8.2" /end CHARACTERISTIC
/begin CHARACTERISTIC DFC_CtlMsk.DFC_VehVPlausPwr_C "Behaviour control mask / Behaviour control masks of check DFC_VehVPlausPwr" VALUE 0x804D8EC0 Val_Wu16 65535.00 DFES_OneToOne 0.00 65535.00 FORMAT "%8.2" /end CHARACTERISTIC
/begin CHARACTERISTIC DFC_CtlMsk.DFC_VehVPlausV2N_C "Behaviour control mask / Behaviour control masks of check DFC_VehVPlausV2N" VALUE 0x804D8EC2 Val_Wu16 65535.00 DFES_OneToOne 0.00 65535.00 FORMAT "%8.2" /end CHARACTERISTIC
/begin CHARACTERISTIC DFC_CtlMsk.DFC_VehVSpdSnsrAElecFailr_C "Behaviour control mask / Behaviour control masks of check DFC_VehVSpdSnsrAElecFailr" VALUE 0x804D8EC4 Val_Wu16 65535.00 DFES_OneToOne 0.00 65535.00 FORMAT "%8.2" /end CHARACTERISTIC
/begin CHARACTERISTIC DFC_CtlMsk.DFC_VehVSpdSnsrBElecFailr_C "Behaviour control mask / Behaviour control masks of check DFC_VehVSpdSnsrBElecFailr" VALUE 0x804D8EC6 Val_Wu16 65535.00 DFES_OneToOne 0.00 65535.00 FORMAT "%8.2" /end CHARACTERISTIC
/begin CHARACTERISTIC DFC_CtlMsk.DFC_ClthMax_C "Behaviour control mask / Behaviour control masks of check DFC_ClthMax" VALUE 0x804D8EC8 Val_Wu16 65535.00 DFES_OneToOne 0.00 65535.00 FORMAT "%8.2" /end CHARACTERISTIC
/begin CHARACTERISTIC DFC_CtlMsk.DFC_IgnClPs_DevComErr_C "Behaviour control mask / Behaviour control masks of check DFC_IgnClPs_DevComErr" VALUE 0x804D8ECA Val_Wu16 65535.00 DFES_OneToOne 0.00 65535.00 FORMAT "%8.2" /end CHARACTERISTIC
/begin CHARACTERISTIC DFC_CtlMsk.DFC_IgnClPs_LineOl_0_C "Behaviour control mask / Behaviour control masks of check DFC_IgnClPs_LineOl_0" VALUE 0x804D8ECC Val_Wu16 65535.00 DFES_OneToOne 0.00 65535.00 FORMAT "%8.2" /end CHARACTERISTIC
/begin CHARACTERISTIC DFC_CtlMsk.DFC_IgnClPs_LineOl_1_C "Behaviour control mask / Behaviour control masks of check DFC_IgnClPs_LineOl_1" VALUE 0x804D8ECE Val_Wu16 65535.00 DFES_OneToOne 0.00 65535.00 FORMAT "%8.2" /end CHARACTERISTIC
/begin CHARACTERISTIC DFC_CtlMsk.DFC_IgnClPs_LineOl_2_C "Behaviour control mask / Behaviour control masks of check DFC_IgnClPs_LineOl_2" VALUE 0x804D8ED0 Val_Wu16 65535.00 DFES_OneToOne 0.00 65535.00 FORMAT "%8.2" /end CHARACTERISTIC
/begin CHARACTERISTIC DFC_CtlMsk.DFC_IgnClPs_LineOl_3_C "Behaviour control mask / Behaviour control masks of check DFC_IgnClPs_LineOl_3" VALUE 0x804D8ED2 Val_Wu16 65535.00 DFES_OneToOne 0.00 65535.00 FORMAT "%8.2" /end CHARACTERISTIC
/begin CHARACTERISTIC DFC_CtlMsk.DFC_IgnClPs_LineScb_0_C "Behaviour control mask / Behaviour control masks of check DFC_IgnClPs_LineScb_0" VALUE 0x804D8ED4 Val_Wu16 65535.00 DFES_OneToOne 0.00 65535.00 FORMAT "%8.2" /end CHARACTERISTIC
/begin CHARACTERISTIC DFC_CtlMsk.DFC_IgnClPs_LineScb_1_C "Behaviour control mask / Behaviour control masks of check DFC_IgnClPs_LineScb_1" VALUE 0x804D8ED6 Val_Wu16 65535.00 DFES_OneToOne 0.00 65535.00 FORMAT "%8.2" /end CHARACTERISTIC
/begin CHARACTERISTIC DFC_CtlMsk.DFC_IgnClPs_LineScb_2_C "Behaviour control mask / Behaviour control masks of check DFC_IgnClPs_LineScb_2" VALUE 0x804D8ED8 Val_Wu16 65535.00 DFES_OneToOne 0.00 65535.00 FORMAT "%8.2" /end CHARACTERISTIC
/begin CHARACTERISTIC DFC_CtlMsk.DFC_IgnClPs_LineScb_3_C "Behaviour control mask / Behaviour control masks of check DFC_IgnClPs_LineScb_3" VALUE 0x804D8EDA Val_Wu16 65535.00 DFES_OneToOne 0.00 65535.00 FORMAT "%8.2" /end CHARACTERISTIC
/begin CHARACTERISTIC DFC_CtlMsk.DFC_IgnClPs_LineScg_0_C "Behaviour control mask / Behaviour control masks of check DFC_IgnClPs_LineScg_0" VALUE 0x804D8EDC Val_Wu16 65535.00 DFES_OneToOne 0.00 65535.00 FORMAT "%8.2" /end CHARACTERISTIC
/begin CHARACTERISTIC DFC_CtlMsk.DFC_IgnClPs_LineScg_1_C "Behaviour control mask / Behaviour control masks of check DFC_IgnClPs_LineScg_1" VALUE 0x804D8EDE Val_Wu16 65535.00 DFES_OneToOne 0.00 65535.00 FORMAT "%8.2" /end CHARACTERISTIC
/begin CHARACTERISTIC DFC_CtlMsk.DFC_IgnClPs_LineScg_2_C "Behaviour control mask / Behaviour control masks of check DFC_IgnClPs_LineScg_2" VALUE 0x804D8EE0 Val_Wu16 65535.00 DFES_OneToOne 0.00 65535.00 FORMAT "%8.2" /end CHARACTERISTIC
/begin CHARACTERISTIC DFC_CtlMsk.DFC_IgnClPs_LineScg_3_C "Behaviour control mask / Behaviour control masks of check DFC_IgnClPs_LineScg_3" VALUE 0x804D8EE2 Val_Wu16 65535.00 DFES_OneToOne 0.00 65535.00 FORMAT "%8.2" /end CHARACTERISTIC
/begin CHARACTERISTIC DFC_CtlMsk.DFC_KRVEKOEVAB_C "Behaviour control mask / Behaviour control masks of check DFC_KRVEKOEVAB" VALUE 0x804D8EE4 Val_Wu16 65535.00 DFES_OneToOne 0.00 65535.00 FORMAT "%8.2" /end CHARACTERISTIC
/begin CHARACTERISTIC DFC_CtlMsk.DFC_KRVEKOEVAB0_C "Behaviour control mask / Behaviour control masks of check DFC_KRVEKOEVAB0" VALUE 0x804D8EE6 Val_Wu16 65535.00 DFES_OneToOne 0.00 65535.00 FORMAT "%8.2" /end CHARACTERISTIC
/begin CHARACTERISTIC DFC_CtlMsk.DFC_KRVEKOEVAB1_C "Behaviour control mask / Behaviour control masks of check DFC_KRVEKOEVAB1" VALUE 0x804D8EE8 Val_Wu16 65535.00 DFES_OneToOne 0.00 65535.00 FORMAT "%8.2" /end CHARACTERISTIC
/begin CHARACTERISTIC DFC_CtlMsk.DFC_KRVEKOEVAB2_C "Behaviour control mask / Behaviour control masks of check DFC_KRVEKOEVAB2" VALUE 0x804D8EEA Val_Wu16 65535.00 DFES_OneToOne 0.00 65535.00 FORMAT "%8.2" /end CHARACTERISTIC
/begin CHARACTERISTIC DFC_CtlMsk.DFC_KRVEKOEVAB3_C "Behaviour control mask / Behaviour control masks of check DFC_KRVEKOEVAB3" VALUE 0x804D8EEC Val_Wu16 65535.00 DFES_OneToOne 0.00 65535.00 FORMAT "%8.2" /end CHARACTERISTIC
/begin CHARACTERISTIC DFC_CtlMsk.DFC_UegoSigEcuAsicS1B1_C "Behaviour control mask / Behaviour control masks of check DFC_UegoSigEcuAsicS1B1" VALUE 0x804D8EEE Val_Wu16 65535.00 DFES_OneToOne 0.00 65535.00 FORMAT "%8.2" /end CHARACTERISTIC
/begin CHARACTERISTIC DFC_CtlMsk.DFC_UegoSigEcuComS1B1_C "Behaviour control mask / Behaviour control masks of check DFC_UegoSigEcuComS1B1" VALUE 0x804D8EF0 Val_Wu16 65535.00 DFES_OneToOne 0.00 65535.00 FORMAT "%8.2" /end CHARACTERISTIC
/begin CHARACTERISTIC DFC_CtlMsk.DFC_UegoSigSnsrS1B1_C "Behaviour control mask / Behaviour control masks of check DFC_UegoSigSnsrS1B1" VALUE 0x804D8EF2 Val_Wu16 65535.00 DFES_OneToOne 0.00 65535.00 FORMAT "%8.2" /end CHARACTERISTIC
/begin CHARACTERISTIC DFC_CtlMsk.DFC_UegoSigWireOlApesS1B1_C "Behaviour control mask / Behaviour control masks of check DFC_UegoSigWireOlApesS1B1" VALUE 0x804D8EF4 Val_Wu16 65535.00 DFES_OneToOne 0.00 65535.00 FORMAT "%8.2" /end CHARACTERISTIC
/begin CHARACTERISTIC DFC_CtlMsk.DFC_UegoSigWireOlIpeS1B1_C "Behaviour control mask / Behaviour control masks of check DFC_UegoSigWireOlIpeS1B1" VALUE 0x804D8EF6 Val_Wu16 65535.00 DFES_OneToOne 0.00 65535.00 FORMAT "%8.2" /end CHARACTERISTIC
/begin CHARACTERISTIC DFC_CtlMsk.DFC_UegoSigWireOlReS1B1_C "Behaviour control mask / Behaviour control masks of check DFC_UegoSigWireOlReS1B1" VALUE 0x804D8EF8 Val_Wu16 65535.00 DFES_OneToOne 0.00 65535.00 FORMAT "%8.2" /end CHARACTERISTIC
/begin CHARACTERISTIC DFC_CtlMsk.DFC_UegoSigWireRCmpS1B1_C "Behaviour control mask / Behaviour control masks of check DFC_UegoSigWireRCmpS1B1" VALUE 0x804D8EFA Val_Wu16 65535.00 DFES_OneToOne 0.00 65535.00 FORMAT "%8.2" /end CHARACTERISTIC
/begin CHARACTERISTIC DFC_CtlMsk.DFC_UegoSigWireScbS1B1_C "Behaviour control mask / Behaviour control masks of check DFC_UegoSigWireScbS1B1" VALUE 0x804D8EFC Val_Wu16 65535.00 DFES_OneToOne 0.00 65535.00 FORMAT "%8.2" /end CHARACTERISTIC
/begin CHARACTERISTIC DFC_CtlMsk.DFC_UegoSigWireScgS1B1_C "Behaviour control mask / Behaviour control masks of check DFC_UegoSigWireScgS1B1" VALUE 0x804D8EFE Val_Wu16 65535.00 DFES_OneToOne 0.00 65535.00 FORMAT "%8.2" /end CHARACTERISTIC
/begin CHARACTERISTIC DFC_CtlMsk.DFC_AfsPhyRngHiB1_C "Behaviour control mask / Behaviour control masks of check DFC_AfsPhyRngHiB1" VALUE 0x804D8F00 Val_Wu16 65535.00 DFES_OneToOne 0.00 65535.00 FORMAT "%8.2" /end CHARACTERISTIC
/begin CHARACTERISTIC DFC_CtlMsk.DFC_AfsPhyRngLoB1_C "Behaviour control mask / Behaviour control masks of check DFC_AfsPhyRngLoB1" VALUE 0x804D8F02 Val_Wu16 65535.00 DFES_OneToOne 0.00 65535.00 FORMAT "%8.2" /end CHARACTERISTIC
/begin CHARACTERISTIC DFC_CtlMsk.DFC_AirCCmprOL_C "Behaviour control mask / Behaviour control masks of check DFC_AirCCmprOL" VALUE 0x804D8F04 Val_Wu16 65535.00 DFES_OneToOne 0.00 65535.00 FORMAT "%8.2" /end CHARACTERISTIC
/begin CHARACTERISTIC DFC_CtlMsk.DFC_AirCCmprOvrTemp_C "Behaviour control mask / Behaviour control masks of check DFC_AirCCmprOvrTemp" VALUE 0x804D8F06 Val_Wu16 65535.00 DFES_OneToOne 0.00 65535.00 FORMAT "%8.2" /end CHARACTERISTIC
/begin CHARACTERISTIC DFC_CtlMsk.DFC_AirCCmprSCB_C "Behaviour control mask / Behaviour control masks of check DFC_AirCCmprSCB" VALUE 0x804D8F08 Val_Wu16 65535.00 DFES_OneToOne 0.00 65535.00 FORMAT "%8.2" /end CHARACTERISTIC
/begin CHARACTERISTIC DFC_CtlMsk.DFC_AirCCmprSCG_C "Behaviour control mask / Behaviour control masks of check DFC_AirCCmprSCG" VALUE 0x804D8F0A Val_Wu16 65535.00 DFES_OneToOne 0.00 65535.00 FORMAT "%8.2" /end CHARACTERISTIC
/begin CHARACTERISTIC DFC_CtlMsk.DFC_AltErr_C "Behaviour control mask / Behaviour control masks of check DFC_AltErr" VALUE 0x804D8F0C Val_Wu16 65535.00 DFES_OneToOne 0.00 65535.00 FORMAT "%8.2" /end CHARACTERISTIC
/begin CHARACTERISTIC DFC_CtlMsk.DFC_BattUSRCMax_C "Behaviour control mask / Behaviour control masks of check DFC_BattUSRCMax" VALUE 0x804D8F0E Val_Wu16 65535.00 DFES_OneToOne 0.00 65535.00 FORMAT "%8.2" /end CHARACTERISTIC
/begin CHARACTERISTIC DFC_CtlMsk.DFC_BattUSRCMin_C "Behaviour control mask / Behaviour control masks of check DFC_BattUSRCMin" VALUE 0x804D8F10 Val_Wu16 65535.00 DFES_OneToOne 0.00 65535.00 FORMAT "%8.2" /end CHARACTERISTIC
/begin CHARACTERISTIC DFC_CtlMsk.DFC_ComChksTCU1_C "Behaviour control mask / Behaviour control masks of check DFC_ComChksTCU1" VALUE 0x804D8F12 Val_Wu16 65535.00 DFES_OneToOne 0.00 65535.00 FORMAT "%8.2" /end CHARACTERISTIC
/begin CHARACTERISTIC DFC_CtlMsk.DFC_ComChksTCU11_C "Behaviour control mask / Behaviour control masks of check DFC_ComChksTCU11" VALUE 0x804D8F14 Val_Wu16 65535.00 DFES_OneToOne 0.00 65535.00 FORMAT "%8.2" /end CHARACTERISTIC
/begin CHARACTERISTIC DFC_CtlMsk.DFC_ComChksTCU12_C "Behaviour control mask / Behaviour control masks of check DFC_ComChksTCU12" VALUE 0x804D8F16 Val_Wu16 65535.00 DFES_OneToOne 0.00 65535.00 FORMAT "%8.2" /end CHARACTERISTIC
/begin CHARACTERISTIC DFC_CtlMsk.DFC_ComChksTCU13_C "Behaviour control mask / Behaviour control masks of check DFC_ComChksTCU13" VALUE 0x804D8F18 Val_Wu16 65535.00 DFES_OneToOne 0.00 65535.00 FORMAT "%8.2" /end CHARACTERISTIC
/begin CHARACTERISTIC DFC_CtlMsk.DFC_ComChksTCU2_C "Behaviour control mask / Behaviour control masks of check DFC_ComChksTCU2" VALUE 0x804D8F1A Val_Wu16 65535.00 DFES_OneToOne 0.00 65535.00 FORMAT "%8.2" /end CHARACTERISTIC
/begin CHARACTERISTIC DFC_CtlMsk.DFC_ComChksTCU3_C "Behaviour control mask / Behaviour control masks of check DFC_ComChksTCU3" VALUE 0x804D8F1C Val_Wu16 65535.00 DFES_OneToOne 0.00 65535.00 FORMAT "%8.2" /end CHARACTERISTIC
/begin CHARACTERISTIC DFC_CtlMsk.DFC_ComChksTCU4_C "Behaviour control mask / Behaviour control masks of check DFC_ComChksTCU4" VALUE 0x804D8F1E Val_Wu16 65535.00 DFES_OneToOne 0.00 65535.00 FORMAT "%8.2" /end CHARACTERISTIC
/begin CHARACTERISTIC DFC_CtlMsk.DFC_ComCntTCU1_C "Behaviour control mask / Behaviour control masks of check DFC_ComCntTCU1" VALUE 0x804D8F20 Val_Wu16 65535.00 DFES_OneToOne 0.00 65535.00 FORMAT "%8.2" /end CHARACTERISTIC
/begin CHARACTERISTIC DFC_CtlMsk.DFC_ComCntTCU11_C "Behaviour control mask / Behaviour control masks of check DFC_ComCntTCU11" VALUE 0x804D8F22 Val_Wu16 65535.00 DFES_OneToOne 0.00 65535.00 FORMAT "%8.2" /end CHARACTERISTIC
/begin CHARACTERISTIC DFC_CtlMsk.DFC_ComCntTCU12_C "Behaviour control mask / Behaviour control masks of check DFC_ComCntTCU12" VALUE 0x804D8F24 Val_Wu16 65535.00 DFES_OneToOne 0.00 65535.00 FORMAT "%8.2" /end CHARACTERISTIC
/begin CHARACTERISTIC DFC_CtlMsk.DFC_ComCntTCU13_C "Behaviour control mask / Behaviour control masks of check DFC_ComCntTCU13" VALUE 0x804D8F26 Val_Wu16 65535.00 DFES_OneToOne 0.00 65535.00 FORMAT "%8.2" /end CHARACTERISTIC
/begin CHARACTERISTIC DFC_CtlMsk.DFC_ComCntTCU2_C "Behaviour control mask / Behaviour control masks of check DFC_ComCntTCU2" VALUE 0x804D8F28 Val_Wu16 65535.00 DFES_OneToOne 0.00 65535.00 FORMAT "%8.2" /end CHARACTERISTIC
/begin CHARACTERISTIC DFC_CtlMsk.DFC_ComCntTCU3_C "Behaviour control mask / Behaviour control masks of check DFC_ComCntTCU3" VALUE 0x804D8F2A Val_Wu16 65535.00 DFES_OneToOne 0.00 65535.00 FORMAT "%8.2" /end CHARACTERISTIC
/begin CHARACTERISTIC DFC_CtlMsk.DFC_ComCntTCU4_C "Behaviour control mask / Behaviour control masks of check DFC_ComCntTCU4" VALUE 0x804D8F2C Val_Wu16 65535.00 DFES_OneToOne 0.00 65535.00 FORMAT "%8.2" /end CHARACTERISTIC
/begin CHARACTERISTIC DFC_CtlMsk.DFC_ComTOutTCU01_C "Behaviour control mask / Behaviour control masks of check DFC_ComTOutTCU01" VALUE 0x804D8F2E Val_Wu16 65535.00 DFES_OneToOne 0.00 65535.00 FORMAT "%8.2" /end CHARACTERISTIC
/begin CHARACTERISTIC DFC_CtlMsk.DFC_ComTOutTCU02_C "Behaviour control mask / Behaviour control masks of check DFC_ComTOutTCU02" VALUE 0x804D8F30 Val_Wu16 65535.00 DFES_OneToOne 0.00 65535.00 FORMAT "%8.2" /end CHARACTERISTIC
/begin CHARACTERISTIC DFC_CtlMsk.DFC_ComTOutTCU1_C "Behaviour control mask / Behaviour control masks of check DFC_ComTOutTCU1" VALUE 0x804D8F32 Val_Wu16 65535.00 DFES_OneToOne 0.00 65535.00 FORMAT "%8.2" /end CHARACTERISTIC
/begin CHARACTERISTIC DFC_CtlMsk.DFC_ComTOutTCU11_C "Behaviour control mask / Behaviour control masks of check DFC_ComTOutTCU11" VALUE 0x804D8F34 Val_Wu16 65535.00 DFES_OneToOne 0.00 65535.00 FORMAT "%8.2" /end CHARACTERISTIC
/begin CHARACTERISTIC DFC_CtlMsk.DFC_ComTOutTCU12_C "Behaviour control mask / Behaviour control masks of check DFC_ComTOutTCU12" VALUE 0x804D8F36 Val_Wu16 65535.00 DFES_OneToOne 0.00 65535.00 FORMAT "%8.2" /end CHARACTERISTIC
/begin CHARACTERISTIC DFC_CtlMsk.DFC_ComTOutTCU13_C "Behaviour control mask / Behaviour control masks of check DFC_ComTOutTCU13" VALUE 0x804D8F38 Val_Wu16 65535.00 DFES_OneToOne 0.00 65535.00 FORMAT "%8.2" /end CHARACTERISTIC
/begin CHARACTERISTIC DFC_CtlMsk.DFC_ComTOutTCU14_C "Behaviour control mask / Behaviour control masks of check DFC_ComTOutTCU14" VALUE 0x804D8F3A Val_Wu16 65535.00 DFES_OneToOne 0.00 65535.00 FORMAT "%8.2" /end CHARACTERISTIC
/begin CHARACTERISTIC DFC_CtlMsk.DFC_ComTOutTCU2_C "Behaviour control mask / Behaviour control masks of check DFC_ComTOutTCU2" VALUE 0x804D8F3C Val_Wu16 65535.00 DFES_OneToOne 0.00 65535.00 FORMAT "%8.2" /end CHARACTERISTIC
/begin CHARACTERISTIC DFC_CtlMsk.DFC_ComTOutTCU3_C "Behaviour control mask / Behaviour control masks of check DFC_ComTOutTCU3" VALUE 0x804D8F3E Val_Wu16 65535.00 DFES_OneToOne 0.00 65535.00 FORMAT "%8.2" /end CHARACTERISTIC
/begin CHARACTERISTIC DFC_CtlMsk.DFC_ComTOutTCU4_C "Behaviour control mask / Behaviour control masks of check DFC_ComTOutTCU4" VALUE 0x804D8F40 Val_Wu16 65535.00 DFES_OneToOne 0.00 65535.00 FORMAT "%8.2" /end CHARACTERISTIC
/begin CHARACTERISTIC DFC_CtlMsk.DFC_DevLibBattUHi_C "Behaviour control mask / Behaviour control masks of check DFC_DevLibBattUHi" VALUE 0x804D8F42 Val_Wu16 65535.00 DFES_OneToOne 0.00 65535.00 FORMAT "%8.2" /end CHARACTERISTIC
/begin CHARACTERISTIC DFC_CtlMsk.DFC_DevLibBattULo_C "Behaviour control mask / Behaviour control masks of check DFC_DevLibBattULo" VALUE 0x804D8F44 Val_Wu16 65535.00 DFES_OneToOne 0.00 65535.00 FORMAT "%8.2" /end CHARACTERISTIC
/begin CHARACTERISTIC DFC_CtlMsk.DFC_EGRVlvFailSafeActv_C "Behaviour control mask / Behaviour control masks of check DFC_EGRVlvFailSafeActv" VALUE 0x804D8F46 Val_Wu16 65535.00 DFES_OneToOne 0.00 65535.00 FORMAT "%8.2" /end CHARACTERISTIC
/begin CHARACTERISTIC DFC_CtlMsk.DFC_EGRVlvGovDvtCld_C "Behaviour control mask / Behaviour control masks of check DFC_EGRVlvGovDvtCld" VALUE 0x804D8F48 Val_Wu16 65535.00 DFES_OneToOne 0.00 65535.00 FORMAT "%8.2" /end CHARACTERISTIC
/begin CHARACTERISTIC DFC_CtlMsk.DFC_EGRVlvPhysSRCMax_C "Behaviour control mask / Behaviour control masks of check DFC_EGRVlvPhysSRCMax" VALUE 0x804D8F4A Val_Wu16 65535.00 DFES_OneToOne 0.00 65535.00 FORMAT "%8.2" /end CHARACTERISTIC
/begin CHARACTERISTIC DFC_CtlMsk.DFC_EGRVlvPhysSRCMin_C "Behaviour control mask / Behaviour control masks of check DFC_EGRVlvPhysSRCMin" VALUE 0x804D8F4C Val_Wu16 65535.00 DFES_OneToOne 0.00 65535.00 FORMAT "%8.2" /end CHARACTERISTIC
/begin CHARACTERISTIC DFC_CtlMsk.DFC_FanDIOOL_0_C "Behaviour control mask / Behaviour control masks of check DFC_FanDIOOL_0" VALUE 0x804D8F4E Val_Wu16 65535.00 DFES_OneToOne 0.00 65535.00 FORMAT "%8.2" /end CHARACTERISTIC
/begin CHARACTERISTIC DFC_CtlMsk.DFC_FanDIOOL_1_C "Behaviour control mask / Behaviour control masks of check DFC_FanDIOOL_1" VALUE 0x804D8F50 Val_Wu16 65535.00 DFES_OneToOne 0.00 65535.00 FORMAT "%8.2" /end CHARACTERISTIC
/begin CHARACTERISTIC DFC_CtlMsk.DFC_FanDIOOvrTemp_0_C "Behaviour control mask / Behaviour control masks of check DFC_FanDIOOvrTemp_0" VALUE 0x804D8F52 Val_Wu16 65535.00 DFES_OneToOne 0.00 65535.00 FORMAT "%8.2" /end CHARACTERISTIC
/begin CHARACTERISTIC DFC_CtlMsk.DFC_FanDIOOvrTemp_1_C "Behaviour control mask / Behaviour control masks of check DFC_FanDIOOvrTemp_1" VALUE 0x804D8F54 Val_Wu16 65535.00 DFES_OneToOne 0.00 65535.00 FORMAT "%8.2" /end CHARACTERISTIC
/begin CHARACTERISTIC DFC_CtlMsk.DFC_FanDIOSCB_0_C "Behaviour control mask / Behaviour control masks of check DFC_FanDIOSCB_0" VALUE 0x804D8F56 Val_Wu16 65535.00 DFES_OneToOne 0.00 65535.00 FORMAT "%8.2" /end CHARACTERISTIC
/begin CHARACTERISTIC DFC_CtlMsk.DFC_FanDIOSCB_1_C "Behaviour control mask / Behaviour control masks of check DFC_FanDIOSCB_1" VALUE 0x804D8F58 Val_Wu16 65535.00 DFES_OneToOne 0.00 65535.00 FORMAT "%8.2" /end CHARACTERISTIC
/begin CHARACTERISTIC DFC_CtlMsk.DFC_FanDIOSCG_0_C "Behaviour control mask / Behaviour control masks of check DFC_FanDIOSCG_0" VALUE 0x804D8F5A Val_Wu16 65535.00 DFES_OneToOne 0.00 65535.00 FORMAT "%8.2" /end CHARACTERISTIC
/begin CHARACTERISTIC DFC_CtlMsk.DFC_FanDIOSCG_1_C "Behaviour control mask / Behaviour control masks of check DFC_FanDIOSCG_1" VALUE 0x804D8F5C Val_Wu16 65535.00 DFES_OneToOne 0.00 65535.00 FORMAT "%8.2" /end CHARACTERISTIC
/begin CHARACTERISTIC DFC_CtlMsk.DFC_MRlyDcOL_C "Behaviour control mask / Behaviour control masks of check DFC_MRlyDcOL" VALUE 0x804D8F5E Val_Wu16 65535.00 DFES_OneToOne 0.00 65535.00 FORMAT "%8.2" /end CHARACTERISTIC
/begin CHARACTERISTIC DFC_CtlMsk.DFC_MRlyDcSCB_C "Behaviour control mask / Behaviour control masks of check DFC_MRlyDcSCB" VALUE 0x804D8F60 Val_Wu16 65535.00 DFES_OneToOne 0.00 65535.00 FORMAT "%8.2" /end CHARACTERISTIC
/begin CHARACTERISTIC DFC_CtlMsk.DFC_MRlyDcSCG_C "Behaviour control mask / Behaviour control masks of check DFC_MRlyDcSCG" VALUE 0x804D8F62 Val_Wu16 65535.00 DFES_OneToOne 0.00 65535.00 FORMAT "%8.2" /end CHARACTERISTIC
/begin CHARACTERISTIC DFC_CtlMsk.DFC_PSPOL_C "Behaviour control mask / Behaviour control masks of check DFC_PSPOL" VALUE 0x804D8F64 Val_Wu16 65535.00 DFES_OneToOne 0.00 65535.00 FORMAT "%8.2" /end CHARACTERISTIC
/begin CHARACTERISTIC DFC_CtlMsk.DFC_PSPOvrTemp_C "Behaviour control mask / Behaviour control masks of check DFC_PSPOvrTemp" VALUE 0x804D8F66 Val_Wu16 65535.00 DFES_OneToOne 0.00 65535.00 FORMAT "%8.2" /end CHARACTERISTIC
/begin CHARACTERISTIC DFC_CtlMsk.DFC_PSPSCB_C "Behaviour control mask / Behaviour control masks of check DFC_PSPSCB" VALUE 0x804D8F68 Val_Wu16 65535.00 DFES_OneToOne 0.00 65535.00 FORMAT "%8.2" /end CHARACTERISTIC
/begin CHARACTERISTIC DFC_CtlMsk.DFC_PSPSCG_C "Behaviour control mask / Behaviour control masks of check DFC_PSPSCG" VALUE 0x804D8F6A Val_Wu16 65535.00 DFES_OneToOne 0.00 65535.00 FORMAT "%8.2" /end CHARACTERISTIC
/begin CHARACTERISTIC DFC_CtlMsk.DFC_T50Err_C "Behaviour control mask / Behaviour control masks of check DFC_T50Err" VALUE 0x804D8F6C Val_Wu16 65535.00 DFES_OneToOne 0.00 65535.00 FORMAT "%8.2" /end CHARACTERISTIC
/begin CHARACTERISTIC DFC_CtlMsk.DFC_ThrVlvLoBattB1_C "Behaviour control mask / Behaviour control masks of check DFC_ThrVlvLoBattB1" VALUE 0x804D8F6E Val_Wu16 65535.00 DFES_OneToOne 0.00 65535.00 FORMAT "%8.2" /end CHARACTERISTIC
/begin CHARACTERISTIC DFC_CtlMsk.DFC_UegoSigOperPlausS1B1_C "Behaviour control mask / Behaviour control masks of check DFC_UegoSigOperPlausS1B1" VALUE 0x804D8F70 Val_Wu16 65535.00 DFES_OneToOne 0.00 65535.00 FORMAT "%8.2" /end CHARACTERISTIC
/begin CHARACTERISTIC DFC_CtlMsk.DFC_VehVPhysRngHi_C "Behaviour control mask / Behaviour control masks of check DFC_VehVPhysRngHi" VALUE 0x804D8F72 Val_Wu16 65535.00 DFES_OneToOne 0.00 65535.00 FORMAT "%8.2" /end CHARACTERISTIC
/begin CHARACTERISTIC DFC_CtlMsk.DFC_VehVSclOutOL_C "Behaviour control mask / Behaviour control masks of check DFC_VehVSclOutOL" VALUE 0x804D8F74 Val_Wu16 65535.00 DFES_OneToOne 0.00 65535.00 FORMAT "%8.2" /end CHARACTERISTIC
/begin CHARACTERISTIC DFC_CtlMsk.DFC_VehVSclOutOT_C "Behaviour control mask / Behaviour control masks of check DFC_VehVSclOutOT" VALUE 0x804D8F76 Val_Wu16 65535.00 DFES_OneToOne 0.00 65535.00 FORMAT "%8.2" /end CHARACTERISTIC
/begin CHARACTERISTIC DFC_CtlMsk.DFC_VehVSclOutSCB_C "Behaviour control mask / Behaviour control masks of check DFC_VehVSclOutSCB" VALUE 0x804D8F78 Val_Wu16 65535.00 DFES_OneToOne 0.00 65535.00 FORMAT "%8.2" /end CHARACTERISTIC
/begin CHARACTERISTIC DFC_CtlMsk.DFC_VehVSclOutSCG_C "Behaviour control mask / Behaviour control masks of check DFC_VehVSclOutSCG" VALUE 0x804D8F7A Val_Wu16 65535.00 DFES_OneToOne 0.00 65535.00 FORMAT "%8.2" /end CHARACTERISTIC
/begin CHARACTERISTIC DFC_CtlMsk.DFC_VehVSigFL_C "Behaviour control mask / Behaviour control masks of check DFC_VehVSigFL" VALUE 0x804D8F7C Val_Wu16 65535.00 DFES_OneToOne 0.00 65535.00 FORMAT "%8.2" /end CHARACTERISTIC
/begin CHARACTERISTIC DFC_CtlMsk.DFC_VehVSigFR_C "Behaviour control mask / Behaviour control masks of check DFC_VehVSigFR" VALUE 0x804D8F7E Val_Wu16 65535.00 DFES_OneToOne 0.00 65535.00 FORMAT "%8.2" /end CHARACTERISTIC
/begin CHARACTERISTIC DFC_CtlMsk.DFC_VehVSigRL_C "Behaviour control mask / Behaviour control masks of check DFC_VehVSigRL" VALUE 0x804D8F80 Val_Wu16 65535.00 DFES_OneToOne 0.00 65535.00 FORMAT "%8.2" /end CHARACTERISTIC
/begin CHARACTERISTIC DFC_CtlMsk.DFC_VehVSigRR_C "Behaviour control mask / Behaviour control masks of check DFC_VehVSigRR" VALUE 0x804D8F82 Val_Wu16 65535.00 DFES_OneToOne 0.00 65535.00 FORMAT "%8.2" /end CHARACTERISTIC
/begin CHARACTERISTIC DFC_CtlMsk.DFC_VehVSnsrARngHi_C "Behaviour control mask / Behaviour control masks of check DFC_VehVSnsrARngHi" VALUE 0x804D8F84 Val_Wu16 65535.00 DFES_OneToOne 0.00 65535.00 FORMAT "%8.2" /end CHARACTERISTIC
/begin CHARACTERISTIC DFC_CtlMsk.DFC_VehVSnsrBRngHi_C "Behaviour control mask / Behaviour control masks of check DFC_VehVSnsrBRngHi" VALUE 0x804D8F86 Val_Wu16 65535.00 DFES_OneToOne 0.00 65535.00 FORMAT "%8.2" /end CHARACTERISTIC
/begin CHARACTERISTIC DFC_CtlMsk.DFC_VehVSpdRtyDiag_C "Behaviour control mask / Behaviour control masks of check DFC_VehVSpdRtyDiag" VALUE 0x804D8F88 Val_Wu16 65535.00 DFES_OneToOne 0.00 65535.00 FORMAT "%8.2" /end CHARACTERISTIC
/begin CHARACTERISTIC DFC_CtlMsk.DFC_DHFHD_C "Behaviour control mask / Behaviour control masks of check DFC_DHFHD" VALUE 0x804D8F8A Val_Wu16 65535.00 DFES_OneToOne 0.00 65535.00 FORMAT "%8.2" /end CHARACTERISTIC
/begin CHARACTERISTIC DFC_CtlMsk.DFC_InjVlv_DI_DcDc_C "Behaviour control mask / Behaviour control masks of check DFC_InjVlv_DI_DcDc" VALUE 0x804D8F8C Val_Wu16 65535.00 DFES_OneToOne 0.00 65535.00 FORMAT "%8.2" /end CHARACTERISTIC
/begin CHARACTERISTIC DFC_CtlMsk.DFC_InjVlv_DI_NoLd_0_C "Behaviour control mask / Behaviour control masks of check DFC_InjVlv_DI_NoLd_0" VALUE 0x804D8F8E Val_Wu16 65535.00 DFES_OneToOne 0.00 65535.00 FORMAT "%8.2" /end CHARACTERISTIC
/begin CHARACTERISTIC DFC_CtlMsk.DFC_InjVlv_DI_NoLd_1_C "Behaviour control mask / Behaviour control masks of check DFC_InjVlv_DI_NoLd_1" VALUE 0x804D8F90 Val_Wu16 65535.00 DFES_OneToOne 0.00 65535.00 FORMAT "%8.2" /end CHARACTERISTIC
/begin CHARACTERISTIC DFC_CtlMsk.DFC_InjVlv_DI_NoLd_2_C "Behaviour control mask / Behaviour control masks of check DFC_InjVlv_DI_NoLd_2" VALUE 0x804D8F92 Val_Wu16 65535.00 DFES_OneToOne 0.00 65535.00 FORMAT "%8.2" /end CHARACTERISTIC
/begin CHARACTERISTIC DFC_CtlMsk.DFC_InjVlv_DI_NoLd_3_C "Behaviour control mask / Behaviour control masks of check DFC_InjVlv_DI_NoLd_3" VALUE 0x804D8F94 Val_Wu16 65535.00 DFES_OneToOne 0.00 65535.00 FORMAT "%8.2" /end CHARACTERISTIC
/begin CHARACTERISTIC DFC_CtlMsk.DFC_InjVlv_DI_ScBnk_0_C "Behaviour control mask / Behaviour control masks of check DFC_InjVlv_DI_ScBnk_0" VALUE 0x804D8F96 Val_Wu16 65535.00 DFES_OneToOne 0.00 65535.00 FORMAT "%8.2" /end CHARACTERISTIC
/begin CHARACTERISTIC DFC_CtlMsk.DFC_InjVlv_DI_ScBnk_1_C "Behaviour control mask / Behaviour control masks of check DFC_InjVlv_DI_ScBnk_1" VALUE 0x804D8F98 Val_Wu16 65535.00 DFES_OneToOne 0.00 65535.00 FORMAT "%8.2" /end CHARACTERISTIC
/begin CHARACTERISTIC DFC_CtlMsk.DFC_InjVlv_DI_ScBnk_2_C "Behaviour control mask / Behaviour control masks of check DFC_InjVlv_DI_ScBnk_2" VALUE 0x804D8F9A Val_Wu16 65535.00 DFES_OneToOne 0.00 65535.00 FORMAT "%8.2" /end CHARACTERISTIC
/begin CHARACTERISTIC DFC_CtlMsk.DFC_InjVlv_DI_ScBnk_3_C "Behaviour control mask / Behaviour control masks of check DFC_InjVlv_DI_ScBnk_3" VALUE 0x804D8F9C Val_Wu16 65535.00 DFES_OneToOne 0.00 65535.00 FORMAT "%8.2" /end CHARACTERISTIC
/begin CHARACTERISTIC DFC_CtlMsk.DFC_InjVlv_DI_ScCyl_0_C "Behaviour control mask / Behaviour control masks of check DFC_InjVlv_DI_ScCyl_0" VALUE 0x804D8F9E Val_Wu16 65535.00 DFES_OneToOne 0.00 65535.00 FORMAT "%8.2" /end CHARACTERISTIC
/begin CHARACTERISTIC DFC_CtlMsk.DFC_InjVlv_DI_ScCyl_1_C "Behaviour control mask / Behaviour control masks of check DFC_InjVlv_DI_ScCyl_1" VALUE 0x804D8FA0 Val_Wu16 65535.00 DFES_OneToOne 0.00 65535.00 FORMAT "%8.2" /end CHARACTERISTIC
/begin CHARACTERISTIC DFC_CtlMsk.DFC_InjVlv_DI_ScCyl_2_C "Behaviour control mask / Behaviour control masks of check DFC_InjVlv_DI_ScCyl_2" VALUE 0x804D8FA2 Val_Wu16 65535.00 DFES_OneToOne 0.00 65535.00 FORMAT "%8.2" /end CHARACTERISTIC
/begin CHARACTERISTIC DFC_CtlMsk.DFC_InjVlv_DI_ScCyl_3_C "Behaviour control mask / Behaviour control masks of check DFC_InjVlv_DI_ScCyl_3" VALUE 0x804D8FA4 Val_Wu16 65535.00 DFES_OneToOne 0.00 65535.00 FORMAT "%8.2" /end CHARACTERISTIC
/begin CHARACTERISTIC DFC_CtlMsk.DFC_InjVlv_DI_ScHsLs_0_C "Behaviour control mask / Behaviour control masks of check DFC_InjVlv_DI_ScHsLs_0" VALUE 0x804D8FA6 Val_Wu16 65535.00 DFES_OneToOne 0.00 65535.00 FORMAT "%8.2" /end CHARACTERISTIC
/begin CHARACTERISTIC DFC_CtlMsk.DFC_InjVlv_DI_ScHsLs_1_C "Behaviour control mask / Behaviour control masks of check DFC_InjVlv_DI_ScHsLs_1" VALUE 0x804D8FA8 Val_Wu16 65535.00 DFES_OneToOne 0.00 65535.00 FORMAT "%8.2" /end CHARACTERISTIC
/begin CHARACTERISTIC DFC_CtlMsk.DFC_InjVlv_DI_ScHsLs_2_C "Behaviour control mask / Behaviour control masks of check DFC_InjVlv_DI_ScHsLs_2" VALUE 0x804D8FAA Val_Wu16 65535.00 DFES_OneToOne 0.00 65535.00 FORMAT "%8.2" /end CHARACTERISTIC
/begin CHARACTERISTIC DFC_CtlMsk.DFC_InjVlv_DI_ScHsLs_3_C "Behaviour control mask / Behaviour control masks of check DFC_InjVlv_DI_ScHsLs_3" VALUE 0x804D8FAC Val_Wu16 65535.00 DFES_OneToOne 0.00 65535.00 FORMAT "%8.2" /end CHARACTERISTIC
/begin CHARACTERISTIC DFC_CtlMsk.DFC_MfPsDiaOpenLoad1_C "Behaviour control mask / Behaviour control masks of check DFC_MfPsDiaOpenLoad1" VALUE 0x804D8FAE Val_Wu16 65535.00 DFES_OneToOne 0.00 65535.00 FORMAT "%8.2" /end CHARACTERISTIC
/begin CHARACTERISTIC DFC_CtlMsk.DFC_MfPsDiaScHiS1_C "Behaviour control mask / Behaviour control masks of check DFC_MfPsDiaScHiS1" VALUE 0x804D8FB0 Val_Wu16 65535.00 DFES_OneToOne 0.00 65535.00 FORMAT "%8.2" /end CHARACTERISTIC
/begin CHARACTERISTIC DFC_CtlMsk.DFC_MfPsDiaScHiSLowS1_C "Behaviour control mask / Behaviour control masks of check DFC_MfPsDiaScHiSLowS1" VALUE 0x804D8FB2 Val_Wu16 65535.00 DFES_OneToOne 0.00 65535.00 FORMAT "%8.2" /end CHARACTERISTIC
/begin CHARACTERISTIC DFC_CtlMsk.DFC_MfPsDiaScLowS1_C "Behaviour control mask / Behaviour control masks of check DFC_MfPsDiaScLowS1" VALUE 0x804D8FB4 Val_Wu16 65535.00 DFES_OneToOne 0.00 65535.00 FORMAT "%8.2" /end CHARACTERISTIC
/begin CHARACTERISTIC DFC_CtlMsk.DFC_ACEvpTPhysRngHi_C "Behaviour control mask / Behaviour control masks of check DFC_ACEvpTPhysRngHi" VALUE 0x804D8FB6 Val_Wu16 65535.00 DFES_OneToOne 0.00 65535.00 FORMAT "%8.2" /end CHARACTERISTIC
/begin CHARACTERISTIC DFC_CtlMsk.DFC_ACEvpTPhysRngLo_C "Behaviour control mask / Behaviour control masks of check DFC_ACEvpTPhysRngLo" VALUE 0x804D8FB8 Val_Wu16 65535.00 DFES_OneToOne 0.00 65535.00 FORMAT "%8.2" /end CHARACTERISTIC
/begin CHARACTERISTIC DFC_CtlMsk.DFC_ACEvpTSRCMax_C "Behaviour control mask / Behaviour control masks of check DFC_ACEvpTSRCMax" VALUE 0x804D8FBA Val_Wu16 65535.00 DFES_OneToOne 0.00 65535.00 FORMAT "%8.2" /end CHARACTERISTIC
/begin CHARACTERISTIC DFC_CtlMsk.DFC_ACEvpTSRCMin_C "Behaviour control mask / Behaviour control masks of check DFC_ACEvpTSRCMin" VALUE 0x804D8FBC Val_Wu16 65535.00 DFES_OneToOne 0.00 65535.00 FORMAT "%8.2" /end CHARACTERISTIC
/begin CHARACTERISTIC DFC_CtlMsk.DFC_AfsRawSigRngHiB1_C "Behaviour control mask / Behaviour control masks of check DFC_AfsRawSigRngHiB1" VALUE 0x804D8FBE Val_Wu16 65535.00 DFES_OneToOne 0.00 65535.00 FORMAT "%8.2" /end CHARACTERISTIC
/begin CHARACTERISTIC DFC_CtlMsk.DFC_AfsRawSigRngLoB1_C "Behaviour control mask / Behaviour control masks of check DFC_AfsRawSigRngLoB1" VALUE 0x804D8FC0 Val_Wu16 65535.00 DFES_OneToOne 0.00 65535.00 FORMAT "%8.2" /end CHARACTERISTIC
/begin CHARACTERISTIC DFC_CtlMsk.DFC_AfsSnsrErrB1_C "Behaviour control mask / Behaviour control masks of check DFC_AfsSnsrErrB1" VALUE 0x804D8FC2 Val_Wu16 65535.00 DFES_OneToOne 0.00 65535.00 FORMAT "%8.2" /end CHARACTERISTIC
/begin CHARACTERISTIC DFC_CtlMsk.DFC_AirCClntPAnaSRCMax_C "Behaviour control mask / Behaviour control masks of check DFC_AirCClntPAnaSRCMax" VALUE 0x804D8FC4 Val_Wu16 65535.00 DFES_OneToOne 0.00 65535.00 FORMAT "%8.2" /end CHARACTERISTIC
/begin CHARACTERISTIC DFC_CtlMsk.DFC_AirCClntPAnaSRCMin_C "Behaviour control mask / Behaviour control masks of check DFC_AirCClntPAnaSRCMin" VALUE 0x804D8FC6 Val_Wu16 65535.00 DFES_OneToOne 0.00 65535.00 FORMAT "%8.2" /end CHARACTERISTIC
/begin CHARACTERISTIC DFC_CtlMsk.DFC_AirCSwtNpl_C "Behaviour control mask / Behaviour control masks of check DFC_AirCSwtNpl" VALUE 0x804D8FC8 Val_Wu16 65535.00 DFES_OneToOne 0.00 65535.00 FORMAT "%8.2" /end CHARACTERISTIC
/begin CHARACTERISTIC DFC_CtlMsk.DFC_AirCSwtSig_C "Behaviour control mask / Behaviour control masks of check DFC_AirCSwtSig" VALUE 0x804D8FCA Val_Wu16 65535.00 DFES_OneToOne 0.00 65535.00 FORMAT "%8.2" /end CHARACTERISTIC
/begin CHARACTERISTIC DFC_CtlMsk.DFC_Brk_C "Behaviour control mask / Behaviour control masks of check DFC_Brk" VALUE 0x804D8FCC Val_Wu16 65535.00 DFES_OneToOne 0.00 65535.00 FORMAT "%8.2" /end CHARACTERISTIC
/begin CHARACTERISTIC DFC_CtlMsk.DFC_BrkBstSensSCB_C "Behaviour control mask / Behaviour control masks of check DFC_BrkBstSensSCB" VALUE 0x804D8FCE Val_Wu16 65535.00 DFES_OneToOne 0.00 65535.00 FORMAT "%8.2" /end CHARACTERISTIC
/begin CHARACTERISTIC DFC_CtlMsk.DFC_BrkBstSensSCG_C "Behaviour control mask / Behaviour control masks of check DFC_BrkBstSensSCG" VALUE 0x804D8FD0 Val_Wu16 65535.00 DFES_OneToOne 0.00 65535.00 FORMAT "%8.2" /end CHARACTERISTIC
/begin CHARACTERISTIC DFC_CtlMsk.DFC_BrkSig_C "Behaviour control mask / Behaviour control masks of check DFC_BrkSig" VALUE 0x804D8FD2 Val_Wu16 65535.00 DFES_OneToOne 0.00 65535.00 FORMAT "%8.2" /end CHARACTERISTIC
/begin CHARACTERISTIC DFC_CtlMsk.DFC_ClthSig_C "Behaviour control mask / Behaviour control masks of check DFC_ClthSig" VALUE 0x804D8FD4 Val_Wu16 65535.00 DFES_OneToOne 0.00 65535.00 FORMAT "%8.2" /end CHARACTERISTIC
/begin CHARACTERISTIC DFC_CtlMsk.DFC_EGRVlvCurrLim_C "Behaviour control mask / Behaviour control masks of check DFC_EGRVlvCurrLim" VALUE 0x804D8FD6 Val_Wu16 65535.00 DFES_OneToOne 0.00 65535.00 FORMAT "%8.2" /end CHARACTERISTIC
/begin CHARACTERISTIC DFC_CtlMsk.DFC_EGRVlvOL_C "Behaviour control mask / Behaviour control masks of check DFC_EGRVlvOL" VALUE 0x804D8FD8 Val_Wu16 65535.00 DFES_OneToOne 0.00 65535.00 FORMAT "%8.2" /end CHARACTERISTIC
/begin CHARACTERISTIC DFC_CtlMsk.DFC_EGRVlvOvrTemp_C "Behaviour control mask / Behaviour control masks of check DFC_EGRVlvOvrTemp" VALUE 0x804D8FDA Val_Wu16 65535.00 DFES_OneToOne 0.00 65535.00 FORMAT "%8.2" /end CHARACTERISTIC
/begin CHARACTERISTIC DFC_CtlMsk.DFC_EGRVlvSCB_C "Behaviour control mask / Behaviour control masks of check DFC_EGRVlvSCB" VALUE 0x804D8FDC Val_Wu16 65535.00 DFES_OneToOne 0.00 65535.00 FORMAT "%8.2" /end CHARACTERISTIC
/begin CHARACTERISTIC DFC_CtlMsk.DFC_EGRVlvSCG_C "Behaviour control mask / Behaviour control masks of check DFC_EGRVlvSCG" VALUE 0x804D8FDE Val_Wu16 65535.00 DFES_OneToOne 0.00 65535.00 FORMAT "%8.2" /end CHARACTERISTIC
/begin CHARACTERISTIC DFC_CtlMsk.DFC_EGRVlvSRCMax_C "Behaviour control mask / Behaviour control masks of check DFC_EGRVlvSRCMax" VALUE 0x804D8FE0 Val_Wu16 65535.00 DFES_OneToOne 0.00 65535.00 FORMAT "%8.2" /end CHARACTERISTIC
/begin CHARACTERISTIC DFC_CtlMsk.DFC_EGRVlvSRCMin_C "Behaviour control mask / Behaviour control masks of check DFC_EGRVlvSRCMin" VALUE 0x804D8FE2 Val_Wu16 65535.00 DFES_OneToOne 0.00 65535.00 FORMAT "%8.2" /end CHARACTERISTIC
/begin CHARACTERISTIC DFC_CtlMsk.DFC_HLSDemOvhtEngLim_C "Behaviour control mask / Behaviour control masks of check DFC_HLSDemOvhtEngLim" VALUE 0x804D8FE4 Val_Wu16 65535.00 DFES_OneToOne 0.00 65535.00 FORMAT "%8.2" /end CHARACTERISTIC
/begin CHARACTERISTIC DFC_CtlMsk.DFC_OilPSwmpSRCMax_C "Behaviour control mask / Behaviour control masks of check DFC_OilPSwmpSRCMax" VALUE 0x804D8FE6 Val_Wu16 65535.00 DFES_OneToOne 0.00 65535.00 FORMAT "%8.2" /end CHARACTERISTIC
/begin CHARACTERISTIC DFC_CtlMsk.DFC_OilPSwmpSRCMin_C "Behaviour control mask / Behaviour control masks of check DFC_OilPSwmpSRCMin" VALUE 0x804D8FE8 Val_Wu16 65535.00 DFES_OneToOne 0.00 65535.00 FORMAT "%8.2" /end CHARACTERISTIC
/begin CHARACTERISTIC DFC_CtlMsk.DFC_PIntkVUsLineHiB1_C "Behaviour control mask / Behaviour control masks of check DFC_PIntkVUsLineHiB1" VALUE 0x804D8FEA Val_Wu16 65535.00 DFES_OneToOne 0.00 65535.00 FORMAT "%8.2" /end CHARACTERISTIC
/begin CHARACTERISTIC DFC_CtlMsk.DFC_PIntkVUsLineLoB1_C "Behaviour control mask / Behaviour control masks of check DFC_PIntkVUsLineLoB1" VALUE 0x804D8FEC Val_Wu16 65535.00 DFES_OneToOne 0.00 65535.00 FORMAT "%8.2" /end CHARACTERISTIC
/begin CHARACTERISTIC DFC_CtlMsk.DFC_VehVPhysRngLo_C "Behaviour control mask / Behaviour control masks of check DFC_VehVPhysRngLo" VALUE 0x804D8FEE Val_Wu16 65535.00 DFES_OneToOne 0.00 65535.00 FORMAT "%8.2" /end CHARACTERISTIC
/begin CHARACTERISTIC DFC_CtlMsk.DFC_VehVSigCan_C "Behaviour control mask / Behaviour control masks of check DFC_VehVSigCan" VALUE 0x804D8FF0 Val_Wu16 65535.00 DFES_OneToOne 0.00 65535.00 FORMAT "%8.2" /end CHARACTERISTIC
/begin CHARACTERISTIC DFC_CtlMsk.DFC_VehVSigCanSafe_C "Behaviour control mask / Behaviour control masks of check DFC_VehVSigCanSafe" VALUE 0x804D8FF2 Val_Wu16 65535.00 DFES_OneToOne 0.00 65535.00 FORMAT "%8.2" /end CHARACTERISTIC
/begin CHARACTERISTIC DFC_CtlMsk.DFC_VlvLftFbOilPSnsrIntk11SRCMax_C "Behaviour control mask / Behaviour control masks of check DFC_VlvLftFbOilPSnsrIntk11SRCMax" VALUE 0x804D8FF4 Val_Wu16 65535.00 DFES_OneToOne 0.00 65535.00 FORMAT "%8.2" /end CHARACTERISTIC
/begin CHARACTERISTIC DFC_CtlMsk.DFC_VlvLftFbOilPSnsrIntk11SRCMin_C "Behaviour control mask / Behaviour control masks of check DFC_VlvLftFbOilPSnsrIntk11SRCMin" VALUE 0x804D8FF6 Val_Wu16 65535.00 DFES_OneToOne 0.00 65535.00 FORMAT "%8.2" /end CHARACTERISTIC
/begin CHARACTERISTIC DFC_CtlMsk.DFC_ClthNpl_C "Behaviour control mask / Behaviour control masks of check DFC_ClthNpl" VALUE 0x804D8FF8 Val_Wu16 65535.00 DFES_OneToOne 0.00 65535.00 FORMAT "%8.2" /end CHARACTERISTIC
/begin CHARACTERISTIC DFC_CtlMsk.DFC_GbxPNPosnDrvCdn_C "Behaviour control mask / Behaviour control masks of check DFC_GbxPNPosnDrvCdn" VALUE 0x804D8FFA Val_Wu16 65535.00 DFES_OneToOne 0.00 65535.00 FORMAT "%8.2" /end CHARACTERISTIC
/begin CHARACTERISTIC DFC_CtlMsk.DFC_GbxPNPosnPlausy_C "Behaviour control mask / Behaviour control masks of check DFC_GbxPNPosnPlausy" VALUE 0x804D8FFC Val_Wu16 65535.00 DFES_OneToOne 0.00 65535.00 FORMAT "%8.2" /end CHARACTERISTIC
/begin CHARACTERISTIC DFC_CtlMsk.DFC_AfsSigErrLineHiB1_C "Behaviour control mask / Behaviour control masks of check DFC_AfsSigErrLineHiB1" VALUE 0x804D8FFE Val_Wu16 65535.00 DFES_OneToOne 0.00 65535.00 FORMAT "%8.2" /end CHARACTERISTIC
/begin CHARACTERISTIC DFC_CtlMsk.DFC_AfsSigErrLineLoB1_C "Behaviour control mask / Behaviour control masks of check DFC_AfsSigErrLineLoB1" VALUE 0x804D9000 Val_Wu16 65535.00 DFES_OneToOne 0.00 65535.00 FORMAT "%8.2" /end CHARACTERISTIC
/begin CHARACTERISTIC DFC_CtlMsk.DFC_PEnvCcMax_C "Behaviour control mask / Behaviour control masks of check DFC_PEnvCcMax" VALUE 0x804D9002 Val_Wu16 65535.00 DFES_OneToOne 0.00 65535.00 FORMAT "%8.2" /end CHARACTERISTIC
/begin CHARACTERISTIC DFC_CtlMsk.DFC_PEnvCcMin_C "Behaviour control mask / Behaviour control masks of check DFC_PEnvCcMin" VALUE 0x804D9004 Val_Wu16 65535.00 DFES_OneToOne 0.00 65535.00 FORMAT "%8.2" /end CHARACTERISTIC
/begin CHARACTERISTIC DFC_CtlMsk.DFC_PEnvRngChkMax_C "Behaviour control mask / Behaviour control masks of check DFC_PEnvRngChkMax" VALUE 0x804D9006 Val_Wu16 65535.00 DFES_OneToOne 0.00 65535.00 FORMAT "%8.2" /end CHARACTERISTIC
/begin CHARACTERISTIC DFC_CtlMsk.DFC_PEnvRngChkMin_C "Behaviour control mask / Behaviour control masks of check DFC_PEnvRngChkMin" VALUE 0x804D9008 Val_Wu16 65535.00 DFES_OneToOne 0.00 65535.00 FORMAT "%8.2" /end CHARACTERISTIC
/begin CHARACTERISTIC DFC_CtlMsk.DFC_PEnvSnsrPlaus_C "Behaviour control mask / Behaviour control masks of check DFC_PEnvSnsrPlaus" VALUE 0x804D900A Val_Wu16 65535.00 DFES_OneToOne 0.00 65535.00 FORMAT "%8.2" /end CHARACTERISTIC
/begin CHARACTERISTIC DFC_CtlMsk.DFC_UEGOHeatrRlyPsOLS1B1_C "Behaviour control mask / Behaviour control masks of check DFC_UEGOHeatrRlyPsOLS1B1" VALUE 0x804D900C Val_Wu16 65535.00 DFES_OneToOne 0.00 65535.00 FORMAT "%8.2" /end CHARACTERISTIC
/begin CHARACTERISTIC DFC_CtlMsk.DFC_UEGOHeatrRlyPsSCBS1B1_C "Behaviour control mask / Behaviour control masks of check DFC_UEGOHeatrRlyPsSCBS1B1" VALUE 0x804D900E Val_Wu16 65535.00 DFES_OneToOne 0.00 65535.00 FORMAT "%8.2" /end CHARACTERISTIC
/begin CHARACTERISTIC DFC_CtlMsk.DFC_UEGOHeatrRlyPsSCGS1B1_C "Behaviour control mask / Behaviour control masks of check DFC_UEGOHeatrRlyPsSCGS1B1" VALUE 0x804D9010 Val_Wu16 65535.00 DFES_OneToOne 0.00 65535.00 FORMAT "%8.2" /end CHARACTERISTIC
/begin CHARACTERISTIC DFC_CtlMsk.DFC_UegoHeatrWireOlS1B1_C "Behaviour control mask / Behaviour control masks of check DFC_UegoHeatrWireOlS1B1" VALUE 0x804D9012 Val_Wu16 65535.00 DFES_OneToOne 0.00 65535.00 FORMAT "%8.2" /end CHARACTERISTIC
/begin CHARACTERISTIC DFC_CtlMsk.DFC_UegoHeatrWireScbS1B1_C "Behaviour control mask / Behaviour control masks of check DFC_UegoHeatrWireScbS1B1" VALUE 0x804D9014 Val_Wu16 65535.00 DFES_OneToOne 0.00 65535.00 FORMAT "%8.2" /end CHARACTERISTIC
/begin CHARACTERISTIC DFC_CtlMsk.DFC_UegoHeatrWireScgS1B1_C "Behaviour control mask / Behaviour control masks of check DFC_UegoHeatrWireScgS1B1" VALUE 0x804D9016 Val_Wu16 65535.00 DFES_OneToOne 0.00 65535.00 FORMAT "%8.2" /end CHARACTERISTIC
/begin CHARACTERISTIC DFC_CtlMsk.DFC_KnDetSens1PortAMax_C "Behaviour control mask / Behaviour control masks of check DFC_KnDetSens1PortAMax" VALUE 0x804D9018 Val_Wu16 65535.00 DFES_OneToOne 0.00 65535.00 FORMAT "%8.2" /end CHARACTERISTIC
/begin CHARACTERISTIC DFC_CtlMsk.DFC_KnDetSens1PortAMin_C "Behaviour control mask / Behaviour control masks of check DFC_KnDetSens1PortAMin" VALUE 0x804D901A Val_Wu16 65535.00 DFES_OneToOne 0.00 65535.00 FORMAT "%8.2" /end CHARACTERISTIC
/begin CHARACTERISTIC DFC_CtlMsk.DFC_KnDetSens1PortBMax_C "Behaviour control mask / Behaviour control masks of check DFC_KnDetSens1PortBMax" VALUE 0x804D901C Val_Wu16 65535.00 DFES_OneToOne 0.00 65535.00 FORMAT "%8.2" /end CHARACTERISTIC
/begin CHARACTERISTIC DFC_CtlMsk.DFC_KnDetSens1PortBMin_C "Behaviour control mask / Behaviour control masks of check DFC_KnDetSens1PortBMin" VALUE 0x804D901E Val_Wu16 65535.00 DFES_OneToOne 0.00 65535.00 FORMAT "%8.2" /end CHARACTERISTIC
/begin CHARACTERISTIC DFC_CtlMsk.DFC_Clth2ONStuck_C "Behaviour control mask / Behaviour control masks of check DFC_Clth2ONStuck" VALUE 0x804D9020 Val_Wu16 65535.00 DFES_OneToOne 0.00 65535.00 FORMAT "%8.2" /end CHARACTERISTIC
/begin CHARACTERISTIC DFC_CtlMsk.DFC_Clth2ONStuckLdc_C "Behaviour control mask / Behaviour control masks of check DFC_Clth2ONStuckLdc" VALUE 0x804D9022 Val_Wu16 65535.00 DFES_OneToOne 0.00 65535.00 FORMAT "%8.2" /end CHARACTERISTIC
/begin CHARACTERISTIC DFC_CtlMsk.DFC_Clth3ONStuckLdc_C "Behaviour control mask / Behaviour control masks of check DFC_Clth3ONStuckLdc" VALUE 0x804D9024 Val_Wu16 65535.00 DFES_OneToOne 0.00 65535.00 FORMAT "%8.2" /end CHARACTERISTIC
/begin CHARACTERISTIC DFC_CtlMsk.DFC_Clth3ONStuckPostDrv_C "Behaviour control mask / Behaviour control masks of check DFC_Clth3ONStuckPostDrv" VALUE 0x804D9026 Val_Wu16 65535.00 DFES_OneToOne 0.00 65535.00 FORMAT "%8.2" /end CHARACTERISTIC
/begin CHARACTERISTIC DFC_CtlMsk.DFC_Clth4ONStuck_C "Behaviour control mask / Behaviour control masks of check DFC_Clth4ONStuck" VALUE 0x804D9028 Val_Wu16 65535.00 DFES_OneToOne 0.00 65535.00 FORMAT "%8.2" /end CHARACTERISTIC
/begin CHARACTERISTIC DFC_CtlMsk.DFC_Clth4ONStuckLdc_C "Behaviour control mask / Behaviour control masks of check DFC_Clth4ONStuckLdc" VALUE 0x804D902A Val_Wu16 65535.00 DFES_OneToOne 0.00 65535.00 FORMAT "%8.2" /end CHARACTERISTIC
/begin CHARACTERISTIC DFC_CtlMsk.DFC_ComBCMUnit_C "Behaviour control mask / Behaviour control masks of check DFC_ComBCMUnit" VALUE 0x804D902C Val_Wu16 65535.00 DFES_OneToOne 0.00 65535.00 FORMAT "%8.2" /end CHARACTERISTIC
/begin CHARACTERISTIC DFC_CtlMsk.DFC_ComDLCTCU01_C "Behaviour control mask / Behaviour control masks of check DFC_ComDLCTCU01" VALUE 0x804D902E Val_Wu16 65535.00 DFES_OneToOne 0.00 65535.00 FORMAT "%8.2" /end CHARACTERISTIC
/begin CHARACTERISTIC DFC_CtlMsk.DFC_ComDLCTCU02_C "Behaviour control mask / Behaviour control masks of check DFC_ComDLCTCU02" VALUE 0x804D9030 Val_Wu16 65535.00 DFES_OneToOne 0.00 65535.00 FORMAT "%8.2" /end CHARACTERISTIC
/begin CHARACTERISTIC DFC_CtlMsk.DFC_ComDLCTCU1_C "Behaviour control mask / Behaviour control masks of check DFC_ComDLCTCU1" VALUE 0x804D9032 Val_Wu16 65535.00 DFES_OneToOne 0.00 65535.00 FORMAT "%8.2" /end CHARACTERISTIC
/begin CHARACTERISTIC DFC_CtlMsk.DFC_ComDLCTCU11_C "Behaviour control mask / Behaviour control masks of check DFC_ComDLCTCU11" VALUE 0x804D9034 Val_Wu16 65535.00 DFES_OneToOne 0.00 65535.00 FORMAT "%8.2" /end CHARACTERISTIC
/begin CHARACTERISTIC DFC_CtlMsk.DFC_ComDLCTCU12_C "Behaviour control mask / Behaviour control masks of check DFC_ComDLCTCU12" VALUE 0x804D9036 Val_Wu16 65535.00 DFES_OneToOne 0.00 65535.00 FORMAT "%8.2" /end CHARACTERISTIC
/begin CHARACTERISTIC DFC_CtlMsk.DFC_ComDLCTCU13_C "Behaviour control mask / Behaviour control masks of check DFC_ComDLCTCU13" VALUE 0x804D9038 Val_Wu16 65535.00 DFES_OneToOne 0.00 65535.00 FORMAT "%8.2" /end CHARACTERISTIC
/begin CHARACTERISTIC DFC_CtlMsk.DFC_ComDLCTCU14_C "Behaviour control mask / Behaviour control masks of check DFC_ComDLCTCU14" VALUE 0x804D903A Val_Wu16 65535.00 DFES_OneToOne 0.00 65535.00 FORMAT "%8.2" /end CHARACTERISTIC
/begin CHARACTERISTIC DFC_CtlMsk.DFC_ComDLCTCU2_C "Behaviour control mask / Behaviour control masks of check DFC_ComDLCTCU2" VALUE 0x804D903C Val_Wu16 65535.00 DFES_OneToOne 0.00 65535.00 FORMAT "%8.2" /end CHARACTERISTIC
/begin CHARACTERISTIC DFC_CtlMsk.DFC_ComDLCTCU3_C "Behaviour control mask / Behaviour control masks of check DFC_ComDLCTCU3" VALUE 0x804D903E Val_Wu16 65535.00 DFES_OneToOne 0.00 65535.00 FORMAT "%8.2" /end CHARACTERISTIC
/begin CHARACTERISTIC DFC_CtlMsk.DFC_ComDLCTCU4_C "Behaviour control mask / Behaviour control masks of check DFC_ComDLCTCU4" VALUE 0x804D9040 Val_Wu16 65535.00 DFES_OneToOne 0.00 65535.00 FORMAT "%8.2" /end CHARACTERISTIC
/begin CHARACTERISTIC DFC_CtlMsk.DFC_ComEPSUnit_C "Behaviour control mask / Behaviour control masks of check DFC_ComEPSUnit" VALUE 0x804D9042 Val_Wu16 65535.00 DFES_OneToOne 0.00 65535.00 FORMAT "%8.2" /end CHARACTERISTIC
/begin CHARACTERISTIC DFC_CtlMsk.DFC_ComIDASBUnit_C "Behaviour control mask / Behaviour control masks of check DFC_ComIDASBUnit" VALUE 0x804D9044 Val_Wu16 65535.00 DFES_OneToOne 0.00 65535.00 FORMAT "%8.2" /end CHARACTERISTIC
/begin CHARACTERISTIC DFC_CtlMsk.DFC_ComIMGUnit_C "Behaviour control mask / Behaviour control masks of check DFC_ComIMGUnit" VALUE 0x804D9046 Val_Wu16 65535.00 DFES_OneToOne 0.00 65535.00 FORMAT "%8.2" /end CHARACTERISTIC
/begin CHARACTERISTIC DFC_CtlMsk.DFC_ComMETUnit_C "Behaviour control mask / Behaviour control masks of check DFC_ComMETUnit" VALUE 0x804D9048 Val_Wu16 65535.00 DFES_OneToOne 0.00 65535.00 FORMAT "%8.2" /end CHARACTERISTIC
/begin CHARACTERISTIC DFC_CtlMsk.DFC_ComSRSUnit_C "Behaviour control mask / Behaviour control masks of check DFC_ComSRSUnit" VALUE 0x804D904A Val_Wu16 65535.00 DFES_OneToOne 0.00 65535.00 FORMAT "%8.2" /end CHARACTERISTIC
/begin CHARACTERISTIC DFC_CtlMsk.DFC_ComVSAUnit_C "Behaviour control mask / Behaviour control masks of check DFC_ComVSAUnit" VALUE 0x804D904C Val_Wu16 65535.00 DFES_OneToOne 0.00 65535.00 FORMAT "%8.2" /end CHARACTERISTIC
/begin CHARACTERISTIC DFC_CtlMsk.DFC_EbsSocFlt_C "Behaviour control mask / Behaviour control masks of check DFC_EbsSocFlt" VALUE 0x804D904E Val_Wu16 65535.00 DFES_OneToOne 0.00 65535.00 FORMAT "%8.2" /end CHARACTERISTIC
/begin CHARACTERISTIC DFC_CtlMsk.DFC_I14229VINErr_C "Behaviour control mask / Behaviour control masks of check DFC_I14229VINErr" VALUE 0x804D9050 Val_Wu16 65535.00 DFES_OneToOne 0.00 65535.00 FORMAT "%8.2" /end CHARACTERISTIC
/begin CHARACTERISTIC DFC_CtlMsk.DFC_InjCatHeatgErr_C "Behaviour control mask / Behaviour control masks of check DFC_InjCatHeatgErr" VALUE 0x804D9052 Val_Wu16 65535.00 DFES_OneToOne 0.00 65535.00 FORMAT "%8.2" /end CHARACTERISTIC
/begin CHARACTERISTIC DFC_CtlMsk.DFC_InjSysMulInjDiagErr_C "Behaviour control mask / Behaviour control masks of check DFC_InjSysMulInjDiagErr" VALUE 0x804D9054 Val_Wu16 65535.00 DFES_OneToOne 0.00 65535.00 FORMAT "%8.2" /end CHARACTERISTIC
/begin CHARACTERISTIC DFC_CtlMsk.DFC_LLRHmax_C "Behaviour control mask / Behaviour control masks of check DFC_LLRHmax" VALUE 0x804D9056 Val_Wu16 65535.00 DFES_OneToOne 0.00 65535.00 FORMAT "%8.2" /end CHARACTERISTIC
/begin CHARACTERISTIC DFC_CtlMsk.DFC_LLRHmin_C "Behaviour control mask / Behaviour control masks of check DFC_LLRHmin" VALUE 0x804D9058 Val_Wu16 65535.00 DFES_OneToOne 0.00 65535.00 FORMAT "%8.2" /end CHARACTERISTIC
/begin CHARACTERISTIC DFC_CtlMsk.DFC_LLRHnpl_C "Behaviour control mask / Behaviour control masks of check DFC_LLRHnpl" VALUE 0x804D905A Val_Wu16 65535.00 DFES_OneToOne 0.00 65535.00 FORMAT "%8.2" /end CHARACTERISTIC
/begin CHARACTERISTIC DFC_CtlMsk.DFC_LLRKHmax_C "Behaviour control mask / Behaviour control masks of check DFC_LLRKHmax" VALUE 0x804D905C Val_Wu16 65535.00 DFES_OneToOne 0.00 65535.00 FORMAT "%8.2" /end CHARACTERISTIC
/begin CHARACTERISTIC DFC_CtlMsk.DFC_LLRKHmin_C "Behaviour control mask / Behaviour control masks of check DFC_LLRKHmin" VALUE 0x804D905E Val_Wu16 65535.00 DFES_OneToOne 0.00 65535.00 FORMAT "%8.2" /end CHARACTERISTIC
/begin CHARACTERISTIC DFC_CtlMsk.DFC_LLRKHnpl_C "Behaviour control mask / Behaviour control masks of check DFC_LLRKHnpl" VALUE 0x804D9060 Val_Wu16 65535.00 DFES_OneToOne 0.00 65535.00 FORMAT "%8.2" /end CHARACTERISTIC
/begin CHARACTERISTIC DFC_CtlMsk.DFC_LinACGUnit_C "Behaviour control mask / Behaviour control masks of check DFC_LinACGUnit" VALUE 0x804D9062 Val_Wu16 65535.00 DFES_OneToOne 0.00 65535.00 FORMAT "%8.2" /end CHARACTERISTIC
/begin CHARACTERISTIC DFC_CtlMsk.DFC_LinAEVUnit_C "Behaviour control mask / Behaviour control masks of check DFC_LinAEVUnit" VALUE 0x804D9064 Val_Wu16 65535.00 DFES_OneToOne 0.00 65535.00 FORMAT "%8.2" /end CHARACTERISTIC
/begin CHARACTERISTIC DFC_CtlMsk.DFC_LinEBSUnit_C "Behaviour control mask / Behaviour control masks of check DFC_LinEBSUnit" VALUE 0x804D9066 Val_Wu16 65535.00 DFES_OneToOne 0.00 65535.00 FORMAT "%8.2" /end CHARACTERISTIC
/begin CHARACTERISTIC DFC_CtlMsk.DFC_RoughRoad_C "Behaviour control mask / Behaviour control masks of check DFC_RoughRoad" VALUE 0x804D9068 Val_Wu16 65535.00 DFES_OneToOne 0.00 65535.00 FORMAT "%8.2" /end CHARACTERISTIC
/begin CHARACTERISTIC DFC_CtlMsk.DFC_SiaEEPRdErr_C "Behaviour control mask / Behaviour control masks of check DFC_SiaEEPRdErr" VALUE 0x804D906A Val_Wu16 65535.00 DFES_OneToOne 0.00 65535.00 FORMAT "%8.2" /end CHARACTERISTIC
/begin CHARACTERISTIC DFC_CtlMsk.DFC_SiaEEPWrngCod_C "Behaviour control mask / Behaviour control masks of check DFC_SiaEEPWrngCod" VALUE 0x804D906C Val_Wu16 65535.00 DFES_OneToOne 0.00 65535.00 FORMAT "%8.2" /end CHARACTERISTIC
/begin CHARACTERISTIC DFC_CtlMsk.DFC_UegoHeatrStrtS1B1_C "Behaviour control mask / Behaviour control masks of check DFC_UegoHeatrStrtS1B1" VALUE 0x804D906E Val_Wu16 65535.00 DFES_OneToOne 0.00 65535.00 FORMAT "%8.2" /end CHARACTERISTIC
/begin CHARACTERISTIC DFC_CtlMsk.DFC_BusDiagCANAPPLBusOff_C "Behaviour control mask / Behaviour control masks of check DFC_BusDiagCANAPPLBusOff" VALUE 0x804D9070 Val_Wu16 65535.00 DFES_OneToOne 0.00 65535.00 FORMAT "%8.2" /end CHARACTERISTIC
/begin CHARACTERISTIC DFC_CtlMsk.DFC_BusDiagCANCANCBusOff_C "Behaviour control mask / Behaviour control masks of check DFC_BusDiagCANCANCBusOff" VALUE 0x804D9072 Val_Wu16 65535.00 DFES_OneToOne 0.00 65535.00 FORMAT "%8.2" /end CHARACTERISTIC
/begin CHARACTERISTIC DFC_CtlMsk.DFC_BusDiagCANVEHICLEBusOff_C "Behaviour control mask / Behaviour control masks of check DFC_BusDiagCANVEHICLEBusOff" VALUE 0x804D9074 Val_Wu16 65535.00 DFES_OneToOne 0.00 65535.00 FORMAT "%8.2" /end CHARACTERISTIC
/begin CHARACTERISTIC DFC_CtlMsk.DFC_RBA_IODIAGPWR_rba_IoExtCy329_SignalVltSply_0_C "Behaviour control mask / Behaviour control masks of check DFC_RBA_IODIAGPWR_rba_IoExtCy329_SignalVltSply_0" VALUE 0x804D9076 Val_Wu16 65535.00 DFES_OneToOne 0.00 65535.00 FORMAT "%8.2" /end CHARACTERISTIC
/begin CHARACTERISTIC DFC_CtlMsk.DFC_RBA_IODIAGPWR_rba_IoExtCy329_SignalVltSply_0OT_C "Behaviour control mask / Behaviour control masks of check DFC_RBA_IODIAGPWR_rba_IoExtCy329_SignalVltSply_0OT" VALUE 0x804D9078 Val_Wu16 65535.00 DFES_OneToOne 0.00 65535.00 FORMAT "%8.2" /end CHARACTERISTIC
/begin CHARACTERISTIC DFC_CtlMsk.DFC_RBA_IODIAGPWR_rba_IoExtCy329_SignalVltSply_0OV_C "Behaviour control mask / Behaviour control masks of check DFC_RBA_IODIAGPWR_rba_IoExtCy329_SignalVltSply_0OV" VALUE 0x804D907A Val_Wu16 65535.00 DFES_OneToOne 0.00 65535.00 FORMAT "%8.2" /end CHARACTERISTIC
/begin CHARACTERISTIC DFC_CtlMsk.DFC_RBA_IODIAGPWR_rba_IoExtCy329_SignalVltSply_0SCG_C "Behaviour control mask / Behaviour control masks of check DFC_RBA_IODIAGPWR_rba_IoExtCy329_SignalVltSply_0SCG" VALUE 0x804D907C Val_Wu16 65535.00 DFES_OneToOne 0.00 65535.00 FORMAT "%8.2" /end CHARACTERISTIC
/begin CHARACTERISTIC DFC_CtlMsk.DFC_RBA_IODIAGPWR_rba_IoExtCy329_SignalVltSply_0UV_C "Behaviour control mask / Behaviour control masks of check DFC_RBA_IODIAGPWR_rba_IoExtCy329_SignalVltSply_0UV" VALUE 0x804D907E Val_Wu16 65535.00 DFES_OneToOne 0.00 65535.00 FORMAT "%8.2" /end CHARACTERISTIC
/begin CHARACTERISTIC DFC_CtlMsk.DFC_RBA_IODIAGPWR_rba_IoExtCy329_SignalVltSply_1_C "Behaviour control mask / Behaviour control masks of check DFC_RBA_IODIAGPWR_rba_IoExtCy329_SignalVltSply_1" VALUE 0x804D9080 Val_Wu16 65535.00 DFES_OneToOne 0.00 65535.00 FORMAT "%8.2" /end CHARACTERISTIC
/begin CHARACTERISTIC DFC_CtlMsk.DFC_RBA_IODIAGPWR_rba_IoExtCy329_SignalVltSply_1OT_C "Behaviour control mask / Behaviour control masks of check DFC_RBA_IODIAGPWR_rba_IoExtCy329_SignalVltSply_1OT" VALUE 0x804D9082 Val_Wu16 65535.00 DFES_OneToOne 0.00 65535.00 FORMAT "%8.2" /end CHARACTERISTIC
/begin CHARACTERISTIC DFC_CtlMsk.DFC_RBA_IODIAGPWR_rba_IoExtCy329_SignalVltSply_1OV_C "Behaviour control mask / Behaviour control masks of check DFC_RBA_IODIAGPWR_rba_IoExtCy329_SignalVltSply_1OV" VALUE 0x804D9084 Val_Wu16 65535.00 DFES_OneToOne 0.00 65535.00 FORMAT "%8.2" /end CHARACTERISTIC
/begin CHARACTERISTIC DFC_CtlMsk.DFC_RBA_IODIAGPWR_rba_IoExtCy329_SignalVltSply_1SCG_C "Behaviour control mask / Behaviour control masks of check DFC_RBA_IODIAGPWR_rba_IoExtCy329_SignalVltSply_1SCG" VALUE 0x804D9086 Val_Wu16 65535.00 DFES_OneToOne 0.00 65535.00 FORMAT "%8.2" /end CHARACTERISTIC
/begin CHARACTERISTIC DFC_CtlMsk.DFC_RBA_IODIAGPWR_rba_IoExtCy329_SignalVltSply_1UV_C "Behaviour control mask / Behaviour control masks of check DFC_RBA_IODIAGPWR_rba_IoExtCy329_SignalVltSply_1UV" VALUE 0x804D9088 Val_Wu16 65535.00 DFES_OneToOne 0.00 65535.00 FORMAT "%8.2" /end CHARACTERISTIC
/begin CHARACTERISTIC DFC_CtlMsk.DFC_RBA_IODIAGPWR_rba_IoExtCy329_SignalVltSply_2_C "Behaviour control mask / Behaviour control masks of check DFC_RBA_IODIAGPWR_rba_IoExtCy329_SignalVltSply_2" VALUE 0x804D908A Val_Wu16 65535.00 DFES_OneToOne 0.00 65535.00 FORMAT "%8.2" /end CHARACTERISTIC
/begin CHARACTERISTIC DFC_CtlMsk.DFC_RBA_IODIAGPWR_rba_IoExtCy329_SignalVltSply_2OT_C "Behaviour control mask / Behaviour control masks of check DFC_RBA_IODIAGPWR_rba_IoExtCy329_SignalVltSply_2OT" VALUE 0x804D908C Val_Wu16 65535.00 DFES_OneToOne 0.00 65535.00 FORMAT "%8.2" /end CHARACTERISTIC
/begin CHARACTERISTIC DFC_CtlMsk.DFC_RBA_IODIAGPWR_rba_IoExtCy329_SignalVltSply_2OV_C "Behaviour control mask / Behaviour control masks of check DFC_RBA_IODIAGPWR_rba_IoExtCy329_SignalVltSply_2OV" VALUE 0x804D908E Val_Wu16 65535.00 DFES_OneToOne 0.00 65535.00 FORMAT "%8.2" /end CHARACTERISTIC
/begin CHARACTERISTIC DFC_CtlMsk.DFC_RBA_IODIAGPWR_rba_IoExtCy329_SignalVltSply_2SCG_C "Behaviour control mask / Behaviour control masks of check DFC_RBA_IODIAGPWR_rba_IoExtCy329_SignalVltSply_2SCG" VALUE 0x804D9090 Val_Wu16 65535.00 DFES_OneToOne 0.00 65535.00 FORMAT "%8.2" /end CHARACTERISTIC
/begin CHARACTERISTIC DFC_CtlMsk.DFC_RBA_IODIAGPWR_rba_IoExtCy329_SignalVltSply_2UV_C "Behaviour control mask / Behaviour control masks of check DFC_RBA_IODIAGPWR_rba_IoExtCy329_SignalVltSply_2UV" VALUE 0x804D9092 Val_Wu16 65535.00 DFES_OneToOne 0.00 65535.00 FORMAT "%8.2" /end CHARACTERISTIC
/begin CHARACTERISTIC DFC_CtlMsk.DFC_CAN_E_TIMEOUT_C "Behaviour control mask / Behaviour control masks of check DFC_CAN_E_TIMEOUT" VALUE 0x804D9094 Val_Wu16 65535.00 DFES_OneToOne 0.00 65535.00 FORMAT "%8.2" /end CHARACTERISTIC
/begin CHARACTERISTIC DFC_CtlMsk.DFC_LIN_E_TIMEOUT_C "Behaviour control mask / Behaviour control masks of check DFC_LIN_E_TIMEOUT" VALUE 0x804D9096 Val_Wu16 65535.00 DFES_OneToOne 0.00 65535.00 FORMAT "%8.2" /end CHARACTERISTIC
/begin CHARACTERISTIC DFC_CtlMsk.DFC_MRlyOL_C "Behaviour control mask / Behaviour control masks of check DFC_MRlyOL" VALUE 0x804D9098 Val_Wu16 65535.00 DFES_OneToOne 0.00 65535.00 FORMAT "%8.2" /end CHARACTERISTIC
/begin CHARACTERISTIC DFC_CtlMsk.DFC_MRlySCB_C "Behaviour control mask / Behaviour control masks of check DFC_MRlySCB" VALUE 0x804D909A Val_Wu16 65535.00 DFES_OneToOne 0.00 65535.00 FORMAT "%8.2" /end CHARACTERISTIC
/begin CHARACTERISTIC DFC_CtlMsk.DFC_MRlySCG_C "Behaviour control mask / Behaviour control masks of check DFC_MRlySCG" VALUE 0x804D909C Val_Wu16 65535.00 DFES_OneToOne 0.00 65535.00 FORMAT "%8.2" /end CHARACTERISTIC
/begin CHARACTERISTIC DFC_CtlMsk.DFC_rba_MultiStackTrace_Threshold_C "Behaviour control mask / Behaviour control masks of check DFC_rba_MultiStackTrace_Threshold" VALUE 0x804D909E Val_Wu16 65535.00 DFES_OneToOne 0.00 65535.00 FORMAT "%8.2" /end CHARACTERISTIC
/begin CHARACTERISTIC DFC_CtlMsk.DFC_BSWM_E_ACTION_FAILED_C "Behaviour control mask / Behaviour control masks of check DFC_BSWM_E_ACTION_FAILED" VALUE 0x804D90A0 Val_Wu16 65535.00 DFES_OneToOne 0.00 65535.00 FORMAT "%8.2" /end CHARACTERISTIC
/begin CHARACTERISTIC DFC_CtlMsk.DFC_BSWM_E_INTRPTQUEUE_FULL_C "Behaviour control mask / Behaviour control masks of check DFC_BSWM_E_INTRPTQUEUE_FULL" VALUE 0x804D90A2 Val_Wu16 65535.00 DFES_OneToOne 0.00 65535.00 FORMAT "%8.2" /end CHARACTERISTIC
/begin CHARACTERISTIC DFC_CtlMsk.DFC_RBA_IOEXTLIB_KEEPALIVE_DRV_C "Behaviour control mask / Behaviour control masks of check DFC_RBA_IOEXTLIB_KEEPALIVE_DRV" VALUE 0x804D90A4 Val_Wu16 65535.00 DFES_OneToOne 0.00 65535.00 FORMAT "%8.2" /end CHARACTERISTIC
/begin CHARACTERISTIC DFC_CtlMsk.DFC_RBA_IOEXTLIB_KEEPALIVE_INI_C "Behaviour control mask / Behaviour control masks of check DFC_RBA_IOEXTLIB_KEEPALIVE_INI" VALUE 0x804D90A6 Val_Wu16 65535.00 DFES_OneToOne 0.00 65535.00 FORMAT "%8.2" /end CHARACTERISTIC
/begin CHARACTERISTIC DFC_CtlMsk.DFC_rba_IoSigRtc_StopCounter_C "Behaviour control mask / Behaviour control masks of check DFC_rba_IoSigRtc_StopCounter" VALUE 0x804D90A8 Val_Wu16 65535.00 DFES_OneToOne 0.00 65535.00 FORMAT "%8.2" /end CHARACTERISTIC
/begin CHARACTERISTIC DFC_CtlMsk.DFC_rba_MRly_Diag_Stk_Event_C "Behaviour control mask / Behaviour control masks of check DFC_rba_MRly_Diag_Stk_Event" VALUE 0x804D90AA Val_Wu16 65535.00 DFES_OneToOne 0.00 65535.00 FORMAT "%8.2" /end CHARACTERISTIC
/begin CHARACTERISTIC DFC_CtlMsk.DFC_rba_MemDiag_MemReadErr_C "Behaviour control mask / Behaviour control masks of check DFC_rba_MemDiag_MemReadErr" VALUE 0x804D90AC Val_Wu16 65535.00 DFES_OneToOne 0.00 65535.00 FORMAT "%8.2" /end CHARACTERISTIC
/begin CHARACTERISTIC DFC_CtlMsk.DFC_rba_MemDiag_MemWrErr_C "Behaviour control mask / Behaviour control masks of check DFC_rba_MemDiag_MemWrErr" VALUE 0x804D90AE Val_Wu16 65535.00 DFES_OneToOne 0.00 65535.00 FORMAT "%8.2" /end CHARACTERISTIC
/begin CHARACTERISTIC DFC_CtlMsk.DFC_rba_SyC_IrrSwOffTrigEngRun_Event_C "Behaviour control mask / Behaviour control masks of check DFC_rba_SyC_IrrSwOffTrigEngRun_Event" VALUE 0x804D90B0 Val_Wu16 65535.00 DFES_OneToOne 0.00 65535.00 FORMAT "%8.2" /end CHARACTERISTIC
/begin CHARACTERISTIC DFC_CtlMsk.DFC_rba_T15_Diag_ComInVld_Event_C "Behaviour control mask / Behaviour control masks of check DFC_rba_T15_Diag_ComInVld_Event" VALUE 0x804D90B2 Val_Wu16 65535.00 DFES_OneToOne 0.00 65535.00 FORMAT "%8.2" /end CHARACTERISTIC
/begin CHARACTERISTIC DFC_CtlMsk.DFC_rba_T15_Diag_ComOff_HwOn_Event_C "Behaviour control mask / Behaviour control masks of check DFC_rba_T15_Diag_ComOff_HwOn_Event" VALUE 0x804D90B4 Val_Wu16 65535.00 DFES_OneToOne 0.00 65535.00 FORMAT "%8.2" /end CHARACTERISTIC
/begin CHARACTERISTIC DFC_CtlMsk.DFC_rba_T15_Diag_ComOn_HwOff_Event_C "Behaviour control mask / Behaviour control masks of check DFC_rba_T15_Diag_ComOn_HwOff_Event" VALUE 0x804D90B6 Val_Wu16 65535.00 DFES_OneToOne 0.00 65535.00 FORMAT "%8.2" /end CHARACTERISTIC
/begin CHARACTERISTIC DFC_CtlMsk.DFC_AAVmin_C "Behaviour control mask / Behaviour control masks of check DFC_AAVmin" VALUE 0x804D90B8 Val_Wu16 65535.00 DFES_OneToOne 0.00 65535.00 FORMAT "%8.2" /end CHARACTERISTIC
/begin CHARACTERISTIC DFC_CtlMsk.DFC_AGRSUS_C "Behaviour control mask / Behaviour control masks of check DFC_AGRSUS" VALUE 0x804D90BA Val_Wu16 65535.00 DFES_OneToOne 0.00 65535.00 FORMAT "%8.2" /end CHARACTERISTIC
/begin CHARACTERISTIC DFC_CtlMsk.DFC_AfsPlausDiagHi_C "Behaviour control mask / Behaviour control masks of check DFC_AfsPlausDiagHi" VALUE 0x804D90BC Val_Wu16 65535.00 DFES_OneToOne 0.00 65535.00 FORMAT "%8.2" /end CHARACTERISTIC
/begin CHARACTERISTIC DFC_CtlMsk.DFC_AfsPlausDiagLo_C "Behaviour control mask / Behaviour control masks of check DFC_AfsPlausDiagLo" VALUE 0x804D90BE Val_Wu16 65535.00 DFES_OneToOne 0.00 65535.00 FORMAT "%8.2" /end CHARACTERISTIC
/begin CHARACTERISTIC DFC_CtlMsk.DFC_AfsVrntDiagErrB1_C "Behaviour control mask / Behaviour control masks of check DFC_AfsVrntDiagErrB1" VALUE 0x804D90C0 Val_Wu16 65535.00 DFES_OneToOne 0.00 65535.00 FORMAT "%8.2" /end CHARACTERISTIC
/begin CHARACTERISTIC DFC_CtlMsk.DFC_AppAllSnsrDfct_C "Behaviour control mask / Behaviour control masks of check DFC_AppAllSnsrDfct" VALUE 0x804D90C2 Val_Wu16 65535.00 DFES_OneToOne 0.00 65535.00 FORMAT "%8.2" /end CHARACTERISTIC
/begin CHARACTERISTIC DFC_CtlMsk.DFC_BBKRnldg_C "Behaviour control mask / Behaviour control masks of check DFC_BBKRnldg" VALUE 0x804D90C4 Val_Wu16 65535.00 DFES_OneToOne 0.00 65535.00 FORMAT "%8.2" /end CHARACTERISTIC
/begin CHARACTERISTIC DFC_CtlMsk.DFC_BBKRsyne_C "Behaviour control mask / Behaviour control masks of check DFC_BBKRsyne" VALUE 0x804D90C6 Val_Wu16 65535.00 DFES_OneToOne 0.00 65535.00 FORMAT "%8.2" /end CHARACTERISTIC
/begin CHARACTERISTIC DFC_CtlMsk.DFC_BattUStdbyDiaOL_C "Behaviour control mask / Behaviour control masks of check DFC_BattUStdbyDiaOL" VALUE 0x804D90C8 Val_Wu16 65535.00 DFES_OneToOne 0.00 65535.00 FORMAT "%8.2" /end CHARACTERISTIC
/begin CHARACTERISTIC DFC_CtlMsk.DFC_BigLeakIntkMnfldEmiInfl_C "Behaviour control mask / Behaviour control masks of check DFC_BigLeakIntkMnfldEmiInfl" VALUE 0x804D90CA Val_Wu16 65535.00 DFES_OneToOne 0.00 65535.00 FORMAT "%8.2" /end CHARACTERISTIC
/begin CHARACTERISTIC DFC_CtlMsk.DFC_BlkdLineTank_C "Behaviour control mask / Behaviour control masks of check DFC_BlkdLineTank" VALUE 0x804D90CC Val_Wu16 65535.00 DFES_OneToOne 0.00 65535.00 FORMAT "%8.2" /end CHARACTERISTIC
/begin CHARACTERISTIC DFC_CtlMsk.DFC_BrkMnSwtContOnWarnLmp_C "Behaviour control mask / Behaviour control masks of check DFC_BrkMnSwtContOnWarnLmp" VALUE 0x804D90CE Val_Wu16 65535.00 DFES_OneToOne 0.00 65535.00 FORMAT "%8.2" /end CHARACTERISTIC
/begin CHARACTERISTIC DFC_CtlMsk.DFC_BrkMnSwtNotStpWarnLmp_C "Behaviour control mask / Behaviour control masks of check DFC_BrkMnSwtNotStpWarnLmp" VALUE 0x804D90D0 Val_Wu16 65535.00 DFES_OneToOne 0.00 65535.00 FORMAT "%8.2" /end CHARACTERISTIC
/begin CHARACTERISTIC DFC_CtlMsk.DFC_BrkRdntSwtContOnWarnLmp_C "Behaviour control mask / Behaviour control masks of check DFC_BrkRdntSwtContOnWarnLmp" VALUE 0x804D90D2 Val_Wu16 65535.00 DFES_OneToOne 0.00 65535.00 FORMAT "%8.2" /end CHARACTERISTIC
/begin CHARACTERISTIC DFC_CtlMsk.DFC_BrkRdntSwtNotStpWarnLmp_C "Behaviour control mask / Behaviour control masks of check DFC_BrkRdntSwtNotStpWarnLmp" VALUE 0x804D90D4 Val_Wu16 65535.00 DFES_OneToOne 0.00 65535.00 FORMAT "%8.2" /end CHARACTERISTIC
/begin CHARACTERISTIC DFC_CtlMsk.DFC_CEngDsTColdStrtMax_C "Behaviour control mask / Behaviour control masks of check DFC_CEngDsTColdStrtMax" VALUE 0x804D90D6 Val_Wu16 65535.00 DFES_OneToOne 0.00 65535.00 FORMAT "%8.2" /end CHARACTERISTIC
/begin CHARACTERISTIC DFC_CtlMsk.DFC_CEngDsTColdStrtMin_C "Behaviour control mask / Behaviour control masks of check DFC_CEngDsTColdStrtMin" VALUE 0x804D90D8 Val_Wu16 65535.00 DFES_OneToOne 0.00 65535.00 FORMAT "%8.2" /end CHARACTERISTIC
/begin CHARACTERISTIC DFC_CtlMsk.DFC_CEngDsTImps_C "Behaviour control mask / Behaviour control masks of check DFC_CEngDsTImps" VALUE 0x804D90DA Val_Wu16 65535.00 DFES_OneToOne 0.00 65535.00 FORMAT "%8.2" /end CHARACTERISTIC
/begin CHARACTERISTIC DFC_CtlMsk.DFC_CEngDsTPlausHSC_C "Behaviour control mask / Behaviour control masks of check DFC_CEngDsTPlausHSC" VALUE 0x804D90DC Val_Wu16 65535.00 DFES_OneToOne 0.00 65535.00 FORMAT "%8.2" /end CHARACTERISTIC
/begin CHARACTERISTIC DFC_CtlMsk.DFC_CEngDsTPlausLSC_C "Behaviour control mask / Behaviour control masks of check DFC_CEngDsTPlausLSC" VALUE 0x804D90DE Val_Wu16 65535.00 DFES_OneToOne 0.00 65535.00 FORMAT "%8.2" /end CHARACTERISTIC
/begin CHARACTERISTIC DFC_CtlMsk.DFC_CEngDsTPlausSTC_C "Behaviour control mask / Behaviour control masks of check DFC_CEngDsTPlausSTC" VALUE 0x804D90E0 Val_Wu16 65535.00 DFES_OneToOne 0.00 65535.00 FORMAT "%8.2" /end CHARACTERISTIC
/begin CHARACTERISTIC DFC_CtlMsk.DFC_CEngDsTSRCMax_C "Behaviour control mask / Behaviour control masks of check DFC_CEngDsTSRCMax" VALUE 0x804D90E2 Val_Wu16 65535.00 DFES_OneToOne 0.00 65535.00 FORMAT "%8.2" /end CHARACTERISTIC
/begin CHARACTERISTIC DFC_CtlMsk.DFC_CEngDsTSRCMin_C "Behaviour control mask / Behaviour control masks of check DFC_CEngDsTSRCMin" VALUE 0x804D90E4 Val_Wu16 65535.00 DFES_OneToOne 0.00 65535.00 FORMAT "%8.2" /end CHARACTERISTIC
/begin CHARACTERISTIC DFC_CtlMsk.DFC_CEngDsTSig_C "Behaviour control mask / Behaviour control masks of check DFC_CEngDsTSig" VALUE 0x804D90E6 Val_Wu16 65535.00 DFES_OneToOne 0.00 65535.00 FORMAT "%8.2" /end CHARACTERISTIC
/begin CHARACTERISTIC DFC_CtlMsk.DFC_CEngUsTColdStrtMax_C "Behaviour control mask / Behaviour control masks of check DFC_CEngUsTColdStrtMax" VALUE 0x804D90E8 Val_Wu16 65535.00 DFES_OneToOne 0.00 65535.00 FORMAT "%8.2" /end CHARACTERISTIC
/begin CHARACTERISTIC DFC_CtlMsk.DFC_CEngUsTColdStrtMin_C "Behaviour control mask / Behaviour control masks of check DFC_CEngUsTColdStrtMin" VALUE 0x804D90EA Val_Wu16 65535.00 DFES_OneToOne 0.00 65535.00 FORMAT "%8.2" /end CHARACTERISTIC
/begin CHARACTERISTIC DFC_CtlMsk.DFC_CEngUsTLooseCnctn_C "Behaviour control mask / Behaviour control masks of check DFC_CEngUsTLooseCnctn" VALUE 0x804D90EC Val_Wu16 65535.00 DFES_OneToOne 0.00 65535.00 FORMAT "%8.2" /end CHARACTERISTIC
/begin CHARACTERISTIC DFC_CtlMsk.DFC_CEngUsTSRCMax_C "Behaviour control mask / Behaviour control masks of check DFC_CEngUsTSRCMax" VALUE 0x804D90EE Val_Wu16 65535.00 DFES_OneToOne 0.00 65535.00 FORMAT "%8.2" /end CHARACTERISTIC
/begin CHARACTERISTIC DFC_CtlMsk.DFC_CEngUsTSRCMin_C "Behaviour control mask / Behaviour control masks of check DFC_CEngUsTSRCMin" VALUE 0x804D90F0 Val_Wu16 65535.00 DFES_OneToOne 0.00 65535.00 FORMAT "%8.2" /end CHARACTERISTIC
/begin CHARACTERISTIC DFC_CtlMsk.DFC_ComDCDCACCFailr_C "Behaviour control mask / Behaviour control masks of check DFC_ComDCDCACCFailr" VALUE 0x804D90F2 Val_Wu16 65535.00 DFES_OneToOne 0.00 65535.00 FORMAT "%8.2" /end CHARACTERISTIC
/begin CHARACTERISTIC DFC_CtlMsk.DFC_DCDCFltDet_C "Behaviour control mask / Behaviour control masks of check DFC_DCDCFltDet" VALUE 0x804D90F4 Val_Wu16 65535.00 DFES_OneToOne 0.00 65535.00 FORMAT "%8.2" /end CHARACTERISTIC
/begin CHARACTERISTIC DFC_CtlMsk.DFC_DKRSA_C "Behaviour control mask / Behaviour control masks of check DFC_DKRSA" VALUE 0x804D90F6 Val_Wu16 65535.00 DFES_OneToOne 0.00 65535.00 FORMAT "%8.2" /end CHARACTERISTIC
/begin CHARACTERISTIC DFC_CtlMsk.DFC_DKVSmax_C "Behaviour control mask / Behaviour control masks of check DFC_DKVSmax" VALUE 0x804D90F8 Val_Wu16 65535.00 DFES_OneToOne 0.00 65535.00 FORMAT "%8.2" /end CHARACTERISTIC
/begin CHARACTERISTIC DFC_CtlMsk.DFC_DKnpl_C "Behaviour control mask / Behaviour control masks of check DFC_DKnpl" VALUE 0x804D90FA Val_Wu16 65535.00 DFES_OneToOne 0.00 65535.00 FORMAT "%8.2" /end CHARACTERISTIC
/begin CHARACTERISTIC DFC_CtlMsk.DFC_DSKVRmax_C "Behaviour control mask / Behaviour control masks of check DFC_DSKVRmax" VALUE 0x804D90FC Val_Wu16 65535.00 DFES_OneToOne 0.00 65535.00 FORMAT "%8.2" /end CHARACTERISTIC
/begin CHARACTERISTIC DFC_CtlMsk.DFC_DSKVRmin_C "Behaviour control mask / Behaviour control masks of check DFC_DSKVRmin" VALUE 0x804D90FE Val_Wu16 65535.00 DFES_OneToOne 0.00 65535.00 FORMAT "%8.2" /end CHARACTERISTIC
/begin CHARACTERISTIC DFC_CtlMsk.DFC_DSKVRnpl_C "Behaviour control mask / Behaviour control masks of check DFC_DSKVRnpl" VALUE 0x804D9100 Val_Wu16 65535.00 DFES_OneToOne 0.00 65535.00 FORMAT "%8.2" /end CHARACTERISTIC
/begin CHARACTERISTIC DFC_CtlMsk.DFC_DSKVRsig_C "Behaviour control mask / Behaviour control masks of check DFC_DSKVRsig" VALUE 0x804D9102 Val_Wu16 65535.00 DFES_OneToOne 0.00 65535.00 FORMAT "%8.2" /end CHARACTERISTIC
/begin CHARACTERISTIC DFC_CtlMsk.DFC_DSKVSsig_C "Behaviour control mask / Behaviour control masks of check DFC_DSKVSsig" VALUE 0x804D9104 Val_Wu16 65535.00 DFES_OneToOne 0.00 65535.00 FORMAT "%8.2" /end CHARACTERISTIC
/begin CHARACTERISTIC DFC_CtlMsk.DFC_DSSmax_C "Behaviour control mask / Behaviour control masks of check DFC_DSSmax" VALUE 0x804D9106 Val_Wu16 65535.00 DFES_OneToOne 0.00 65535.00 FORMAT "%8.2" /end CHARACTERISTIC
/begin CHARACTERISTIC DFC_CtlMsk.DFC_DSTDmax_C "Behaviour control mask / Behaviour control masks of check DFC_DSTDmax" VALUE 0x804D9108 Val_Wu16 65535.00 DFES_OneToOne 0.00 65535.00 FORMAT "%8.2" /end CHARACTERISTIC
/begin CHARACTERISTIC DFC_CtlMsk.DFC_DSTEmax_C "Behaviour control mask / Behaviour control masks of check DFC_DSTEmax" VALUE 0x804D910A Val_Wu16 65535.00 DFES_OneToOne 0.00 65535.00 FORMAT "%8.2" /end CHARACTERISTIC
/begin CHARACTERISTIC DFC_CtlMsk.DFC_DSTEmin_C "Behaviour control mask / Behaviour control masks of check DFC_DSTEmin" VALUE 0x804D910C Val_Wu16 65535.00 DFES_OneToOne 0.00 65535.00 FORMAT "%8.2" /end CHARACTERISTIC
/begin CHARACTERISTIC DFC_CtlMsk.DFC_DSTOFmax_C "Behaviour control mask / Behaviour control masks of check DFC_DSTOFmax" VALUE 0x804D910E Val_Wu16 65535.00 DFES_OneToOne 0.00 65535.00 FORMAT "%8.2" /end CHARACTERISTIC
/begin CHARACTERISTIC DFC_CtlMsk.DFC_DSTRmax_C "Behaviour control mask / Behaviour control masks of check DFC_DSTRmax" VALUE 0x804D9110 Val_Wu16 65535.00 DFES_OneToOne 0.00 65535.00 FORMAT "%8.2" /end CHARACTERISTIC
/begin CHARACTERISTIC DFC_CtlMsk.DFC_DSTRmin_C "Behaviour control mask / Behaviour control masks of check DFC_DSTRmin" VALUE 0x804D9112 Val_Wu16 65535.00 DFES_OneToOne 0.00 65535.00 FORMAT "%8.2" /end CHARACTERISTIC
/begin CHARACTERISTIC DFC_CtlMsk.DFC_DSTRnpl_C "Behaviour control mask / Behaviour control masks of check DFC_DSTRnpl" VALUE 0x804D9114 Val_Wu16 65535.00 DFES_OneToOne 0.00 65535.00 FORMAT "%8.2" /end CHARACTERISTIC
/begin CHARACTERISTIC DFC_CtlMsk.DFC_DSTRsig_C "Behaviour control mask / Behaviour control masks of check DFC_DSTRsig" VALUE 0x804D9116 Val_Wu16 65535.00 DFES_OneToOne 0.00 65535.00 FORMAT "%8.2" /end CHARACTERISTIC
/begin CHARACTERISTIC DFC_CtlMsk.DFC_DSTTI_C "Behaviour control mask / Behaviour control masks of check DFC_DSTTI" VALUE 0x804D9118 Val_Wu16 65535.00 DFES_OneToOne 0.00 65535.00 FORMAT "%8.2" /end CHARACTERISTIC
/begin MEASUREMENT DFC_lenMaxCllsn "Measurement longest DFC Kollision" ULONG OneToOne 1 100 0.00 4294967295.00 FORMAT "%13.2" ECU_ADDRESS 0x6003947C /end MEASUREMENT
/begin MEASUREMENT DFC_nrCllsnClear "Number of DFC collisions at fcmclear" ULONG OneToOne 1 100 0.00 4294967295.00 FORMAT "%13.2" ECU_ADDRESS 0x50000200 /end MEASUREMENT
/begin MEASUREMENT DFC_nrCllsnReInit "Number of DFC collisions at reInit" ULONG OneToOne 1 100 0.00 4294967295.00 FORMAT "%13.2" ECU_ADDRESS 0x600002F0 /end MEASUREMENT
/begin MEASUREMENT DFC_nrCllsnReport "Number of DFC collisions at report" ULONG OneToOne 1 100 0.00 4294967295.00 FORMAT "%13.2" ECU_ADDRESS 0x50000204 /end MEASUREMENT
/begin MEASUREMENT DFC_numDfcMaxCllsn "DFC which encountered the longest collision" UWORD DFCDFP_Verb 1 100 0.00 989.000000000 FORMAT "%13.9" ECU_ADDRESS 0x6003947A /end MEASUREMENT
/begin MEASUREMENT DFC_st.DFC_ORAmin "Status of DFC / Status of diagnostic fault check DFC_ORAmin" UBYTE DFC_OneToOne 1 100 0.00 255.0 FORMAT "%5.1" ECU_ADDRESS 0x600371FD /end MEASUREMENT
/begin MEASUREMENT DFC_st.DFC_OilPPlaus "Status of DFC / Status of diagnostic fault check DFC_OilPPlaus" UBYTE DFC_OneToOne 1 100 0.00 255.0 FORMAT "%5.1" ECU_ADDRESS 0x600371FE /end MEASUREMENT
/begin MEASUREMENT DFC_st.DFC_PLLSUmax "Status of DFC / Status of diagnostic fault check DFC_PLLSUmax" UBYTE DFC_OneToOne 1 100 0.00 255.0 FORMAT "%5.1" ECU_ADDRESS 0x600371FF /end MEASUREMENT
/begin MEASUREMENT DFC_st.DFC_PLLSUmin "Status of DFC / Status of diagnostic fault check DFC_PLLSUmin" UBYTE DFC_OneToOne 1 100 0.00 255.0 FORMAT "%5.1" ECU_ADDRESS 0x60037200 /end MEASUREMENT
/begin MEASUREMENT DFC_st.DFC_PSR1max "Status of DFC / Status of diagnostic fault check DFC_PSR1max" UBYTE DFC_OneToOne 1 100 0.00 255.0 FORMAT "%5.1" ECU_ADDRESS 0x60037201 /end MEASUREMENT
/begin MEASUREMENT DFC_st.DFC_PSRBmax "Status of DFC / Status of diagnostic fault check DFC_PSRBmax" UBYTE DFC_OneToOne 1 100 0.00 255.0 FORMAT "%5.1" ECU_ADDRESS 0x60037202 /end MEASUREMENT
/begin MEASUREMENT DFC_st.DFC_PSRBmin "Status of DFC / Status of diagnostic fault check DFC_PSRBmin" UBYTE DFC_OneToOne 1 100 0.00 255.0 FORMAT "%5.1" ECU_ADDRESS 0x60037203 /end MEASUREMENT
/begin MEASUREMENT DFC_st.DFC_PSRPmax "Status of DFC / Status of diagnostic fault check DFC_PSRPmax" UBYTE DFC_OneToOne 1 100 0.00 255.0 FORMAT "%5.1" ECU_ADDRESS 0x60037204 /end MEASUREMENT
/begin MEASUREMENT DFC_st.DFC_PSRPmin "Status of DFC / Status of diagnostic fault check DFC_PSRPmin" UBYTE DFC_OneToOne 1 100 0.00 255.0 FORMAT "%5.1" ECU_ADDRESS 0x60037205 /end MEASUREMENT
/begin MEASUREMENT DFC_st.DFC_PSRPsig "Status of DFC / Status of diagnostic fault check DFC_PSRPsig" UBYTE DFC_OneToOne 1 100 0.00 255.0 FORMAT "%5.1" ECU_ADDRESS 0x60037206 /end MEASUREMENT
/begin MEASUREMENT DFC_st.DFC_PSRmax "Status of DFC / Status of diagnostic fault check DFC_PSRmax" UBYTE DFC_OneToOne 1 100 0.00 255.0 FORMAT "%5.1" ECU_ADDRESS 0x60037207 /end MEASUREMENT
/begin MEASUREMENT DFC_st.DFC_PUmax "Status of DFC / Status of diagnostic fault check DFC_PUmax" UBYTE DFC_OneToOne 1 100 0.00 255.0 FORMAT "%5.1" ECU_ADDRESS 0x60037208 /end MEASUREMENT
/begin MEASUREMENT DFC_st.DFC_P_VSE11_OL "Status of DFC / Status of diagnostic fault check DFC_P_VSE11_OL" UBYTE DFC_OneToOne 1 100 0.00 255.0 FORMAT "%5.1" ECU_ADDRESS 0x60037209 /end MEASUREMENT
/begin MEASUREMENT DFC_st.DFC_P_VSE11_SCB "Status of DFC / Status of diagnostic fault check DFC_P_VSE11_SCB" UBYTE DFC_OneToOne 1 100 0.00 255.0 FORMAT "%5.1" ECU_ADDRESS 0x6003720A /end MEASUREMENT
/begin MEASUREMENT DFC_st.DFC_P_VSE11_SCG "Status of DFC / Status of diagnostic fault check DFC_P_VSE11_SCG" UBYTE DFC_OneToOne 1 100 0.00 255.0 FORMAT "%5.1" ECU_ADDRESS 0x6003720B /end MEASUREMENT
/begin MEASUREMENT DFC_st.DFC_PhyHighAPP1 "Status of DFC / Status of diagnostic fault check DFC_PhyHighAPP1" UBYTE DFC_OneToOne 1 100 0.00 255.0 FORMAT "%5.1" ECU_ADDRESS 0x6003720C /end MEASUREMENT
/begin MEASUREMENT DFC_st.DFC_PhyHighAPP2 "Status of DFC / Status of diagnostic fault check DFC_PhyHighAPP2" UBYTE DFC_OneToOne 1 100 0.00 255.0 FORMAT "%5.1" ECU_ADDRESS 0x6003720D /end MEASUREMENT
/begin MEASUREMENT DFC_st.DFC_PhyLowAPP1 "Status of DFC / Status of diagnostic fault check DFC_PhyLowAPP1" UBYTE DFC_OneToOne 1 100 0.00 255.0 FORMAT "%5.1" ECU_ADDRESS 0x6003720E /end MEASUREMENT
/begin MEASUREMENT DFC_st.DFC_PhyLowAPP2 "Status of DFC / Status of diagnostic fault check DFC_PhyLowAPP2" UBYTE DFC_OneToOne 1 100 0.00 255.0 FORMAT "%5.1" ECU_ADDRESS 0x6003720F /end MEASUREMENT
/begin MEASUREMENT DFC_st.DFC_SRCHighAPP1 "Status of DFC / Status of diagnostic fault check DFC_SRCHighAPP1" UBYTE DFC_OneToOne 1 100 0.00 255.0 FORMAT "%5.1" ECU_ADDRESS 0x60037210 /end MEASUREMENT
/begin MEASUREMENT DFC_st.DFC_SRCHighAPP2 "Status of DFC / Status of diagnostic fault check DFC_SRCHighAPP2" UBYTE DFC_OneToOne 1 100 0.00 255.0 FORMAT "%5.1" ECU_ADDRESS 0x60037211 /end MEASUREMENT
/begin MEASUREMENT DFC_st.DFC_SRCLowAPP1 "Status of DFC / Status of diagnostic fault check DFC_SRCLowAPP1" UBYTE DFC_OneToOne 1 100 0.00 255.0 FORMAT "%5.1" ECU_ADDRESS 0x60037212 /end MEASUREMENT
/begin MEASUREMENT DFC_st.DFC_SRCLowAPP2 "Status of DFC / Status of diagnostic fault check DFC_SRCLowAPP2" UBYTE DFC_OneToOne 1 100 0.00 255.0 FORMAT "%5.1" ECU_ADDRESS 0x60037213 /end MEASUREMENT
/begin MEASUREMENT DFC_st.DFC_SSpMon2 "Status of DFC / Status of diagnostic fault check DFC_SSpMon2" UBYTE DFC_OneToOne 1 100 0.00 255.0 FORMAT "%5.1" ECU_ADDRESS 0x60037214 /end MEASUREMENT
/begin MEASUREMENT DFC_st.DFC_STHDRmax "Status of DFC / Status of diagnostic fault check DFC_STHDRmax" UBYTE DFC_OneToOne 1 100 0.00 255.0 FORMAT "%5.1" ECU_ADDRESS 0x60037215 /end MEASUREMENT
/begin MEASUREMENT DFC_st.DFC_SWReset_0 "Status of DFC / Status of diagnostic fault check DFC_SWReset_0" UBYTE DFC_OneToOne 1 100 0.00 255.0 FORMAT "%5.1" ECU_ADDRESS 0x60037216 /end MEASUREMENT
/begin MEASUREMENT DFC_st.DFC_SWReset_1 "Status of DFC / Status of diagnostic fault check DFC_SWReset_1" UBYTE DFC_OneToOne 1 100 0.00 255.0 FORMAT "%5.1" ECU_ADDRESS 0x60037217 /end MEASUREMENT
/begin MEASUREMENT DFC_st.DFC_SWReset_2 "Status of DFC / Status of diagnostic fault check DFC_SWReset_2" UBYTE DFC_OneToOne 1 100 0.00 255.0 FORMAT "%5.1" ECU_ADDRESS 0x60037218 /end MEASUREMENT
/begin MEASUREMENT DFC_st.DFC_SyncAPP "Status of DFC / Status of diagnostic fault check DFC_SyncAPP" UBYTE DFC_OneToOne 1 100 0.00 255.0 FORMAT "%5.1" ECU_ADDRESS 0x60037219 /end MEASUREMENT
/begin MEASUREMENT DFC_st.DFC_TANKLnpl "Status of DFC / Status of diagnostic fault check DFC_TANKLnpl" UBYTE DFC_OneToOne 1 100 0.00 255.0 FORMAT "%5.1" ECU_ADDRESS 0x6003721A /end MEASUREMENT
/begin MEASUREMENT DFC_st.DFC_TAmax_Dummy "Status of DFC / Status of diagnostic fault check DFC_TAmax_Dummy" UBYTE DFC_OneToOne 1 100 0.00 255.0 FORMAT "%5.1" ECU_ADDRESS 0x6003721B /end MEASUREMENT
/begin MEASUREMENT DFC_st.DFC_TESFmax "Status of DFC / Status of diagnostic fault check DFC_TESFmax" UBYTE DFC_OneToOne 1 100 0.00 255.0 FORMAT "%5.1" ECU_ADDRESS 0x6003721C /end MEASUREMENT
/begin MEASUREMENT DFC_st.DFC_TESGmax "Status of DFC / Status of diagnostic fault check DFC_TESGmax" UBYTE DFC_OneToOne 1 100 0.00 255.0 FORMAT "%5.1" ECU_ADDRESS 0x6003721D /end MEASUREMENT
/begin MEASUREMENT DFC_st.DFC_TKAEmax "Status of DFC / Status of diagnostic fault check DFC_TKAEmax" UBYTE DFC_OneToOne 1 100 0.00 255.0 FORMAT "%5.1" ECU_ADDRESS 0x6003721E /end MEASUREMENT
/begin MEASUREMENT DFC_st.DFC_TKAEmin "Status of DFC / Status of diagnostic fault check DFC_TKAEmin" UBYTE DFC_OneToOne 1 100 0.00 255.0 FORMAT "%5.1" ECU_ADDRESS 0x6003721F /end MEASUREMENT
/begin MEASUREMENT DFC_st.DFC_TKARmax "Status of DFC / Status of diagnostic fault check DFC_TKARmax" UBYTE DFC_OneToOne 1 100 0.00 255.0 FORMAT "%5.1" ECU_ADDRESS 0x60037220 /end MEASUREMENT
/begin MEASUREMENT DFC_st.DFC_TKARnpl "Status of DFC / Status of diagnostic fault check DFC_TKARnpl" UBYTE DFC_OneToOne 1 100 0.00 255.0 FORMAT "%5.1" ECU_ADDRESS 0x60037221 /end MEASUREMENT
/begin MEASUREMENT DFC_st.DFC_TMmax_Dummy "Status of DFC / Status of diagnostic fault check DFC_TMmax_Dummy" UBYTE DFC_OneToOne 1 100 0.00 255.0 FORMAT "%5.1" ECU_ADDRESS 0x60037222 /end MEASUREMENT
/begin MEASUREMENT DFC_st.DFC_TUMmax_Dummy "Status of DFC / Status of diagnostic fault check DFC_TUMmax_Dummy" UBYTE DFC_OneToOne 1 100 0.00 255.0 FORMAT "%5.1" ECU_ADDRESS 0x60037223 /end MEASUREMENT
/begin MEASUREMENT DFC_st.DFC_TWCDPriCatB1 "Status of DFC / Status of diagnostic fault check DFC_TWCDPriCatB1" UBYTE DFC_OneToOne 1 100 0.00 255.0 FORMAT "%5.1" ECU_ADDRESS 0x60037224 /end MEASUREMENT
/begin MEASUREMENT DFC_st.DFC_ThrVlvClsdPosnFirstOffsLrnImpoB1 "Status of DFC / Status of diagnostic fault check DFC_ThrVlvClsdPosnFirstOffsLrnImpoB1" UBYTE DFC_OneToOne 1 100 0.00 255.0 FORMAT "%5.1" ECU_ADDRESS 0x60037225 /end MEASUREMENT
/begin MEASUREMENT DFC_st.DFC_ThrVlvClsdPosnOffsLrnImpoB1 "Status of DFC / Status of diagnostic fault check DFC_ThrVlvClsdPosnOffsLrnImpoB1" UBYTE DFC_OneToOne 1 100 0.00 255.0 FORMAT "%5.1" ECU_ADDRESS 0x60037226 /end MEASUREMENT
/begin MEASUREMENT DFC_st.DFC_ThrVlvClsdPosnOffsLrnMaxB1 "Status of DFC / Status of diagnostic fault check DFC_ThrVlvClsdPosnOffsLrnMaxB1" UBYTE DFC_OneToOne 1 100 0.00 255.0 FORMAT "%5.1" ECU_ADDRESS 0x60037227 /end MEASUREMENT
/begin MEASUREMENT DFC_st.DFC_ThrVlvClsdPosnOffsLrnMinB1 "Status of DFC / Status of diagnostic fault check DFC_ThrVlvClsdPosnOffsLrnMinB1" UBYTE DFC_OneToOne 1 100 0.00 255.0 FORMAT "%5.1" ECU_ADDRESS 0x60037228 /end MEASUREMENT
/begin MEASUREMENT DFC_st.DFC_ThrVlvCtrlDeB1 "Status of DFC / Status of diagnostic fault check DFC_ThrVlvCtrlDeB1" UBYTE DFC_OneToOne 1 100 0.00 255.0 FORMAT "%5.1" ECU_ADDRESS 0x60037229 /end MEASUREMENT
/begin MEASUREMENT DFC_st.DFC_ThrVlvDycB1 "Status of DFC / Status of diagnostic fault check DFC_ThrVlvDycB1" UBYTE DFC_OneToOne 1 100 0.00 255.0 FORMAT "%5.1" ECU_ADDRESS 0x6003722A /end MEASUREMENT
/begin MEASUREMENT DFC_st.DFC_ThrVlvLimpAirPosnMaxAbsltDriftB1 "Status of DFC / Status of diagnostic fault check DFC_ThrVlvLimpAirPosnMaxAbsltDriftB1" UBYTE DFC_OneToOne 1 100 0.00 255.0 FORMAT "%5.1" ECU_ADDRESS 0x6003722B /end MEASUREMENT
/begin MEASUREMENT DFC_st.DFC_ThrVlvLimpAirPosnMaxB1 "Status of DFC / Status of diagnostic fault check DFC_ThrVlvLimpAirPosnMaxB1" UBYTE DFC_OneToOne 1 100 0.00 255.0 FORMAT "%5.1" ECU_ADDRESS 0x6003722C /end MEASUREMENT
/begin MEASUREMENT DFC_st.DFC_ThrVlvLimpAirPosnMaxRelDriftB1 "Status of DFC / Status of diagnostic fault check DFC_ThrVlvLimpAirPosnMaxRelDriftB1" UBYTE DFC_OneToOne 1 100 0.00 255.0 FORMAT "%5.1" ECU_ADDRESS 0x6003722D /end MEASUREMENT
/begin MEASUREMENT DFC_st.DFC_ThrVlvLimpAirPosnMinB1 "Status of DFC / Status of diagnostic fault check DFC_ThrVlvLimpAirPosnMinB1" UBYTE DFC_OneToOne 1 100 0.00 255.0 FORMAT "%5.1" ECU_ADDRESS 0x6003722E /end MEASUREMENT
/begin MEASUREMENT DFC_st.DFC_ThrVlvOpenLoadB1 "Status of DFC / Status of diagnostic fault check DFC_ThrVlvOpenLoadB1" UBYTE DFC_OneToOne 1 100 0.00 255.0 FORMAT "%5.1" ECU_ADDRESS 0x6003722F /end MEASUREMENT
/begin MEASUREMENT DFC_st.DFC_ThrVlvOpenSprgB1 "Status of DFC / Status of diagnostic fault check DFC_ThrVlvOpenSprgB1" UBYTE DFC_OneToOne 1 100 0.00 255.0 FORMAT "%5.1" ECU_ADDRESS 0x60037230 /end MEASUREMENT
/begin MEASUREMENT DFC_st.DFC_ThrVlvOpenSprgSprdB1 "Status of DFC / Status of diagnostic fault check DFC_ThrVlvOpenSprgSprdB1" UBYTE DFC_OneToOne 1 100 0.00 255.0 FORMAT "%5.1" ECU_ADDRESS 0x60037231 /end MEASUREMENT
/begin MEASUREMENT DFC_st.DFC_ThrVlvOpenSprgTwnB1 "Status of DFC / Status of diagnostic fault check DFC_ThrVlvOpenSprgTwnB1" UBYTE DFC_OneToOne 1 100 0.00 255.0 FORMAT "%5.1" ECU_ADDRESS 0x60037232 /end MEASUREMENT
/begin MEASUREMENT DFC_st.DFC_ThrVlvOverTB1 "Status of DFC / Status of diagnostic fault check DFC_ThrVlvOverTB1" UBYTE DFC_OneToOne 1 100 0.00 255.0 FORMAT "%5.1" ECU_ADDRESS 0x60037233 /end MEASUREMENT
/begin MEASUREMENT DFC_st.DFC_ThrVlvRetSprgB1 "Status of DFC / Status of diagnostic fault check DFC_ThrVlvRetSprgB1" UBYTE DFC_OneToOne 1 100 0.00 255.0 FORMAT "%5.1" ECU_ADDRESS 0x60037234 /end MEASUREMENT
/begin MEASUREMENT DFC_st.DFC_ThrVlvRetSprgSprdB1 "Status of DFC / Status of diagnostic fault check DFC_ThrVlvRetSprgSprdB1" UBYTE DFC_OneToOne 1 100 0.00 255.0 FORMAT "%5.1" ECU_ADDRESS 0x60037235 /end MEASUREMENT
/begin MEASUREMENT DFC_st.DFC_ThrVlvRetSprgTwnB1 "Status of DFC / Status of diagnostic fault check DFC_ThrVlvRetSprgTwnB1" UBYTE DFC_OneToOne 1 100 0.00 255.0 FORMAT "%5.1" ECU_ADDRESS 0x60037236 /end MEASUREMENT
/begin MEASUREMENT DFC_st.DFC_ThrVlvSens1MaxB1 "Status of DFC / Status of diagnostic fault check DFC_ThrVlvSens1MaxB1" UBYTE DFC_OneToOne 1 100 0.00 255.0 FORMAT "%5.1" ECU_ADDRESS 0x60037237 /end MEASUREMENT
/begin MEASUREMENT DFC_st.DFC_ThrVlvSens1NplB1 "Status of DFC / Status of diagnostic fault check DFC_ThrVlvSens1NplB1" UBYTE DFC_OneToOne 1 100 0.00 255.0 FORMAT "%5.1" ECU_ADDRESS 0x60037238 /end MEASUREMENT
/begin MEASUREMENT DFC_st.DFC_ThrVlvSens2MaxB1 "Status of DFC / Status of diagnostic fault check DFC_ThrVlvSens2MaxB1" UBYTE DFC_OneToOne 1 100 0.00 255.0 FORMAT "%5.1" ECU_ADDRESS 0x60037239 /end MEASUREMENT
/begin MEASUREMENT DFC_st.DFC_ThrVlvSens2MinB1 "Status of DFC / Status of diagnostic fault check DFC_ThrVlvSens2MinB1" UBYTE DFC_OneToOne 1 100 0.00 255.0 FORMAT "%5.1" ECU_ADDRESS 0x6003723A /end MEASUREMENT
/begin MEASUREMENT DFC_st.DFC_ThrVlvSens2NplB1 "Status of DFC / Status of diagnostic fault check DFC_ThrVlvSens2NplB1" UBYTE DFC_OneToOne 1 100 0.00 255.0 FORMAT "%5.1" ECU_ADDRESS 0x6003723B /end MEASUREMENT
/begin MEASUREMENT DFC_st.DFC_ThrVlvShoCircB1 "Status of DFC / Status of diagnostic fault check DFC_ThrVlvShoCircB1" UBYTE DFC_OneToOne 1 100 0.00 255.0 FORMAT "%5.1" ECU_ADDRESS 0x6003723C /end MEASUREMENT
/begin MEASUREMENT DFC_st.DFC_ThrVlvSpiErrB1 "Status of DFC / Status of diagnostic fault check DFC_ThrVlvSpiErrB1" UBYTE DFC_OneToOne 1 100 0.00 255.0 FORMAT "%5.1" ECU_ADDRESS 0x6003723D /end MEASUREMENT
/begin MEASUREMENT DFC_st.DFC_ThrvlvSens1MinB1 "Status of DFC / Status of diagnostic fault check DFC_ThrvlvSens1MinB1" UBYTE DFC_OneToOne 1 100 0.00 255.0 FORMAT "%5.1" ECU_ADDRESS 0x6003723E /end MEASUREMENT
/begin MEASUREMENT DFC_st.DFC_TiOffTBasdChkFast "Status of DFC / Status of diagnostic fault check DFC_TiOffTBasdChkFast" UBYTE DFC_OneToOne 1 100 0.00 255.0 FORMAT "%5.1" ECU_ADDRESS 0x6003723F /end MEASUREMENT
/begin MEASUREMENT DFC_st.DFC_TiOffTBasdChkSlow "Status of DFC / Status of diagnostic fault check DFC_TiOffTBasdChkSlow" UBYTE DFC_OneToOne 1 100 0.00 255.0 FORMAT "%5.1" ECU_ADDRESS 0x60037240 /end MEASUREMENT
/begin MEASUREMENT DFC_st.DFC_UEGOSnsrMntdS1B1 "Status of DFC / Status of diagnostic fault check DFC_UEGOSnsrMntdS1B1" UBYTE DFC_OneToOne 1 100 0.00 255.0 FORMAT "%5.1" ECU_ADDRESS 0x60037241 /end MEASUREMENT
/begin MEASUREMENT DFC_st.DFC_VehVSig "Status of DFC / Status of diagnostic fault check DFC_VehVSig" UBYTE DFC_OneToOne 1 100 0.00 255.0 FORMAT "%5.1" ECU_ADDRESS 0x60037242 /end MEASUREMENT
/begin MEASUREMENT DFC_st.DFC_VlvLftFbSwtIntk11SpclFail "Status of DFC / Status of diagnostic fault check DFC_VlvLftFbSwtIntk11SpclFail" UBYTE DFC_OneToOne 1 100 0.00 255.0 FORMAT "%5.1" ECU_ADDRESS 0x60037243 /end MEASUREMENT
/begin MEASUREMENT DFC_st.DFC_VlvLftFbSwtIntk11StdFail "Status of DFC / Status of diagnostic fault check DFC_VlvLftFbSwtIntk11StdFail" UBYTE DFC_OneToOne 1 100 0.00 255.0 FORMAT "%5.1" ECU_ADDRESS 0x60037244 /end MEASUREMENT
/begin MEASUREMENT DFC_stClctFault_mp "Collected error states of all fault checks" UWORD DFC_OneToOne 1 100 0.00 65535.00 FORMAT "%8.2" ARRAY_SIZE 57 ECU_ADDRESS 0x70009E66 /end MEASUREMENT
/begin MEASUREMENT DFC_stClctTst_mp "Collected tested states of all fault checks" UWORD DFC_OneToOne 1 100 0.00 65535.00 FORMAT "%8.2" ARRAY_SIZE 57 ECU_ADDRESS 0x70009DF4 /end MEASUREMENT
/begin MEASUREMENT DFC_stFinal "Disable (or check finished) status of all DFCs (for PID$41 calculation)" UWORD DFC_OneToOne 1 100 0.00 65535.00 FORMAT "%8.2" ARRAY_SIZE 57 ECU_ADDRESS 0x500058DE /end MEASUREMENT
/begin MEASUREMENT DFC_stMem "Fault entry exists - per DFC" UWORD DFC_OneToOne 1 100 0.00 65535.00 FORMAT "%8.2" ARRAY_SIZE 57 ECU_ADDRESS 0x60036E48 /end MEASUREMENT
/begin MEASUREMENT DFC_stRdy "Ready state due to ""OK"" per DFC" UWORD DFC_OneToOne 1 100 0.00 65535.00 FORMAT "%8.2" ARRAY_SIZE 57 ECU_ADDRESS 0x60038734 /end MEASUREMENT
/begin MEASUREMENT DFC_stTestFaildInhb "" UWORD DFC_OneToOne 1 100 0.00 65535.00 FORMAT "%8.2" ARRAY_SIZE 57 ECU_ADDRESS 0x600386C2 /end MEASUREMENT
/begin MEASUREMENT DSQ_st.DSQ_ACClntP "Status signal quality / Status of signal quality DSQ_ACClntP" UBYTE DFC_OneToOne 1 100 0.00 255.0 FORMAT "%5.1" ECU_ADDRESS 0x600101CC /end MEASUREMENT
/begin MEASUREMENT DSQ_st.DSQ_ACEvpT "Status signal quality / Status of signal quality DSQ_ACEvpT" UBYTE DFC_OneToOne 1 100 0.00 255.0 FORMAT "%5.1" ECU_ADDRESS 0x600101CD /end MEASUREMENT
/begin MEASUREMENT DSQ_st.DSQ_AirCCmprActr "Status signal quality / Status of signal quality DSQ_AirCCmprActr" UBYTE DFC_OneToOne 1 100 0.00 255.0 FORMAT "%5.1" ECU_ADDRESS 0x600101CE /end MEASUREMENT
/begin MEASUREMENT DSQ_st.DSQ_BattU "Status signal quality / Status of signal quality DSQ_BattU" UBYTE DFC_OneToOne 1 100 0.00 255.0 FORMAT "%5.1" ECU_ADDRESS 0x600101CF /end MEASUREMENT
/begin MEASUREMENT DSQ_st.DSQ_BattULo "Status signal quality / Status of signal quality DSQ_BattULo" UBYTE DFC_OneToOne 1 100 0.00 255.0 FORMAT "%5.1" ECU_ADDRESS 0x600101D0 /end MEASUREMENT
/begin MEASUREMENT DSQ_st.DSQ_BrkBstPMdl "Status signal quality / Status of signal quality DSQ_BrkBstPMdl" UBYTE DFC_OneToOne 1 100 0.00 255.0 FORMAT "%5.1" ECU_ADDRESS 0x600101D1 /end MEASUREMENT
/begin MEASUREMENT DSQ_st.DSQ_BrkP "Status signal quality / Status of signal quality DSQ_BrkP" UBYTE DFC_OneToOne 1 100 0.00 255.0 FORMAT "%5.1" ECU_ADDRESS 0x600101D2 /end MEASUREMENT
/begin MEASUREMENT DSQ_st.DSQ_BrkPSnsr "Status signal quality / Status of signal quality DSQ_BrkPSnsr" UBYTE DFC_OneToOne 1 100 0.00 255.0 FORMAT "%5.1" ECU_ADDRESS 0x600101D3 /end MEASUREMENT
/begin MEASUREMENT DSQ_st.DSQ_CoVMDIDASFail "Status signal quality / Status of signal quality DSQ_CoVMDIDASFail" UBYTE DFC_OneToOne 1 100 0.00 255.0 FORMAT "%5.1" ECU_ADDRESS 0x600101D4 /end MEASUREMENT
/begin MEASUREMENT DSQ_st.DSQ_DSMInhibitAlways "Status signal quality / Status of signal quality DSQ_DSMInhibitAlways" UBYTE DFC_OneToOne 1 100 0.00 255.0 FORMAT "%5.1" ECU_ADDRESS 0x600101D5 /end MEASUREMENT
/begin MEASUREMENT DSQ_st.DSQ_EGRVlv_GovDesVal "Status signal quality / Status of signal quality DSQ_EGRVlv_GovDesVal" UBYTE DFC_OneToOne 1 100 0.00 255.0 FORMAT "%5.1" ECU_ADDRESS 0x600101D6 /end MEASUREMENT
/begin MEASUREMENT DSQ_st.DSQ_ElecLd "Status signal quality / Status of signal quality DSQ_ElecLd" UBYTE DFC_OneToOne 1 100 0.00 255.0 FORMAT "%5.1" ECU_ADDRESS 0x600101D7 /end MEASUREMENT
/begin MEASUREMENT DSQ_st.DSQ_EngICO "Status signal quality / Status of signal quality DSQ_EngICO" UBYTE DFC_OneToOne 1 100 0.00 255.0 FORMAT "%5.1" ECU_ADDRESS 0x600101D8 /end MEASUREMENT
/begin MEASUREMENT DSQ_st.DSQ_EpmCaSSigQuality "Status signal quality / Status of signal quality DSQ_EpmCaSSigQuality" UBYTE DFC_OneToOne 1 100 0.00 255.0 FORMAT "%5.1" ECU_ADDRESS 0x600101D9 /end MEASUREMENT
/begin MEASUREMENT DSQ_st.DSQ_EpmReverseRun "Status signal quality / Status of signal quality DSQ_EpmReverseRun" UBYTE DFC_OneToOne 1 100 0.00 255.0 FORMAT "%5.1" ECU_ADDRESS 0x600101DA /end MEASUREMENT
/begin MEASUREMENT DSQ_st.DSQ_FanDIO_0 "Status signal quality / Status of signal quality DSQ_FanDIO_0" UBYTE DFC_OneToOne 1 100 0.00 255.0 FORMAT "%5.1" ECU_ADDRESS 0x600101DB /end MEASUREMENT
/begin MEASUREMENT DSQ_st.DSQ_FanDIO_1 "Status signal quality / Status of signal quality DSQ_FanDIO_1" UBYTE DFC_OneToOne 1 100 0.00 255.0 FORMAT "%5.1" ECU_ADDRESS 0x600101DC /end MEASUREMENT
/begin MEASUREMENT DSQ_st.DSQ_FuelP "Status signal quality / Status of signal quality DSQ_FuelP" UBYTE DFC_OneToOne 1 100 0.00 255.0 FORMAT "%5.1" ECU_ADDRESS 0x600101DD /end MEASUREMENT
/begin MEASUREMENT DSQ_st.DSQ_FuelT "Status signal quality / Status of signal quality DSQ_FuelT" UBYTE DFC_OneToOne 1 100 0.00 255.0 FORMAT "%5.1" ECU_ADDRESS 0x600101DE /end MEASUREMENT
/begin MEASUREMENT DSQ_st.DSQ_GEVCtlTOilCylHd "Status signal quality / Status of signal quality DSQ_GEVCtlTOilCylHd" UBYTE DFC_OneToOne 1 100 0.00 255.0 FORMAT "%5.1" ECU_ADDRESS 0x600101DF /end MEASUREMENT
/begin MEASUREMENT DSQ_st.DSQ_GEVlvAgIntkB1 "Status signal quality / Status of signal quality DSQ_GEVlvAgIntkB1" UBYTE DFC_OneToOne 1 100 0.00 255.0 FORMAT "%5.1" ECU_ADDRESS 0x600101E0 /end MEASUREMENT
/begin MEASUREMENT DSQ_st.DSQ_GbxPNPos "Status signal quality / Status of signal quality DSQ_GbxPNPos" UBYTE DFC_OneToOne 1 100 0.00 255.0 FORMAT "%5.1" ECU_ADDRESS 0x600101E1 /end MEASUREMENT
/begin MEASUREMENT DSQ_st.DSQ_GbxPosNotPN "Status signal quality / Status of signal quality DSQ_GbxPosNotPN" UBYTE DFC_OneToOne 1 100 0.00 255.0 FORMAT "%5.1" ECU_ADDRESS 0x600101E2 /end MEASUREMENT
/begin MEASUREMENT DSQ_st.DSQ_InjVlv_DI_CylOk "Status signal quality / Status of signal quality DSQ_InjVlv_DI_CylOk" UBYTE DFC_OneToOne 1 100 0.00 255.0 FORMAT "%5.1" ECU_ADDRESS 0x600101E3 /end MEASUREMENT
/begin MEASUREMENT DSQ_st.DSQ_MRly "Status signal quality / Status of signal quality DSQ_MRly" UBYTE DFC_OneToOne 1 100 0.00 255.0 FORMAT "%5.1" ECU_ADDRESS 0x600101E4 /end MEASUREMENT
/begin MEASUREMENT DSQ_st.DSQ_OilP "Status signal quality / Status of signal quality DSQ_OilP" UBYTE DFC_OneToOne 1 100 0.00 255.0 FORMAT "%5.1" ECU_ADDRESS 0x600101E5 /end MEASUREMENT
/begin MEASUREMENT DSQ_st.DSQ_PEnvMeasVld "Status signal quality / Status of signal quality DSQ_PEnvMeasVld" UBYTE DFC_OneToOne 1 100 0.00 255.0 FORMAT "%5.1" ECU_ADDRESS 0x600101E6 /end MEASUREMENT
/begin MEASUREMENT DSQ_st.DSQ_PEnvVld "Status signal quality / Status of signal quality DSQ_PEnvVld" UBYTE DFC_OneToOne 1 100 0.00 255.0 FORMAT "%5.1" ECU_ADDRESS 0x600101E7 /end MEASUREMENT
/begin MEASUREMENT DSQ_st.DSQ_PEnv_pRaw "Status signal quality / Status of signal quality DSQ_PEnv_pRaw" UBYTE DFC_OneToOne 1 100 0.00 255.0 FORMAT "%5.1" ECU_ADDRESS 0x600101E8 /end MEASUREMENT
/begin MEASUREMENT DSQ_st.DSQ_PRail "Status signal quality / Status of signal quality DSQ_PRail" UBYTE DFC_OneToOne 1 100 0.00 255.0 FORMAT "%5.1" ECU_ADDRESS 0x600101E9 /end MEASUREMENT
/begin MEASUREMENT DSQ_st.DSQ_PThrVlvUs "Status signal quality / Status of signal quality DSQ_PThrVlvUs" UBYTE DFC_OneToOne 1 100 0.00 255.0 FORMAT "%5.1" ECU_ADDRESS 0x600101EA /end MEASUREMENT
/begin MEASUREMENT DSQ_st.DSQ_PThrVlvUsB1 "Status signal quality / Status of signal quality DSQ_PThrVlvUsB1" UBYTE DFC_OneToOne 1 100 0.00 255.0 FORMAT "%5.1" ECU_ADDRESS 0x600101EB /end MEASUREMENT
/begin MEASUREMENT DSQ_st.DSQ_StrtImobChk "Status signal quality / Status of signal quality DSQ_StrtImobChk" UBYTE DFC_OneToOne 1 100 0.00 255.0 FORMAT "%5.1" ECU_ADDRESS 0x600101EC /end MEASUREMENT
/begin MEASUREMENT DSQ_st.DSQ_TDevCenColdStrt "Status signal quality / Status of signal quality DSQ_TDevCenColdStrt" UBYTE DFC_OneToOne 1 100 0.00 255.0 FORMAT "%5.1" ECU_ADDRESS 0x600101ED /end MEASUREMENT
/begin MEASUREMENT DSQ_st.DSQ_VehV "Status signal quality / Status of signal quality DSQ_VehV" UBYTE DFC_OneToOne 1 100 0.00 255.0 FORMAT "%5.1" ECU_ADDRESS 0x600101EE /end MEASUREMENT
/begin MEASUREMENT DSQ_st.DSQ_VehVSens "Status signal quality / Status of signal quality DSQ_VehVSens" UBYTE DFC_OneToOne 1 100 0.00 255.0 FORMAT "%5.1" ECU_ADDRESS 0x600101EF /end MEASUREMENT
/begin MEASUREMENT DSQ_st.DSQ_VehVSnsr "Status signal quality / Status of signal quality DSQ_VehVSnsr" UBYTE DFC_OneToOne 1 100 0.00 255.0 FORMAT "%5.1" ECU_ADDRESS 0x600101F0 /end MEASUREMENT
/begin MEASUREMENT DSQ_st.DSQ_stAPP "Status signal quality / Status of signal quality DSQ_stAPP" UBYTE DFC_OneToOne 1 100 0.00 255.0 FORMAT "%5.1" ECU_ADDRESS 0x600101F1 /end MEASUREMENT
/begin MEASUREMENT DSQ_st.DSQ_stComEAT4 "Status signal quality / Status of signal quality DSQ_stComEAT4" UBYTE DFC_OneToOne 1 100 0.00 255.0 FORMAT "%5.1" ECU_ADDRESS 0x600101F2 /end MEASUREMENT
/begin FUNCTION DFC "30000.33.0_1.1.0Diagnostic Fault Check"
 /begin DEF_CHARACTERISTIC DFC_CtlMsk.DFC_Unused_C DFC_CtlMsk.DFC_AAVEmax_C DFC_CtlMsk.DFC_AAVEmin_C DFC_CtlMsk.DFC_AAVEsig_C DFC_CtlMsk.DFC_AltIOACGFailr_C DFC_CtlMsk.DFC_AltIOACGHiVltg_C DFC_CtlMsk.DFC_AltIOACGLoVltg_C DFC_CtlMsk.DFC_AltIOACGTHi_C DFC_CtlMsk.DFC_AltIODConnACG_C DFC_CtlMsk.DFC_BGOELWAF_C DFC_CtlMsk.DFC_BattUHiFailr_C DFC_CtlMsk.DFC_BattULoFailr_C DFC_CtlMsk.DFC_BrkBstPDriftHiErr_C DFC_CtlMsk.DFC_BrkBstPDriftLoErr_C DFC_CtlMsk.DFC_BrkBstPSnsrStuck_C DFC_CtlMsk.DFC_BrkMnSwtContOn_C DFC_CtlMsk.DFC_BrkMnSwtNotStp_C DFC_CtlMsk.DFC_BrkNpl_C DFC_CtlMsk.DFC_BrkRdntSwtContOn_C DFC_CtlMsk.DFC_BrkRdntSwtNotStp_C DFC_CtlMsk.DFC_Clth3ONStuck_C DFC_CtlMsk.DFC_Clth4OFFStuck_C DFC_CtlMsk.DFC_ClthOFFStuck_C DFC_CtlMsk.DFC_ClthONStuck_C DFC_CtlMsk.DFC_ClthStkFailInfo_C DFC_CtlMsk.DFC_ComACFailInfo_C DFC_CtlMsk.DFC_ComATFTValErr_C DFC_CtlMsk.DFC_ComATMILReq_C DFC_CtlMsk.DFC_ComAYCAChksum_C DFC_CtlMsk.DFC_ComAYCARingCnt_C DFC_CtlMsk.DFC_ComAYCATOut_C DFC_CtlMsk.DFC_ComAYCDChkSum_C DFC_CtlMsk.DFC_ComAYCDTOut_C DFC_CtlMsk.DFC_ComAYCFChksum_C DFC_CtlMsk.DFC_ComAYCFRingCnt_C DFC_CtlMsk.DFC_ComAYCFTOut_C DFC_CtlMsk.DFC_ComAYCGChksum_C DFC_CtlMsk.DFC_ComAYCGRingCnt_C DFC_CtlMsk.DFC_ComAYCGTOut_C DFC_CtlMsk.DFC_ComAYCIChkSum_C DFC_CtlMsk.DFC_ComAYCIRingCnt_C DFC_CtlMsk.DFC_ComAYCITOut_C DFC_CtlMsk.DFC_ComBCM1ChkSum_C DFC_CtlMsk.DFC_ComBCM1RingCnt_C DFC_CtlMsk.DFC_ComBCM1TOut_C DFC_CtlMsk.DFC_ComCANABusOffErr_C DFC_CtlMsk.DFC_ComCANBBusOffErr_C DFC_CtlMsk.DFC_ComCANCBusOffErr_C DFC_CtlMsk.DFC_ComCGW1ChkSum_C DFC_CtlMsk.DFC_ComCGW1RingCnt_C DFC_CtlMsk.DFC_ComCGW1TOut_C DFC_CtlMsk.DFC_ComConvBoostErr_C DFC_CtlMsk.DFC_ComConvSlipErr_C DFC_CtlMsk.DFC_ComDCDCPrfmncErr_C DFC_CtlMsk.DFC_ComDCDCTempWarn_C DFC_CtlMsk.DFC_ComEAT10Chksum_C DFC_CtlMsk.DFC_ComEAT10RingCnt_C DFC_CtlMsk.DFC_ComEAT10TOut_C DFC_CtlMsk.DFC_ComEAT11ChkSum_C DFC_CtlMsk.DFC_ComEAT11RingCnt_C DFC_CtlMsk.DFC_ComEAT11TOut_C DFC_CtlMsk.DFC_ComEAT12ChkSum_C DFC_CtlMsk.DFC_ComEAT12RingCnt_C DFC_CtlMsk.DFC_ComEAT12TOut_C DFC_CtlMsk.DFC_ComEAT13ChkSum_C DFC_CtlMsk.DFC_ComEAT13RingCnt_C DFC_CtlMsk.DFC_ComEAT13TOut_C DFC_CtlMsk.DFC_ComEAT1Chksum_C DFC_CtlMsk.DFC_ComEAT1RingCnt_C DFC_CtlMsk.DFC_ComEAT1TOut_C DFC_CtlMsk.DFC_ComEAT2ChkSum_C DFC_CtlMsk.DFC_ComEAT2RingCnt_C DFC_CtlMsk.DFC_ComEAT2TOut_C DFC_CtlMsk.DFC_ComEAT4ChkSum_C DFC_CtlMsk.DFC_ComEAT4RingCnt_C DFC_CtlMsk.DFC_ComEAT4TOut_C DFC_CtlMsk.DFC_ComEAT6Chksum_C DFC_CtlMsk.DFC_ComEAT6RingCnt_C DFC_CtlMsk.DFC_ComEAT6TOut_C DFC_CtlMsk.DFC_ComEAT7Chksum_C DFC_CtlMsk.DFC_ComEAT7RingCnt_C DFC_CtlMsk.DFC_ComEAT7TOut_C DFC_CtlMsk.DFC_ComEAT8Chksum_C DFC_CtlMsk.DFC_ComEAT8RingCnt_C DFC_CtlMsk.DFC_ComEAT8TOut_C DFC_CtlMsk.DFC_ComEATAChksum_C DFC_CtlMsk.DFC_ComEATARingCnt_C DFC_CtlMsk.DFC_ComEATATOut_C DFC_CtlMsk.DFC_ComEATBChkSum_C DFC_CtlMsk.DFC_ComEATBRingCnt_C DFC_CtlMsk.DFC_ComEATBTOut_C DFC_CtlMsk.DFC_ComEATCChksum_C DFC_CtlMsk.DFC_ComEATCRingCnt_C DFC_CtlMsk.DFC_ComEATCTOut_C DFC_CtlMsk.DFC_ComEPBBChkSum_C DFC_CtlMsk.DFC_ComEPBBRingCnt_C DFC_CtlMsk.DFC_ComEPBBTOut_C DFC_CtlMsk.DFC_ComEPBChksum_C DFC_CtlMsk.DFC_ComEPBTOut_C DFC_CtlMsk.DFC_ComEPBctRing_C DFC_CtlMsk.DFC_ComEPS1Chksum_C DFC_CtlMsk.DFC_ComEPS1RingCnt_C DFC_CtlMsk.DFC_ComEPS1TOut_C DFC_CtlMsk.DFC_ComEngCanRxErr_C DFC_CtlMsk.DFC_ComGrvySnsrErr_C DFC_CtlMsk.DFC_ComGwIMG1ChkSum_C DFC_CtlMsk.DFC_ComGwIMG1RingCnt_C DFC_CtlMsk.DFC_ComGwIMG1TOut_C DFC_CtlMsk.DFC_ComGwIMG3ChkSum_C DFC_CtlMsk.DFC_ComGwIMG3RingCnt_C DFC_CtlMsk.DFC_ComGwIMG3TOut_C DFC_CtlMsk.DFC_ComGwIMG4ChkSum_C DFC_CtlMsk.DFC_ComGwIMG4RingCnt_C DFC_CtlMsk.DFC_ComGwIMG4TOut_C DFC_CtlMsk.DFC_ComGwIMG5ChkSum_C DFC_CtlMsk.DFC_ComGwIMG5RingCnt_C DFC_CtlMsk.DFC_ComGwIMG5TOut_C DFC_CtlMsk.DFC_ComGwIMG6ChkSum_C DFC_CtlMsk.DFC_ComGwIMG6RingCnt_C DFC_CtlMsk.DFC_ComGwIMG6TOut_C DFC_CtlMsk.DFC_ComIDASBChksum_C DFC_CtlMsk.DFC_ComIDASBRingCnt_C DFC_CtlMsk.DFC_ComIDASBTOut_C DFC_CtlMsk.DFC_ComIMGMILReq_C DFC_CtlMsk.DFC_ComISSPrms_C DFC_CtlMsk.DFC_ComMETAChksum_C DFC_CtlMsk.DFC_ComMETAChksumPstDrv_C DFC_CtlMsk.DFC_ComMETARingCnt_C DFC_CtlMsk.DFC_ComMETARingCntPstDrv_C DFC_CtlMsk.DFC_ComMETATOut_C DFC_CtlMsk.DFC_ComMETATOutPstDrv_C DFC_CtlMsk.DFC_ComMETCChksum_C DFC_CtlMsk.DFC_ComMETCRingCnt_C DFC_CtlMsk.DFC_ComMETCTOut_C DFC_CtlMsk.DFC_ComMETDChksum_C DFC_CtlMsk.DFC_ComMETDRingCnt_C DFC_CtlMsk.DFC_ComMETDTOut_C DFC_CtlMsk.DFC_ComMETE2Chksum_C DFC_CtlMsk.DFC_ComMETE2RingCnt_C DFC_CtlMsk.DFC_ComMETE2TOut_C DFC_CtlMsk.DFC_ComMETFChksum_C DFC_CtlMsk.DFC_ComMETFRingCnt_C DFC_CtlMsk.DFC_ComMETFTOut_C DFC_CtlMsk.DFC_ComMETGChksum_C DFC_CtlMsk.DFC_ComMETGRingCnt_C DFC_CtlMsk.DFC_ComMETGTOut_C DFC_CtlMsk.DFC_ComMETH2Chksum_C DFC_CtlMsk.DFC_ComMETH2RingCnt_C DFC_CtlMsk.DFC_ComMETH2TOut_C DFC_CtlMsk.DFC_ComMETHChksum_C DFC_CtlMsk.DFC_ComMETHRingCnt_C DFC_CtlMsk.DFC_ComMETHTOut_C DFC_CtlMsk.DFC_ComMETIChksum_C DFC_CtlMsk.DFC_ComMETIRingCnt_C DFC_CtlMsk.DFC_ComMETITOut_C DFC_CtlMsk.DFC_ComMETKChksum_C DFC_CtlMsk.DFC_ComMETKRingCnt_C DFC_CtlMsk.DFC_ComMETKTOut_C DFC_CtlMsk.DFC_ComMETLChksum_C DFC_CtlMsk.DFC_ComMETLRingCnt_C DFC_CtlMsk.DFC_ComMETLTOut_C DFC_CtlMsk.DFC_ComMETMChksum_C DFC_CtlMsk.DFC_ComMETMRingCnt_C DFC_CtlMsk.DFC_ComMETMTOut_C DFC_CtlMsk.DFC_ComMETNChksum_C DFC_CtlMsk.DFC_ComMETNRingCnt_C DFC_CtlMsk.DFC_ComMETNTOut_C DFC_CtlMsk.DFC_ComMtrCom_C DFC_CtlMsk.DFC_ComPCUChkSum_C DFC_CtlMsk.DFC_ComPCURingCnt_C DFC_CtlMsk.DFC_ComPCUTOut_C DFC_CtlMsk.DFC_ComSRSAChksum_C DFC_CtlMsk.DFC_ComSRSARingCnt_C DFC_CtlMsk.DFC_ComSRSATOut_C DFC_CtlMsk.DFC_ComSRSBChksum_C DFC_CtlMsk.DFC_ComSRSBRingCnt_C DFC_CtlMsk.DFC_ComSRSBTOut_C DFC_CtlMsk.DFC_ComSRSChksum_C DFC_CtlMsk.DFC_ComSRSErr_C DFC_CtlMsk.DFC_ComSRSRingCnt_C DFC_CtlMsk.DFC_ComSRSTOut_C DFC_CtlMsk.DFC_ComVehSpdPndFltTCU_C DFC_CtlMsk.DFC_EbsChartcCurrErr_C DFC_CtlMsk.DFC_EbsSelfDiagErr_C DFC_CtlMsk.DFC_GEVlvPhaCsersIntkB1_C DFC_CtlMsk.DFC_GEVlvPhaPsOpenLoadIntkB1_C DFC_CtlMsk.DFC_GEVlvPhaPsShoToBattIntkB1_C DFC_CtlMsk.DFC_GEVlvPhaPsShoToGndIntkB1_C DFC_CtlMsk.DFC_GbxCANDigPlausErr_C DFC_CtlMsk.DFC_GbxNPos1SRCMax_C DFC_CtlMsk.DFC_GbxNPos1SRCMin_C DFC_CtlMsk.DFC_GbxNPos2SRCMax_C DFC_CtlMsk.DFC_GbxNPos2SRCMin_C DFC_CtlMsk.DFC_GbxNPosAlvChk_C DFC_CtlMsk.DFC_GbxNPosSyncErr_C DFC_CtlMsk.DFC_HEGOS2B1HtrPsMax_C DFC_CtlMsk.DFC_HEGOS2B1HtrPsMin_C DFC_CtlMsk.DFC_HEGOS2B1HtrPsSig_C DFC_CtlMsk.DFC_LinCSErrACG_C DFC_CtlMsk.DFC_LinCSErrAEV_C DFC_CtlMsk.DFC_LinCSErrDCDC_C DFC_CtlMsk.DFC_LinCSErrEBS_C DFC_CtlMsk.DFC_LinHdrTimeoutErrACG_C DFC_CtlMsk.DFC_LinHdrTimeoutErrAEV_C DFC_CtlMsk.DFC_LinHdrTimeoutErrDCDC_C DFC_CtlMsk.DFC_LinHdrTimeoutErrEBS_C DFC_CtlMsk.DFC_LinMsgTimeoutErrACG_C DFC_CtlMsk.DFC_LinMsgTimeoutErrAEV_C DFC_CtlMsk.DFC_LinMsgTimeoutErrDCDC_C DFC_CtlMsk.DFC_LinMsgTimeoutErrEBS_C DFC_CtlMsk.DFC_LinNoStrtComErr_C DFC_CtlMsk.DFC_LowPresOilP_C DFC_CtlMsk.DFC_MisfDetVWhlFrntLeOORHi_C DFC_CtlMsk.DFC_MisfDetVWhlFrntLeRatyHi_C DFC_CtlMsk.DFC_MisfDetVWhlFrntLeRatyLo_C DFC_CtlMsk.DFC_MisfDetVWhlFrntLeStuck_C DFC_CtlMsk.DFC_MisfDetVWhlFrntRiOORHi_C DFC_CtlMsk.DFC_MisfDetVWhlFrntRiRatyHi_C DFC_CtlMsk.DFC_MisfDetVWhlFrntRiRatyLo_C DFC_CtlMsk.DFC_MisfDetVWhlFrntRiStuck_C DFC_CtlMsk.DFC_MisfDetVWhlReLeOORHi_C DFC_CtlMsk.DFC_MisfDetVWhlReLeRatyHi_C DFC_CtlMsk.DFC_MisfDetVWhlReLeRatyLo_C DFC_CtlMsk.DFC_MisfDetVWhlReLeStuck_C DFC_CtlMsk.DFC_MisfDetVWhlReRiOORHi_C DFC_CtlMsk.DFC_MisfDetVWhlReRiRatyHi_C DFC_CtlMsk.DFC_MisfDetVWhlReRiRatyLo_C DFC_CtlMsk.DFC_MisfDetVWhlReRiStuck_C DFC_CtlMsk.DFC_MisfDetdVWhlFrntLePlaus_C DFC_CtlMsk.DFC_MisfDetdVWhlFrntRiPlaus_C DFC_CtlMsk.DFC_MisfDetdVWhlReLePlaus_C DFC_CtlMsk.DFC_MisfDetdVWhlReRiPlaus_C DFC_CtlMsk.DFC_PEnvSigRngMax_C DFC_CtlMsk.DFC_PEnvSigRngMin_C DFC_CtlMsk.DFC_StmFault_C DFC_CtlMsk.DFC_StrtCtOffPth_C DFC_CtlMsk.DFC_StrtCtlErr_C DFC_CtlMsk.DFC_StrtFault_C DFC_CtlMsk.DFC_StrtLckJudg1_C DFC_CtlMsk.DFC_StrtLckJudg2_C DFC_CtlMsk.DFC_StrtOL_C DFC_CtlMsk.DFC_StrtOL2_C DFC_CtlMsk.DFC_StrtSCB_C DFC_CtlMsk.DFC_StrtSCB2_C DFC_CtlMsk.DFC_StrtSCG_C DFC_CtlMsk.DFC_StrtSCG2_C DFC_CtlMsk.DFC_StrtStkRly1_C DFC_CtlMsk.DFC_StrtStkRly2_C DFC_CtlMsk.DFC_TEVEmax_C DFC_CtlMsk.DFC_TEVEmin_C DFC_CtlMsk.DFC_TEVEsig_C DFC_CtlMsk.DFC_UegoHeatrPrfmncLoS1B1_C DFC_CtlMsk.DFC_VehVAllPlaus_C DFC_CtlMsk.DFC_VehVNCSnsrElecFailr_C DFC_CtlMsk.DFC_VehVPlausCan_C DFC_CtlMsk.DFC_VehVPlausFco_C DFC_CtlMsk.DFC_VehVPlausPwr_C DFC_CtlMsk.DFC_VehVPlausV2N_C DFC_CtlMsk.DFC_VehVSpdSnsrAElecFailr_C DFC_CtlMsk.DFC_VehVSpdSnsrBElecFailr_C DFC_CtlMsk.DFC_ClthMax_C DFC_CtlMsk.DFC_IgnClPs_DevComErr_C DFC_CtlMsk.DFC_IgnClPs_LineOl_0_C DFC_CtlMsk.DFC_IgnClPs_LineOl_1_C DFC_CtlMsk.DFC_IgnClPs_LineOl_2_C DFC_CtlMsk.DFC_IgnClPs_LineOl_3_C DFC_CtlMsk.DFC_IgnClPs_LineScb_0_C DFC_CtlMsk.DFC_IgnClPs_LineScb_1_C DFC_CtlMsk.DFC_IgnClPs_LineScb_2_C DFC_CtlMsk.DFC_IgnClPs_LineScb_3_C DFC_CtlMsk.DFC_IgnClPs_LineScg_0_C DFC_CtlMsk.DFC_IgnClPs_LineScg_1_C DFC_CtlMsk.DFC_IgnClPs_LineScg_2_C DFC_CtlMsk.DFC_IgnClPs_LineScg_3_C DFC_CtlMsk.DFC_KRVEKOEVAB_C DFC_CtlMsk.DFC_KRVEKOEVAB0_C DFC_CtlMsk.DFC_KRVEKOEVAB1_C DFC_CtlMsk.DFC_KRVEKOEVAB2_C DFC_CtlMsk.DFC_KRVEKOEVAB3_C DFC_CtlMsk.DFC_UegoSigEcuAsicS1B1_C DFC_CtlMsk.DFC_UegoSigEcuComS1B1_C DFC_CtlMsk.DFC_UegoSigSnsrS1B1_C DFC_CtlMsk.DFC_UegoSigWireOlApesS1B1_C DFC_CtlMsk.DFC_UegoSigWireOlIpeS1B1_C DFC_CtlMsk.DFC_UegoSigWireOlReS1B1_C DFC_CtlMsk.DFC_UegoSigWireRCmpS1B1_C DFC_CtlMsk.DFC_UegoSigWireScbS1B1_C DFC_CtlMsk.DFC_UegoSigWireScgS1B1_C DFC_CtlMsk.DFC_AfsPhyRngHiB1_C DFC_CtlMsk.DFC_AfsPhyRngLoB1_C DFC_CtlMsk.DFC_AirCCmprOL_C DFC_CtlMsk.DFC_AirCCmprOvrTemp_C DFC_CtlMsk.DFC_AirCCmprSCB_C DFC_CtlMsk.DFC_AirCCmprSCG_C DFC_CtlMsk.DFC_AltErr_C DFC_CtlMsk.DFC_BattUSRCMax_C DFC_CtlMsk.DFC_BattUSRCMin_C DFC_CtlMsk.DFC_ComChksTCU1_C DFC_CtlMsk.DFC_ComChksTCU11_C DFC_CtlMsk.DFC_ComChksTCU12_C DFC_CtlMsk.DFC_ComChksTCU13_C DFC_CtlMsk.DFC_ComChksTCU2_C DFC_CtlMsk.DFC_ComChksTCU3_C DFC_CtlMsk.DFC_ComChksTCU4_C DFC_CtlMsk.DFC_ComCntTCU1_C DFC_CtlMsk.DFC_ComCntTCU11_C DFC_CtlMsk.DFC_ComCntTCU12_C DFC_CtlMsk.DFC_ComCntTCU13_C DFC_CtlMsk.DFC_ComCntTCU2_C DFC_CtlMsk.DFC_ComCntTCU3_C DFC_CtlMsk.DFC_ComCntTCU4_C DFC_CtlMsk.DFC_ComTOutTCU01_C DFC_CtlMsk.DFC_ComTOutTCU02_C DFC_CtlMsk.DFC_ComTOutTCU1_C DFC_CtlMsk.DFC_ComTOutTCU11_C DFC_CtlMsk.DFC_ComTOutTCU12_C DFC_CtlMsk.DFC_ComTOutTCU13_C DFC_CtlMsk.DFC_ComTOutTCU14_C DFC_CtlMsk.DFC_ComTOutTCU2_C DFC_CtlMsk.DFC_ComTOutTCU3_C DFC_CtlMsk.DFC_ComTOutTCU4_C DFC_CtlMsk.DFC_DevLibBattUHi_C DFC_CtlMsk.DFC_DevLibBattULo_C DFC_CtlMsk.DFC_EGRVlvFailSafeActv_C DFC_CtlMsk.DFC_EGRVlvGovDvtCld_C DFC_CtlMsk.DFC_EGRVlvPhysSRCMax_C DFC_CtlMsk.DFC_EGRVlvPhysSRCMin_C DFC_CtlMsk.DFC_FanDIOOL_0_C DFC_CtlMsk.DFC_FanDIOOL_1_C DFC_CtlMsk.DFC_FanDIOOvrTemp_0_C DFC_CtlMsk.DFC_FanDIOOvrTemp_1_C DFC_CtlMsk.DFC_FanDIOSCB_0_C DFC_CtlMsk.DFC_FanDIOSCB_1_C DFC_CtlMsk.DFC_FanDIOSCG_0_C DFC_CtlMsk.DFC_FanDIOSCG_1_C DFC_CtlMsk.DFC_MRlyDcOL_C DFC_CtlMsk.DFC_MRlyDcSCB_C DFC_CtlMsk.DFC_MRlyDcSCG_C DFC_CtlMsk.DFC_PSPOL_C DFC_CtlMsk.DFC_PSPOvrTemp_C DFC_CtlMsk.DFC_PSPSCB_C DFC_CtlMsk.DFC_PSPSCG_C DFC_CtlMsk.DFC_T50Err_C DFC_CtlMsk.DFC_ThrVlvLoBattB1_C DFC_CtlMsk.DFC_UegoSigOperPlausS1B1_C DFC_CtlMsk.DFC_VehVPhysRngHi_C DFC_CtlMsk.DFC_VehVSclOutOL_C DFC_CtlMsk.DFC_VehVSclOutOT_C DFC_CtlMsk.DFC_VehVSclOutSCB_C DFC_CtlMsk.DFC_VehVSclOutSCG_C DFC_CtlMsk.DFC_VehVSigFL_C DFC_CtlMsk.DFC_VehVSigFR_C DFC_CtlMsk.DFC_VehVSigRL_C DFC_CtlMsk.DFC_VehVSigRR_C DFC_CtlMsk.DFC_VehVSnsrARngHi_C DFC_CtlMsk.DFC_VehVSnsrBRngHi_C DFC_CtlMsk.DFC_VehVSpdRtyDiag_C DFC_CtlMsk.DFC_DHFHD_C DFC_CtlMsk.DFC_InjVlv_DI_DcDc_C DFC_CtlMsk.DFC_InjVlv_DI_NoLd_0_C DFC_CtlMsk.DFC_InjVlv_DI_NoLd_1_C DFC_CtlMsk.DFC_InjVlv_DI_NoLd_2_C DFC_CtlMsk.DFC_InjVlv_DI_NoLd_3_C DFC_CtlMsk.DFC_InjVlv_DI_ScBnk_0_C DFC_CtlMsk.DFC_InjVlv_DI_ScBnk_1_C DFC_CtlMsk.DFC_InjVlv_DI_ScBnk_2_C DFC_CtlMsk.DFC_InjVlv_DI_ScBnk_3_C DFC_CtlMsk.DFC_InjVlv_DI_ScCyl_0_C DFC_CtlMsk.DFC_InjVlv_DI_ScCyl_1_C DFC_CtlMsk.DFC_InjVlv_DI_ScCyl_2_C DFC_CtlMsk.DFC_InjVlv_DI_ScCyl_3_C DFC_CtlMsk.DFC_InjVlv_DI_ScHsLs_0_C DFC_CtlMsk.DFC_InjVlv_DI_ScHsLs_1_C DFC_CtlMsk.DFC_InjVlv_DI_ScHsLs_2_C DFC_CtlMsk.DFC_InjVlv_DI_ScHsLs_3_C DFC_CtlMsk.DFC_MfPsDiaOpenLoad1_C DFC_CtlMsk.DFC_MfPsDiaScHiS1_C DFC_CtlMsk.DFC_MfPsDiaScHiSLowS1_C DFC_CtlMsk.DFC_MfPsDiaScLowS1_C DFC_CtlMsk.DFC_ACEvpTPhysRngHi_C DFC_CtlMsk.DFC_ACEvpTPhysRngLo_C DFC_CtlMsk.DFC_ACEvpTSRCMax_C DFC_CtlMsk.DFC_ACEvpTSRCMin_C DFC_CtlMsk.DFC_AfsRawSigRngHiB1_C DFC_CtlMsk.DFC_AfsRawSigRngLoB1_C DFC_CtlMsk.DFC_AfsSnsrErrB1_C DFC_CtlMsk.DFC_AirCClntPAnaSRCMax_C DFC_CtlMsk.DFC_AirCClntPAnaSRCMin_C DFC_CtlMsk.DFC_AirCSwtNpl_C DFC_CtlMsk.DFC_AirCSwtSig_C DFC_CtlMsk.DFC_Brk_C DFC_CtlMsk.DFC_BrkBstSensSCB_C DFC_CtlMsk.DFC_BrkBstSensSCG_C DFC_CtlMsk.DFC_BrkSig_C DFC_CtlMsk.DFC_ClthSig_C DFC_CtlMsk.DFC_EGRVlvCurrLim_C DFC_CtlMsk.DFC_EGRVlvOL_C DFC_CtlMsk.DFC_EGRVlvOvrTemp_C DFC_CtlMsk.DFC_EGRVlvSCB_C DFC_CtlMsk.DFC_EGRVlvSCG_C DFC_CtlMsk.DFC_EGRVlvSRCMax_C DFC_CtlMsk.DFC_EGRVlvSRCMin_C DFC_CtlMsk.DFC_HLSDemOvhtEngLim_C DFC_CtlMsk.DFC_OilPSwmpSRCMax_C DFC_CtlMsk.DFC_OilPSwmpSRCMin_C DFC_CtlMsk.DFC_PIntkVUsLineHiB1_C DFC_CtlMsk.DFC_PIntkVUsLineLoB1_C DFC_CtlMsk.DFC_VehVPhysRngLo_C DFC_CtlMsk.DFC_VehVSigCan_C DFC_CtlMsk.DFC_VehVSigCanSafe_C DFC_CtlMsk.DFC_VlvLftFbOilPSnsrIntk11SRCMax_C DFC_CtlMsk.DFC_VlvLftFbOilPSnsrIntk11SRCMin_C DFC_CtlMsk.DFC_ClthNpl_C DFC_CtlMsk.DFC_GbxPNPosnDrvCdn_C DFC_CtlMsk.DFC_GbxPNPosnPlausy_C DFC_CtlMsk.DFC_AfsSigErrLineHiB1_C DFC_CtlMsk.DFC_AfsSigErrLineLoB1_C DFC_CtlMsk.DFC_PEnvCcMax_C DFC_CtlMsk.DFC_PEnvCcMin_C DFC_CtlMsk.DFC_PEnvRngChkMax_C DFC_CtlMsk.DFC_PEnvRngChkMin_C DFC_CtlMsk.DFC_PEnvSnsrPlaus_C DFC_CtlMsk.DFC_UEGOHeatrRlyPsOLS1B1_C DFC_CtlMsk.DFC_UEGOHeatrRlyPsSCBS1B1_C DFC_CtlMsk.DFC_UEGOHeatrRlyPsSCGS1B1_C DFC_CtlMsk.DFC_UegoHeatrWireOlS1B1_C DFC_CtlMsk.DFC_UegoHeatrWireScbS1B1_C DFC_CtlMsk.DFC_UegoHeatrWireScgS1B1_C DFC_CtlMsk.DFC_KnDetSens1PortAMax_C DFC_CtlMsk.DFC_KnDetSens1PortAMin_C DFC_CtlMsk.DFC_KnDetSens1PortBMax_C DFC_CtlMsk.DFC_KnDetSens1PortBMin_C DFC_CtlMsk.DFC_Clth2ONStuck_C DFC_CtlMsk.DFC_Clth2ONStuckLdc_C DFC_CtlMsk.DFC_Clth3ONStuckLdc_C DFC_CtlMsk.DFC_Clth3ONStuckPostDrv_C DFC_CtlMsk.DFC_Clth4ONStuck_C DFC_CtlMsk.DFC_Clth4ONStuckLdc_C DFC_CtlMsk.DFC_ComBCMUnit_C DFC_CtlMsk.DFC_ComDLCTCU01_C DFC_CtlMsk.DFC_ComDLCTCU02_C DFC_CtlMsk.DFC_ComDLCTCU1_C DFC_CtlMsk.DFC_ComDLCTCU11_C DFC_CtlMsk.DFC_ComDLCTCU12_C DFC_CtlMsk.DFC_ComDLCTCU13_C DFC_CtlMsk.DFC_ComDLCTCU14_C DFC_CtlMsk.DFC_ComDLCTCU2_C DFC_CtlMsk.DFC_ComDLCTCU3_C DFC_CtlMsk.DFC_ComDLCTCU4_C DFC_CtlMsk.DFC_ComEPSUnit_C DFC_CtlMsk.DFC_ComIDASBUnit_C DFC_CtlMsk.DFC_ComIMGUnit_C DFC_CtlMsk.DFC_ComMETUnit_C DFC_CtlMsk.DFC_ComSRSUnit_C DFC_CtlMsk.DFC_ComVSAUnit_C DFC_CtlMsk.DFC_EbsSocFlt_C DFC_CtlMsk.DFC_I14229VINErr_C DFC_CtlMsk.DFC_InjCatHeatgErr_C DFC_CtlMsk.DFC_InjSysMulInjDiagErr_C DFC_CtlMsk.DFC_LLRHmax_C DFC_CtlMsk.DFC_LLRHmin_C DFC_CtlMsk.DFC_LLRHnpl_C DFC_CtlMsk.DFC_LLRKHmax_C DFC_CtlMsk.DFC_LLRKHmin_C DFC_CtlMsk.DFC_LLRKHnpl_C DFC_CtlMsk.DFC_LinACGUnit_C DFC_CtlMsk.DFC_LinAEVUnit_C DFC_CtlMsk.DFC_LinEBSUnit_C DFC_CtlMsk.DFC_RoughRoad_C DFC_CtlMsk.DFC_SiaEEPRdErr_C DFC_CtlMsk.DFC_SiaEEPWrngCod_C DFC_CtlMsk.DFC_UegoHeatrStrtS1B1_C DFC_CtlMsk.DFC_BusDiagCANAPPLBusOff_C DFC_CtlMsk.DFC_BusDiagCANCANCBusOff_C DFC_CtlMsk.DFC_BusDiagCANVEHICLEBusOff_C DFC_CtlMsk.DFC_RBA_IODIAGPWR_rba_IoExtCy329_SignalVltSply_0_C DFC_CtlMsk.DFC_RBA_IODIAGPWR_rba_IoExtCy329_SignalVltSply_0OT_C DFC_CtlMsk.DFC_RBA_IODIAGPWR_rba_IoExtCy329_SignalVltSply_0OV_C DFC_CtlMsk.DFC_RBA_IODIAGPWR_rba_IoExtCy329_SignalVltSply_0SCG_C DFC_CtlMsk.DFC_RBA_IODIAGPWR_rba_IoExtCy329_SignalVltSply_0UV_C DFC_CtlMsk.DFC_RBA_IODIAGPWR_rba_IoExtCy329_SignalVltSply_1_C DFC_CtlMsk.DFC_RBA_IODIAGPWR_rba_IoExtCy329_SignalVltSply_1OT_C DFC_CtlMsk.DFC_RBA_IODIAGPWR_rba_IoExtCy329_SignalVltSply_1OV_C DFC_CtlMsk.DFC_RBA_IODIAGPWR_rba_IoExtCy329_SignalVltSply_1SCG_C DFC_CtlMsk.DFC_RBA_IODIAGPWR_rba_IoExtCy329_SignalVltSply_1UV_C DFC_CtlMsk.DFC_RBA_IODIAGPWR_rba_IoExtCy329_SignalVltSply_2_C DFC_CtlMsk.DFC_RBA_IODIAGPWR_rba_IoExtCy329_SignalVltSply_2OT_C DFC_CtlMsk.DFC_RBA_IODIAGPWR_rba_IoExtCy329_SignalVltSply_2OV_C DFC_CtlMsk.DFC_RBA_IODIAGPWR_rba_IoExtCy329_SignalVltSply_2SCG_C DFC_CtlMsk.DFC_RBA_IODIAGPWR_rba_IoExtCy329_SignalVltSply_2UV_C DFC_CtlMsk.DFC_CAN_E_TIMEOUT_C DFC_CtlMsk.DFC_LIN_E_TIMEOUT_C DFC_CtlMsk.DFC_MRlyOL_C DFC_CtlMsk.DFC_MRlySCB_C DFC_CtlMsk.DFC_MRlySCG_C DFC_CtlMsk.DFC_rba_MultiStackTrace_Threshold_C DFC_CtlMsk.DFC_BSWM_E_ACTION_FAILED_C DFC_CtlMsk.DFC_BSWM_E_INTRPTQUEUE_FULL_C DFC_CtlMsk.DFC_RBA_IOEXTLIB_KEEPALIVE_DRV_C DFC_CtlMsk.DFC_RBA_IOEXTLIB_KEEPALIVE_INI_C DFC_CtlMsk.DFC_rba_IoSigRtc_StopCounter_C DFC_CtlMsk.DFC_rba_MRly_Diag_Stk_Event_C DFC_CtlMsk.DFC_rba_MemDiag_MemReadErr_C DFC_CtlMsk.DFC_rba_MemDiag_MemWrErr_C DFC_CtlMsk.DFC_rba_SyC_IrrSwOffTrigEngRun_Event_C DFC_CtlMsk.DFC_rba_T15_Diag_ComInVld_Event_C DFC_CtlMsk.DFC_rba_T15_Diag_ComOff_HwOn_Event_C DFC_CtlMsk.DFC_rba_T15_Diag_ComOn_HwOff_Event_C DFC_CtlMsk.DFC_AAVmin_C DFC_CtlMsk.DFC_AGRSUS_C DFC_CtlMsk.DFC_AfsPlausDiagHi_C DFC_CtlMsk.DFC_AfsPlausDiagLo_C DFC_CtlMsk.DFC_AfsVrntDiagErrB1_C DFC_CtlMsk.DFC_AppAllSnsrDfct_C DFC_CtlMsk.DFC_BBKRnldg_C DFC_CtlMsk.DFC_BBKRsyne_C DFC_CtlMsk.DFC_BattUStdbyDiaOL_C DFC_CtlMsk.DFC_BigLeakIntkMnfldEmiInfl_C DFC_CtlMsk.DFC_BlkdLineTank_C DFC_CtlMsk.DFC_BrkMnSwtContOnWarnLmp_C DFC_CtlMsk.DFC_BrkMnSwtNotStpWarnLmp_C DFC_CtlMsk.DFC_BrkRdntSwtContOnWarnLmp_C DFC_CtlMsk.DFC_BrkRdntSwtNotStpWarnLmp_C DFC_CtlMsk.DFC_CEngDsTColdStrtMax_C DFC_CtlMsk.DFC_CEngDsTColdStrtMin_C DFC_CtlMsk.DFC_CEngDsTImps_C DFC_CtlMsk.DFC_CEngDsTPlausHSC_C DFC_CtlMsk.DFC_CEngDsTPlausLSC_C DFC_CtlMsk.DFC_CEngDsTPlausSTC_C DFC_CtlMsk.DFC_CEngDsTSRCMax_C DFC_CtlMsk.DFC_CEngDsTSRCMin_C DFC_CtlMsk.DFC_CEngDsTSig_C DFC_CtlMsk.DFC_CEngUsTColdStrtMax_C DFC_CtlMsk.DFC_CEngUsTColdStrtMin_C DFC_CtlMsk.DFC_CEngUsTLooseCnctn_C DFC_CtlMsk.DFC_CEngUsTSRCMax_C DFC_CtlMsk.DFC_CEngUsTSRCMin_C DFC_CtlMsk.DFC_ComDCDCACCFailr_C DFC_CtlMsk.DFC_DCDCFltDet_C DFC_CtlMsk.DFC_DKRSA_C DFC_CtlMsk.DFC_DKVSmax_C DFC_CtlMsk.DFC_DKnpl_C DFC_CtlMsk.DFC_DSKVRmax_C DFC_CtlMsk.DFC_DSKVRmin_C DFC_CtlMsk.DFC_DSKVRnpl_C DFC_CtlMsk.DFC_DSKVRsig_C DFC_CtlMsk.DFC_DSKVSsig_C DFC_CtlMsk.DFC_DSSmax_C DFC_CtlMsk.DFC_DSTDmax_C DFC_CtlMsk.DFC_DSTEmax_C DFC_CtlMsk.DFC_DSTEmin_C DFC_CtlMsk.DFC_DSTOFmax_C DFC_CtlMsk.DFC_DSTRmax_C DFC_CtlMsk.DFC_DSTRmin_C DFC_CtlMsk.DFC_DSTRnpl_C DFC_CtlMsk.DFC_DSTRsig_C DFC_CtlMsk.DFC_DSTTI_C /end DEF_CHARACTERISTIC
 /begin OUT_MEASUREMENT DFC_st.DFC_ORAmin DFC_st.DFC_OilPPlaus DFC_st.DFC_PLLSUmax DFC_st.DFC_PLLSUmin DFC_st.DFC_PSR1max DFC_st.DFC_PSRBmax DFC_st.DFC_PSRBmin DFC_st.DFC_PSRPmax DFC_st.DFC_PSRPmin DFC_st.DFC_PSRPsig DFC_st.DFC_PSRmax DFC_st.DFC_PUmax DFC_st.DFC_P_VSE11_OL DFC_st.DFC_P_VSE11_SCB DFC_st.DFC_P_VSE11_SCG DFC_st.DFC_PhyHighAPP1 DFC_st.DFC_PhyHighAPP2 DFC_st.DFC_PhyLowAPP1 DFC_st.DFC_PhyLowAPP2 DFC_st.DFC_SRCHighAPP1 DFC_st.DFC_SRCHighAPP2 DFC_st.DFC_SRCLowAPP1 DFC_st.DFC_SRCLowAPP2 DFC_st.DFC_SSpMon2 DFC_st.DFC_STHDRmax DFC_st.DFC_SWReset_0 DFC_st.DFC_SWReset_1 DFC_st.DFC_SWReset_2 DFC_st.DFC_SyncAPP DFC_st.DFC_TANKLnpl DFC_st.DFC_TAmax_Dummy DFC_st.DFC_TESFmax DFC_st.DFC_TESGmax DFC_st.DFC_TKAEmax DFC_st.DFC_TKAEmin DFC_st.DFC_TKARmax DFC_st.DFC_TKARnpl DFC_st.DFC_TMmax_Dummy DFC_st.DFC_TUMmax_Dummy DFC_st.DFC_TWCDPriCatB1 DFC_st.DFC_ThrVlvClsdPosnFirstOffsLrnImpoB1 DFC_st.DFC_ThrVlvClsdPosnOffsLrnImpoB1 DFC_st.DFC_ThrVlvClsdPosnOffsLrnMaxB1 DFC_st.DFC_ThrVlvClsdPosnOffsLrnMinB1 DFC_st.DFC_ThrVlvCtrlDeB1 DFC_st.DFC_ThrVlvDycB1 DFC_st.DFC_ThrVlvLimpAirPosnMaxAbsltDriftB1 DFC_st.DFC_ThrVlvLimpAirPosnMaxB1 DFC_st.DFC_ThrVlvLimpAirPosnMaxRelDriftB1 DFC_st.DFC_ThrVlvLimpAirPosnMinB1 DFC_st.DFC_ThrVlvOpenLoadB1 DFC_st.DFC_ThrVlvOpenSprgB1 DFC_st.DFC_ThrVlvOpenSprgSprdB1 DFC_st.DFC_ThrVlvOpenSprgTwnB1 DFC_st.DFC_ThrVlvOverTB1 DFC_st.DFC_ThrVlvRetSprgB1 DFC_st.DFC_ThrVlvRetSprgSprdB1 DFC_st.DFC_ThrVlvRetSprgTwnB1 DFC_st.DFC_ThrVlvSens1MaxB1 DFC_st.DFC_ThrVlvSens1NplB1 DFC_st.DFC_ThrVlvSens2MaxB1 DFC_st.DFC_ThrVlvSens2MinB1 DFC_st.DFC_ThrVlvSens2NplB1 DFC_st.DFC_ThrVlvShoCircB1 DFC_st.DFC_ThrVlvSpiErrB1 DFC_st.DFC_ThrvlvSens1MinB1 DFC_st.DFC_TiOffTBasdChkFast DFC_st.DFC_TiOffTBasdChkSlow DFC_st.DFC_UEGOSnsrMntdS1B1 DFC_st.DFC_VehVSig DFC_st.DFC_VlvLftFbSwtIntk11SpclFail DFC_st.DFC_VlvLftFbSwtIntk11StdFail DSQ_st.DSQ_ACClntP DSQ_st.DSQ_ACEvpT DSQ_st.DSQ_AirCCmprActr DSQ_st.DSQ_BattU DSQ_st.DSQ_BattULo DSQ_st.DSQ_BrkBstPMdl DSQ_st.DSQ_BrkP DSQ_st.DSQ_BrkPSnsr DSQ_st.DSQ_CoVMDIDASFail DSQ_st.DSQ_DSMInhibitAlways DSQ_st.DSQ_EGRVlv_GovDesVal DSQ_st.DSQ_ElecLd DSQ_st.DSQ_EngICO DSQ_st.DSQ_EpmCaSSigQuality DSQ_st.DSQ_EpmReverseRun DSQ_st.DSQ_FanDIO_0 DSQ_st.DSQ_FanDIO_1 DSQ_st.DSQ_FuelP DSQ_st.DSQ_FuelT DSQ_st.DSQ_GEVCtlTOilCylHd DSQ_st.DSQ_GEVlvAgIntkB1 DSQ_st.DSQ_GbxPNPos DSQ_st.DSQ_GbxPosNotPN DSQ_st.DSQ_InjVlv_DI_CylOk DSQ_st.DSQ_MRly DSQ_st.DSQ_OilP DSQ_st.DSQ_PEnvMeasVld DSQ_st.DSQ_PEnvVld DSQ_st.DSQ_PEnv_pRaw DSQ_st.DSQ_PRail DSQ_st.DSQ_PThrVlvUs DSQ_st.DSQ_PThrVlvUsB1 DSQ_st.DSQ_StrtImobChk DSQ_st.DSQ_TDevCenColdStrt DSQ_st.DSQ_VehV DSQ_st.DSQ_VehVSens DSQ_st.DSQ_VehVSnsr DSQ_st.DSQ_stAPP DSQ_st.DSQ_stComEAT4 /end OUT_MEASUREMENT
 /begin LOC_MEASUREMENT DFC_lenMaxCllsn DFC_nrCllsnClear DFC_nrCllsnReInit DFC_nrCllsnReport DFC_numDfcMaxCllsn DFC_stClctFault_mp DFC_stClctTst_mp DFC_stFinal DFC_stMem DFC_stRdy DFC_stTestFaildInhb /end LOC_MEASUREMENT
 FUNCTION_VERSION "30000.33.0_1.1.0" /end FUNCTION
/begin COMPU_METHOD DFCDFP_Verb "" TAB_VERB "%6.3" "-" COMPU_TAB_REF DFCDFP_Verb /end COMPU_METHOD
/begin COMPU_VTAB DFCDFP_Verb "" TAB_VERB 990 0 "NoEntry" 1 "DFC_AAVEmax" 2 "DFC_AAVEmin" 3 "DFC_AAVEsig" 4 "DFC_AltIOACGFailr" 5 "DFC_AltIOACGHiVltg" 6 "DFC_AltIOACGLoVltg" 7 "DFC_AltIOACGTHi" 8 "DFC_AltIODConnACG" 9 "DFC_BGOELWAF" 10 "DFC_BattUHiFailr" 11 "DFC_BattULoFailr" 12 "DFC_BrkBstPDriftHiErr" 13 "DFC_BrkBstPDriftLoErr" 14 "DFC_BrkBstPSnsrStuck" 15 "DFC_BrkMnSwtContOn" 16 "DFC_BrkMnSwtNotStp" 17 "DFC_BrkNpl" 18 "DFC_BrkRdntSwtContOn" 19 "DFC_BrkRdntSwtNotStp" 20 "DFC_Clth3ONStuck" 21 "DFC_Clth4OFFStuck" 22 "DFC_ClthOFFStuck" 23 "DFC_ClthONStuck" 24 "DFC_ClthStkFailInfo" 25 "DFC_ComACFailInfo" 26 "DFC_ComATFTValErr" 27 "DFC_ComATMILReq" 28 "DFC_ComAYCAChksum" 29 "DFC_ComAYCARingCnt" 30 "DFC_ComAYCATOut" 31 "DFC_ComAYCDChkSum" 32 "DFC_ComAYCDTOut" 33 "DFC_ComAYCFChksum" 34 "DFC_ComAYCFRingCnt" 35 "DFC_ComAYCFTOut" 36 "DFC_ComAYCGChksum" 37 "DFC_ComAYCGRingCnt" 38 "DFC_ComAYCGTOut" 39 "DFC_ComAYCIChkSum" 40 "DFC_ComAYCIRingCnt" 41 "DFC_ComAYCITOut" 42 "DFC_ComBCM1ChkSum" 43 "DFC_ComBCM1RingCnt" 44 "DFC_ComBCM1TOut" 45 "DFC_ComCANABusOffErr" 46 "DFC_ComCANBBusOffErr" 47 "DFC_ComCANCBusOffErr" 48 "DFC_ComCGW1ChkSum" 49 "DFC_ComCGW1RingCnt" 50 "DFC_ComCGW1TOut" 51 "DFC_ComConvBoostErr" 52 "DFC_ComConvSlipErr" 53 "DFC_ComDCDCPrfmncErr" 54 "DFC_ComDCDCTempWarn" 55 "DFC_ComEAT10Chksum" 56 "DFC_ComEAT10RingCnt" 57 "DFC_ComEAT10TOut" 58 "DFC_ComEAT11ChkSum" 59 "DFC_ComEAT11RingCnt" 60 "DFC_ComEAT11TOut" 61 "DFC_ComEAT12ChkSum" 62 "DFC_ComEAT12RingCnt" 63 "DFC_ComEAT12TOut" 64 "DFC_ComEAT13ChkSum" 65 "DFC_ComEAT13RingCnt" 66 "DFC_ComEAT13TOut" 67 "DFC_ComEAT1Chksum" 68 "DFC_ComEAT1RingCnt" 69 "DFC_ComEAT1TOut" 70 "DFC_ComEAT2ChkSum" 71 "DFC_ComEAT2RingCnt" 72 "DFC_ComEAT2TOut" 73 "DFC_ComEAT4ChkSum" 74 "DFC_ComEAT4RingCnt" 75 "DFC_ComEAT4TOut" 76 "DFC_ComEAT6Chksum" 77 "DFC_ComEAT6RingCnt" 78 "DFC_ComEAT6TOut" 79 "DFC_ComEAT7Chksum" 80 "DFC_ComEAT7RingCnt" 81 "DFC_ComEAT7TOut" 82 "DFC_ComEAT8Chksum" 83 "DFC_ComEAT8RingCnt" 84 "DFC_ComEAT8TOut" 85 "DFC_ComEATAChksum" 86 "DFC_ComEATARingCnt" 87 "DFC_ComEATATOut" 88 "DFC_ComEATBChkSum" 89 "DFC_ComEATBRingCnt" 90 "DFC_ComEATBTOut" 91 "DFC_ComEATCChksum" 92 "DFC_ComEATCRingCnt" 93 "DFC_ComEATCTOut" 94 "DFC_ComEPBBChkSum" 95 "DFC_ComEPBBRingCnt" 96 "DFC_ComEPBBTOut" 97 "DFC_ComEPBChksum" 98 "DFC_ComEPBTOut" 99 "DFC_ComEPBctRing" 100 "DFC_ComEPS1Chksum" 101 "DFC_ComEPS1RingCnt" 102 "DFC_ComEPS1TOut" 103 "DFC_ComEngCanRxErr" 104 "DFC_ComGrvySnsrErr" 105 "DFC_ComGwIMG1ChkSum" 106 "DFC_ComGwIMG1RingCnt" 107 "DFC_ComGwIMG1TOut" 108 "DFC_ComGwIMG3ChkSum" 109 "DFC_ComGwIMG3RingCnt" 110 "DFC_ComGwIMG3TOut" 111 "DFC_ComGwIMG4ChkSum" 112 "DFC_ComGwIMG4RingCnt" 113 "DFC_ComGwIMG4TOut" 114 "DFC_ComGwIMG5ChkSum" 115 "DFC_ComGwIMG5RingCnt" 116 "DFC_ComGwIMG5TOut" 117 "DFC_ComGwIMG6ChkSum" 118 "DFC_ComGwIMG6RingCnt" 119 "DFC_ComGwIMG6TOut" 120 "DFC_ComIDASBChksum" 121 "DFC_ComIDASBRingCnt" 122 "DFC_ComIDASBTOut" 123 "DFC_ComIMGMILReq" 124 "DFC_ComISSPrms" 125 "DFC_ComMETAChksum" 126 "DFC_ComMETAChksumPstDrv" 127 "DFC_ComMETARingCnt" 128 "DFC_ComMETARingCntPstDrv" 129 "DFC_ComMETATOut" 130 "DFC_ComMETATOutPstDrv" 131 "DFC_ComMETCChksum" 132 "DFC_ComMETCRingCnt" 133 "DFC_ComMETCTOut" 134 "DFC_ComMETDChksum" 135 "DFC_ComMETDRingCnt" 136 "DFC_ComMETDTOut" 137 "DFC_ComMETE2Chksum" 138 "DFC_ComMETE2RingCnt" 139 "DFC_ComMETE2TOut" 140 "DFC_ComMETFChksum" 141 "DFC_ComMETFRingCnt" 142 "DFC_ComMETFTOut" 143 "DFC_ComMETGChksum" 144 "DFC_ComMETGRingCnt" 145 "DFC_ComMETGTOut" 146 "DFC_ComMETH2Chksum" 147 "DFC_ComMETH2RingCnt" 148 "DFC_ComMETH2TOut" 149 "DFC_ComMETHChksum" 150 "DFC_ComMETHRingCnt" 151 "DFC_ComMETHTOut" 152 "DFC_ComMETIChksum" 153 "DFC_ComMETIRingCnt" 154 "DFC_ComMETITOut" 155 "DFC_ComMETKChksum" 156 "DFC_ComMETKRingCnt" 157 "DFC_ComMETKTOut" 158 "DFC_ComMETLChksum" 159 "DFC_ComMETLRingCnt" 160 "DFC_ComMETLTOut" 161 "DFC_ComMETMChksum" 162 "DFC_ComMETMRingCnt" 163 "DFC_ComMETMTOut" 164 "DFC_ComMETNChksum" 165 "DFC_ComMETNRingCnt" 166 "DFC_ComMETNTOut" 167 "DFC_ComMtrCom" 168 "DFC_ComPCUChkSum" 169 "DFC_ComPCURingCnt" 170 "DFC_ComPCUTOut" 171 "DFC_ComSRSAChksum" 172 "DFC_ComSRSARingCnt" 173 "DFC_ComSRSATOut" 174 "DFC_ComSRSBChksum" 175 "DFC_ComSRSBRingCnt" 176 "DFC_ComSRSBTOut" 177 "DFC_ComSRSChksum" 178 "DFC_ComSRSErr" 179 "DFC_ComSRSRingCnt" 180 "DFC_ComSRSTOut" 181 "DFC_ComVehSpdPndFltTCU" 182 "DFC_EbsChartcCurrErr" 183 "DFC_EbsSelfDiagErr" 184 "DFC_GEVlvPhaCsersIntkB1" 185 "DFC_GEVlvPhaPsOpenLoadIntkB1" 186 "DFC_GEVlvPhaPsShoToBattIntkB1" 187 "DFC_GEVlvPhaPsShoToGndIntkB1" 188 "DFC_GbxCANDigPlausErr" 189 "DFC_GbxNPos1SRCMax" 190 "DFC_GbxNPos1SRCMin" 191 "DFC_GbxNPos2SRCMax" 192 "DFC_GbxNPos2SRCMin" 193 "DFC_GbxNPosAlvChk" 194 "DFC_GbxNPosSyncErr" 195 "DFC_HEGOS2B1HtrPsMax" 196 "DFC_HEGOS2B1HtrPsMin" 197 "DFC_HEGOS2B1HtrPsSig" 198 "DFC_LinCSErrACG" 199 "DFC_LinCSErrAEV" 200 "DFC_LinCSErrDCDC" 201 "DFC_LinCSErrEBS" 202 "DFC_LinHdrTimeoutErrACG" 203 "DFC_LinHdrTimeoutErrAEV" 204 "DFC_LinHdrTimeoutErrDCDC" 205 "DFC_LinHdrTimeoutErrEBS" 206 "DFC_LinMsgTimeoutErrACG" 207 "DFC_LinMsgTimeoutErrAEV" 208 "DFC_LinMsgTimeoutErrDCDC" 209 "DFC_LinMsgTimeoutErrEBS" 210 "DFC_LinNoStrtComErr" 211 "DFC_LowPresOilP" 212 "DFC_MisfDetVWhlFrntLeOORHi" 213 "DFC_MisfDetVWhlFrntLeRatyHi" 214 "DFC_MisfDetVWhlFrntLeRatyLo" 215 "DFC_MisfDetVWhlFrntLeStuck" 216 "DFC_MisfDetVWhlFrntRiOORHi" 217 "DFC_MisfDetVWhlFrntRiRatyHi" 218 "DFC_MisfDetVWhlFrntRiRatyLo" 219 "DFC_MisfDetVWhlFrntRiStuck" 220 "DFC_MisfDetVWhlReLeOORHi" 221 "DFC_MisfDetVWhlReLeRatyHi" 222 "DFC_MisfDetVWhlReLeRatyLo" 223 "DFC_MisfDetVWhlReLeStuck" 224 "DFC_MisfDetVWhlReRiOORHi" 225 "DFC_MisfDetVWhlReRiRatyHi" 226 "DFC_MisfDetVWhlReRiRatyLo" 227 "DFC_MisfDetVWhlReRiStuck" 228 "DFC_MisfDetdVWhlFrntLePlaus" 229 "DFC_MisfDetdVWhlFrntRiPlaus" 230 "DFC_MisfDetdVWhlReLePlaus" 231 "DFC_MisfDetdVWhlReRiPlaus" 232 "DFC_PEnvSigRngMax" 233 "DFC_PEnvSigRngMin" 234 "DFC_StmFault" 235 "DFC_StrtCtOffPth" 236 "DFC_StrtCtlErr" 237 "DFC_StrtFault" 238 "DFC_StrtLckJudg1" 239 "DFC_StrtLckJudg2" 240 "DFC_StrtOL" 241 "DFC_StrtOL2" 242 "DFC_StrtSCB" 243 "DFC_StrtSCB2" 244 "DFC_StrtSCG" 245 "DFC_StrtSCG2" 246 "DFC_StrtStkRly1" 247 "DFC_StrtStkRly2" 248 "DFC_TEVEmax" 249 "DFC_TEVEmin" 250 "DFC_TEVEsig" 251 "DFC_UegoHeatrPrfmncLoS1B1" 252 "DFC_VehVAllPlaus" 253 "DFC_VehVNCSnsrElecFailr" 254 "DFC_VehVPlausCan" 255 "DFC_VehVPlausFco" 256 "DFC_VehVPlausPwr" 257 "DFC_VehVPlausV2N" 258 "DFC_VehVSpdSnsrAElecFailr" 259 "DFC_VehVSpdSnsrBElecFailr" 260 "DFC_ClthMax" 261 "DFC_IgnClPs_DevComErr" 262 "DFC_IgnClPs_LineOl_0" 263 "DFC_IgnClPs_LineOl_1" 264 "DFC_IgnClPs_LineOl_2" 265 "DFC_IgnClPs_LineOl_3" 266 "DFC_IgnClPs_LineScb_0" 267 "DFC_IgnClPs_LineScb_1" 268 "DFC_IgnClPs_LineScb_2" 269 "DFC_IgnClPs_LineScb_3" 270 "DFC_IgnClPs_LineScg_0" 271 "DFC_IgnClPs_LineScg_1" 272 "DFC_IgnClPs_LineScg_2" 273 "DFC_IgnClPs_LineScg_3" 274 "DFC_KRVEKOEVAB" 275 "DFC_KRVEKOEVAB0" 276 "DFC_KRVEKOEVAB1" 277 "DFC_KRVEKOEVAB2" 278 "DFC_KRVEKOEVAB3" 279 "DFC_UegoSigEcuAsicS1B1" 280 "DFC_UegoSigEcuComS1B1" 281 "DFC_UegoSigSnsrS1B1" 282 "DFC_UegoSigWireOlApesS1B1" 283 "DFC_UegoSigWireOlIpeS1B1" 284 "DFC_UegoSigWireOlReS1B1" 285 "DFC_UegoSigWireRCmpS1B1" 286 "DFC_UegoSigWireScbS1B1" 287 "DFC_UegoSigWireScgS1B1" 288 "DFC_AfsPhyRngHiB1" 289 "DFC_AfsPhyRngLoB1" 290 "DFC_AirCCmprOL" 291 "DFC_AirCCmprOvrTemp" 292 "DFC_AirCCmprSCB" 293 "DFC_AirCCmprSCG" 294 "DFC_AltErr" 295 "DFC_BattUSRCMax" 296 "DFC_BattUSRCMin" 297 "DFC_ComChksTCU1" 298 "DFC_ComChksTCU11" 299 "DFC_ComChksTCU12" 300 "DFC_ComChksTCU13" 301 "DFC_ComChksTCU2" 302 "DFC_ComChksTCU3" 303 "DFC_ComChksTCU4" 304 "DFC_ComCntTCU1" 305 "DFC_ComCntTCU11" 306 "DFC_ComCntTCU12" 307 "DFC_ComCntTCU13" 308 "DFC_ComCntTCU2" 309 "DFC_ComCntTCU3" 310 "DFC_ComCntTCU4" 311 "DFC_ComTOutTCU01" 312 "DFC_ComTOutTCU02" 313 "DFC_ComTOutTCU1" 314 "DFC_ComTOutTCU11" 315 "DFC_ComTOutTCU12" 316 "DFC_ComTOutTCU13" 317 "DFC_ComTOutTCU14" 318 "DFC_ComTOutTCU2" 319 "DFC_ComTOutTCU3" 320 "DFC_ComTOutTCU4" 321 "DFC_DevLibBattUHi" 322 "DFC_DevLibBattULo" 323 "DFC_EGRVlvFailSafeActv" 324 "DFC_EGRVlvGovDvtCld" 325 "DFC_EGRVlvPhysSRCMax" 326 "DFC_EGRVlvPhysSRCMin" 327 "DFC_FanDIOOL_0" 328 "DFC_FanDIOOL_1" 329 "DFC_FanDIOOvrTemp_0" 330 "DFC_FanDIOOvrTemp_1" 331 "DFC_FanDIOSCB_0" 332 "DFC_FanDIOSCB_1" 333 "DFC_FanDIOSCG_0" 334 "DFC_FanDIOSCG_1" 335 "DFC_MRlyDcOL" 336 "DFC_MRlyDcSCB" 337 "DFC_MRlyDcSCG" 338 "DFC_PSPOL" 339 "DFC_PSPOvrTemp" 340 "DFC_PSPSCB" 341 "DFC_PSPSCG" 342 "DFC_T50Err" 343 "DFC_ThrVlvLoBattB1" 344 "DFC_UegoSigOperPlausS1B1" 345 "DFC_VehVPhysRngHi" 346 "DFC_VehVSclOutOL" 347 "DFC_VehVSclOutOT" 348 "DFC_VehVSclOutSCB" 349 "DFC_VehVSclOutSCG" 350 "DFC_VehVSigFL" 351 "DFC_VehVSigFR" 352 "DFC_VehVSigRL" 353 "DFC_VehVSigRR" 354 "DFC_VehVSnsrARngHi" 355 "DFC_VehVSnsrBRngHi" 356 "DFC_VehVSpdRtyDiag" 357 "DFC_DHFHD" 358 "DFC_InjVlv_DI_DcDc" 359 "DFC_InjVlv_DI_NoLd_0" 360 "DFC_InjVlv_DI_NoLd_1" 361 "DFC_InjVlv_DI_NoLd_2" 362 "DFC_InjVlv_DI_NoLd_3" 363 "DFC_InjVlv_DI_ScBnk_0" 364 "DFC_InjVlv_DI_ScBnk_1" 365 "DFC_InjVlv_DI_ScBnk_2" 366 "DFC_InjVlv_DI_ScBnk_3" 367 "DFC_InjVlv_DI_ScCyl_0" 368 "DFC_InjVlv_DI_ScCyl_1" 369 "DFC_InjVlv_DI_ScCyl_2" 370 "DFC_InjVlv_DI_ScCyl_3" 371 "DFC_InjVlv_DI_ScHsLs_0" 372 "DFC_InjVlv_DI_ScHsLs_1" 373 "DFC_InjVlv_DI_ScHsLs_2" 374 "DFC_InjVlv_DI_ScHsLs_3" 375 "DFC_MfPsDiaOpenLoad1" 376 "DFC_MfPsDiaScHiS1" 377 "DFC_MfPsDiaScHiSLowS1" 378 "DFC_MfPsDiaScLowS1" 379 "DFC_ACEvpTPhysRngHi" 380 "DFC_ACEvpTPhysRngLo" 381 "DFC_ACEvpTSRCMax" 382 "DFC_ACEvpTSRCMin" 383 "DFC_AfsRawSigRngHiB1" 384 "DFC_AfsRawSigRngLoB1" 385 "DFC_AfsSnsrErrB1" 386 "DFC_AirCClntPAnaSRCMax" 387 "DFC_AirCClntPAnaSRCMin" 388 "DFC_AirCSwtNpl" 389 "DFC_AirCSwtSig" 390 "DFC_Brk" 391 "DFC_BrkBstSensSCB" 392 "DFC_BrkBstSensSCG" 393 "DFC_BrkSig" 394 "DFC_ClthSig" 395 "DFC_EGRVlvCurrLim" 396 "DFC_EGRVlvOL" 397 "DFC_EGRVlvOvrTemp" 398 "DFC_EGRVlvSCB" 399 "DFC_EGRVlvSCG" 400 "DFC_EGRVlvSRCMax" 401 "DFC_EGRVlvSRCMin" 402 "DFC_HLSDemOvhtEngLim" 403 "DFC_OilPSwmpSRCMax" 404 "DFC_OilPSwmpSRCMin" 405 "DFC_PIntkVUsLineHiB1" 406 "DFC_PIntkVUsLineLoB1" 407 "DFC_VehVPhysRngLo" 408 "DFC_VehVSigCan" 409 "DFC_VehVSigCanSafe" 410 "DFC_VlvLftFbOilPSnsrIntk11SRCMax" 411 "DFC_VlvLftFbOilPSnsrIntk11SRCMin" 412 "DFC_ClthNpl" 413 "DFC_GbxPNPosnDrvCdn" 414 "DFC_GbxPNPosnPlausy" 415 "DFC_AfsSigErrLineHiB1" 416 "DFC_AfsSigErrLineLoB1" 417 "DFC_PEnvCcMax" 418 "DFC_PEnvCcMin" 419 "DFC_PEnvRngChkMax" 420 "DFC_PEnvRngChkMin" 421 "DFC_PEnvSnsrPlaus" 422 "DFC_UEGOHeatrRlyPsOLS1B1" 423 "DFC_UEGOHeatrRlyPsSCBS1B1" 424 "DFC_UEGOHeatrRlyPsSCGS1B1" 425 "DFC_UegoHeatrWireOlS1B1" 426 "DFC_UegoHeatrWireScbS1B1" 427 "DFC_UegoHeatrWireScgS1B1" 428 "DFC_KnDetSens1PortAMax" 429 "DFC_KnDetSens1PortAMin" 430 "DFC_KnDetSens1PortBMax" 431 "DFC_KnDetSens1PortBMin" 432 "DFC_Clth2ONStuck" 433 "DFC_Clth2ONStuckLdc" 434 "DFC_Clth3ONStuckLdc" 435 "DFC_Clth3ONStuckPostDrv" 436 "DFC_Clth4ONStuck" 437 "DFC_Clth4ONStuckLdc" 438 "DFC_ComBCMUnit" 439 "DFC_ComDLCTCU01" 440 "DFC_ComDLCTCU02" 441 "DFC_ComDLCTCU1" 442 "DFC_ComDLCTCU11" 443 "DFC_ComDLCTCU12" 444 "DFC_ComDLCTCU13" 445 "DFC_ComDLCTCU14" 446 "DFC_ComDLCTCU2" 447 "DFC_ComDLCTCU3" 448 "DFC_ComDLCTCU4" 449 "DFC_ComEPSUnit" 450 "DFC_ComIDASBUnit" 451 "DFC_ComIMGUnit" 452 "DFC_ComMETUnit" 453 "DFC_ComSRSUnit" 454 "DFC_ComVSAUnit" 455 "DFC_EbsSocFlt" 456 "DFC_I14229VINErr" 457 "DFC_InjCatHeatgErr" 458 "DFC_InjSysMulInjDiagErr" 459 "DFC_LLRHmax" 460 "DFC_LLRHmin" 461 "DFC_LLRHnpl" 462 "DFC_LLRKHmax" 463 "DFC_LLRKHmin" 464 "DFC_LLRKHnpl" 465 "DFC_LinACGUnit" 466 "DFC_LinAEVUnit" 467 "DFC_LinEBSUnit" 468 "DFC_RoughRoad" 469 "DFC_SiaEEPRdErr" 470 "DFC_SiaEEPWrngCod" 471 "DFC_UegoHeatrStrtS1B1" 472 "DFC_BusDiagCANAPPLBusOff" 473 "DFC_BusDiagCANCANCBusOff" 474 "DFC_BusDiagCANVEHICLEBusOff" 475 "DFC_RBA_IODIAGPWR_rba_IoExtCy329_SignalVltSply_0" 476 "DFC_RBA_IODIAGPWR_rba_IoExtCy329_SignalVltSply_0OT" 477 "DFC_RBA_IODIAGPWR_rba_IoExtCy329_SignalVltSply_0OV" 478 "DFC_RBA_IODIAGPWR_rba_IoExtCy329_SignalVltSply_0SCG" 479 "DFC_RBA_IODIAGPWR_rba_IoExtCy329_SignalVltSply_0UV" 480 "DFC_RBA_IODIAGPWR_rba_IoExtCy329_SignalVltSply_1" 481 "DFC_RBA_IODIAGPWR_rba_IoExtCy329_SignalVltSply_1OT" 482 "DFC_RBA_IODIAGPWR_rba_IoExtCy329_SignalVltSply_1OV" 483 "DFC_RBA_IODIAGPWR_rba_IoExtCy329_SignalVltSply_1SCG" 484 "DFC_RBA_IODIAGPWR_rba_IoExtCy329_SignalVltSply_1UV" 485 "DFC_RBA_IODIAGPWR_rba_IoExtCy329_SignalVltSply_2" 486 "DFC_RBA_IODIAGPWR_rba_IoExtCy329_SignalVltSply_2OT" 487 "DFC_RBA_IODIAGPWR_rba_IoExtCy329_SignalVltSply_2OV" 488 "DFC_RBA_IODIAGPWR_rba_IoExtCy329_SignalVltSply_2SCG" 489 "DFC_RBA_IODIAGPWR_rba_IoExtCy329_SignalVltSply_2UV" 490 "DFC_CAN_E_TIMEOUT" 491 "DFC_LIN_E_TIMEOUT" 492 "DFC_MRlyOL" 493 "DFC_MRlySCB" 494 "DFC_MRlySCG" 495 "DFC_rba_MultiStackTrace_Threshold" 496 "DFC_BSWM_E_ACTION_FAILED" 497 "DFC_BSWM_E_INTRPTQUEUE_FULL" 498 "DFC_RBA_IOEXTLIB_KEEPALIVE_DRV" 499 "DFC_RBA_IOEXTLIB_KEEPALIVE_INI" 500 "DFC_rba_IoSigRtc_StopCounter" 501 "DFC_rba_MRly_Diag_Stk_Event" 502 "DFC_rba_MemDiag_MemReadErr" 503 "DFC_rba_MemDiag_MemWrErr" 504 "DFC_rba_SyC_IrrSwOffTrigEngRun_Event" 505 "DFC_rba_T15_Diag_ComInVld_Event" 506 "DFC_rba_T15_Diag_ComOff_HwOn_Event" 507 "DFC_rba_T15_Diag_ComOn_HwOff_Event" 508 "DFC_AAVmin" 509 "DFC_AGRSUS" 510 "DFC_AfsPlausDiagHi" 511 "DFC_AfsPlausDiagLo" 512 "DFC_AfsVrntDiagErrB1" 513 "DFC_AppAllSnsrDfct" 514 "DFC_BBKRnldg" 515 "DFC_BBKRsyne" 516 "DFC_BattUStdbyDiaOL" 517 "DFC_BigLeakIntkMnfldEmiInfl" 518 "DFC_BlkdLineTank" 519 "DFC_BrkMnSwtContOnWarnLmp" 520 "DFC_BrkMnSwtNotStpWarnLmp" 521 "DFC_BrkRdntSwtContOnWarnLmp" 522 "DFC_BrkRdntSwtNotStpWarnLmp" 523 "DFC_CEngDsTColdStrtMax" 524 "DFC_CEngDsTColdStrtMin" 525 "DFC_CEngDsTImps" 526 "DFC_CEngDsTPlausHSC" 527 "DFC_CEngDsTPlausLSC" 528 "DFC_CEngDsTPlausSTC" 529 "DFC_CEngDsTSRCMax" 530 "DFC_CEngDsTSRCMin" 531 "DFC_CEngDsTSig" 532 "DFC_CEngUsTColdStrtMax" 533 "DFC_CEngUsTColdStrtMin" 534 "DFC_CEngUsTLooseCnctn" 535 "DFC_CEngUsTSRCMax" 536 "DFC_CEngUsTSRCMin" 537 "DFC_ComDCDCACCFailr" 538 "DFC_DCDCFltDet" 539 "DFC_DKRSA" 540 "DFC_DKVSmax" 541 "DFC_DKnpl" 542 "DFC_DSKVRmax" 543 "DFC_DSKVRmin" 544 "DFC_DSKVRnpl" 545 "DFC_DSKVRsig" 546 "DFC_DSKVSsig" 547 "DFC_DSSmax" 548 "DFC_DSTDmax" 549 "DFC_DSTEmax" 550 "DFC_DSTEmin" 551 "DFC_DSTOFmax" 552 "DFC_DSTRmax" 553 "DFC_DSTRmin" 554 "DFC_DSTRnpl" 555 "DFC_DSTRsig" 556 "DFC_DSTTI" 557 "DFC_DSUmax" 558 "DFC_DiagCpv1DteskLoLoadStuckClsd" 559 "DFC_DiagCpv1DteskLoLoadStuckOpen" 560 "DFC_EGRVlvDrftClsd" 561 "DFC_EGRVlvDrftOpn" 562 "DFC_EGRVlvJamVlvClsd" 563 "DFC_EGRVlvJamVlvOpn" 564 "DFC_EGRVlvSprgBrk" 565 "DFC_EGRVlvTempMdlEEPErr" 566 "DFC_EGRVlvTmpErr" 567 "DFC_EGSDUS2B1LtrDly" 568 "DFC_EGSDUS2B1LtrPT1" 569 "DFC_EGSDUS2B1RtlDly" 570 "DFC_EGSDUS2B1RtlPT1" 571 "DFC_EGSDUS2B1TarLean" 572 "DFC_EGSDUS2B1TarRich" 573 "DFC_EONVmax" 574 "DFC_ETAKHLmax" 575 "DFC_ETAKHTmax" 576 "DFC_ETHSEmax" 577 "DFC_ETHSEmin" 578 "DFC_ETHSFmax" 579 "DFC_ETHSFmin" 580 "DFC_ETHSFsig" 581 "DFC_ETHSNPWmax" 582 "DFC_ETHSNPWmin" 583 "DFC_ETHSNPWsig" 584 "DFC_ETHSPLnpl" 585 "DFC_ETHSTPLnpl" 586 "DFC_EngICO" 587 "DFC_EngPrtOvrSpdMon" 588 "DFC_EpmCaSI1ErrSig" 589 "DFC_EpmCaSI1MntErr" 590 "DFC_EpmCaSI1NoSigMax" 591 "DFC_EpmCaSI1NoSigMin" 592 "DFC_EpmCaSI1OfsErr" 593 "DFC_EpmCrSDGI" 594 "DFC_EpmCrSErrSig" 595 "DFC_EpmCrSNoSig" 596 "DFC_EtaEngIdleNonCsers" 597 "DFC_EtaEngPtlNonCsers" 598 "DFC_FRAmax" 599 "DFC_FRAmin" 600 "DFC_FSTEmax" 601 "DFC_FSTEmin" 602 "DFC_FSTRmax" 603 "DFC_FSTRmin" 604 "DFC_FSTRnpl" 605 "DFC_FSTmax" 606 "DFC_FTDLAmax" 607 "DFC_FTDLAmin" 608 "DFC_FuPHiSnsrEleclmax" 609 "DFC_FuPHiSnsrEleclmin" 610 "DFC_FuPHiSnsrEleclnpl" 611 "DFC_FuPHiSnsrURngMax" 612 "DFC_FuPHiSnsrURngMin" 613 "DFC_FuSnsrPhyRngMaxErr" 614 "DFC_FuSnsrPhyRngMinErr" 615 "DFC_GEVlvLockPinDiagIntkB1" 616 "DFC_GEVlvPhaSlowIntkB1" 617 "DFC_GEVlvPhaTargIntkB1" 618 "DFC_GbxRvsSwtStk" 619 "DFC_HDRKHmax" 620 "DFC_HDRKHmin" 621 "DFC_HDRPLmax" 622 "DFC_HDRPLmin" 623 "DFC_HDRmax" 624 "DFC_HDRmin" 625 "DFC_HEGOS2B1ElecMax" 626 "DFC_HEGOS2B1ElecMin" 627 "DFC_HEGOS2B1ElecSig" 628 "DFC_HEGOS2B1HtgNpl" 629 "DFC_HEV00max" 630 "DFC_HEV01max" 631 "DFC_HEV02max" 632 "DFC_HEV03max" 633 "DFC_HEVE0max" 634 "DFC_HEVE1max" 635 "DFC_HFMmax" 636 "DFC_HiPSysHiPMaxLimExcdd" 637 "DFC_IVGdiCtlCvoErrMax_0" 638 "DFC_IVGdiCtlCvoErrMax_1" 639 "DFC_IVGdiCtlCvoErrMax_2" 640 "DFC_IVGdiCtlCvoErrMax_3" 641 "DFC_IVGdiCtlCvoErrMin_0" 642 "DFC_IVGdiCtlCvoErrMin_1" 643 "DFC_IVGdiCtlCvoErrMin_2" 644 "DFC_IVGdiCtlCvoErrMin_3" 645 "DFC_IVGdiCtlCvoErrMinMax" 646 "DFC_IVGdiCtlCvoSigPlausErrSmrCdn" 647 "DFC_IVGdiCtl_CvoErr" 648 "DFC_IVGdiCtl_CvoSigPlaus_0" 649 "DFC_IVGdiCtl_CvoSigPlaus_1" 650 "DFC_IVGdiCtl_CvoSigPlaus_2" 651 "DFC_IVGdiCtl_CvoSigPlaus_3" 652 "DFC_IntkAirTAirFltDsCrssMax" 653 "DFC_IntkAirTAirFltDsCrssMin" 654 "DFC_IntkAirTAirFltDsHSCMax" 655 "DFC_IntkAirTAirFltDsImps" 656 "DFC_IntkAirTAirFltDsPRCMax" 657 "DFC_IntkAirTAirFltDsPRCMin" 658 "DFC_IntkAirTAirFltDsSRCMax" 659 "DFC_IntkAirTAirFltDsSRCMin" 660 "DFC_IntkAirTAirFltDsSTC" 661 "DFC_IntkAirTIntkMnfldCrssMax" 662 "DFC_IntkAirTIntkMnfldCrssMin" 663 "DFC_IntkAirTIntkMnfldHSCMax" 664 "DFC_IntkAirTIntkMnfldImps" 665 "DFC_IntkAirTIntkMnfldPRCMax" 666 "DFC_IntkAirTIntkMnfldPRCMin" 667 "DFC_IntkAirTIntkMnfldSRCMax" 668 "DFC_IntkAirTIntkMnfldSRCMin" 669 "DFC_IntkAirTIntkMnfldSTC" 670 "DFC_KRREGRLMX" 671 "DFC_KRVEKOCVLCI" 672 "DFC_KRVEKOENCHMT" 673 "DFC_KRVEKOENCHMT0" 674 "DFC_KRVEKOENCHMT1" 675 "DFC_KRVEKOENCHMT2" 676 "DFC_KRVEKOENCHMT3" 677 "DFC_KRVEKOENCHMT4" 678 "DFC_KRVEKOENCHMT5" 679 "DFC_KRVEKOENCHMT6" 680 "DFC_KRVEKOENCHMT7" 681 "DFC_KRVEKORLMX" 682 "DFC_KRVEKORLMXL" 683 "DFC_KS1max" 684 "DFC_KS1min" 685 "DFC_LMmax" 686 "DFC_LZSRnpl" 687 "DFC_LamDynDiagS1B1" 688 "DFC_LeakIntkMnfldEmiInfl" 689 "DFC_LinFrameErrDCDC" 690 "DFC_LinOverrunErrDCDC" 691 "DFC_MD00max" 692 "DFC_MDBmax" 693 "DFC_MDCat" 694 "DFC_MDCatCrit" 695 "DFC_MDCatCurr" 696 "DFC_MDCyl_0" 697 "DFC_MDCyl_1" 698 "DFC_MDCyl_2" 699 "DFC_MDCyl_3" 700 "DFC_MDEmi" 701 "DFC_MDEmiStrt" 702 "DFC_MDFco" 703 "DFC_MDMpl" 704 "DFC_MDSegTiAdpn" 705 "DFC_MDmax" 706 "DFC_MFuOilMax" 707 "DFC_MOXEMM_SMU_ALM0_0" 708 "DFC_MOXEMM_SMU_ALM0_1" 709 "DFC_MOXEMM_SMU_ALM0_10" 710 "DFC_MOXEMM_SMU_ALM0_11" 711 "DFC_MOXEMM_SMU_ALM0_13" 712 "DFC_MOXEMM_SMU_ALM0_14" 713 "DFC_MOXEMM_SMU_ALM0_2" 714 "DFC_MOXEMM_SMU_ALM0_22" 715 "DFC_MOXEMM_SMU_ALM0_23" 716 "DFC_MOXEMM_SMU_ALM0_4" 717 "DFC_MOXEMM_SMU_ALM0_5" 718 "DFC_MOXEMM_SMU_ALM0_7" 719 "DFC_MOXEMM_SMU_ALM0_8" 720 "DFC_MOXEMM_SMU_ALM10_16" 721 "DFC_MOXEMM_SMU_ALM10_17" 722 "DFC_MOXEMM_SMU_ALM10_21" 723 "DFC_MOXEMM_SMU_ALM11_0" 724 "DFC_MOXEMM_SMU_ALM11_1" 725 "DFC_MOXEMM_SMU_ALM11_2" 726 "DFC_MOXEMM_SMU_ALM11_3" 727 "DFC_MOXEMM_SMU_ALM11_4" 728 "DFC_MOXEMM_SMU_ALM11_5" 729 "DFC_MOXEMM_SMU_ALM11_8" 730 "DFC_MOXEMM_SMU_ALM11_9" 731 "DFC_MOXEMM_SMU_ALM1_0" 732 "DFC_MOXEMM_SMU_ALM1_1" 733 "DFC_MOXEMM_SMU_ALM1_10" 734 "DFC_MOXEMM_SMU_ALM1_11" 735 "DFC_MOXEMM_SMU_ALM1_13" 736 "DFC_MOXEMM_SMU_ALM1_14" 737 "DFC_MOXEMM_SMU_ALM1_2" 738 "DFC_MOXEMM_SMU_ALM1_22" 739 "DFC_MOXEMM_SMU_ALM1_23" 740 "DFC_MOXEMM_SMU_ALM1_4" 741 "DFC_MOXEMM_SMU_ALM1_5" 742 "DFC_MOXEMM_SMU_ALM1_7" 743 "DFC_MOXEMM_SMU_ALM1_8" 744 "DFC_MOXEMM_SMU_ALM21_0" 745 "DFC_MOXEMM_SMU_ALM21_16" 746 "DFC_MOXEMM_SMU_ALM21_3" 747 "DFC_MOXEMM_SMU_ALM2_1" 748 "DFC_MOXEMM_SMU_ALM2_10" 749 "DFC_MOXEMM_SMU_ALM2_11" 750 "DFC_MOXEMM_SMU_ALM2_13" 751 "DFC_MOXEMM_SMU_ALM2_14" 752 "DFC_MOXEMM_SMU_ALM2_22" 753 "DFC_MOXEMM_SMU_ALM2_23" 754 "DFC_MOXEMM_SMU_ALM2_4" 755 "DFC_MOXEMM_SMU_ALM2_5" 756 "DFC_MOXEMM_SMU_ALM2_7" 757 "DFC_MOXEMM_SMU_ALM2_8" 758 "DFC_MOXEMM_SMU_ALM6_0" 759 "DFC_MOXEMM_SMU_ALM6_11" 760 "DFC_MOXEMM_SMU_ALM6_12" 761 "DFC_MOXEMM_SMU_ALM6_14" 762 "DFC_MOXEMM_SMU_ALM6_15" 763 "DFC_MOXEMM_SMU_ALM6_17" 764 "DFC_MOXEMM_SMU_ALM6_18" 765 "DFC_MOXEMM_SMU_ALM6_20" 766 "DFC_MOXEMM_SMU_ALM6_21" 767 "DFC_MOXEMM_SMU_ALM6_25" 768 "DFC_MOXEMM_SMU_ALM6_4" 769 "DFC_MOXEMM_SMU_ALM6_5" 770 "DFC_MOXEMM_SMU_ALM6_7" 771 "DFC_MOXEMM_SMU_ALM6_8" 772 "DFC_MOXEMM_SMU_ALM7_1" 773 "DFC_MOXEMM_SMU_ALM7_12" 774 "DFC_MOXEMM_SMU_ALM7_13" 775 "DFC_MOXEMM_SMU_ALM7_14" 776 "DFC_MOXEMM_SMU_ALM7_15" 777 "DFC_MOXEMM_SMU_ALM7_16" 778 "DFC_MOXEMM_SMU_ALM7_17" 779 "DFC_MOXEMM_SMU_ALM7_2" 780 "DFC_MOXEMM_SMU_ALM7_20" 781 "DFC_MOXEMM_SMU_ALM7_25" 782 "DFC_MOXEMM_SMU_ALM7_26" 783 "DFC_MOXEMM_SMU_ALM7_28" 784 "DFC_MOXEMM_SMU_ALM7_29" 785 "DFC_MOXEMM_SMU_ALM7_30" 786 "DFC_MOXEMM_SMU_ALM7_31" 787 "DFC_MOXEMM_SMU_ALM8_0" 788 "DFC_MOXEMM_SMU_ALM8_1" 789 "DFC_MOXEMM_SMU_ALM8_10" 790 "DFC_MOXEMM_SMU_ALM8_11" 791 "DFC_MOXEMM_SMU_ALM8_12" 792 "DFC_MOXEMM_SMU_ALM8_16" 793 "DFC_MOXEMM_SMU_ALM8_18" 794 "DFC_MOXEMM_SMU_ALM8_2" 795 "DFC_MOXEMM_SMU_ALM8_3" 796 "DFC_MOXEMM_SMU_ALM8_31" 797 "DFC_MOXEMM_SMU_ALM8_4" 798 "DFC_MOXEMM_SMU_ALM9_0" 799 "DFC_MOXEMM_SMU_ALM9_15" 800 "DFC_MOXEMM_SMU_ALM9_3" 801 "DFC_MoCADCNTP" 802 "DFC_MoCADCTst" 803 "DFC_MoCSOPICO" 804 "DFC_MoFAPP" 805 "DFC_MoFAirFilgPrdc" 806 "DFC_MoFAirFlCtOffGdi" 807 "DFC_MoFAirFlCylGdi" 808 "DFC_MoFAirFlFF" 809 "DFC_MoFAirFlIn" 810 "DFC_MoFAirFlMixCtlGdiChkAirFl" 811 "DFC_MoFAirFlMixCtlGdiChkCtrl" 812 "DFC_MoFAirFlMode" 813 "DFC_MoFESpd" 814 "DFC_MoFIACo" 815 "DFC_MoFICOL1" 816 "DFC_MoFICOL2" 817 "DFC_MoFStrt" 818 "DFC_MoFTrqCmp" 819 "DFC_MoFTrqCmpMax" 820 "DFC_MoFTrqCmpMin" 821 "DFC_MoFVarPostBldSel" 822 "DFC_MoXEMMHwLTMCUFW" 823 "DFC_MoXEMMHwLTMonBIST" 824 "DFC_MoXEMMHwLTRegMonTest" 825 "DFC_MoXEMMHwLTStbySMUAlvTest" 826 "DFC_MoXEMMHwLTTempSens" 827 "DFC_MoXEMMHwLTUCBCfg" 828 "DFC_NWSEmax" 829 "DFC_NWSmax" 830 "DFC_OCWDAABEActv" 831 "DFC_OCWDACom" 832 "DFC_OCWDAErrPin" 833 "DFC_OCWDAOvrVltg" 834 "DFC_ORAmax" 835 "DFC_ORAmin" 836 "DFC_OilPPlaus" 837 "DFC_PLLSUmax" 838 "DFC_PLLSUmin" 839 "DFC_PSR1max" 840 "DFC_PSRBmax" 841 "DFC_PSRBmin" 842 "DFC_PSRPmax" 843 "DFC_PSRPmin" 844 "DFC_PSRPsig" 845 "DFC_PSRmax" 846 "DFC_PUmax" 847 "DFC_P_VSE11_OL" 848 "DFC_P_VSE11_SCB" 849 "DFC_P_VSE11_SCG" 850 "DFC_PhyHighAPP1" 851 "DFC_PhyHighAPP2" 852 "DFC_PhyLowAPP1" 853 "DFC_PhyLowAPP2" 854 "DFC_SRCHighAPP1" 855 "DFC_SRCHighAPP2" 856 "DFC_SRCLowAPP1" 857 "DFC_SRCLowAPP2" 858 "DFC_SSpMon2" 859 "DFC_STHDRmax" 860 "DFC_SWReset_0" 861 "DFC_SWReset_1" 862 "DFC_SWReset_2" 863 "DFC_SyncAPP" 864 "DFC_TANKLnpl" 865 "DFC_TAmax_Dummy" 866 "DFC_TESFmax" 867 "DFC_TESGmax" 868 "DFC_TKAEmax" 869 "DFC_TKAEmin" 870 "DFC_TKARmax" 871 "DFC_TKARnpl" 872 "DFC_TMmax_Dummy" 873 "DFC_TUMmax_Dummy" 874 "DFC_TWCDPriCatB1" 875 "DFC_ThrVlvClsdPosnFirstOffsLrnImpoB1" 876 "DFC_ThrVlvClsdPosnOffsLrnImpoB1" 877 "DFC_ThrVlvClsdPosnOffsLrnMaxB1" 878 "DFC_ThrVlvClsdPosnOffsLrnMinB1" 879 "DFC_ThrVlvCtrlDeB1" 880 "DFC_ThrVlvDycB1" 881 "DFC_ThrVlvLimpAirPosnMaxAbsltDriftB1" 882 "DFC_ThrVlvLimpAirPosnMaxB1" 883 "DFC_ThrVlvLimpAirPosnMaxRelDriftB1" 884 "DFC_ThrVlvLimpAirPosnMinB1" 885 "DFC_ThrVlvOpenLoadB1" 886 "DFC_ThrVlvOpenSprgB1" 887 "DFC_ThrVlvOpenSprgSprdB1" 888 "DFC_ThrVlvOpenSprgTwnB1" 889 "DFC_ThrVlvOverTB1" 890 "DFC_ThrVlvRetSprgB1" 891 "DFC_ThrVlvRetSprgSprdB1" 892 "DFC_ThrVlvRetSprgTwnB1" 893 "DFC_ThrVlvSens1MaxB1" 894 "DFC_ThrVlvSens1NplB1" 895 "DFC_ThrVlvSens2MaxB1" 896 "DFC_ThrVlvSens2MinB1" 897 "DFC_ThrVlvSens2NplB1" 898 "DFC_ThrVlvShoCircB1" 899 "DFC_ThrVlvSpiErrB1" 900 "DFC_ThrvlvSens1MinB1" 901 "DFC_TiOffTBasdChkFast" 902 "DFC_TiOffTBasdChkSlow" 903 "DFC_UEGOSnsrMntdS1B1" 904 "DFC_VehVSig" 905 "DFC_VlvLftFbSwtIntk11SpclFail" 906 "DFC_VlvLftFbSwtIntk11StdFail" 907 "DFP_AAA" 908 "DFP_AAV" 909 "DFP_AAVE" 910 "DFP_AGRE" 911 "DFP_AGRS" 912 "DFP_DHFHD" 913 "DFP_DK" 914 "DFP_DK1P" 915 "DFP_DK2P" 916 "DFP_DKVS" 917 "DFP_DSKV" 918 "DFP_DSKVR" 919 "DFP_DSKVS" 920 "DFP_DSS" 921 "DFP_DSU" 922 "DFP_DVEE" 923 "DFP_DVEF" 924 "DFP_DVEFO" 925 "DFP_DVEL" 926 "DFP_DVEN" 927 "DFP_DVER" 928 "DFP_DVEU" 929 "DFP_DVEUB" 930 "DFP_DVEUW" 931 "DFP_DYLSU" 932 "DFP_ENWCS" 933 "DFP_ENWS" 934 "DFP_ENWSE" 935 "DFP_EONV" 936 "DFP_FP1P" 937 "DFP_FP2P" 938 "DFP_FRA" 939 "DFP_FST" 940 "DFP_FSTE" 941 "DFP_FSTR" 942 "DFP_FTDLA" 943 "DFP_HDR" 944 "DFP_HDRKH" 945 "DFP_HDRPL" 946 "DFP_HFM" 947 "DFP_HSH" 948 "DFP_HSHE" 949 "DFP_KAT" 950 "DFP_KPE" 951 "DFP_KS1" 952 "DFP_LLRH" 953 "DFP_LLRKH" 954 "DFP_LM" 955 "DFP_LSH" 956 "DFP_LZSR" 957 "DFP_MD" 958 "DFP_NWS" 959 "DFP_NWSE" 960 "DFP_ORA" 961 "DFP_PLLSU" 962 "DFP_PSR" 963 "DFP_PSR1" 964 "DFP_PSRB" 965 "DFP_PSRE" 966 "DFP_PSRP" 967 "DFP_PU" 968 "DFP_PUE" 969 "DFP_PUPL" 970 "DFP_PUR" 971 "DFP_STHDR" 972 "DFP_TA" 973 "DFP_TANKL" 974 "DFP_TANLCS" 975 "DFP_TANLPRC" 976 "DFP_TANLR" 977 "DFP_TASRCS" 978 "DFP_TASRE" 979 "DFP_TASRPRC" 980 "DFP_TASRR" 981 "DFP_TESF" 982 "DFP_TESG" 983 "DFP_TM" 984 "DFP_TMCS" 985 "DFP_TME" 986 "DFP_TMP" 987 "DFP_UB" 988 "DFP_VFZ" 989 "DFP_ZZZ" DEFAULT_VALUE "---" /end COMPU_VTAB
/begin COMPU_METHOD DFC_OneToOne "" RAT_FUNC "%6.2" "-" COEFFS 0 1 0 0 0 1 /end COMPU_METHOD
/begin COMPU_METHOD DFES_OneToOne "" RAT_FUNC "%6.2" "-" COEFFS 0 1 0 0 0 1 /end COMPU_METHOD
/begin COMPU_METHOD OneToOne "" RAT_FUNC "%6.2" "-" COEFFS 0 1 0 0 0 1 /end COMPU_METHOD
/begin RECORD_LAYOUT Val_Wu16 FNC_VALUES 1 UWORD COLUMN_DIR DIRECT /end RECORD_LAYOUT
/end MODULE
/end PROJECT
