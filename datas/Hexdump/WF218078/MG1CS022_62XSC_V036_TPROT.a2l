ASAP2_VERSION 1 60
/begin PROJECT MG1CS022 "MG1CS022"
/begin HEADER "" VERSION "MG1CS022_62XSC_V036_TPROT" PROJECT_NO MG1CS022 /end HEADER
/begin MODULE DIM ""
/begin MOD_COMMON "" BYTE_ORDER MSB_LAST ALIGNMENT_BYTE 1 ALIGNMENT_WORD 2 ALIGNMENT_LONG 4 ALIGNMENT_INT64 4 ALIGNMENT_FLOAT32_IEEE 4 ALIGNMENT_FLOAT64_IEEE 4 DATA_SIZE 32 /end MOD_COMMON
/begin CHARACTERISTIC DFES_FaultTyp.DFC_LMmax_C "assigned fault type / Fault type assignment for check DFC_LMmax" VALUE 0x805049EB Val_Wu8 255.0 DFES_OneToOne 0.00 255.0 FORMAT "%5.1" /end CHARACTERISTIC
/begin CHARACTERISTIC DFES_FaultTyp.DFC_LZSRnpl_C "assigned fault type / Fault type assignment for check DFC_LZSRnpl" VALUE 0x805049EC Val_Wu8 255.0 DFES_OneToOne 0.00 255.0 FORMAT "%5.1" /end CHARACTERISTIC
/begin CHARACTERISTIC DFES_FaultTyp.DFC_LamDynDiagS1B1_C "assigned fault type / Fault type assignment for check DFC_LamDynDiagS1B1" VALUE 0x805049ED Val_Wu8 255.0 DFES_OneToOne 0.00 255.0 FORMAT "%5.1" /end CHARACTERISTIC
/begin CHARACTERISTIC DFES_FaultTyp.DFC_LeakIntkMnfldEmiInfl_C "assigned fault type / Fault type assignment for check DFC_LeakIntkMnfldEmiInfl" VALUE 0x805049EE Val_Wu8 255.0 DFES_OneToOne 0.00 255.0 FORMAT "%5.1" /end CHARACTERISTIC
/begin CHARACTERISTIC DFES_FaultTyp.DFC_LinFrameErrDCDC_C "assigned fault type / Fault type assignment for check DFC_LinFrameErrDCDC" VALUE 0x805049EF Val_Wu8 255.0 DFES_OneToOne 0.00 255.0 FORMAT "%5.1" /end CHARACTERISTIC
/begin CHARACTERISTIC DFES_FaultTyp.DFC_LinOverrunErrDCDC_C "assigned fault type / Fault type assignment for check DFC_LinOverrunErrDCDC" VALUE 0x805049F0 Val_Wu8 255.0 DFES_OneToOne 0.00 255.0 FORMAT "%5.1" /end CHARACTERISTIC
/begin CHARACTERISTIC DFES_FaultTyp.DFC_MD00max_C "assigned fault type / Fault type assignment for check DFC_MD00max" VALUE 0x805049F1 Val_Wu8 255.0 DFES_OneToOne 0.00 255.0 FORMAT "%5.1" /end CHARACTERISTIC
/begin CHARACTERISTIC DFES_FaultTyp.DFC_MDBmax_C "assigned fault type / Fault type assignment for check DFC_MDBmax" VALUE 0x805049F2 Val_Wu8 255.0 DFES_OneToOne 0.00 255.0 FORMAT "%5.1" /end CHARACTERISTIC
/begin CHARACTERISTIC DFES_FaultTyp.DFC_MDCat_C "assigned fault type / Fault type assignment for check DFC_MDCat" VALUE 0x805049F3 Val_Wu8 255.0 DFES_OneToOne 0.00 255.0 FORMAT "%5.1" /end CHARACTERISTIC
/begin CHARACTERISTIC DFES_FaultTyp.DFC_MDCatCrit_C "assigned fault type / Fault type assignment for check DFC_MDCatCrit" VALUE 0x805049F4 Val_Wu8 255.0 DFES_OneToOne 0.00 255.0 FORMAT "%5.1" /end CHARACTERISTIC
/begin CHARACTERISTIC DFES_FaultTyp.DFC_MDCatCurr_C "assigned fault type / Fault type assignment for check DFC_MDCatCurr" VALUE 0x805049F5 Val_Wu8 255.0 DFES_OneToOne 0.00 255.0 FORMAT "%5.1" /end CHARACTERISTIC
/begin CHARACTERISTIC DFES_FaultTyp.DFC_MDCyl_0_C "assigned fault type / Fault type assignment for check DFC_MDCyl_0" VALUE 0x805049F6 Val_Wu8 255.0 DFES_OneToOne 0.00 255.0 FORMAT "%5.1" /end CHARACTERISTIC
/begin CHARACTERISTIC DFES_FaultTyp.DFC_MDCyl_1_C "assigned fault type / Fault type assignment for check DFC_MDCyl_1" VALUE 0x805049F7 Val_Wu8 255.0 DFES_OneToOne 0.00 255.0 FORMAT "%5.1" /end CHARACTERISTIC
/begin CHARACTERISTIC DFES_FaultTyp.DFC_MDCyl_2_C "assigned fault type / Fault type assignment for check DFC_MDCyl_2" VALUE 0x805049F8 Val_Wu8 255.0 DFES_OneToOne 0.00 255.0 FORMAT "%5.1" /end CHARACTERISTIC
/begin CHARACTERISTIC DFES_FaultTyp.DFC_MDCyl_3_C "assigned fault type / Fault type assignment for check DFC_MDCyl_3" VALUE 0x805049F9 Val_Wu8 255.0 DFES_OneToOne 0.00 255.0 FORMAT "%5.1" /end CHARACTERISTIC
/begin CHARACTERISTIC DFES_FaultTyp.DFC_MDEmi_C "assigned fault type / Fault type assignment for check DFC_MDEmi" VALUE 0x805049FA Val_Wu8 255.0 DFES_OneToOne 0.00 255.0 FORMAT "%5.1" /end CHARACTERISTIC
/begin CHARACTERISTIC DFES_FaultTyp.DFC_MDEmiStrt_C "assigned fault type / Fault type assignment for check DFC_MDEmiStrt" VALUE 0x805049FB Val_Wu8 255.0 DFES_OneToOne 0.00 255.0 FORMAT "%5.1" /end CHARACTERISTIC
/begin CHARACTERISTIC DFES_FaultTyp.DFC_MDFco_C "assigned fault type / Fault type assignment for check DFC_MDFco" VALUE 0x805049FC Val_Wu8 255.0 DFES_OneToOne 0.00 255.0 FORMAT "%5.1" /end CHARACTERISTIC
/begin CHARACTERISTIC DFES_FaultTyp.DFC_MDMpl_C "assigned fault type / Fault type assignment for check DFC_MDMpl" VALUE 0x805049FD Val_Wu8 255.0 DFES_OneToOne 0.00 255.0 FORMAT "%5.1" /end CHARACTERISTIC
/begin CHARACTERISTIC DFES_FaultTyp.DFC_MDSegTiAdpn_C "assigned fault type / Fault type assignment for check DFC_MDSegTiAdpn" VALUE 0x805049FE Val_Wu8 255.0 DFES_OneToOne 0.00 255.0 FORMAT "%5.1" /end CHARACTERISTIC
/begin CHARACTERISTIC DFES_FaultTyp.DFC_MDmax_C "assigned fault type / Fault type assignment for check DFC_MDmax" VALUE 0x805049FF Val_Wu8 255.0 DFES_OneToOne 0.00 255.0 FORMAT "%5.1" /end CHARACTERISTIC
/begin CHARACTERISTIC DFES_FaultTyp.DFC_MFuOilMax_C "assigned fault type / Fault type assignment for check DFC_MFuOilMax" VALUE 0x80504A00 Val_Wu8 255.0 DFES_OneToOne 0.00 255.0 FORMAT "%5.1" /end CHARACTERISTIC
/begin CHARACTERISTIC DFES_FaultTyp.DFC_MOXEMM_SMU_ALM0_0_C "assigned fault type / Fault type assignment for check DFC_MOXEMM_SMU_ALM0_0" VALUE 0x80504A01 Val_Wu8 255.0 DFES_OneToOne 0.00 255.0 FORMAT "%5.1" /end CHARACTERISTIC
/begin CHARACTERISTIC DFES_FaultTyp.DFC_MOXEMM_SMU_ALM0_1_C "assigned fault type / Fault type assignment for check DFC_MOXEMM_SMU_ALM0_1" VALUE 0x80504A02 Val_Wu8 255.0 DFES_OneToOne 0.00 255.0 FORMAT "%5.1" /end CHARACTERISTIC
/begin CHARACTERISTIC DFES_FaultTyp.DFC_MOXEMM_SMU_ALM0_10_C "assigned fault type / Fault type assignment for check DFC_MOXEMM_SMU_ALM0_10" VALUE 0x80504A03 Val_Wu8 255.0 DFES_OneToOne 0.00 255.0 FORMAT "%5.1" /end CHARACTERISTIC
/begin CHARACTERISTIC DFES_FaultTyp.DFC_MOXEMM_SMU_ALM0_11_C "assigned fault type / Fault type assignment for check DFC_MOXEMM_SMU_ALM0_11" VALUE 0x80504A04 Val_Wu8 255.0 DFES_OneToOne 0.00 255.0 FORMAT "%5.1" /end CHARACTERISTIC
/begin CHARACTERISTIC DFES_FaultTyp.DFC_MOXEMM_SMU_ALM0_13_C "assigned fault type / Fault type assignment for check DFC_MOXEMM_SMU_ALM0_13" VALUE 0x80504A05 Val_Wu8 255.0 DFES_OneToOne 0.00 255.0 FORMAT "%5.1" /end CHARACTERISTIC
/begin CHARACTERISTIC DFES_FaultTyp.DFC_MOXEMM_SMU_ALM0_14_C "assigned fault type / Fault type assignment for check DFC_MOXEMM_SMU_ALM0_14" VALUE 0x80504A06 Val_Wu8 255.0 DFES_OneToOne 0.00 255.0 FORMAT "%5.1" /end CHARACTERISTIC
/begin CHARACTERISTIC DFES_FaultTyp.DFC_MOXEMM_SMU_ALM0_2_C "assigned fault type / Fault type assignment for check DFC_MOXEMM_SMU_ALM0_2" VALUE 0x80504A07 Val_Wu8 255.0 DFES_OneToOne 0.00 255.0 FORMAT "%5.1" /end CHARACTERISTIC
/begin CHARACTERISTIC DFES_FaultTyp.DFC_MOXEMM_SMU_ALM0_22_C "assigned fault type / Fault type assignment for check DFC_MOXEMM_SMU_ALM0_22" VALUE 0x80504A08 Val_Wu8 255.0 DFES_OneToOne 0.00 255.0 FORMAT "%5.1" /end CHARACTERISTIC
/begin CHARACTERISTIC DFES_FaultTyp.DFC_MOXEMM_SMU_ALM0_23_C "assigned fault type / Fault type assignment for check DFC_MOXEMM_SMU_ALM0_23" VALUE 0x80504A09 Val_Wu8 255.0 DFES_OneToOne 0.00 255.0 FORMAT "%5.1" /end CHARACTERISTIC
/begin CHARACTERISTIC DFES_FaultTyp.DFC_MOXEMM_SMU_ALM0_4_C "assigned fault type / Fault type assignment for check DFC_MOXEMM_SMU_ALM0_4" VALUE 0x80504A0A Val_Wu8 255.0 DFES_OneToOne 0.00 255.0 FORMAT "%5.1" /end CHARACTERISTIC
/begin CHARACTERISTIC DFES_FaultTyp.DFC_MOXEMM_SMU_ALM0_5_C "assigned fault type / Fault type assignment for check DFC_MOXEMM_SMU_ALM0_5" VALUE 0x80504A0B Val_Wu8 255.0 DFES_OneToOne 0.00 255.0 FORMAT "%5.1" /end CHARACTERISTIC
/begin CHARACTERISTIC DFES_FaultTyp.DFC_MOXEMM_SMU_ALM0_7_C "assigned fault type / Fault type assignment for check DFC_MOXEMM_SMU_ALM0_7" VALUE 0x80504A0C Val_Wu8 255.0 DFES_OneToOne 0.00 255.0 FORMAT "%5.1" /end CHARACTERISTIC
/begin CHARACTERISTIC DFES_FaultTyp.DFC_MOXEMM_SMU_ALM0_8_C "assigned fault type / Fault type assignment for check DFC_MOXEMM_SMU_ALM0_8" VALUE 0x80504A0D Val_Wu8 255.0 DFES_OneToOne 0.00 255.0 FORMAT "%5.1" /end CHARACTERISTIC
/begin CHARACTERISTIC DFES_FaultTyp.DFC_MOXEMM_SMU_ALM10_16_C "assigned fault type / Fault type assignment for check DFC_MOXEMM_SMU_ALM10_16" VALUE 0x80504A0E Val_Wu8 255.0 DFES_OneToOne 0.00 255.0 FORMAT "%5.1" /end CHARACTERISTIC
/begin CHARACTERISTIC DFES_FaultTyp.DFC_MOXEMM_SMU_ALM10_17_C "assigned fault type / Fault type assignment for check DFC_MOXEMM_SMU_ALM10_17" VALUE 0x80504A0F Val_Wu8 255.0 DFES_OneToOne 0.00 255.0 FORMAT "%5.1" /end CHARACTERISTIC
/begin CHARACTERISTIC DFES_FaultTyp.DFC_MOXEMM_SMU_ALM10_21_C "assigned fault type / Fault type assignment for check DFC_MOXEMM_SMU_ALM10_21" VALUE 0x80504A10 Val_Wu8 255.0 DFES_OneToOne 0.00 255.0 FORMAT "%5.1" /end CHARACTERISTIC
/begin CHARACTERISTIC DFES_FaultTyp.DFC_MOXEMM_SMU_ALM11_0_C "assigned fault type / Fault type assignment for check DFC_MOXEMM_SMU_ALM11_0" VALUE 0x80504A11 Val_Wu8 255.0 DFES_OneToOne 0.00 255.0 FORMAT "%5.1" /end CHARACTERISTIC
/begin CHARACTERISTIC DFES_FaultTyp.DFC_MOXEMM_SMU_ALM11_1_C "assigned fault type / Fault type assignment for check DFC_MOXEMM_SMU_ALM11_1" VALUE 0x80504A12 Val_Wu8 255.0 DFES_OneToOne 0.00 255.0 FORMAT "%5.1" /end CHARACTERISTIC
/begin CHARACTERISTIC DFES_FaultTyp.DFC_MOXEMM_SMU_ALM11_2_C "assigned fault type / Fault type assignment for check DFC_MOXEMM_SMU_ALM11_2" VALUE 0x80504A13 Val_Wu8 255.0 DFES_OneToOne 0.00 255.0 FORMAT "%5.1" /end CHARACTERISTIC
/begin CHARACTERISTIC DFES_FaultTyp.DFC_MOXEMM_SMU_ALM11_3_C "assigned fault type / Fault type assignment for check DFC_MOXEMM_SMU_ALM11_3" VALUE 0x80504A14 Val_Wu8 255.0 DFES_OneToOne 0.00 255.0 FORMAT "%5.1" /end CHARACTERISTIC
/begin CHARACTERISTIC DFES_FaultTyp.DFC_MOXEMM_SMU_ALM11_4_C "assigned fault type / Fault type assignment for check DFC_MOXEMM_SMU_ALM11_4" VALUE 0x80504A15 Val_Wu8 255.0 DFES_OneToOne 0.00 255.0 FORMAT "%5.1" /end CHARACTERISTIC
/begin CHARACTERISTIC DFES_FaultTyp.DFC_MOXEMM_SMU_ALM11_5_C "assigned fault type / Fault type assignment for check DFC_MOXEMM_SMU_ALM11_5" VALUE 0x80504A16 Val_Wu8 255.0 DFES_OneToOne 0.00 255.0 FORMAT "%5.1" /end CHARACTERISTIC
/begin CHARACTERISTIC DFES_FaultTyp.DFC_MOXEMM_SMU_ALM11_8_C "assigned fault type / Fault type assignment for check DFC_MOXEMM_SMU_ALM11_8" VALUE 0x80504A17 Val_Wu8 255.0 DFES_OneToOne 0.00 255.0 FORMAT "%5.1" /end CHARACTERISTIC
/begin CHARACTERISTIC DFES_FaultTyp.DFC_MOXEMM_SMU_ALM11_9_C "assigned fault type / Fault type assignment for check DFC_MOXEMM_SMU_ALM11_9" VALUE 0x80504A18 Val_Wu8 255.0 DFES_OneToOne 0.00 255.0 FORMAT "%5.1" /end CHARACTERISTIC
/begin CHARACTERISTIC DFES_FaultTyp.DFC_MOXEMM_SMU_ALM1_0_C "assigned fault type / Fault type assignment for check DFC_MOXEMM_SMU_ALM1_0" VALUE 0x80504A19 Val_Wu8 255.0 DFES_OneToOne 0.00 255.0 FORMAT "%5.1" /end CHARACTERISTIC
/begin CHARACTERISTIC DFES_FaultTyp.DFC_MOXEMM_SMU_ALM1_1_C "assigned fault type / Fault type assignment for check DFC_MOXEMM_SMU_ALM1_1" VALUE 0x80504A1A Val_Wu8 255.0 DFES_OneToOne 0.00 255.0 FORMAT "%5.1" /end CHARACTERISTIC
/begin CHARACTERISTIC DFES_FaultTyp.DFC_MOXEMM_SMU_ALM1_10_C "assigned fault type / Fault type assignment for check DFC_MOXEMM_SMU_ALM1_10" VALUE 0x80504A1B Val_Wu8 255.0 DFES_OneToOne 0.00 255.0 FORMAT "%5.1" /end CHARACTERISTIC
/begin CHARACTERISTIC DFES_FaultTyp.DFC_MOXEMM_SMU_ALM1_11_C "assigned fault type / Fault type assignment for check DFC_MOXEMM_SMU_ALM1_11" VALUE 0x80504A1C Val_Wu8 255.0 DFES_OneToOne 0.00 255.0 FORMAT "%5.1" /end CHARACTERISTIC
/begin CHARACTERISTIC DFES_FaultTyp.DFC_MOXEMM_SMU_ALM1_13_C "assigned fault type / Fault type assignment for check DFC_MOXEMM_SMU_ALM1_13" VALUE 0x80504A1D Val_Wu8 255.0 DFES_OneToOne 0.00 255.0 FORMAT "%5.1" /end CHARACTERISTIC
/begin CHARACTERISTIC DFES_FaultTyp.DFC_MOXEMM_SMU_ALM1_14_C "assigned fault type / Fault type assignment for check DFC_MOXEMM_SMU_ALM1_14" VALUE 0x80504A1E Val_Wu8 255.0 DFES_OneToOne 0.00 255.0 FORMAT "%5.1" /end CHARACTERISTIC
/begin CHARACTERISTIC DFES_FaultTyp.DFC_MOXEMM_SMU_ALM1_2_C "assigned fault type / Fault type assignment for check DFC_MOXEMM_SMU_ALM1_2" VALUE 0x80504A1F Val_Wu8 255.0 DFES_OneToOne 0.00 255.0 FORMAT "%5.1" /end CHARACTERISTIC
/begin CHARACTERISTIC DFES_FaultTyp.DFC_MOXEMM_SMU_ALM1_22_C "assigned fault type / Fault type assignment for check DFC_MOXEMM_SMU_ALM1_22" VALUE 0x80504A20 Val_Wu8 255.0 DFES_OneToOne 0.00 255.0 FORMAT "%5.1" /end CHARACTERISTIC
/begin CHARACTERISTIC DFES_FaultTyp.DFC_MOXEMM_SMU_ALM1_23_C "assigned fault type / Fault type assignment for check DFC_MOXEMM_SMU_ALM1_23" VALUE 0x80504A21 Val_Wu8 255.0 DFES_OneToOne 0.00 255.0 FORMAT "%5.1" /end CHARACTERISTIC
/begin CHARACTERISTIC DFES_FaultTyp.DFC_MOXEMM_SMU_ALM1_4_C "assigned fault type / Fault type assignment for check DFC_MOXEMM_SMU_ALM1_4" VALUE 0x80504A22 Val_Wu8 255.0 DFES_OneToOne 0.00 255.0 FORMAT "%5.1" /end CHARACTERISTIC
/begin CHARACTERISTIC DFES_FaultTyp.DFC_MOXEMM_SMU_ALM1_5_C "assigned fault type / Fault type assignment for check DFC_MOXEMM_SMU_ALM1_5" VALUE 0x80504A23 Val_Wu8 255.0 DFES_OneToOne 0.00 255.0 FORMAT "%5.1" /end CHARACTERISTIC
/begin CHARACTERISTIC DFES_FaultTyp.DFC_MOXEMM_SMU_ALM1_7_C "assigned fault type / Fault type assignment for check DFC_MOXEMM_SMU_ALM1_7" VALUE 0x80504A24 Val_Wu8 255.0 DFES_OneToOne 0.00 255.0 FORMAT "%5.1" /end CHARACTERISTIC
/begin CHARACTERISTIC DFES_FaultTyp.DFC_MOXEMM_SMU_ALM1_8_C "assigned fault type / Fault type assignment for check DFC_MOXEMM_SMU_ALM1_8" VALUE 0x80504A25 Val_Wu8 255.0 DFES_OneToOne 0.00 255.0 FORMAT "%5.1" /end CHARACTERISTIC
/begin CHARACTERISTIC DFES_FaultTyp.DFC_MOXEMM_SMU_ALM21_0_C "assigned fault type / Fault type assignment for check DFC_MOXEMM_SMU_ALM21_0" VALUE 0x80504A26 Val_Wu8 255.0 DFES_OneToOne 0.00 255.0 FORMAT "%5.1" /end CHARACTERISTIC
/begin CHARACTERISTIC DFES_FaultTyp.DFC_MOXEMM_SMU_ALM21_16_C "assigned fault type / Fault type assignment for check DFC_MOXEMM_SMU_ALM21_16" VALUE 0x80504A27 Val_Wu8 255.0 DFES_OneToOne 0.00 255.0 FORMAT "%5.1" /end CHARACTERISTIC
/begin CHARACTERISTIC DFES_FaultTyp.DFC_MOXEMM_SMU_ALM21_3_C "assigned fault type / Fault type assignment for check DFC_MOXEMM_SMU_ALM21_3" VALUE 0x80504A28 Val_Wu8 255.0 DFES_OneToOne 0.00 255.0 FORMAT "%5.1" /end CHARACTERISTIC
/begin CHARACTERISTIC DFES_FaultTyp.DFC_MOXEMM_SMU_ALM2_1_C "assigned fault type / Fault type assignment for check DFC_MOXEMM_SMU_ALM2_1" VALUE 0x80504A29 Val_Wu8 255.0 DFES_OneToOne 0.00 255.0 FORMAT "%5.1" /end CHARACTERISTIC
/begin CHARACTERISTIC DFES_FaultTyp.DFC_MOXEMM_SMU_ALM2_10_C "assigned fault type / Fault type assignment for check DFC_MOXEMM_SMU_ALM2_10" VALUE 0x80504A2A Val_Wu8 255.0 DFES_OneToOne 0.00 255.0 FORMAT "%5.1" /end CHARACTERISTIC
/begin CHARACTERISTIC DFES_FaultTyp.DFC_MOXEMM_SMU_ALM2_11_C "assigned fault type / Fault type assignment for check DFC_MOXEMM_SMU_ALM2_11" VALUE 0x80504A2B Val_Wu8 255.0 DFES_OneToOne 0.00 255.0 FORMAT "%5.1" /end CHARACTERISTIC
/begin CHARACTERISTIC DFES_FaultTyp.DFC_MOXEMM_SMU_ALM2_13_C "assigned fault type / Fault type assignment for check DFC_MOXEMM_SMU_ALM2_13" VALUE 0x80504A2C Val_Wu8 255.0 DFES_OneToOne 0.00 255.0 FORMAT "%5.1" /end CHARACTERISTIC
/begin CHARACTERISTIC DFES_FaultTyp.DFC_MOXEMM_SMU_ALM2_14_C "assigned fault type / Fault type assignment for check DFC_MOXEMM_SMU_ALM2_14" VALUE 0x80504A2D Val_Wu8 255.0 DFES_OneToOne 0.00 255.0 FORMAT "%5.1" /end CHARACTERISTIC
/begin CHARACTERISTIC DFES_FaultTyp.DFC_MOXEMM_SMU_ALM2_22_C "assigned fault type / Fault type assignment for check DFC_MOXEMM_SMU_ALM2_22" VALUE 0x80504A2E Val_Wu8 255.0 DFES_OneToOne 0.00 255.0 FORMAT "%5.1" /end CHARACTERISTIC
/begin CHARACTERISTIC DFES_FaultTyp.DFC_MOXEMM_SMU_ALM2_23_C "assigned fault type / Fault type assignment for check DFC_MOXEMM_SMU_ALM2_23" VALUE 0x80504A2F Val_Wu8 255.0 DFES_OneToOne 0.00 255.0 FORMAT "%5.1" /end CHARACTERISTIC
/begin CHARACTERISTIC DFES_FaultTyp.DFC_MOXEMM_SMU_ALM2_4_C "assigned fault type / Fault type assignment for check DFC_MOXEMM_SMU_ALM2_4" VALUE 0x80504A30 Val_Wu8 255.0 DFES_OneToOne 0.00 255.0 FORMAT "%5.1" /end CHARACTERISTIC
/begin CHARACTERISTIC DFES_FaultTyp.DFC_MOXEMM_SMU_ALM2_5_C "assigned fault type / Fault type assignment for check DFC_MOXEMM_SMU_ALM2_5" VALUE 0x80504A31 Val_Wu8 255.0 DFES_OneToOne 0.00 255.0 FORMAT "%5.1" /end CHARACTERISTIC
/begin CHARACTERISTIC DFES_FaultTyp.DFC_MOXEMM_SMU_ALM2_7_C "assigned fault type / Fault type assignment for check DFC_MOXEMM_SMU_ALM2_7" VALUE 0x80504A32 Val_Wu8 255.0 DFES_OneToOne 0.00 255.0 FORMAT "%5.1" /end CHARACTERISTIC
/begin CHARACTERISTIC DFES_FaultTyp.DFC_MOXEMM_SMU_ALM2_8_C "assigned fault type / Fault type assignment for check DFC_MOXEMM_SMU_ALM2_8" VALUE 0x80504A33 Val_Wu8 255.0 DFES_OneToOne 0.00 255.0 FORMAT "%5.1" /end CHARACTERISTIC
/begin CHARACTERISTIC DFES_FaultTyp.DFC_MOXEMM_SMU_ALM6_0_C "assigned fault type / Fault type assignment for check DFC_MOXEMM_SMU_ALM6_0" VALUE 0x80504A34 Val_Wu8 255.0 DFES_OneToOne 0.00 255.0 FORMAT "%5.1" /end CHARACTERISTIC
/begin CHARACTERISTIC DFES_FaultTyp.DFC_MOXEMM_SMU_ALM6_11_C "assigned fault type / Fault type assignment for check DFC_MOXEMM_SMU_ALM6_11" VALUE 0x80504A35 Val_Wu8 255.0 DFES_OneToOne 0.00 255.0 FORMAT "%5.1" /end CHARACTERISTIC
/begin CHARACTERISTIC DFES_FaultTyp.DFC_MOXEMM_SMU_ALM6_12_C "assigned fault type / Fault type assignment for check DFC_MOXEMM_SMU_ALM6_12" VALUE 0x80504A36 Val_Wu8 255.0 DFES_OneToOne 0.00 255.0 FORMAT "%5.1" /end CHARACTERISTIC
/begin CHARACTERISTIC DFES_FaultTyp.DFC_MOXEMM_SMU_ALM6_14_C "assigned fault type / Fault type assignment for check DFC_MOXEMM_SMU_ALM6_14" VALUE 0x80504A37 Val_Wu8 255.0 DFES_OneToOne 0.00 255.0 FORMAT "%5.1" /end CHARACTERISTIC
/begin CHARACTERISTIC DFES_FaultTyp.DFC_MOXEMM_SMU_ALM6_15_C "assigned fault type / Fault type assignment for check DFC_MOXEMM_SMU_ALM6_15" VALUE 0x80504A38 Val_Wu8 255.0 DFES_OneToOne 0.00 255.0 FORMAT "%5.1" /end CHARACTERISTIC
/begin CHARACTERISTIC DFES_FaultTyp.DFC_MOXEMM_SMU_ALM6_17_C "assigned fault type / Fault type assignment for check DFC_MOXEMM_SMU_ALM6_17" VALUE 0x80504A39 Val_Wu8 255.0 DFES_OneToOne 0.00 255.0 FORMAT "%5.1" /end CHARACTERISTIC
/begin CHARACTERISTIC DFES_FaultTyp.DFC_MOXEMM_SMU_ALM6_18_C "assigned fault type / Fault type assignment for check DFC_MOXEMM_SMU_ALM6_18" VALUE 0x80504A3A Val_Wu8 255.0 DFES_OneToOne 0.00 255.0 FORMAT "%5.1" /end CHARACTERISTIC
/begin CHARACTERISTIC DFES_FaultTyp.DFC_MOXEMM_SMU_ALM6_20_C "assigned fault type / Fault type assignment for check DFC_MOXEMM_SMU_ALM6_20" VALUE 0x80504A3B Val_Wu8 255.0 DFES_OneToOne 0.00 255.0 FORMAT "%5.1" /end CHARACTERISTIC
/begin CHARACTERISTIC DFES_FaultTyp.DFC_MOXEMM_SMU_ALM6_21_C "assigned fault type / Fault type assignment for check DFC_MOXEMM_SMU_ALM6_21" VALUE 0x80504A3C Val_Wu8 255.0 DFES_OneToOne 0.00 255.0 FORMAT "%5.1" /end CHARACTERISTIC
/begin CHARACTERISTIC DFES_FaultTyp.DFC_MOXEMM_SMU_ALM6_25_C "assigned fault type / Fault type assignment for check DFC_MOXEMM_SMU_ALM6_25" VALUE 0x80504A3D Val_Wu8 255.0 DFES_OneToOne 0.00 255.0 FORMAT "%5.1" /end CHARACTERISTIC
/begin CHARACTERISTIC DFES_FaultTyp.DFC_MOXEMM_SMU_ALM6_4_C "assigned fault type / Fault type assignment for check DFC_MOXEMM_SMU_ALM6_4" VALUE 0x80504A3E Val_Wu8 255.0 DFES_OneToOne 0.00 255.0 FORMAT "%5.1" /end CHARACTERISTIC
/begin CHARACTERISTIC DFES_FaultTyp.DFC_MOXEMM_SMU_ALM6_5_C "assigned fault type / Fault type assignment for check DFC_MOXEMM_SMU_ALM6_5" VALUE 0x80504A3F Val_Wu8 255.0 DFES_OneToOne 0.00 255.0 FORMAT "%5.1" /end CHARACTERISTIC
/begin CHARACTERISTIC DFES_FaultTyp.DFC_MOXEMM_SMU_ALM6_7_C "assigned fault type / Fault type assignment for check DFC_MOXEMM_SMU_ALM6_7" VALUE 0x80504A40 Val_Wu8 255.0 DFES_OneToOne 0.00 255.0 FORMAT "%5.1" /end CHARACTERISTIC
/begin CHARACTERISTIC DFES_FaultTyp.DFC_MOXEMM_SMU_ALM6_8_C "assigned fault type / Fault type assignment for check DFC_MOXEMM_SMU_ALM6_8" VALUE 0x80504A41 Val_Wu8 255.0 DFES_OneToOne 0.00 255.0 FORMAT "%5.1" /end CHARACTERISTIC
/begin CHARACTERISTIC DFES_FaultTyp.DFC_MOXEMM_SMU_ALM7_1_C "assigned fault type / Fault type assignment for check DFC_MOXEMM_SMU_ALM7_1" VALUE 0x80504A42 Val_Wu8 255.0 DFES_OneToOne 0.00 255.0 FORMAT "%5.1" /end CHARACTERISTIC
/begin CHARACTERISTIC DFES_FaultTyp.DFC_MOXEMM_SMU_ALM7_12_C "assigned fault type / Fault type assignment for check DFC_MOXEMM_SMU_ALM7_12" VALUE 0x80504A43 Val_Wu8 255.0 DFES_OneToOne 0.00 255.0 FORMAT "%5.1" /end CHARACTERISTIC
/begin CHARACTERISTIC DFES_FaultTyp.DFC_MOXEMM_SMU_ALM7_13_C "assigned fault type / Fault type assignment for check DFC_MOXEMM_SMU_ALM7_13" VALUE 0x80504A44 Val_Wu8 255.0 DFES_OneToOne 0.00 255.0 FORMAT "%5.1" /end CHARACTERISTIC
/begin CHARACTERISTIC DFES_FaultTyp.DFC_MOXEMM_SMU_ALM7_14_C "assigned fault type / Fault type assignment for check DFC_MOXEMM_SMU_ALM7_14" VALUE 0x80504A45 Val_Wu8 255.0 DFES_OneToOne 0.00 255.0 FORMAT "%5.1" /end CHARACTERISTIC
/begin CHARACTERISTIC DFES_FaultTyp.DFC_MOXEMM_SMU_ALM7_15_C "assigned fault type / Fault type assignment for check DFC_MOXEMM_SMU_ALM7_15" VALUE 0x80504A46 Val_Wu8 255.0 DFES_OneToOne 0.00 255.0 FORMAT "%5.1" /end CHARACTERISTIC
/begin CHARACTERISTIC DFES_FaultTyp.DFC_MOXEMM_SMU_ALM7_16_C "assigned fault type / Fault type assignment for check DFC_MOXEMM_SMU_ALM7_16" VALUE 0x80504A47 Val_Wu8 255.0 DFES_OneToOne 0.00 255.0 FORMAT "%5.1" /end CHARACTERISTIC
/begin CHARACTERISTIC DFES_FaultTyp.DFC_MOXEMM_SMU_ALM7_17_C "assigned fault type / Fault type assignment for check DFC_MOXEMM_SMU_ALM7_17" VALUE 0x80504A48 Val_Wu8 255.0 DFES_OneToOne 0.00 255.0 FORMAT "%5.1" /end CHARACTERISTIC
/begin CHARACTERISTIC DFES_FaultTyp.DFC_MOXEMM_SMU_ALM7_2_C "assigned fault type / Fault type assignment for check DFC_MOXEMM_SMU_ALM7_2" VALUE 0x80504A49 Val_Wu8 255.0 DFES_OneToOne 0.00 255.0 FORMAT "%5.1" /end CHARACTERISTIC
/begin CHARACTERISTIC DFES_FaultTyp.DFC_MOXEMM_SMU_ALM7_20_C "assigned fault type / Fault type assignment for check DFC_MOXEMM_SMU_ALM7_20" VALUE 0x80504A4A Val_Wu8 255.0 DFES_OneToOne 0.00 255.0 FORMAT "%5.1" /end CHARACTERISTIC
/begin CHARACTERISTIC DFES_FaultTyp.DFC_MOXEMM_SMU_ALM7_25_C "assigned fault type / Fault type assignment for check DFC_MOXEMM_SMU_ALM7_25" VALUE 0x80504A4B Val_Wu8 255.0 DFES_OneToOne 0.00 255.0 FORMAT "%5.1" /end CHARACTERISTIC
/begin CHARACTERISTIC DFES_FaultTyp.DFC_MOXEMM_SMU_ALM7_26_C "assigned fault type / Fault type assignment for check DFC_MOXEMM_SMU_ALM7_26" VALUE 0x80504A4C Val_Wu8 255.0 DFES_OneToOne 0.00 255.0 FORMAT "%5.1" /end CHARACTERISTIC
/begin CHARACTERISTIC DFES_FaultTyp.DFC_MOXEMM_SMU_ALM7_28_C "assigned fault type / Fault type assignment for check DFC_MOXEMM_SMU_ALM7_28" VALUE 0x80504A4D Val_Wu8 255.0 DFES_OneToOne 0.00 255.0 FORMAT "%5.1" /end CHARACTERISTIC
/begin CHARACTERISTIC DFES_FaultTyp.DFC_MOXEMM_SMU_ALM7_29_C "assigned fault type / Fault type assignment for check DFC_MOXEMM_SMU_ALM7_29" VALUE 0x80504A4E Val_Wu8 255.0 DFES_OneToOne 0.00 255.0 FORMAT "%5.1" /end CHARACTERISTIC
/begin CHARACTERISTIC DFES_FaultTyp.DFC_MOXEMM_SMU_ALM7_30_C "assigned fault type / Fault type assignment for check DFC_MOXEMM_SMU_ALM7_30" VALUE 0x80504A4F Val_Wu8 255.0 DFES_OneToOne 0.00 255.0 FORMAT "%5.1" /end CHARACTERISTIC
/begin CHARACTERISTIC DFES_FaultTyp.DFC_MOXEMM_SMU_ALM7_31_C "assigned fault type / Fault type assignment for check DFC_MOXEMM_SMU_ALM7_31" VALUE 0x80504A50 Val_Wu8 255.0 DFES_OneToOne 0.00 255.0 FORMAT "%5.1" /end CHARACTERISTIC
/begin CHARACTERISTIC DFES_FaultTyp.DFC_MOXEMM_SMU_ALM8_0_C "assigned fault type / Fault type assignment for check DFC_MOXEMM_SMU_ALM8_0" VALUE 0x80504A51 Val_Wu8 255.0 DFES_OneToOne 0.00 255.0 FORMAT "%5.1" /end CHARACTERISTIC
/begin CHARACTERISTIC DFES_FaultTyp.DFC_MOXEMM_SMU_ALM8_1_C "assigned fault type / Fault type assignment for check DFC_MOXEMM_SMU_ALM8_1" VALUE 0x80504A52 Val_Wu8 255.0 DFES_OneToOne 0.00 255.0 FORMAT "%5.1" /end CHARACTERISTIC
/begin CHARACTERISTIC DFES_FaultTyp.DFC_MOXEMM_SMU_ALM8_10_C "assigned fault type / Fault type assignment for check DFC_MOXEMM_SMU_ALM8_10" VALUE 0x80504A53 Val_Wu8 255.0 DFES_OneToOne 0.00 255.0 FORMAT "%5.1" /end CHARACTERISTIC
/begin CHARACTERISTIC DFES_FaultTyp.DFC_MOXEMM_SMU_ALM8_11_C "assigned fault type / Fault type assignment for check DFC_MOXEMM_SMU_ALM8_11" VALUE 0x80504A54 Val_Wu8 255.0 DFES_OneToOne 0.00 255.0 FORMAT "%5.1" /end CHARACTERISTIC
/begin CHARACTERISTIC DFES_FaultTyp.DFC_MOXEMM_SMU_ALM8_12_C "assigned fault type / Fault type assignment for check DFC_MOXEMM_SMU_ALM8_12" VALUE 0x80504A55 Val_Wu8 255.0 DFES_OneToOne 0.00 255.0 FORMAT "%5.1" /end CHARACTERISTIC
/begin CHARACTERISTIC DFES_FaultTyp.DFC_MOXEMM_SMU_ALM8_16_C "assigned fault type / Fault type assignment for check DFC_MOXEMM_SMU_ALM8_16" VALUE 0x80504A56 Val_Wu8 255.0 DFES_OneToOne 0.00 255.0 FORMAT "%5.1" /end CHARACTERISTIC
/begin CHARACTERISTIC DFES_FaultTyp.DFC_MOXEMM_SMU_ALM8_18_C "assigned fault type / Fault type assignment for check DFC_MOXEMM_SMU_ALM8_18" VALUE 0x80504A57 Val_Wu8 255.0 DFES_OneToOne 0.00 255.0 FORMAT "%5.1" /end CHARACTERISTIC
/begin CHARACTERISTIC DFES_FaultTyp.DFC_MOXEMM_SMU_ALM8_2_C "assigned fault type / Fault type assignment for check DFC_MOXEMM_SMU_ALM8_2" VALUE 0x80504A58 Val_Wu8 255.0 DFES_OneToOne 0.00 255.0 FORMAT "%5.1" /end CHARACTERISTIC
/begin CHARACTERISTIC DFES_FaultTyp.DFC_MOXEMM_SMU_ALM8_3_C "assigned fault type / Fault type assignment for check DFC_MOXEMM_SMU_ALM8_3" VALUE 0x80504A59 Val_Wu8 255.0 DFES_OneToOne 0.00 255.0 FORMAT "%5.1" /end CHARACTERISTIC
/begin CHARACTERISTIC DFES_FaultTyp.DFC_MOXEMM_SMU_ALM8_31_C "assigned fault type / Fault type assignment for check DFC_MOXEMM_SMU_ALM8_31" VALUE 0x80504A5A Val_Wu8 255.0 DFES_OneToOne 0.00 255.0 FORMAT "%5.1" /end CHARACTERISTIC
/begin CHARACTERISTIC DFES_FaultTyp.DFC_MOXEMM_SMU_ALM8_4_C "assigned fault type / Fault type assignment for check DFC_MOXEMM_SMU_ALM8_4" VALUE 0x80504A5B Val_Wu8 255.0 DFES_OneToOne 0.00 255.0 FORMAT "%5.1" /end CHARACTERISTIC
/begin CHARACTERISTIC DFES_FaultTyp.DFC_MOXEMM_SMU_ALM9_0_C "assigned fault type / Fault type assignment for check DFC_MOXEMM_SMU_ALM9_0" VALUE 0x80504A5C Val_Wu8 255.0 DFES_OneToOne 0.00 255.0 FORMAT "%5.1" /end CHARACTERISTIC
/begin CHARACTERISTIC DFES_FaultTyp.DFC_MOXEMM_SMU_ALM9_15_C "assigned fault type / Fault type assignment for check DFC_MOXEMM_SMU_ALM9_15" VALUE 0x80504A5D Val_Wu8 255.0 DFES_OneToOne 0.00 255.0 FORMAT "%5.1" /end CHARACTERISTIC
/begin CHARACTERISTIC DFES_FaultTyp.DFC_MOXEMM_SMU_ALM9_3_C "assigned fault type / Fault type assignment for check DFC_MOXEMM_SMU_ALM9_3" VALUE 0x80504A5E Val_Wu8 255.0 DFES_OneToOne 0.00 255.0 FORMAT "%5.1" /end CHARACTERISTIC
/begin CHARACTERISTIC DFES_FaultTyp.DFC_MoCADCNTP_C "assigned fault type / Fault type assignment for check DFC_MoCADCNTP" VALUE 0x80504A5F Val_Wu8 255.0 DFES_OneToOne 0.00 255.0 FORMAT "%5.1" /end CHARACTERISTIC
/begin CHARACTERISTIC DFES_FaultTyp.DFC_MoCADCTst_C "assigned fault type / Fault type assignment for check DFC_MoCADCTst" VALUE 0x80504A60 Val_Wu8 255.0 DFES_OneToOne 0.00 255.0 FORMAT "%5.1" /end CHARACTERISTIC
/begin CHARACTERISTIC DFES_FaultTyp.DFC_MoCSOPICO_C "assigned fault type / Fault type assignment for check DFC_MoCSOPICO" VALUE 0x80504A61 Val_Wu8 255.0 DFES_OneToOne 0.00 255.0 FORMAT "%5.1" /end CHARACTERISTIC
/begin CHARACTERISTIC DFES_FaultTyp.DFC_MoFAPP_C "assigned fault type / Fault type assignment for check DFC_MoFAPP" VALUE 0x80504A62 Val_Wu8 255.0 DFES_OneToOne 0.00 255.0 FORMAT "%5.1" /end CHARACTERISTIC
/begin CHARACTERISTIC DFES_FaultTyp.DFC_MoFAirFilgPrdc_C "assigned fault type / Fault type assignment for check DFC_MoFAirFilgPrdc" VALUE 0x80504A63 Val_Wu8 255.0 DFES_OneToOne 0.00 255.0 FORMAT "%5.1" /end CHARACTERISTIC
/begin CHARACTERISTIC DFES_FaultTyp.DFC_MoFAirFlCtOffGdi_C "assigned fault type / Fault type assignment for check DFC_MoFAirFlCtOffGdi" VALUE 0x80504A64 Val_Wu8 255.0 DFES_OneToOne 0.00 255.0 FORMAT "%5.1" /end CHARACTERISTIC
/begin CHARACTERISTIC DFES_FaultTyp.DFC_MoFAirFlCylGdi_C "assigned fault type / Fault type assignment for check DFC_MoFAirFlCylGdi" VALUE 0x80504A65 Val_Wu8 255.0 DFES_OneToOne 0.00 255.0 FORMAT "%5.1" /end CHARACTERISTIC
/begin CHARACTERISTIC DFES_FaultTyp.DFC_MoFAirFlFF_C "assigned fault type / Fault type assignment for check DFC_MoFAirFlFF" VALUE 0x80504A66 Val_Wu8 255.0 DFES_OneToOne 0.00 255.0 FORMAT "%5.1" /end CHARACTERISTIC
/begin CHARACTERISTIC DFES_FaultTyp.DFC_MoFAirFlIn_C "assigned fault type / Fault type assignment for check DFC_MoFAirFlIn" VALUE 0x80504A67 Val_Wu8 255.0 DFES_OneToOne 0.00 255.0 FORMAT "%5.1" /end CHARACTERISTIC
/begin CHARACTERISTIC DFES_FaultTyp.DFC_MoFAirFlMixCtlGdiChkAirFl_C "assigned fault type / Fault type assignment for check DFC_MoFAirFlMixCtlGdiChkAirFl" VALUE 0x80504A68 Val_Wu8 255.0 DFES_OneToOne 0.00 255.0 FORMAT "%5.1" /end CHARACTERISTIC
/begin CHARACTERISTIC DFES_FaultTyp.DFC_MoFAirFlMixCtlGdiChkCtrl_C "assigned fault type / Fault type assignment for check DFC_MoFAirFlMixCtlGdiChkCtrl" VALUE 0x80504A69 Val_Wu8 255.0 DFES_OneToOne 0.00 255.0 FORMAT "%5.1" /end CHARACTERISTIC
/begin CHARACTERISTIC DFES_FaultTyp.DFC_MoFAirFlMode_C "assigned fault type / Fault type assignment for check DFC_MoFAirFlMode" VALUE 0x80504A6A Val_Wu8 255.0 DFES_OneToOne 0.00 255.0 FORMAT "%5.1" /end CHARACTERISTIC
/begin CHARACTERISTIC DFES_FaultTyp.DFC_MoFESpd_C "assigned fault type / Fault type assignment for check DFC_MoFESpd" VALUE 0x80504A6B Val_Wu8 255.0 DFES_OneToOne 0.00 255.0 FORMAT "%5.1" /end CHARACTERISTIC
/begin CHARACTERISTIC DFES_FaultTyp.DFC_MoFIACo_C "assigned fault type / Fault type assignment for check DFC_MoFIACo" VALUE 0x80504A6C Val_Wu8 255.0 DFES_OneToOne 0.00 255.0 FORMAT "%5.1" /end CHARACTERISTIC
/begin CHARACTERISTIC DFES_FaultTyp.DFC_MoFICOL1_C "assigned fault type / Fault type assignment for check DFC_MoFICOL1" VALUE 0x80504A6D Val_Wu8 255.0 DFES_OneToOne 0.00 255.0 FORMAT "%5.1" /end CHARACTERISTIC
/begin CHARACTERISTIC DFES_FaultTyp.DFC_MoFICOL2_C "assigned fault type / Fault type assignment for check DFC_MoFICOL2" VALUE 0x80504A6E Val_Wu8 255.0 DFES_OneToOne 0.00 255.0 FORMAT "%5.1" /end CHARACTERISTIC
/begin CHARACTERISTIC DFES_FaultTyp.DFC_MoFStrt_C "assigned fault type / Fault type assignment for check DFC_MoFStrt" VALUE 0x80504A6F Val_Wu8 255.0 DFES_OneToOne 0.00 255.0 FORMAT "%5.1" /end CHARACTERISTIC
/begin CHARACTERISTIC DFES_FaultTyp.DFC_MoFTrqCmp_C "assigned fault type / Fault type assignment for check DFC_MoFTrqCmp" VALUE 0x80504A70 Val_Wu8 255.0 DFES_OneToOne 0.00 255.0 FORMAT "%5.1" /end CHARACTERISTIC
/begin CHARACTERISTIC DFES_FaultTyp.DFC_MoFTrqCmpMax_C "assigned fault type / Fault type assignment for check DFC_MoFTrqCmpMax" VALUE 0x80504A71 Val_Wu8 255.0 DFES_OneToOne 0.00 255.0 FORMAT "%5.1" /end CHARACTERISTIC
/begin CHARACTERISTIC DFES_FaultTyp.DFC_MoFTrqCmpMin_C "assigned fault type / Fault type assignment for check DFC_MoFTrqCmpMin" VALUE 0x80504A72 Val_Wu8 255.0 DFES_OneToOne 0.00 255.0 FORMAT "%5.1" /end CHARACTERISTIC
/begin CHARACTERISTIC DFES_FaultTyp.DFC_MoFVarPostBldSel_C "assigned fault type / Fault type assignment for check DFC_MoFVarPostBldSel" VALUE 0x80504A73 Val_Wu8 255.0 DFES_OneToOne 0.00 255.0 FORMAT "%5.1" /end CHARACTERISTIC
/begin CHARACTERISTIC DFES_FaultTyp.DFC_MoXEMMHwLTMCUFW_C "assigned fault type / Fault type assignment for check DFC_MoXEMMHwLTMCUFW" VALUE 0x80504A74 Val_Wu8 255.0 DFES_OneToOne 0.00 255.0 FORMAT "%5.1" /end CHARACTERISTIC
/begin CHARACTERISTIC DFES_FaultTyp.DFC_MoXEMMHwLTMonBIST_C "assigned fault type / Fault type assignment for check DFC_MoXEMMHwLTMonBIST" VALUE 0x80504A75 Val_Wu8 255.0 DFES_OneToOne 0.00 255.0 FORMAT "%5.1" /end CHARACTERISTIC
/begin CHARACTERISTIC DFES_FaultTyp.DFC_MoXEMMHwLTRegMonTest_C "assigned fault type / Fault type assignment for check DFC_MoXEMMHwLTRegMonTest" VALUE 0x80504A76 Val_Wu8 255.0 DFES_OneToOne 0.00 255.0 FORMAT "%5.1" /end CHARACTERISTIC
/begin CHARACTERISTIC DFES_FaultTyp.DFC_MoXEMMHwLTStbySMUAlvTest_C "assigned fault type / Fault type assignment for check DFC_MoXEMMHwLTStbySMUAlvTest" VALUE 0x80504A77 Val_Wu8 255.0 DFES_OneToOne 0.00 255.0 FORMAT "%5.1" /end CHARACTERISTIC
/begin CHARACTERISTIC DFES_FaultTyp.DFC_MoXEMMHwLTTempSens_C "assigned fault type / Fault type assignment for check DFC_MoXEMMHwLTTempSens" VALUE 0x80504A78 Val_Wu8 255.0 DFES_OneToOne 0.00 255.0 FORMAT "%5.1" /end CHARACTERISTIC
/begin CHARACTERISTIC DFES_FaultTyp.DFC_MoXEMMHwLTUCBCfg_C "assigned fault type / Fault type assignment for check DFC_MoXEMMHwLTUCBCfg" VALUE 0x80504A79 Val_Wu8 255.0 DFES_OneToOne 0.00 255.0 FORMAT "%5.1" /end CHARACTERISTIC
/begin CHARACTERISTIC DFES_FaultTyp.DFC_NWSEmax_C "assigned fault type / Fault type assignment for check DFC_NWSEmax" VALUE 0x80504A7A Val_Wu8 255.0 DFES_OneToOne 0.00 255.0 FORMAT "%5.1" /end CHARACTERISTIC
/begin CHARACTERISTIC DFES_FaultTyp.DFC_NWSmax_C "assigned fault type / Fault type assignment for check DFC_NWSmax" VALUE 0x80504A7B Val_Wu8 255.0 DFES_OneToOne 0.00 255.0 FORMAT "%5.1" /end CHARACTERISTIC
/begin CHARACTERISTIC DFES_FaultTyp.DFC_OCWDAABEActv_C "assigned fault type / Fault type assignment for check DFC_OCWDAABEActv" VALUE 0x80504A7C Val_Wu8 255.0 DFES_OneToOne 0.00 255.0 FORMAT "%5.1" /end CHARACTERISTIC
/begin CHARACTERISTIC DFES_FaultTyp.DFC_OCWDACom_C "assigned fault type / Fault type assignment for check DFC_OCWDACom" VALUE 0x80504A7D Val_Wu8 255.0 DFES_OneToOne 0.00 255.0 FORMAT "%5.1" /end CHARACTERISTIC
/begin CHARACTERISTIC DFES_FaultTyp.DFC_OCWDAErrPin_C "assigned fault type / Fault type assignment for check DFC_OCWDAErrPin" VALUE 0x80504A7E Val_Wu8 255.0 DFES_OneToOne 0.00 255.0 FORMAT "%5.1" /end CHARACTERISTIC
/begin CHARACTERISTIC DFES_FaultTyp.DFC_OCWDAOvrVltg_C "assigned fault type / Fault type assignment for check DFC_OCWDAOvrVltg" VALUE 0x80504A7F Val_Wu8 255.0 DFES_OneToOne 0.00 255.0 FORMAT "%5.1" /end CHARACTERISTIC
/begin CHARACTERISTIC DFES_FaultTyp.DFC_ORAmax_C "assigned fault type / Fault type assignment for check DFC_ORAmax" VALUE 0x80504A80 Val_Wu8 255.0 DFES_OneToOne 0.00 255.0 FORMAT "%5.1" /end CHARACTERISTIC
/begin CHARACTERISTIC DFES_FaultTyp.DFC_ORAmin_C "assigned fault type / Fault type assignment for check DFC_ORAmin" VALUE 0x80504A81 Val_Wu8 255.0 DFES_OneToOne 0.00 255.0 FORMAT "%5.1" /end CHARACTERISTIC
/begin CHARACTERISTIC DFES_FaultTyp.DFC_OilPPlaus_C "assigned fault type / Fault type assignment for check DFC_OilPPlaus" VALUE 0x80504A82 Val_Wu8 255.0 DFES_OneToOne 0.00 255.0 FORMAT "%5.1" /end CHARACTERISTIC
/begin CHARACTERISTIC DFES_FaultTyp.DFC_PLLSUmax_C "assigned fault type / Fault type assignment for check DFC_PLLSUmax" VALUE 0x80504A83 Val_Wu8 255.0 DFES_OneToOne 0.00 255.0 FORMAT "%5.1" /end CHARACTERISTIC
/begin CHARACTERISTIC DFES_FaultTyp.DFC_PLLSUmin_C "assigned fault type / Fault type assignment for check DFC_PLLSUmin" VALUE 0x80504A84 Val_Wu8 255.0 DFES_OneToOne 0.00 255.0 FORMAT "%5.1" /end CHARACTERISTIC
/begin CHARACTERISTIC DFES_FaultTyp.DFC_PSR1max_C "assigned fault type / Fault type assignment for check DFC_PSR1max" VALUE 0x80504A85 Val_Wu8 255.0 DFES_OneToOne 0.00 255.0 FORMAT "%5.1" /end CHARACTERISTIC
/begin CHARACTERISTIC DFES_FaultTyp.DFC_PSRBmax_C "assigned fault type / Fault type assignment for check DFC_PSRBmax" VALUE 0x80504A86 Val_Wu8 255.0 DFES_OneToOne 0.00 255.0 FORMAT "%5.1" /end CHARACTERISTIC
/begin CHARACTERISTIC DFES_FaultTyp.DFC_PSRBmin_C "assigned fault type / Fault type assignment for check DFC_PSRBmin" VALUE 0x80504A87 Val_Wu8 255.0 DFES_OneToOne 0.00 255.0 FORMAT "%5.1" /end CHARACTERISTIC
/begin CHARACTERISTIC DFES_FaultTyp.DFC_PSRPmax_C "assigned fault type / Fault type assignment for check DFC_PSRPmax" VALUE 0x80504A88 Val_Wu8 255.0 DFES_OneToOne 0.00 255.0 FORMAT "%5.1" /end CHARACTERISTIC
/begin CHARACTERISTIC DFES_FaultTyp.DFC_PSRPmin_C "assigned fault type / Fault type assignment for check DFC_PSRPmin" VALUE 0x80504A89 Val_Wu8 255.0 DFES_OneToOne 0.00 255.0 FORMAT "%5.1" /end CHARACTERISTIC
/begin CHARACTERISTIC DFES_FaultTyp.DFC_PSRPsig_C "assigned fault type / Fault type assignment for check DFC_PSRPsig" VALUE 0x80504A8A Val_Wu8 255.0 DFES_OneToOne 0.00 255.0 FORMAT "%5.1" /end CHARACTERISTIC
/begin CHARACTERISTIC DFES_FaultTyp.DFC_PSRmax_C "assigned fault type / Fault type assignment for check DFC_PSRmax" VALUE 0x80504A8B Val_Wu8 255.0 DFES_OneToOne 0.00 255.0 FORMAT "%5.1" /end CHARACTERISTIC
/begin CHARACTERISTIC DFES_FaultTyp.DFC_PUmax_C "assigned fault type / Fault type assignment for check DFC_PUmax" VALUE 0x80504A8C Val_Wu8 255.0 DFES_OneToOne 0.00 255.0 FORMAT "%5.1" /end CHARACTERISTIC
/begin CHARACTERISTIC DFES_FaultTyp.DFC_P_VSE11_OL_C "assigned fault type / Fault type assignment for check DFC_P_VSE11_OL" VALUE 0x80504A8D Val_Wu8 255.0 DFES_OneToOne 0.00 255.0 FORMAT "%5.1" /end CHARACTERISTIC
/begin CHARACTERISTIC DFES_FaultTyp.DFC_P_VSE11_SCB_C "assigned fault type / Fault type assignment for check DFC_P_VSE11_SCB" VALUE 0x80504A8E Val_Wu8 255.0 DFES_OneToOne 0.00 255.0 FORMAT "%5.1" /end CHARACTERISTIC
/begin CHARACTERISTIC DFES_FaultTyp.DFC_P_VSE11_SCG_C "assigned fault type / Fault type assignment for check DFC_P_VSE11_SCG" VALUE 0x80504A8F Val_Wu8 255.0 DFES_OneToOne 0.00 255.0 FORMAT "%5.1" /end CHARACTERISTIC
/begin CHARACTERISTIC DFES_FaultTyp.DFC_PhyHighAPP1_C "assigned fault type / Fault type assignment for check DFC_PhyHighAPP1" VALUE 0x80504A90 Val_Wu8 255.0 DFES_OneToOne 0.00 255.0 FORMAT "%5.1" /end CHARACTERISTIC
/begin CHARACTERISTIC DFES_FaultTyp.DFC_PhyHighAPP2_C "assigned fault type / Fault type assignment for check DFC_PhyHighAPP2" VALUE 0x80504A91 Val_Wu8 255.0 DFES_OneToOne 0.00 255.0 FORMAT "%5.1" /end CHARACTERISTIC
/begin CHARACTERISTIC DFES_FaultTyp.DFC_PhyLowAPP1_C "assigned fault type / Fault type assignment for check DFC_PhyLowAPP1" VALUE 0x80504A92 Val_Wu8 255.0 DFES_OneToOne 0.00 255.0 FORMAT "%5.1" /end CHARACTERISTIC
/begin CHARACTERISTIC DFES_FaultTyp.DFC_PhyLowAPP2_C "assigned fault type / Fault type assignment for check DFC_PhyLowAPP2" VALUE 0x80504A93 Val_Wu8 255.0 DFES_OneToOne 0.00 255.0 FORMAT "%5.1" /end CHARACTERISTIC
/begin CHARACTERISTIC DFES_FaultTyp.DFC_SRCHighAPP1_C "assigned fault type / Fault type assignment for check DFC_SRCHighAPP1" VALUE 0x80504A94 Val_Wu8 255.0 DFES_OneToOne 0.00 255.0 FORMAT "%5.1" /end CHARACTERISTIC
/begin CHARACTERISTIC DFES_FaultTyp.DFC_SRCHighAPP2_C "assigned fault type / Fault type assignment for check DFC_SRCHighAPP2" VALUE 0x80504A95 Val_Wu8 255.0 DFES_OneToOne 0.00 255.0 FORMAT "%5.1" /end CHARACTERISTIC
/begin CHARACTERISTIC DFES_FaultTyp.DFC_SRCLowAPP1_C "assigned fault type / Fault type assignment for check DFC_SRCLowAPP1" VALUE 0x80504A96 Val_Wu8 255.0 DFES_OneToOne 0.00 255.0 FORMAT "%5.1" /end CHARACTERISTIC
/begin CHARACTERISTIC DFES_FaultTyp.DFC_SRCLowAPP2_C "assigned fault type / Fault type assignment for check DFC_SRCLowAPP2" VALUE 0x80504A97 Val_Wu8 255.0 DFES_OneToOne 0.00 255.0 FORMAT "%5.1" /end CHARACTERISTIC
/begin CHARACTERISTIC DFES_FaultTyp.DFC_SSpMon2_C "assigned fault type / Fault type assignment for check DFC_SSpMon2" VALUE 0x80504A98 Val_Wu8 255.0 DFES_OneToOne 0.00 255.0 FORMAT "%5.1" /end CHARACTERISTIC
/begin CHARACTERISTIC DFES_FaultTyp.DFC_STHDRmax_C "assigned fault type / Fault type assignment for check DFC_STHDRmax" VALUE 0x80504A99 Val_Wu8 255.0 DFES_OneToOne 0.00 255.0 FORMAT "%5.1" /end CHARACTERISTIC
/begin CHARACTERISTIC DFES_FaultTyp.DFC_SWReset_0_C "assigned fault type / Fault type assignment for check DFC_SWReset_0" VALUE 0x80504A9A Val_Wu8 255.0 DFES_OneToOne 0.00 255.0 FORMAT "%5.1" /end CHARACTERISTIC
/begin CHARACTERISTIC DFES_FaultTyp.DFC_SWReset_1_C "assigned fault type / Fault type assignment for check DFC_SWReset_1" VALUE 0x80504A9B Val_Wu8 255.0 DFES_OneToOne 0.00 255.0 FORMAT "%5.1" /end CHARACTERISTIC
/begin CHARACTERISTIC DFES_FaultTyp.DFC_SWReset_2_C "assigned fault type / Fault type assignment for check DFC_SWReset_2" VALUE 0x80504A9C Val_Wu8 255.0 DFES_OneToOne 0.00 255.0 FORMAT "%5.1" /end CHARACTERISTIC
/begin CHARACTERISTIC DFES_FaultTyp.DFC_SyncAPP_C "assigned fault type / Fault type assignment for check DFC_SyncAPP" VALUE 0x80504A9D Val_Wu8 255.0 DFES_OneToOne 0.00 255.0 FORMAT "%5.1" /end CHARACTERISTIC
/begin CHARACTERISTIC DFES_FaultTyp.DFC_TANKLnpl_C "assigned fault type / Fault type assignment for check DFC_TANKLnpl" VALUE 0x80504A9E Val_Wu8 255.0 DFES_OneToOne 0.00 255.0 FORMAT "%5.1" /end CHARACTERISTIC
/begin CHARACTERISTIC DFES_FaultTyp.DFC_TAmax_Dummy_C "assigned fault type / Fault type assignment for check DFC_TAmax_Dummy" VALUE 0x80504A9F Val_Wu8 255.0 DFES_OneToOne 0.00 255.0 FORMAT "%5.1" /end CHARACTERISTIC
/begin CHARACTERISTIC DFES_FaultTyp.DFC_TESFmax_C "assigned fault type / Fault type assignment for check DFC_TESFmax" VALUE 0x80504AA0 Val_Wu8 255.0 DFES_OneToOne 0.00 255.0 FORMAT "%5.1" /end CHARACTERISTIC
/begin CHARACTERISTIC DFES_FaultTyp.DFC_TESGmax_C "assigned fault type / Fault type assignment for check DFC_TESGmax" VALUE 0x80504AA1 Val_Wu8 255.0 DFES_OneToOne 0.00 255.0 FORMAT "%5.1" /end CHARACTERISTIC
/begin CHARACTERISTIC DFES_FaultTyp.DFC_TKAEmax_C "assigned fault type / Fault type assignment for check DFC_TKAEmax" VALUE 0x80504AA2 Val_Wu8 255.0 DFES_OneToOne 0.00 255.0 FORMAT "%5.1" /end CHARACTERISTIC
/begin CHARACTERISTIC DFES_FaultTyp.DFC_TKAEmin_C "assigned fault type / Fault type assignment for check DFC_TKAEmin" VALUE 0x80504AA3 Val_Wu8 255.0 DFES_OneToOne 0.00 255.0 FORMAT "%5.1" /end CHARACTERISTIC
/begin CHARACTERISTIC DFES_FaultTyp.DFC_TKARmax_C "assigned fault type / Fault type assignment for check DFC_TKARmax" VALUE 0x80504AA4 Val_Wu8 255.0 DFES_OneToOne 0.00 255.0 FORMAT "%5.1" /end CHARACTERISTIC
/begin CHARACTERISTIC DFES_FaultTyp.DFC_TKARnpl_C "assigned fault type / Fault type assignment for check DFC_TKARnpl" VALUE 0x80504AA5 Val_Wu8 255.0 DFES_OneToOne 0.00 255.0 FORMAT "%5.1" /end CHARACTERISTIC
/begin CHARACTERISTIC DFES_FaultTyp.DFC_TMmax_Dummy_C "assigned fault type / Fault type assignment for check DFC_TMmax_Dummy" VALUE 0x80504AA6 Val_Wu8 255.0 DFES_OneToOne 0.00 255.0 FORMAT "%5.1" /end CHARACTERISTIC
/begin CHARACTERISTIC DFES_FaultTyp.DFC_TUMmax_Dummy_C "assigned fault type / Fault type assignment for check DFC_TUMmax_Dummy" VALUE 0x80504AA7 Val_Wu8 255.0 DFES_OneToOne 0.00 255.0 FORMAT "%5.1" /end CHARACTERISTIC
/begin CHARACTERISTIC DFES_FaultTyp.DFC_TWCDPriCatB1_C "assigned fault type / Fault type assignment for check DFC_TWCDPriCatB1" VALUE 0x80504AA8 Val_Wu8 255.0 DFES_OneToOne 0.00 255.0 FORMAT "%5.1" /end CHARACTERISTIC
/begin CHARACTERISTIC DFES_FaultTyp.DFC_ThrVlvClsdPosnFirstOffsLrnImpoB1_C "assigned fault type / Fault type assignment for check DFC_ThrVlvClsdPosnFirstOffsLrnImpoB1" VALUE 0x80504AA9 Val_Wu8 255.0 DFES_OneToOne 0.00 255.0 FORMAT "%5.1" /end CHARACTERISTIC
/begin CHARACTERISTIC DFES_FaultTyp.DFC_ThrVlvClsdPosnOffsLrnImpoB1_C "assigned fault type / Fault type assignment for check DFC_ThrVlvClsdPosnOffsLrnImpoB1" VALUE 0x80504AAA Val_Wu8 255.0 DFES_OneToOne 0.00 255.0 FORMAT "%5.1" /end CHARACTERISTIC
/begin CHARACTERISTIC DFES_FaultTyp.DFC_ThrVlvClsdPosnOffsLrnMaxB1_C "assigned fault type / Fault type assignment for check DFC_ThrVlvClsdPosnOffsLrnMaxB1" VALUE 0x80504AAB Val_Wu8 255.0 DFES_OneToOne 0.00 255.0 FORMAT "%5.1" /end CHARACTERISTIC
/begin CHARACTERISTIC DFES_FaultTyp.DFC_ThrVlvClsdPosnOffsLrnMinB1_C "assigned fault type / Fault type assignment for check DFC_ThrVlvClsdPosnOffsLrnMinB1" VALUE 0x80504AAC Val_Wu8 255.0 DFES_OneToOne 0.00 255.0 FORMAT "%5.1" /end CHARACTERISTIC
/begin CHARACTERISTIC DFES_FaultTyp.DFC_ThrVlvCtrlDeB1_C "assigned fault type / Fault type assignment for check DFC_ThrVlvCtrlDeB1" VALUE 0x80504AAD Val_Wu8 255.0 DFES_OneToOne 0.00 255.0 FORMAT "%5.1" /end CHARACTERISTIC
/begin CHARACTERISTIC DFES_FaultTyp.DFC_ThrVlvDycB1_C "assigned fault type / Fault type assignment for check DFC_ThrVlvDycB1" VALUE 0x80504AAE Val_Wu8 255.0 DFES_OneToOne 0.00 255.0 FORMAT "%5.1" /end CHARACTERISTIC
/begin CHARACTERISTIC DFES_FaultTyp.DFC_ThrVlvLimpAirPosnMaxAbsltDriftB1_C "assigned fault type / Fault type assignment for check DFC_ThrVlvLimpAirPosnMaxAbsltDriftB1" VALUE 0x80504AAF Val_Wu8 255.0 DFES_OneToOne 0.00 255.0 FORMAT "%5.1" /end CHARACTERISTIC
/begin CHARACTERISTIC DFES_FaultTyp.DFC_ThrVlvLimpAirPosnMaxB1_C "assigned fault type / Fault type assignment for check DFC_ThrVlvLimpAirPosnMaxB1" VALUE 0x80504AB0 Val_Wu8 255.0 DFES_OneToOne 0.00 255.0 FORMAT "%5.1" /end CHARACTERISTIC
/begin CHARACTERISTIC DFES_FaultTyp.DFC_ThrVlvLimpAirPosnMaxRelDriftB1_C "assigned fault type / Fault type assignment for check DFC_ThrVlvLimpAirPosnMaxRelDriftB1" VALUE 0x80504AB1 Val_Wu8 255.0 DFES_OneToOne 0.00 255.0 FORMAT "%5.1" /end CHARACTERISTIC
/begin CHARACTERISTIC DFES_FaultTyp.DFC_ThrVlvLimpAirPosnMinB1_C "assigned fault type / Fault type assignment for check DFC_ThrVlvLimpAirPosnMinB1" VALUE 0x80504AB2 Val_Wu8 255.0 DFES_OneToOne 0.00 255.0 FORMAT "%5.1" /end CHARACTERISTIC
/begin CHARACTERISTIC DFES_FaultTyp.DFC_ThrVlvOpenLoadB1_C "assigned fault type / Fault type assignment for check DFC_ThrVlvOpenLoadB1" VALUE 0x80504AB3 Val_Wu8 255.0 DFES_OneToOne 0.00 255.0 FORMAT "%5.1" /end CHARACTERISTIC
/begin CHARACTERISTIC DFES_FaultTyp.DFC_ThrVlvOpenSprgB1_C "assigned fault type / Fault type assignment for check DFC_ThrVlvOpenSprgB1" VALUE 0x80504AB4 Val_Wu8 255.0 DFES_OneToOne 0.00 255.0 FORMAT "%5.1" /end CHARACTERISTIC
/begin CHARACTERISTIC DFES_FaultTyp.DFC_ThrVlvOpenSprgSprdB1_C "assigned fault type / Fault type assignment for check DFC_ThrVlvOpenSprgSprdB1" VALUE 0x80504AB5 Val_Wu8 255.0 DFES_OneToOne 0.00 255.0 FORMAT "%5.1" /end CHARACTERISTIC
/begin CHARACTERISTIC DFES_FaultTyp.DFC_ThrVlvOpenSprgTwnB1_C "assigned fault type / Fault type assignment for check DFC_ThrVlvOpenSprgTwnB1" VALUE 0x80504AB6 Val_Wu8 255.0 DFES_OneToOne 0.00 255.0 FORMAT "%5.1" /end CHARACTERISTIC
/begin CHARACTERISTIC DFES_FaultTyp.DFC_ThrVlvOverTB1_C "assigned fault type / Fault type assignment for check DFC_ThrVlvOverTB1" VALUE 0x80504AB7 Val_Wu8 255.0 DFES_OneToOne 0.00 255.0 FORMAT "%5.1" /end CHARACTERISTIC
/begin CHARACTERISTIC DFES_FaultTyp.DFC_ThrVlvRetSprgB1_C "assigned fault type / Fault type assignment for check DFC_ThrVlvRetSprgB1" VALUE 0x80504AB8 Val_Wu8 255.0 DFES_OneToOne 0.00 255.0 FORMAT "%5.1" /end CHARACTERISTIC
/begin CHARACTERISTIC DFES_FaultTyp.DFC_ThrVlvRetSprgSprdB1_C "assigned fault type / Fault type assignment for check DFC_ThrVlvRetSprgSprdB1" VALUE 0x80504AB9 Val_Wu8 255.0 DFES_OneToOne 0.00 255.0 FORMAT "%5.1" /end CHARACTERISTIC
/begin CHARACTERISTIC DFES_FaultTyp.DFC_ThrVlvRetSprgTwnB1_C "assigned fault type / Fault type assignment for check DFC_ThrVlvRetSprgTwnB1" VALUE 0x80504ABA Val_Wu8 255.0 DFES_OneToOne 0.00 255.0 FORMAT "%5.1" /end CHARACTERISTIC
/begin CHARACTERISTIC DFES_FaultTyp.DFC_ThrVlvSens1MaxB1_C "assigned fault type / Fault type assignment for check DFC_ThrVlvSens1MaxB1" VALUE 0x80504ABB Val_Wu8 255.0 DFES_OneToOne 0.00 255.0 FORMAT "%5.1" /end CHARACTERISTIC
/begin CHARACTERISTIC DFES_FaultTyp.DFC_ThrVlvSens1NplB1_C "assigned fault type / Fault type assignment for check DFC_ThrVlvSens1NplB1" VALUE 0x80504ABC Val_Wu8 255.0 DFES_OneToOne 0.00 255.0 FORMAT "%5.1" /end CHARACTERISTIC
/begin CHARACTERISTIC DFES_FaultTyp.DFC_ThrVlvSens2MaxB1_C "assigned fault type / Fault type assignment for check DFC_ThrVlvSens2MaxB1" VALUE 0x80504ABD Val_Wu8 255.0 DFES_OneToOne 0.00 255.0 FORMAT "%5.1" /end CHARACTERISTIC
/begin CHARACTERISTIC DFES_FaultTyp.DFC_ThrVlvSens2MinB1_C "assigned fault type / Fault type assignment for check DFC_ThrVlvSens2MinB1" VALUE 0x80504ABE Val_Wu8 255.0 DFES_OneToOne 0.00 255.0 FORMAT "%5.1" /end CHARACTERISTIC
/begin CHARACTERISTIC DFES_FaultTyp.DFC_ThrVlvSens2NplB1_C "assigned fault type / Fault type assignment for check DFC_ThrVlvSens2NplB1" VALUE 0x80504ABF Val_Wu8 255.0 DFES_OneToOne 0.00 255.0 FORMAT "%5.1" /end CHARACTERISTIC
/begin CHARACTERISTIC DFES_FaultTyp.DFC_ThrVlvShoCircB1_C "assigned fault type / Fault type assignment for check DFC_ThrVlvShoCircB1" VALUE 0x80504AC0 Val_Wu8 255.0 DFES_OneToOne 0.00 255.0 FORMAT "%5.1" /end CHARACTERISTIC
/begin CHARACTERISTIC DFES_FaultTyp.DFC_ThrVlvSpiErrB1_C "assigned fault type / Fault type assignment for check DFC_ThrVlvSpiErrB1" VALUE 0x80504AC1 Val_Wu8 255.0 DFES_OneToOne 0.00 255.0 FORMAT "%5.1" /end CHARACTERISTIC
/begin CHARACTERISTIC DFES_FaultTyp.DFC_ThrvlvSens1MinB1_C "assigned fault type / Fault type assignment for check DFC_ThrvlvSens1MinB1" VALUE 0x80504AC2 Val_Wu8 255.0 DFES_OneToOne 0.00 255.0 FORMAT "%5.1" /end CHARACTERISTIC
/begin CHARACTERISTIC DFES_FaultTyp.DFC_TiOffTBasdChkFast_C "assigned fault type / Fault type assignment for check DFC_TiOffTBasdChkFast" VALUE 0x80504AC3 Val_Wu8 255.0 DFES_OneToOne 0.00 255.0 FORMAT "%5.1" /end CHARACTERISTIC
/begin CHARACTERISTIC DFES_FaultTyp.DFC_TiOffTBasdChkSlow_C "assigned fault type / Fault type assignment for check DFC_TiOffTBasdChkSlow" VALUE 0x80504AC4 Val_Wu8 255.0 DFES_OneToOne 0.00 255.0 FORMAT "%5.1" /end CHARACTERISTIC
/begin CHARACTERISTIC DFES_FaultTyp.DFC_UEGOSnsrMntdS1B1_C "assigned fault type / Fault type assignment for check DFC_UEGOSnsrMntdS1B1" VALUE 0x80504AC5 Val_Wu8 255.0 DFES_OneToOne 0.00 255.0 FORMAT "%5.1" /end CHARACTERISTIC
/begin CHARACTERISTIC DFES_FaultTyp.DFC_VehVSig_C "assigned fault type / Fault type assignment for check DFC_VehVSig" VALUE 0x80504AC6 Val_Wu8 255.0 DFES_OneToOne 0.00 255.0 FORMAT "%5.1" /end CHARACTERISTIC
/begin CHARACTERISTIC DFES_FaultTyp.DFC_VlvLftFbSwtIntk11SpclFail_C "assigned fault type / Fault type assignment for check DFC_VlvLftFbSwtIntk11SpclFail" VALUE 0x80504AC7 Val_Wu8 255.0 DFES_OneToOne 0.00 255.0 FORMAT "%5.1" /end CHARACTERISTIC
/begin CHARACTERISTIC DFES_FaultTyp.DFC_VlvLftFbSwtIntk11StdFail_C "assigned fault type / Fault type assignment for check DFC_VlvLftFbSwtIntk11StdFail" VALUE 0x80504AC8 Val_Wu8 255.0 DFES_OneToOne 0.00 255.0 FORMAT "%5.1" /end CHARACTERISTIC
/begin CHARACTERISTIC DFES_GrpRpr.DFC_Unused_C "common MIL debouncing / " VALUE 0x80504ACE Val_Wu16 906.000000000 DFC_Verb 0.00 906.000000000 FORMAT "%13.9" READ_ONLY /end CHARACTERISTIC
/begin CHARACTERISTIC DFES_GrpRpr.DFC_AAVEmax_C "common MIL debouncing / group representative for common MIL debouncing of DFC_AAVEmax" VALUE 0x80504AD0 Val_Wu16 906.000000000 DFC_Verb 0.00 906.000000000 FORMAT "%13.9" /end CHARACTERISTIC
/begin CHARACTERISTIC DFES_GrpRpr.DFC_AAVEmin_C "common MIL debouncing / group representative for common MIL debouncing of DFC_AAVEmin" VALUE 0x80504AD2 Val_Wu16 906.000000000 DFC_Verb 0.00 906.000000000 FORMAT "%13.9" /end CHARACTERISTIC
/begin CHARACTERISTIC DFES_GrpRpr.DFC_AAVEsig_C "common MIL debouncing / group representative for common MIL debouncing of DFC_AAVEsig" VALUE 0x80504AD4 Val_Wu16 906.000000000 DFC_Verb 0.00 906.000000000 FORMAT "%13.9" /end CHARACTERISTIC
/begin CHARACTERISTIC DFES_GrpRpr.DFC_AltIOACGFailr_C "common MIL debouncing / group representative for common MIL debouncing of DFC_AltIOACGFailr" VALUE 0x80504AD6 Val_Wu16 906.000000000 DFC_Verb 0.00 906.000000000 FORMAT "%13.9" /end CHARACTERISTIC
/begin CHARACTERISTIC DFES_GrpRpr.DFC_AltIOACGHiVltg_C "common MIL debouncing / group representative for common MIL debouncing of DFC_AltIOACGHiVltg" VALUE 0x80504AD8 Val_Wu16 906.000000000 DFC_Verb 0.00 906.000000000 FORMAT "%13.9" /end CHARACTERISTIC
/begin CHARACTERISTIC DFES_GrpRpr.DFC_AltIOACGLoVltg_C "common MIL debouncing / group representative for common MIL debouncing of DFC_AltIOACGLoVltg" VALUE 0x80504ADA Val_Wu16 906.000000000 DFC_Verb 0.00 906.000000000 FORMAT "%13.9" /end CHARACTERISTIC
/begin CHARACTERISTIC DFES_GrpRpr.DFC_AltIOACGTHi_C "common MIL debouncing / group representative for common MIL debouncing of DFC_AltIOACGTHi" VALUE 0x80504ADC Val_Wu16 906.000000000 DFC_Verb 0.00 906.000000000 FORMAT "%13.9" /end CHARACTERISTIC
/begin CHARACTERISTIC DFES_GrpRpr.DFC_AltIODConnACG_C "common MIL debouncing / group representative for common MIL debouncing of DFC_AltIODConnACG" VALUE 0x80504ADE Val_Wu16 906.000000000 DFC_Verb 0.00 906.000000000 FORMAT "%13.9" /end CHARACTERISTIC
/begin CHARACTERISTIC DFES_GrpRpr.DFC_BGOELWAF_C "common MIL debouncing / group representative for common MIL debouncing of DFC_BGOELWAF" VALUE 0x80504AE0 Val_Wu16 906.000000000 DFC_Verb 0.00 906.000000000 FORMAT "%13.9" /end CHARACTERISTIC
/begin CHARACTERISTIC DFES_GrpRpr.DFC_BattUHiFailr_C "common MIL debouncing / group representative for common MIL debouncing of DFC_BattUHiFailr" VALUE 0x80504AE2 Val_Wu16 906.000000000 DFC_Verb 0.00 906.000000000 FORMAT "%13.9" /end CHARACTERISTIC
/begin CHARACTERISTIC DFES_GrpRpr.DFC_BattULoFailr_C "common MIL debouncing / group representative for common MIL debouncing of DFC_BattULoFailr" VALUE 0x80504AE4 Val_Wu16 906.000000000 DFC_Verb 0.00 906.000000000 FORMAT "%13.9" /end CHARACTERISTIC
/begin CHARACTERISTIC DFES_GrpRpr.DFC_BrkBstPDriftHiErr_C "common MIL debouncing / group representative for common MIL debouncing of DFC_BrkBstPDriftHiErr" VALUE 0x80504AE6 Val_Wu16 906.000000000 DFC_Verb 0.00 906.000000000 FORMAT "%13.9" /end CHARACTERISTIC
/begin CHARACTERISTIC DFES_GrpRpr.DFC_BrkBstPDriftLoErr_C "common MIL debouncing / group representative for common MIL debouncing of DFC_BrkBstPDriftLoErr" VALUE 0x80504AE8 Val_Wu16 906.000000000 DFC_Verb 0.00 906.000000000 FORMAT "%13.9" /end CHARACTERISTIC
/begin CHARACTERISTIC DFES_GrpRpr.DFC_BrkBstPSnsrStuck_C "common MIL debouncing / group representative for common MIL debouncing of DFC_BrkBstPSnsrStuck" VALUE 0x80504AEA Val_Wu16 906.000000000 DFC_Verb 0.00 906.000000000 FORMAT "%13.9" /end CHARACTERISTIC
/begin CHARACTERISTIC DFES_GrpRpr.DFC_BrkMnSwtContOn_C "common MIL debouncing / group representative for common MIL debouncing of DFC_BrkMnSwtContOn" VALUE 0x80504AEC Val_Wu16 906.000000000 DFC_Verb 0.00 906.000000000 FORMAT "%13.9" /end CHARACTERISTIC
/begin CHARACTERISTIC DFES_GrpRpr.DFC_BrkMnSwtNotStp_C "common MIL debouncing / group representative for common MIL debouncing of DFC_BrkMnSwtNotStp" VALUE 0x80504AEE Val_Wu16 906.000000000 DFC_Verb 0.00 906.000000000 FORMAT "%13.9" /end CHARACTERISTIC
/begin CHARACTERISTIC DFES_GrpRpr.DFC_BrkNpl_C "common MIL debouncing / group representative for common MIL debouncing of DFC_BrkNpl" VALUE 0x80504AF0 Val_Wu16 906.000000000 DFC_Verb 0.00 906.000000000 FORMAT "%13.9" /end CHARACTERISTIC
/begin CHARACTERISTIC DFES_GrpRpr.DFC_BrkRdntSwtContOn_C "common MIL debouncing / group representative for common MIL debouncing of DFC_BrkRdntSwtContOn" VALUE 0x80504AF2 Val_Wu16 906.000000000 DFC_Verb 0.00 906.000000000 FORMAT "%13.9" /end CHARACTERISTIC
/begin CHARACTERISTIC DFES_GrpRpr.DFC_BrkRdntSwtNotStp_C "common MIL debouncing / group representative for common MIL debouncing of DFC_BrkRdntSwtNotStp" VALUE 0x80504AF4 Val_Wu16 906.000000000 DFC_Verb 0.00 906.000000000 FORMAT "%13.9" /end CHARACTERISTIC
/begin CHARACTERISTIC DFES_GrpRpr.DFC_Clth3ONStuck_C "common MIL debouncing / group representative for common MIL debouncing of DFC_Clth3ONStuck" VALUE 0x80504AF6 Val_Wu16 906.000000000 DFC_Verb 0.00 906.000000000 FORMAT "%13.9" /end CHARACTERISTIC
/begin CHARACTERISTIC DFES_GrpRpr.DFC_Clth4OFFStuck_C "common MIL debouncing / group representative for common MIL debouncing of DFC_Clth4OFFStuck" VALUE 0x80504AF8 Val_Wu16 906.000000000 DFC_Verb 0.00 906.000000000 FORMAT "%13.9" /end CHARACTERISTIC
/begin CHARACTERISTIC DFES_GrpRpr.DFC_ClthOFFStuck_C "common MIL debouncing / group representative for common MIL debouncing of DFC_ClthOFFStuck" VALUE 0x80504AFA Val_Wu16 906.000000000 DFC_Verb 0.00 906.000000000 FORMAT "%13.9" /end CHARACTERISTIC
/begin CHARACTERISTIC DFES_GrpRpr.DFC_ClthONStuck_C "common MIL debouncing / group representative for common MIL debouncing of DFC_ClthONStuck" VALUE 0x80504AFC Val_Wu16 906.000000000 DFC_Verb 0.00 906.000000000 FORMAT "%13.9" /end CHARACTERISTIC
/begin CHARACTERISTIC DFES_GrpRpr.DFC_ClthStkFailInfo_C "common MIL debouncing / group representative for common MIL debouncing of DFC_ClthStkFailInfo" VALUE 0x80504AFE Val_Wu16 906.000000000 DFC_Verb 0.00 906.000000000 FORMAT "%13.9" /end CHARACTERISTIC
/begin CHARACTERISTIC DFES_GrpRpr.DFC_ComACFailInfo_C "common MIL debouncing / group representative for common MIL debouncing of DFC_ComACFailInfo" VALUE 0x80504B00 Val_Wu16 906.000000000 DFC_Verb 0.00 906.000000000 FORMAT "%13.9" /end CHARACTERISTIC
/begin CHARACTERISTIC DFES_GrpRpr.DFC_ComATFTValErr_C "common MIL debouncing / group representative for common MIL debouncing of DFC_ComATFTValErr" VALUE 0x80504B02 Val_Wu16 906.000000000 DFC_Verb 0.00 906.000000000 FORMAT "%13.9" /end CHARACTERISTIC
/begin CHARACTERISTIC DFES_GrpRpr.DFC_ComATMILReq_C "common MIL debouncing / group representative for common MIL debouncing of DFC_ComATMILReq" VALUE 0x80504B04 Val_Wu16 906.000000000 DFC_Verb 0.00 906.000000000 FORMAT "%13.9" /end CHARACTERISTIC
/begin CHARACTERISTIC DFES_GrpRpr.DFC_ComAYCAChksum_C "common MIL debouncing / group representative for common MIL debouncing of DFC_ComAYCAChksum" VALUE 0x80504B06 Val_Wu16 906.000000000 DFC_Verb 0.00 906.000000000 FORMAT "%13.9" /end CHARACTERISTIC
/begin CHARACTERISTIC DFES_GrpRpr.DFC_ComAYCARingCnt_C "common MIL debouncing / group representative for common MIL debouncing of DFC_ComAYCARingCnt" VALUE 0x80504B08 Val_Wu16 906.000000000 DFC_Verb 0.00 906.000000000 FORMAT "%13.9" /end CHARACTERISTIC
/begin CHARACTERISTIC DFES_GrpRpr.DFC_ComAYCATOut_C "common MIL debouncing / group representative for common MIL debouncing of DFC_ComAYCATOut" VALUE 0x80504B0A Val_Wu16 906.000000000 DFC_Verb 0.00 906.000000000 FORMAT "%13.9" /end CHARACTERISTIC
/begin CHARACTERISTIC DFES_GrpRpr.DFC_ComAYCDChkSum_C "common MIL debouncing / group representative for common MIL debouncing of DFC_ComAYCDChkSum" VALUE 0x80504B0C Val_Wu16 906.000000000 DFC_Verb 0.00 906.000000000 FORMAT "%13.9" /end CHARACTERISTIC
/begin CHARACTERISTIC DFES_GrpRpr.DFC_ComAYCDTOut_C "common MIL debouncing / group representative for common MIL debouncing of DFC_ComAYCDTOut" VALUE 0x80504B0E Val_Wu16 906.000000000 DFC_Verb 0.00 906.000000000 FORMAT "%13.9" /end CHARACTERISTIC
/begin CHARACTERISTIC DFES_GrpRpr.DFC_ComAYCFChksum_C "common MIL debouncing / group representative for common MIL debouncing of DFC_ComAYCFChksum" VALUE 0x80504B10 Val_Wu16 906.000000000 DFC_Verb 0.00 906.000000000 FORMAT "%13.9" /end CHARACTERISTIC
/begin CHARACTERISTIC DFES_GrpRpr.DFC_ComAYCFRingCnt_C "common MIL debouncing / group representative for common MIL debouncing of DFC_ComAYCFRingCnt" VALUE 0x80504B12 Val_Wu16 906.000000000 DFC_Verb 0.00 906.000000000 FORMAT "%13.9" /end CHARACTERISTIC
/begin CHARACTERISTIC DFES_GrpRpr.DFC_ComAYCFTOut_C "common MIL debouncing / group representative for common MIL debouncing of DFC_ComAYCFTOut" VALUE 0x80504B14 Val_Wu16 906.000000000 DFC_Verb 0.00 906.000000000 FORMAT "%13.9" /end CHARACTERISTIC
/begin CHARACTERISTIC DFES_GrpRpr.DFC_ComAYCGChksum_C "common MIL debouncing / group representative for common MIL debouncing of DFC_ComAYCGChksum" VALUE 0x80504B16 Val_Wu16 906.000000000 DFC_Verb 0.00 906.000000000 FORMAT "%13.9" /end CHARACTERISTIC
/begin CHARACTERISTIC DFES_GrpRpr.DFC_ComAYCGRingCnt_C "common MIL debouncing / group representative for common MIL debouncing of DFC_ComAYCGRingCnt" VALUE 0x80504B18 Val_Wu16 906.000000000 DFC_Verb 0.00 906.000000000 FORMAT "%13.9" /end CHARACTERISTIC
/begin CHARACTERISTIC DFES_GrpRpr.DFC_ComAYCGTOut_C "common MIL debouncing / group representative for common MIL debouncing of DFC_ComAYCGTOut" VALUE 0x80504B1A Val_Wu16 906.000000000 DFC_Verb 0.00 906.000000000 FORMAT "%13.9" /end CHARACTERISTIC
/begin CHARACTERISTIC DFES_GrpRpr.DFC_ComAYCIChkSum_C "common MIL debouncing / group representative for common MIL debouncing of DFC_ComAYCIChkSum" VALUE 0x80504B1C Val_Wu16 906.000000000 DFC_Verb 0.00 906.000000000 FORMAT "%13.9" /end CHARACTERISTIC
/begin CHARACTERISTIC DFES_GrpRpr.DFC_ComAYCIRingCnt_C "common MIL debouncing / group representative for common MIL debouncing of DFC_ComAYCIRingCnt" VALUE 0x80504B1E Val_Wu16 906.000000000 DFC_Verb 0.00 906.000000000 FORMAT "%13.9" /end CHARACTERISTIC
/begin CHARACTERISTIC DFES_GrpRpr.DFC_ComAYCITOut_C "common MIL debouncing / group representative for common MIL debouncing of DFC_ComAYCITOut" VALUE 0x80504B20 Val_Wu16 906.000000000 DFC_Verb 0.00 906.000000000 FORMAT "%13.9" /end CHARACTERISTIC
/begin CHARACTERISTIC DFES_GrpRpr.DFC_ComBCM1ChkSum_C "common MIL debouncing / group representative for common MIL debouncing of DFC_ComBCM1ChkSum" VALUE 0x80504B22 Val_Wu16 906.000000000 DFC_Verb 0.00 906.000000000 FORMAT "%13.9" /end CHARACTERISTIC
/begin CHARACTERISTIC DFES_GrpRpr.DFC_ComBCM1RingCnt_C "common MIL debouncing / group representative for common MIL debouncing of DFC_ComBCM1RingCnt" VALUE 0x80504B24 Val_Wu16 906.000000000 DFC_Verb 0.00 906.000000000 FORMAT "%13.9" /end CHARACTERISTIC
/begin CHARACTERISTIC DFES_GrpRpr.DFC_ComBCM1TOut_C "common MIL debouncing / group representative for common MIL debouncing of DFC_ComBCM1TOut" VALUE 0x80504B26 Val_Wu16 906.000000000 DFC_Verb 0.00 906.000000000 FORMAT "%13.9" /end CHARACTERISTIC
/begin CHARACTERISTIC DFES_GrpRpr.DFC_ComCANABusOffErr_C "common MIL debouncing / group representative for common MIL debouncing of DFC_ComCANABusOffErr" VALUE 0x80504B28 Val_Wu16 906.000000000 DFC_Verb 0.00 906.000000000 FORMAT "%13.9" /end CHARACTERISTIC
/begin CHARACTERISTIC DFES_GrpRpr.DFC_ComCANBBusOffErr_C "common MIL debouncing / group representative for common MIL debouncing of DFC_ComCANBBusOffErr" VALUE 0x80504B2A Val_Wu16 906.000000000 DFC_Verb 0.00 906.000000000 FORMAT "%13.9" /end CHARACTERISTIC
/begin CHARACTERISTIC DFES_GrpRpr.DFC_ComCANCBusOffErr_C "common MIL debouncing / group representative for common MIL debouncing of DFC_ComCANCBusOffErr" VALUE 0x80504B2C Val_Wu16 906.000000000 DFC_Verb 0.00 906.000000000 FORMAT "%13.9" /end CHARACTERISTIC
/begin CHARACTERISTIC DFES_GrpRpr.DFC_ComCGW1ChkSum_C "common MIL debouncing / group representative for common MIL debouncing of DFC_ComCGW1ChkSum" VALUE 0x80504B2E Val_Wu16 906.000000000 DFC_Verb 0.00 906.000000000 FORMAT "%13.9" /end CHARACTERISTIC
/begin CHARACTERISTIC DFES_GrpRpr.DFC_ComCGW1RingCnt_C "common MIL debouncing / group representative for common MIL debouncing of DFC_ComCGW1RingCnt" VALUE 0x80504B30 Val_Wu16 906.000000000 DFC_Verb 0.00 906.000000000 FORMAT "%13.9" /end CHARACTERISTIC
/begin CHARACTERISTIC DFES_GrpRpr.DFC_ComCGW1TOut_C "common MIL debouncing / group representative for common MIL debouncing of DFC_ComCGW1TOut" VALUE 0x80504B32 Val_Wu16 906.000000000 DFC_Verb 0.00 906.000000000 FORMAT "%13.9" /end CHARACTERISTIC
/begin CHARACTERISTIC DFES_GrpRpr.DFC_ComConvBoostErr_C "common MIL debouncing / group representative for common MIL debouncing of DFC_ComConvBoostErr" VALUE 0x80504B34 Val_Wu16 906.000000000 DFC_Verb 0.00 906.000000000 FORMAT "%13.9" /end CHARACTERISTIC
/begin CHARACTERISTIC DFES_GrpRpr.DFC_ComConvSlipErr_C "common MIL debouncing / group representative for common MIL debouncing of DFC_ComConvSlipErr" VALUE 0x80504B36 Val_Wu16 906.000000000 DFC_Verb 0.00 906.000000000 FORMAT "%13.9" /end CHARACTERISTIC
/begin CHARACTERISTIC DFES_GrpRpr.DFC_ComDCDCPrfmncErr_C "common MIL debouncing / group representative for common MIL debouncing of DFC_ComDCDCPrfmncErr" VALUE 0x80504B38 Val_Wu16 906.000000000 DFC_Verb 0.00 906.000000000 FORMAT "%13.9" /end CHARACTERISTIC
/begin CHARACTERISTIC DFES_GrpRpr.DFC_ComDCDCTempWarn_C "common MIL debouncing / group representative for common MIL debouncing of DFC_ComDCDCTempWarn" VALUE 0x80504B3A Val_Wu16 906.000000000 DFC_Verb 0.00 906.000000000 FORMAT "%13.9" /end CHARACTERISTIC
/begin CHARACTERISTIC DFES_GrpRpr.DFC_ComEAT10Chksum_C "common MIL debouncing / group representative for common MIL debouncing of DFC_ComEAT10Chksum" VALUE 0x80504B3C Val_Wu16 906.000000000 DFC_Verb 0.00 906.000000000 FORMAT "%13.9" /end CHARACTERISTIC
/begin CHARACTERISTIC DFES_GrpRpr.DFC_ComEAT10RingCnt_C "common MIL debouncing / group representative for common MIL debouncing of DFC_ComEAT10RingCnt" VALUE 0x80504B3E Val_Wu16 906.000000000 DFC_Verb 0.00 906.000000000 FORMAT "%13.9" /end CHARACTERISTIC
/begin CHARACTERISTIC DFES_GrpRpr.DFC_ComEAT10TOut_C "common MIL debouncing / group representative for common MIL debouncing of DFC_ComEAT10TOut" VALUE 0x80504B40 Val_Wu16 906.000000000 DFC_Verb 0.00 906.000000000 FORMAT "%13.9" /end CHARACTERISTIC
/begin CHARACTERISTIC DFES_GrpRpr.DFC_ComEAT11ChkSum_C "common MIL debouncing / group representative for common MIL debouncing of DFC_ComEAT11ChkSum" VALUE 0x80504B42 Val_Wu16 906.000000000 DFC_Verb 0.00 906.000000000 FORMAT "%13.9" /end CHARACTERISTIC
/begin CHARACTERISTIC DFES_GrpRpr.DFC_ComEAT11RingCnt_C "common MIL debouncing / group representative for common MIL debouncing of DFC_ComEAT11RingCnt" VALUE 0x80504B44 Val_Wu16 906.000000000 DFC_Verb 0.00 906.000000000 FORMAT "%13.9" /end CHARACTERISTIC
/begin CHARACTERISTIC DFES_GrpRpr.DFC_ComEAT11TOut_C "common MIL debouncing / group representative for common MIL debouncing of DFC_ComEAT11TOut" VALUE 0x80504B46 Val_Wu16 906.000000000 DFC_Verb 0.00 906.000000000 FORMAT "%13.9" /end CHARACTERISTIC
/begin CHARACTERISTIC DFES_GrpRpr.DFC_ComEAT12ChkSum_C "common MIL debouncing / group representative for common MIL debouncing of DFC_ComEAT12ChkSum" VALUE 0x80504B48 Val_Wu16 906.000000000 DFC_Verb 0.00 906.000000000 FORMAT "%13.9" /end CHARACTERISTIC
/begin CHARACTERISTIC DFES_GrpRpr.DFC_ComEAT12RingCnt_C "common MIL debouncing / group representative for common MIL debouncing of DFC_ComEAT12RingCnt" VALUE 0x80504B4A Val_Wu16 906.000000000 DFC_Verb 0.00 906.000000000 FORMAT "%13.9" /end CHARACTERISTIC
/begin CHARACTERISTIC DFES_GrpRpr.DFC_ComEAT12TOut_C "common MIL debouncing / group representative for common MIL debouncing of DFC_ComEAT12TOut" VALUE 0x80504B4C Val_Wu16 906.000000000 DFC_Verb 0.00 906.000000000 FORMAT "%13.9" /end CHARACTERISTIC
/begin CHARACTERISTIC DFES_GrpRpr.DFC_ComEAT13ChkSum_C "common MIL debouncing / group representative for common MIL debouncing of DFC_ComEAT13ChkSum" VALUE 0x80504B4E Val_Wu16 906.000000000 DFC_Verb 0.00 906.000000000 FORMAT "%13.9" /end CHARACTERISTIC
/begin CHARACTERISTIC DFES_GrpRpr.DFC_ComEAT13RingCnt_C "common MIL debouncing / group representative for common MIL debouncing of DFC_ComEAT13RingCnt" VALUE 0x80504B50 Val_Wu16 906.000000000 DFC_Verb 0.00 906.000000000 FORMAT "%13.9" /end CHARACTERISTIC
/begin CHARACTERISTIC DFES_GrpRpr.DFC_ComEAT13TOut_C "common MIL debouncing / group representative for common MIL debouncing of DFC_ComEAT13TOut" VALUE 0x80504B52 Val_Wu16 906.000000000 DFC_Verb 0.00 906.000000000 FORMAT "%13.9" /end CHARACTERISTIC
/begin CHARACTERISTIC DFES_GrpRpr.DFC_ComEAT1Chksum_C "common MIL debouncing / group representative for common MIL debouncing of DFC_ComEAT1Chksum" VALUE 0x80504B54 Val_Wu16 906.000000000 DFC_Verb 0.00 906.000000000 FORMAT "%13.9" /end CHARACTERISTIC
/begin CHARACTERISTIC DFES_GrpRpr.DFC_ComEAT1RingCnt_C "common MIL debouncing / group representative for common MIL debouncing of DFC_ComEAT1RingCnt" VALUE 0x80504B56 Val_Wu16 906.000000000 DFC_Verb 0.00 906.000000000 FORMAT "%13.9" /end CHARACTERISTIC
/begin CHARACTERISTIC DFES_GrpRpr.DFC_ComEAT1TOut_C "common MIL debouncing / group representative for common MIL debouncing of DFC_ComEAT1TOut" VALUE 0x80504B58 Val_Wu16 906.000000000 DFC_Verb 0.00 906.000000000 FORMAT "%13.9" /end CHARACTERISTIC
/begin CHARACTERISTIC DFES_GrpRpr.DFC_ComEAT2ChkSum_C "common MIL debouncing / group representative for common MIL debouncing of DFC_ComEAT2ChkSum" VALUE 0x80504B5A Val_Wu16 906.000000000 DFC_Verb 0.00 906.000000000 FORMAT "%13.9" /end CHARACTERISTIC
/begin CHARACTERISTIC DFES_GrpRpr.DFC_ComEAT2RingCnt_C "common MIL debouncing / group representative for common MIL debouncing of DFC_ComEAT2RingCnt" VALUE 0x80504B5C Val_Wu16 906.000000000 DFC_Verb 0.00 906.000000000 FORMAT "%13.9" /end CHARACTERISTIC
/begin CHARACTERISTIC DFES_GrpRpr.DFC_ComEAT2TOut_C "common MIL debouncing / group representative for common MIL debouncing of DFC_ComEAT2TOut" VALUE 0x80504B5E Val_Wu16 906.000000000 DFC_Verb 0.00 906.000000000 FORMAT "%13.9" /end CHARACTERISTIC
/begin CHARACTERISTIC DFES_GrpRpr.DFC_ComEAT4ChkSum_C "common MIL debouncing / group representative for common MIL debouncing of DFC_ComEAT4ChkSum" VALUE 0x80504B60 Val_Wu16 906.000000000 DFC_Verb 0.00 906.000000000 FORMAT "%13.9" /end CHARACTERISTIC
/begin CHARACTERISTIC DFES_GrpRpr.DFC_ComEAT4RingCnt_C "common MIL debouncing / group representative for common MIL debouncing of DFC_ComEAT4RingCnt" VALUE 0x80504B62 Val_Wu16 906.000000000 DFC_Verb 0.00 906.000000000 FORMAT "%13.9" /end CHARACTERISTIC
/begin CHARACTERISTIC DFES_GrpRpr.DFC_ComEAT4TOut_C "common MIL debouncing / group representative for common MIL debouncing of DFC_ComEAT4TOut" VALUE 0x80504B64 Val_Wu16 906.000000000 DFC_Verb 0.00 906.000000000 FORMAT "%13.9" /end CHARACTERISTIC
/begin CHARACTERISTIC DFES_GrpRpr.DFC_ComEAT6Chksum_C "common MIL debouncing / group representative for common MIL debouncing of DFC_ComEAT6Chksum" VALUE 0x80504B66 Val_Wu16 906.000000000 DFC_Verb 0.00 906.000000000 FORMAT "%13.9" /end CHARACTERISTIC
/begin CHARACTERISTIC DFES_GrpRpr.DFC_ComEAT6RingCnt_C "common MIL debouncing / group representative for common MIL debouncing of DFC_ComEAT6RingCnt" VALUE 0x80504B68 Val_Wu16 906.000000000 DFC_Verb 0.00 906.000000000 FORMAT "%13.9" /end CHARACTERISTIC
/begin CHARACTERISTIC DFES_GrpRpr.DFC_ComEAT6TOut_C "common MIL debouncing / group representative for common MIL debouncing of DFC_ComEAT6TOut" VALUE 0x80504B6A Val_Wu16 906.000000000 DFC_Verb 0.00 906.000000000 FORMAT "%13.9" /end CHARACTERISTIC
/begin CHARACTERISTIC DFES_GrpRpr.DFC_ComEAT7Chksum_C "common MIL debouncing / group representative for common MIL debouncing of DFC_ComEAT7Chksum" VALUE 0x80504B6C Val_Wu16 906.000000000 DFC_Verb 0.00 906.000000000 FORMAT "%13.9" /end CHARACTERISTIC
/begin CHARACTERISTIC DFES_GrpRpr.DFC_ComEAT7RingCnt_C "common MIL debouncing / group representative for common MIL debouncing of DFC_ComEAT7RingCnt" VALUE 0x80504B6E Val_Wu16 906.000000000 DFC_Verb 0.00 906.000000000 FORMAT "%13.9" /end CHARACTERISTIC
/begin CHARACTERISTIC DFES_GrpRpr.DFC_ComEAT7TOut_C "common MIL debouncing / group representative for common MIL debouncing of DFC_ComEAT7TOut" VALUE 0x80504B70 Val_Wu16 906.000000000 DFC_Verb 0.00 906.000000000 FORMAT "%13.9" /end CHARACTERISTIC
/begin CHARACTERISTIC DFES_GrpRpr.DFC_ComEAT8Chksum_C "common MIL debouncing / group representative for common MIL debouncing of DFC_ComEAT8Chksum" VALUE 0x80504B72 Val_Wu16 906.000000000 DFC_Verb 0.00 906.000000000 FORMAT "%13.9" /end CHARACTERISTIC
/begin CHARACTERISTIC DFES_GrpRpr.DFC_ComEAT8RingCnt_C "common MIL debouncing / group representative for common MIL debouncing of DFC_ComEAT8RingCnt" VALUE 0x80504B74 Val_Wu16 906.000000000 DFC_Verb 0.00 906.000000000 FORMAT "%13.9" /end CHARACTERISTIC
/begin CHARACTERISTIC DFES_GrpRpr.DFC_ComEAT8TOut_C "common MIL debouncing / group representative for common MIL debouncing of DFC_ComEAT8TOut" VALUE 0x80504B76 Val_Wu16 906.000000000 DFC_Verb 0.00 906.000000000 FORMAT "%13.9" /end CHARACTERISTIC
/begin CHARACTERISTIC DFES_GrpRpr.DFC_ComEATAChksum_C "common MIL debouncing / group representative for common MIL debouncing of DFC_ComEATAChksum" VALUE 0x80504B78 Val_Wu16 906.000000000 DFC_Verb 0.00 906.000000000 FORMAT "%13.9" /end CHARACTERISTIC
/begin CHARACTERISTIC DFES_GrpRpr.DFC_ComEATARingCnt_C "common MIL debouncing / group representative for common MIL debouncing of DFC_ComEATARingCnt" VALUE 0x80504B7A Val_Wu16 906.000000000 DFC_Verb 0.00 906.000000000 FORMAT "%13.9" /end CHARACTERISTIC
/begin CHARACTERISTIC DFES_GrpRpr.DFC_ComEATATOut_C "common MIL debouncing / group representative for common MIL debouncing of DFC_ComEATATOut" VALUE 0x80504B7C Val_Wu16 906.000000000 DFC_Verb 0.00 906.000000000 FORMAT "%13.9" /end CHARACTERISTIC
/begin CHARACTERISTIC DFES_GrpRpr.DFC_ComEATBChkSum_C "common MIL debouncing / group representative for common MIL debouncing of DFC_ComEATBChkSum" VALUE 0x80504B7E Val_Wu16 906.000000000 DFC_Verb 0.00 906.000000000 FORMAT "%13.9" /end CHARACTERISTIC
/begin CHARACTERISTIC DFES_GrpRpr.DFC_ComEATBRingCnt_C "common MIL debouncing / group representative for common MIL debouncing of DFC_ComEATBRingCnt" VALUE 0x80504B80 Val_Wu16 906.000000000 DFC_Verb 0.00 906.000000000 FORMAT "%13.9" /end CHARACTERISTIC
/begin CHARACTERISTIC DFES_GrpRpr.DFC_ComEATBTOut_C "common MIL debouncing / group representative for common MIL debouncing of DFC_ComEATBTOut" VALUE 0x80504B82 Val_Wu16 906.000000000 DFC_Verb 0.00 906.000000000 FORMAT "%13.9" /end CHARACTERISTIC
/begin CHARACTERISTIC DFES_GrpRpr.DFC_ComEATCChksum_C "common MIL debouncing / group representative for common MIL debouncing of DFC_ComEATCChksum" VALUE 0x80504B84 Val_Wu16 906.000000000 DFC_Verb 0.00 906.000000000 FORMAT "%13.9" /end CHARACTERISTIC
/begin CHARACTERISTIC DFES_GrpRpr.DFC_ComEATCRingCnt_C "common MIL debouncing / group representative for common MIL debouncing of DFC_ComEATCRingCnt" VALUE 0x80504B86 Val_Wu16 906.000000000 DFC_Verb 0.00 906.000000000 FORMAT "%13.9" /end CHARACTERISTIC
/begin CHARACTERISTIC DFES_GrpRpr.DFC_ComEATCTOut_C "common MIL debouncing / group representative for common MIL debouncing of DFC_ComEATCTOut" VALUE 0x80504B88 Val_Wu16 906.000000000 DFC_Verb 0.00 906.000000000 FORMAT "%13.9" /end CHARACTERISTIC
/begin CHARACTERISTIC DFES_GrpRpr.DFC_ComEPBBChkSum_C "common MIL debouncing / group representative for common MIL debouncing of DFC_ComEPBBChkSum" VALUE 0x80504B8A Val_Wu16 906.000000000 DFC_Verb 0.00 906.000000000 FORMAT "%13.9" /end CHARACTERISTIC
/begin CHARACTERISTIC DFES_GrpRpr.DFC_ComEPBBRingCnt_C "common MIL debouncing / group representative for common MIL debouncing of DFC_ComEPBBRingCnt" VALUE 0x80504B8C Val_Wu16 906.000000000 DFC_Verb 0.00 906.000000000 FORMAT "%13.9" /end CHARACTERISTIC
/begin CHARACTERISTIC DFES_GrpRpr.DFC_ComEPBBTOut_C "common MIL debouncing / group representative for common MIL debouncing of DFC_ComEPBBTOut" VALUE 0x80504B8E Val_Wu16 906.000000000 DFC_Verb 0.00 906.000000000 FORMAT "%13.9" /end CHARACTERISTIC
/begin CHARACTERISTIC DFES_GrpRpr.DFC_ComEPBChksum_C "common MIL debouncing / group representative for common MIL debouncing of DFC_ComEPBChksum" VALUE 0x80504B90 Val_Wu16 906.000000000 DFC_Verb 0.00 906.000000000 FORMAT "%13.9" /end CHARACTERISTIC
/begin CHARACTERISTIC DFES_GrpRpr.DFC_ComEPBTOut_C "common MIL debouncing / group representative for common MIL debouncing of DFC_ComEPBTOut" VALUE 0x80504B92 Val_Wu16 906.000000000 DFC_Verb 0.00 906.000000000 FORMAT "%13.9" /end CHARACTERISTIC
/begin CHARACTERISTIC DFES_GrpRpr.DFC_ComEPBctRing_C "common MIL debouncing / group representative for common MIL debouncing of DFC_ComEPBctRing" VALUE 0x80504B94 Val_Wu16 906.000000000 DFC_Verb 0.00 906.000000000 FORMAT "%13.9" /end CHARACTERISTIC
/begin CHARACTERISTIC DFES_GrpRpr.DFC_ComEPS1Chksum_C "common MIL debouncing / group representative for common MIL debouncing of DFC_ComEPS1Chksum" VALUE 0x80504B96 Val_Wu16 906.000000000 DFC_Verb 0.00 906.000000000 FORMAT "%13.9" /end CHARACTERISTIC
/begin CHARACTERISTIC DFES_GrpRpr.DFC_ComEPS1RingCnt_C "common MIL debouncing / group representative for common MIL debouncing of DFC_ComEPS1RingCnt" VALUE 0x80504B98 Val_Wu16 906.000000000 DFC_Verb 0.00 906.000000000 FORMAT "%13.9" /end CHARACTERISTIC
/begin CHARACTERISTIC DFES_GrpRpr.DFC_ComEPS1TOut_C "common MIL debouncing / group representative for common MIL debouncing of DFC_ComEPS1TOut" VALUE 0x80504B9A Val_Wu16 906.000000000 DFC_Verb 0.00 906.000000000 FORMAT "%13.9" /end CHARACTERISTIC
/begin CHARACTERISTIC DFES_GrpRpr.DFC_ComEngCanRxErr_C "common MIL debouncing / group representative for common MIL debouncing of DFC_ComEngCanRxErr" VALUE 0x80504B9C Val_Wu16 906.000000000 DFC_Verb 0.00 906.000000000 FORMAT "%13.9" /end CHARACTERISTIC
/begin CHARACTERISTIC DFES_GrpRpr.DFC_ComGrvySnsrErr_C "common MIL debouncing / group representative for common MIL debouncing of DFC_ComGrvySnsrErr" VALUE 0x80504B9E Val_Wu16 906.000000000 DFC_Verb 0.00 906.000000000 FORMAT "%13.9" /end CHARACTERISTIC
/begin CHARACTERISTIC DFES_GrpRpr.DFC_ComGwIMG1ChkSum_C "common MIL debouncing / group representative for common MIL debouncing of DFC_ComGwIMG1ChkSum" VALUE 0x80504BA0 Val_Wu16 906.000000000 DFC_Verb 0.00 906.000000000 FORMAT "%13.9" /end CHARACTERISTIC
/begin CHARACTERISTIC DFES_GrpRpr.DFC_ComGwIMG1RingCnt_C "common MIL debouncing / group representative for common MIL debouncing of DFC_ComGwIMG1RingCnt" VALUE 0x80504BA2 Val_Wu16 906.000000000 DFC_Verb 0.00 906.000000000 FORMAT "%13.9" /end CHARACTERISTIC
/begin CHARACTERISTIC DFES_GrpRpr.DFC_ComGwIMG1TOut_C "common MIL debouncing / group representative for common MIL debouncing of DFC_ComGwIMG1TOut" VALUE 0x80504BA4 Val_Wu16 906.000000000 DFC_Verb 0.00 906.000000000 FORMAT "%13.9" /end CHARACTERISTIC
/begin CHARACTERISTIC DFES_GrpRpr.DFC_ComGwIMG3ChkSum_C "common MIL debouncing / group representative for common MIL debouncing of DFC_ComGwIMG3ChkSum" VALUE 0x80504BA6 Val_Wu16 906.000000000 DFC_Verb 0.00 906.000000000 FORMAT "%13.9" /end CHARACTERISTIC
/begin CHARACTERISTIC DFES_GrpRpr.DFC_ComGwIMG3RingCnt_C "common MIL debouncing / group representative for common MIL debouncing of DFC_ComGwIMG3RingCnt" VALUE 0x80504BA8 Val_Wu16 906.000000000 DFC_Verb 0.00 906.000000000 FORMAT "%13.9" /end CHARACTERISTIC
/begin CHARACTERISTIC DFES_GrpRpr.DFC_ComGwIMG3TOut_C "common MIL debouncing / group representative for common MIL debouncing of DFC_ComGwIMG3TOut" VALUE 0x80504BAA Val_Wu16 906.000000000 DFC_Verb 0.00 906.000000000 FORMAT "%13.9" /end CHARACTERISTIC
/begin CHARACTERISTIC DFES_GrpRpr.DFC_ComGwIMG4ChkSum_C "common MIL debouncing / group representative for common MIL debouncing of DFC_ComGwIMG4ChkSum" VALUE 0x80504BAC Val_Wu16 906.000000000 DFC_Verb 0.00 906.000000000 FORMAT "%13.9" /end CHARACTERISTIC
/begin CHARACTERISTIC DFES_GrpRpr.DFC_ComGwIMG4RingCnt_C "common MIL debouncing / group representative for common MIL debouncing of DFC_ComGwIMG4RingCnt" VALUE 0x80504BAE Val_Wu16 906.000000000 DFC_Verb 0.00 906.000000000 FORMAT "%13.9" /end CHARACTERISTIC
/begin CHARACTERISTIC DFES_GrpRpr.DFC_ComGwIMG4TOut_C "common MIL debouncing / group representative for common MIL debouncing of DFC_ComGwIMG4TOut" VALUE 0x80504BB0 Val_Wu16 906.000000000 DFC_Verb 0.00 906.000000000 FORMAT "%13.9" /end CHARACTERISTIC
/begin CHARACTERISTIC DFES_GrpRpr.DFC_ComGwIMG5ChkSum_C "common MIL debouncing / group representative for common MIL debouncing of DFC_ComGwIMG5ChkSum" VALUE 0x80504BB2 Val_Wu16 906.000000000 DFC_Verb 0.00 906.000000000 FORMAT "%13.9" /end CHARACTERISTIC
/begin CHARACTERISTIC DFES_GrpRpr.DFC_ComGwIMG5RingCnt_C "common MIL debouncing / group representative for common MIL debouncing of DFC_ComGwIMG5RingCnt" VALUE 0x80504BB4 Val_Wu16 906.000000000 DFC_Verb 0.00 906.000000000 FORMAT "%13.9" /end CHARACTERISTIC
/begin CHARACTERISTIC DFES_GrpRpr.DFC_ComGwIMG5TOut_C "common MIL debouncing / group representative for common MIL debouncing of DFC_ComGwIMG5TOut" VALUE 0x80504BB6 Val_Wu16 906.000000000 DFC_Verb 0.00 906.000000000 FORMAT "%13.9" /end CHARACTERISTIC
/begin CHARACTERISTIC DFES_GrpRpr.DFC_ComGwIMG6ChkSum_C "common MIL debouncing / group representative for common MIL debouncing of DFC_ComGwIMG6ChkSum" VALUE 0x80504BB8 Val_Wu16 906.000000000 DFC_Verb 0.00 906.000000000 FORMAT "%13.9" /end CHARACTERISTIC
/begin CHARACTERISTIC DFES_GrpRpr.DFC_ComGwIMG6RingCnt_C "common MIL debouncing / group representative for common MIL debouncing of DFC_ComGwIMG6RingCnt" VALUE 0x80504BBA Val_Wu16 906.000000000 DFC_Verb 0.00 906.000000000 FORMAT "%13.9" /end CHARACTERISTIC
/begin CHARACTERISTIC DFES_GrpRpr.DFC_ComGwIMG6TOut_C "common MIL debouncing / group representative for common MIL debouncing of DFC_ComGwIMG6TOut" VALUE 0x80504BBC Val_Wu16 906.000000000 DFC_Verb 0.00 906.000000000 FORMAT "%13.9" /end CHARACTERISTIC
/begin CHARACTERISTIC DFES_GrpRpr.DFC_ComIDASBChksum_C "common MIL debouncing / group representative for common MIL debouncing of DFC_ComIDASBChksum" VALUE 0x80504BBE Val_Wu16 906.000000000 DFC_Verb 0.00 906.000000000 FORMAT "%13.9" /end CHARACTERISTIC
/begin CHARACTERISTIC DFES_GrpRpr.DFC_ComIDASBRingCnt_C "common MIL debouncing / group representative for common MIL debouncing of DFC_ComIDASBRingCnt" VALUE 0x80504BC0 Val_Wu16 906.000000000 DFC_Verb 0.00 906.000000000 FORMAT "%13.9" /end CHARACTERISTIC
/begin CHARACTERISTIC DFES_GrpRpr.DFC_ComIDASBTOut_C "common MIL debouncing / group representative for common MIL debouncing of DFC_ComIDASBTOut" VALUE 0x80504BC2 Val_Wu16 906.000000000 DFC_Verb 0.00 906.000000000 FORMAT "%13.9" /end CHARACTERISTIC
/begin CHARACTERISTIC DFES_GrpRpr.DFC_ComIMGMILReq_C "common MIL debouncing / group representative for common MIL debouncing of DFC_ComIMGMILReq" VALUE 0x80504BC4 Val_Wu16 906.000000000 DFC_Verb 0.00 906.000000000 FORMAT "%13.9" /end CHARACTERISTIC
/begin CHARACTERISTIC DFES_GrpRpr.DFC_ComISSPrms_C "common MIL debouncing / group representative for common MIL debouncing of DFC_ComISSPrms" VALUE 0x80504BC6 Val_Wu16 906.000000000 DFC_Verb 0.00 906.000000000 FORMAT "%13.9" /end CHARACTERISTIC
/begin CHARACTERISTIC DFES_GrpRpr.DFC_ComMETAChksum_C "common MIL debouncing / group representative for common MIL debouncing of DFC_ComMETAChksum" VALUE 0x80504BC8 Val_Wu16 906.000000000 DFC_Verb 0.00 906.000000000 FORMAT "%13.9" /end CHARACTERISTIC
/begin CHARACTERISTIC DFES_GrpRpr.DFC_ComMETAChksumPstDrv_C "common MIL debouncing / group representative for common MIL debouncing of DFC_ComMETAChksumPstDrv" VALUE 0x80504BCA Val_Wu16 906.000000000 DFC_Verb 0.00 906.000000000 FORMAT "%13.9" /end CHARACTERISTIC
/begin CHARACTERISTIC DFES_GrpRpr.DFC_ComMETARingCnt_C "common MIL debouncing / group representative for common MIL debouncing of DFC_ComMETARingCnt" VALUE 0x80504BCC Val_Wu16 906.000000000 DFC_Verb 0.00 906.000000000 FORMAT "%13.9" /end CHARACTERISTIC
/begin CHARACTERISTIC DFES_GrpRpr.DFC_ComMETARingCntPstDrv_C "common MIL debouncing / group representative for common MIL debouncing of DFC_ComMETARingCntPstDrv" VALUE 0x80504BCE Val_Wu16 906.000000000 DFC_Verb 0.00 906.000000000 FORMAT "%13.9" /end CHARACTERISTIC
/begin CHARACTERISTIC DFES_GrpRpr.DFC_ComMETATOut_C "common MIL debouncing / group representative for common MIL debouncing of DFC_ComMETATOut" VALUE 0x80504BD0 Val_Wu16 906.000000000 DFC_Verb 0.00 906.000000000 FORMAT "%13.9" /end CHARACTERISTIC
/begin CHARACTERISTIC DFES_GrpRpr.DFC_ComMETATOutPstDrv_C "common MIL debouncing / group representative for common MIL debouncing of DFC_ComMETATOutPstDrv" VALUE 0x80504BD2 Val_Wu16 906.000000000 DFC_Verb 0.00 906.000000000 FORMAT "%13.9" /end CHARACTERISTIC
/begin CHARACTERISTIC DFES_GrpRpr.DFC_ComMETCChksum_C "common MIL debouncing / group representative for common MIL debouncing of DFC_ComMETCChksum" VALUE 0x80504BD4 Val_Wu16 906.000000000 DFC_Verb 0.00 906.000000000 FORMAT "%13.9" /end CHARACTERISTIC
/begin CHARACTERISTIC DFES_GrpRpr.DFC_ComMETCRingCnt_C "common MIL debouncing / group representative for common MIL debouncing of DFC_ComMETCRingCnt" VALUE 0x80504BD6 Val_Wu16 906.000000000 DFC_Verb 0.00 906.000000000 FORMAT "%13.9" /end CHARACTERISTIC
/begin CHARACTERISTIC DFES_GrpRpr.DFC_ComMETCTOut_C "common MIL debouncing / group representative for common MIL debouncing of DFC_ComMETCTOut" VALUE 0x80504BD8 Val_Wu16 906.000000000 DFC_Verb 0.00 906.000000000 FORMAT "%13.9" /end CHARACTERISTIC
/begin CHARACTERISTIC DFES_GrpRpr.DFC_ComMETDChksum_C "common MIL debouncing / group representative for common MIL debouncing of DFC_ComMETDChksum" VALUE 0x80504BDA Val_Wu16 906.000000000 DFC_Verb 0.00 906.000000000 FORMAT "%13.9" /end CHARACTERISTIC
/begin CHARACTERISTIC DFES_GrpRpr.DFC_ComMETDRingCnt_C "common MIL debouncing / group representative for common MIL debouncing of DFC_ComMETDRingCnt" VALUE 0x80504BDC Val_Wu16 906.000000000 DFC_Verb 0.00 906.000000000 FORMAT "%13.9" /end CHARACTERISTIC
/begin CHARACTERISTIC DFES_GrpRpr.DFC_ComMETDTOut_C "common MIL debouncing / group representative for common MIL debouncing of DFC_ComMETDTOut" VALUE 0x80504BDE Val_Wu16 906.000000000 DFC_Verb 0.00 906.000000000 FORMAT "%13.9" /end CHARACTERISTIC
/begin CHARACTERISTIC DFES_GrpRpr.DFC_ComMETE2Chksum_C "common MIL debouncing / group representative for common MIL debouncing of DFC_ComMETE2Chksum" VALUE 0x80504BE0 Val_Wu16 906.000000000 DFC_Verb 0.00 906.000000000 FORMAT "%13.9" /end CHARACTERISTIC
/begin CHARACTERISTIC DFES_GrpRpr.DFC_ComMETE2RingCnt_C "common MIL debouncing / group representative for common MIL debouncing of DFC_ComMETE2RingCnt" VALUE 0x80504BE2 Val_Wu16 906.000000000 DFC_Verb 0.00 906.000000000 FORMAT "%13.9" /end CHARACTERISTIC
/begin CHARACTERISTIC DFES_GrpRpr.DFC_ComMETE2TOut_C "common MIL debouncing / group representative for common MIL debouncing of DFC_ComMETE2TOut" VALUE 0x80504BE4 Val_Wu16 906.000000000 DFC_Verb 0.00 906.000000000 FORMAT "%13.9" /end CHARACTERISTIC
/begin CHARACTERISTIC DFES_GrpRpr.DFC_ComMETFChksum_C "common MIL debouncing / group representative for common MIL debouncing of DFC_ComMETFChksum" VALUE 0x80504BE6 Val_Wu16 906.000000000 DFC_Verb 0.00 906.000000000 FORMAT "%13.9" /end CHARACTERISTIC
/begin CHARACTERISTIC DFES_GrpRpr.DFC_ComMETFRingCnt_C "common MIL debouncing / group representative for common MIL debouncing of DFC_ComMETFRingCnt" VALUE 0x80504BE8 Val_Wu16 906.000000000 DFC_Verb 0.00 906.000000000 FORMAT "%13.9" /end CHARACTERISTIC
/begin CHARACTERISTIC DFES_GrpRpr.DFC_ComMETFTOut_C "common MIL debouncing / group representative for common MIL debouncing of DFC_ComMETFTOut" VALUE 0x80504BEA Val_Wu16 906.000000000 DFC_Verb 0.00 906.000000000 FORMAT "%13.9" /end CHARACTERISTIC
/begin CHARACTERISTIC DFES_GrpRpr.DFC_ComMETGChksum_C "common MIL debouncing / group representative for common MIL debouncing of DFC_ComMETGChksum" VALUE 0x80504BEC Val_Wu16 906.000000000 DFC_Verb 0.00 906.000000000 FORMAT "%13.9" /end CHARACTERISTIC
/begin CHARACTERISTIC DFES_GrpRpr.DFC_ComMETGRingCnt_C "common MIL debouncing / group representative for common MIL debouncing of DFC_ComMETGRingCnt" VALUE 0x80504BEE Val_Wu16 906.000000000 DFC_Verb 0.00 906.000000000 FORMAT "%13.9" /end CHARACTERISTIC
/begin CHARACTERISTIC DFES_GrpRpr.DFC_ComMETGTOut_C "common MIL debouncing / group representative for common MIL debouncing of DFC_ComMETGTOut" VALUE 0x80504BF0 Val_Wu16 906.000000000 DFC_Verb 0.00 906.000000000 FORMAT "%13.9" /end CHARACTERISTIC
/begin CHARACTERISTIC DFES_GrpRpr.DFC_ComMETH2Chksum_C "common MIL debouncing / group representative for common MIL debouncing of DFC_ComMETH2Chksum" VALUE 0x80504BF2 Val_Wu16 906.000000000 DFC_Verb 0.00 906.000000000 FORMAT "%13.9" /end CHARACTERISTIC
/begin CHARACTERISTIC DFES_GrpRpr.DFC_ComMETH2RingCnt_C "common MIL debouncing / group representative for common MIL debouncing of DFC_ComMETH2RingCnt" VALUE 0x80504BF4 Val_Wu16 906.000000000 DFC_Verb 0.00 906.000000000 FORMAT "%13.9" /end CHARACTERISTIC
/begin CHARACTERISTIC DFES_GrpRpr.DFC_ComMETH2TOut_C "common MIL debouncing / group representative for common MIL debouncing of DFC_ComMETH2TOut" VALUE 0x80504BF6 Val_Wu16 906.000000000 DFC_Verb 0.00 906.000000000 FORMAT "%13.9" /end CHARACTERISTIC
/begin CHARACTERISTIC DFES_GrpRpr.DFC_ComMETHChksum_C "common MIL debouncing / group representative for common MIL debouncing of DFC_ComMETHChksum" VALUE 0x80504BF8 Val_Wu16 906.000000000 DFC_Verb 0.00 906.000000000 FORMAT "%13.9" /end CHARACTERISTIC
/begin CHARACTERISTIC DFES_GrpRpr.DFC_ComMETHRingCnt_C "common MIL debouncing / group representative for common MIL debouncing of DFC_ComMETHRingCnt" VALUE 0x80504BFA Val_Wu16 906.000000000 DFC_Verb 0.00 906.000000000 FORMAT "%13.9" /end CHARACTERISTIC
/begin CHARACTERISTIC DFES_GrpRpr.DFC_ComMETHTOut_C "common MIL debouncing / group representative for common MIL debouncing of DFC_ComMETHTOut" VALUE 0x80504BFC Val_Wu16 906.000000000 DFC_Verb 0.00 906.000000000 FORMAT "%13.9" /end CHARACTERISTIC
/begin CHARACTERISTIC DFES_GrpRpr.DFC_ComMETIChksum_C "common MIL debouncing / group representative for common MIL debouncing of DFC_ComMETIChksum" VALUE 0x80504BFE Val_Wu16 906.000000000 DFC_Verb 0.00 906.000000000 FORMAT "%13.9" /end CHARACTERISTIC
/begin CHARACTERISTIC DFES_GrpRpr.DFC_ComMETIRingCnt_C "common MIL debouncing / group representative for common MIL debouncing of DFC_ComMETIRingCnt" VALUE 0x80504C00 Val_Wu16 906.000000000 DFC_Verb 0.00 906.000000000 FORMAT "%13.9" /end CHARACTERISTIC
/begin CHARACTERISTIC DFES_GrpRpr.DFC_ComMETITOut_C "common MIL debouncing / group representative for common MIL debouncing of DFC_ComMETITOut" VALUE 0x80504C02 Val_Wu16 906.000000000 DFC_Verb 0.00 906.000000000 FORMAT "%13.9" /end CHARACTERISTIC
/begin CHARACTERISTIC DFES_GrpRpr.DFC_ComMETKChksum_C "common MIL debouncing / group representative for common MIL debouncing of DFC_ComMETKChksum" VALUE 0x80504C04 Val_Wu16 906.000000000 DFC_Verb 0.00 906.000000000 FORMAT "%13.9" /end CHARACTERISTIC
/begin CHARACTERISTIC DFES_GrpRpr.DFC_ComMETKRingCnt_C "common MIL debouncing / group representative for common MIL debouncing of DFC_ComMETKRingCnt" VALUE 0x80504C06 Val_Wu16 906.000000000 DFC_Verb 0.00 906.000000000 FORMAT "%13.9" /end CHARACTERISTIC
/begin CHARACTERISTIC DFES_GrpRpr.DFC_ComMETKTOut_C "common MIL debouncing / group representative for common MIL debouncing of DFC_ComMETKTOut" VALUE 0x80504C08 Val_Wu16 906.000000000 DFC_Verb 0.00 906.000000000 FORMAT "%13.9" /end CHARACTERISTIC
/begin CHARACTERISTIC DFES_GrpRpr.DFC_ComMETLChksum_C "common MIL debouncing / group representative for common MIL debouncing of DFC_ComMETLChksum" VALUE 0x80504C0A Val_Wu16 906.000000000 DFC_Verb 0.00 906.000000000 FORMAT "%13.9" /end CHARACTERISTIC
/begin CHARACTERISTIC DFES_GrpRpr.DFC_ComMETLRingCnt_C "common MIL debouncing / group representative for common MIL debouncing of DFC_ComMETLRingCnt" VALUE 0x80504C0C Val_Wu16 906.000000000 DFC_Verb 0.00 906.000000000 FORMAT "%13.9" /end CHARACTERISTIC
/begin CHARACTERISTIC DFES_GrpRpr.DFC_ComMETLTOut_C "common MIL debouncing / group representative for common MIL debouncing of DFC_ComMETLTOut" VALUE 0x80504C0E Val_Wu16 906.000000000 DFC_Verb 0.00 906.000000000 FORMAT "%13.9" /end CHARACTERISTIC
/begin CHARACTERISTIC DFES_GrpRpr.DFC_ComMETMChksum_C "common MIL debouncing / group representative for common MIL debouncing of DFC_ComMETMChksum" VALUE 0x80504C10 Val_Wu16 906.000000000 DFC_Verb 0.00 906.000000000 FORMAT "%13.9" /end CHARACTERISTIC
/begin CHARACTERISTIC DFES_GrpRpr.DFC_ComMETMRingCnt_C "common MIL debouncing / group representative for common MIL debouncing of DFC_ComMETMRingCnt" VALUE 0x80504C12 Val_Wu16 906.000000000 DFC_Verb 0.00 906.000000000 FORMAT "%13.9" /end CHARACTERISTIC
/begin CHARACTERISTIC DFES_GrpRpr.DFC_ComMETMTOut_C "common MIL debouncing / group representative for common MIL debouncing of DFC_ComMETMTOut" VALUE 0x80504C14 Val_Wu16 906.000000000 DFC_Verb 0.00 906.000000000 FORMAT "%13.9" /end CHARACTERISTIC
/begin CHARACTERISTIC DFES_GrpRpr.DFC_ComMETNChksum_C "common MIL debouncing / group representative for common MIL debouncing of DFC_ComMETNChksum" VALUE 0x80504C16 Val_Wu16 906.000000000 DFC_Verb 0.00 906.000000000 FORMAT "%13.9" /end CHARACTERISTIC
/begin CHARACTERISTIC DFES_GrpRpr.DFC_ComMETNRingCnt_C "common MIL debouncing / group representative for common MIL debouncing of DFC_ComMETNRingCnt" VALUE 0x80504C18 Val_Wu16 906.000000000 DFC_Verb 0.00 906.000000000 FORMAT "%13.9" /end CHARACTERISTIC
/begin CHARACTERISTIC DFES_GrpRpr.DFC_ComMETNTOut_C "common MIL debouncing / group representative for common MIL debouncing of DFC_ComMETNTOut" VALUE 0x80504C1A Val_Wu16 906.000000000 DFC_Verb 0.00 906.000000000 FORMAT "%13.9" /end CHARACTERISTIC
/begin CHARACTERISTIC DFES_GrpRpr.DFC_ComMtrCom_C "common MIL debouncing / group representative for common MIL debouncing of DFC_ComMtrCom" VALUE 0x80504C1C Val_Wu16 906.000000000 DFC_Verb 0.00 906.000000000 FORMAT "%13.9" /end CHARACTERISTIC
/begin CHARACTERISTIC DFES_GrpRpr.DFC_ComPCUChkSum_C "common MIL debouncing / group representative for common MIL debouncing of DFC_ComPCUChkSum" VALUE 0x80504C1E Val_Wu16 906.000000000 DFC_Verb 0.00 906.000000000 FORMAT "%13.9" /end CHARACTERISTIC
/begin CHARACTERISTIC DFES_GrpRpr.DFC_ComPCURingCnt_C "common MIL debouncing / group representative for common MIL debouncing of DFC_ComPCURingCnt" VALUE 0x80504C20 Val_Wu16 906.000000000 DFC_Verb 0.00 906.000000000 FORMAT "%13.9" /end CHARACTERISTIC
/begin CHARACTERISTIC DFES_GrpRpr.DFC_ComPCUTOut_C "common MIL debouncing / group representative for common MIL debouncing of DFC_ComPCUTOut" VALUE 0x80504C22 Val_Wu16 906.000000000 DFC_Verb 0.00 906.000000000 FORMAT "%13.9" /end CHARACTERISTIC
/begin CHARACTERISTIC DFES_GrpRpr.DFC_ComSRSAChksum_C "common MIL debouncing / group representative for common MIL debouncing of DFC_ComSRSAChksum" VALUE 0x80504C24 Val_Wu16 906.000000000 DFC_Verb 0.00 906.000000000 FORMAT "%13.9" /end CHARACTERISTIC
/begin CHARACTERISTIC DFES_GrpRpr.DFC_ComSRSARingCnt_C "common MIL debouncing / group representative for common MIL debouncing of DFC_ComSRSARingCnt" VALUE 0x80504C26 Val_Wu16 906.000000000 DFC_Verb 0.00 906.000000000 FORMAT "%13.9" /end CHARACTERISTIC
/begin CHARACTERISTIC DFES_GrpRpr.DFC_ComSRSATOut_C "common MIL debouncing / group representative for common MIL debouncing of DFC_ComSRSATOut" VALUE 0x80504C28 Val_Wu16 906.000000000 DFC_Verb 0.00 906.000000000 FORMAT "%13.9" /end CHARACTERISTIC
/begin CHARACTERISTIC DFES_GrpRpr.DFC_ComSRSBChksum_C "common MIL debouncing / group representative for common MIL debouncing of DFC_ComSRSBChksum" VALUE 0x80504C2A Val_Wu16 906.000000000 DFC_Verb 0.00 906.000000000 FORMAT "%13.9" /end CHARACTERISTIC
/begin CHARACTERISTIC DFES_GrpRpr.DFC_ComSRSBRingCnt_C "common MIL debouncing / group representative for common MIL debouncing of DFC_ComSRSBRingCnt" VALUE 0x80504C2C Val_Wu16 906.000000000 DFC_Verb 0.00 906.000000000 FORMAT "%13.9" /end CHARACTERISTIC
/begin CHARACTERISTIC DFES_GrpRpr.DFC_ComSRSBTOut_C "common MIL debouncing / group representative for common MIL debouncing of DFC_ComSRSBTOut" VALUE 0x80504C2E Val_Wu16 906.000000000 DFC_Verb 0.00 906.000000000 FORMAT "%13.9" /end CHARACTERISTIC
/begin CHARACTERISTIC DFES_GrpRpr.DFC_ComSRSChksum_C "common MIL debouncing / group representative for common MIL debouncing of DFC_ComSRSChksum" VALUE 0x80504C30 Val_Wu16 906.000000000 DFC_Verb 0.00 906.000000000 FORMAT "%13.9" /end CHARACTERISTIC
/begin CHARACTERISTIC DFES_GrpRpr.DFC_ComSRSErr_C "common MIL debouncing / group representative for common MIL debouncing of DFC_ComSRSErr" VALUE 0x80504C32 Val_Wu16 906.000000000 DFC_Verb 0.00 906.000000000 FORMAT "%13.9" /end CHARACTERISTIC
/begin CHARACTERISTIC DFES_GrpRpr.DFC_ComSRSRingCnt_C "common MIL debouncing / group representative for common MIL debouncing of DFC_ComSRSRingCnt" VALUE 0x80504C34 Val_Wu16 906.000000000 DFC_Verb 0.00 906.000000000 FORMAT "%13.9" /end CHARACTERISTIC
/begin CHARACTERISTIC DFES_GrpRpr.DFC_ComSRSTOut_C "common MIL debouncing / group representative for common MIL debouncing of DFC_ComSRSTOut" VALUE 0x80504C36 Val_Wu16 906.000000000 DFC_Verb 0.00 906.000000000 FORMAT "%13.9" /end CHARACTERISTIC
/begin CHARACTERISTIC DFES_GrpRpr.DFC_ComVehSpdPndFltTCU_C "common MIL debouncing / group representative for common MIL debouncing of DFC_ComVehSpdPndFltTCU" VALUE 0x80504C38 Val_Wu16 906.000000000 DFC_Verb 0.00 906.000000000 FORMAT "%13.9" /end CHARACTERISTIC
/begin CHARACTERISTIC DFES_GrpRpr.DFC_EbsChartcCurrErr_C "common MIL debouncing / group representative for common MIL debouncing of DFC_EbsChartcCurrErr" VALUE 0x80504C3A Val_Wu16 906.000000000 DFC_Verb 0.00 906.000000000 FORMAT "%13.9" /end CHARACTERISTIC
/begin CHARACTERISTIC DFES_GrpRpr.DFC_EbsSelfDiagErr_C "common MIL debouncing / group representative for common MIL debouncing of DFC_EbsSelfDiagErr" VALUE 0x80504C3C Val_Wu16 906.000000000 DFC_Verb 0.00 906.000000000 FORMAT "%13.9" /end CHARACTERISTIC
/begin CHARACTERISTIC DFES_GrpRpr.DFC_GEVlvPhaCsersIntkB1_C "common MIL debouncing / group representative for common MIL debouncing of DFC_GEVlvPhaCsersIntkB1" VALUE 0x80504C3E Val_Wu16 906.000000000 DFC_Verb 0.00 906.000000000 FORMAT "%13.9" /end CHARACTERISTIC
/begin CHARACTERISTIC DFES_GrpRpr.DFC_GEVlvPhaPsOpenLoadIntkB1_C "common MIL debouncing / group representative for common MIL debouncing of DFC_GEVlvPhaPsOpenLoadIntkB1" VALUE 0x80504C40 Val_Wu16 906.000000000 DFC_Verb 0.00 906.000000000 FORMAT "%13.9" /end CHARACTERISTIC
/begin CHARACTERISTIC DFES_GrpRpr.DFC_GEVlvPhaPsShoToBattIntkB1_C "common MIL debouncing / group representative for common MIL debouncing of DFC_GEVlvPhaPsShoToBattIntkB1" VALUE 0x80504C42 Val_Wu16 906.000000000 DFC_Verb 0.00 906.000000000 FORMAT "%13.9" /end CHARACTERISTIC
/begin CHARACTERISTIC DFES_GrpRpr.DFC_GEVlvPhaPsShoToGndIntkB1_C "common MIL debouncing / group representative for common MIL debouncing of DFC_GEVlvPhaPsShoToGndIntkB1" VALUE 0x80504C44 Val_Wu16 906.000000000 DFC_Verb 0.00 906.000000000 FORMAT "%13.9" /end CHARACTERISTIC
/begin CHARACTERISTIC DFES_GrpRpr.DFC_GbxCANDigPlausErr_C "common MIL debouncing / group representative for common MIL debouncing of DFC_GbxCANDigPlausErr" VALUE 0x80504C46 Val_Wu16 906.000000000 DFC_Verb 0.00 906.000000000 FORMAT "%13.9" /end CHARACTERISTIC
/begin CHARACTERISTIC DFES_GrpRpr.DFC_GbxNPos1SRCMax_C "common MIL debouncing / group representative for common MIL debouncing of DFC_GbxNPos1SRCMax" VALUE 0x80504C48 Val_Wu16 906.000000000 DFC_Verb 0.00 906.000000000 FORMAT "%13.9" /end CHARACTERISTIC
/begin CHARACTERISTIC DFES_GrpRpr.DFC_GbxNPos1SRCMin_C "common MIL debouncing / group representative for common MIL debouncing of DFC_GbxNPos1SRCMin" VALUE 0x80504C4A Val_Wu16 906.000000000 DFC_Verb 0.00 906.000000000 FORMAT "%13.9" /end CHARACTERISTIC
/begin CHARACTERISTIC DFES_GrpRpr.DFC_GbxNPos2SRCMax_C "common MIL debouncing / group representative for common MIL debouncing of DFC_GbxNPos2SRCMax" VALUE 0x80504C4C Val_Wu16 906.000000000 DFC_Verb 0.00 906.000000000 FORMAT "%13.9" /end CHARACTERISTIC
/begin CHARACTERISTIC DFES_GrpRpr.DFC_GbxNPos2SRCMin_C "common MIL debouncing / group representative for common MIL debouncing of DFC_GbxNPos2SRCMin" VALUE 0x80504C4E Val_Wu16 906.000000000 DFC_Verb 0.00 906.000000000 FORMAT "%13.9" /end CHARACTERISTIC
/begin CHARACTERISTIC DFES_GrpRpr.DFC_GbxNPosAlvChk_C "common MIL debouncing / group representative for common MIL debouncing of DFC_GbxNPosAlvChk" VALUE 0x80504C50 Val_Wu16 906.000000000 DFC_Verb 0.00 906.000000000 FORMAT "%13.9" /end CHARACTERISTIC
/begin CHARACTERISTIC DFES_GrpRpr.DFC_GbxNPosSyncErr_C "common MIL debouncing / group representative for common MIL debouncing of DFC_GbxNPosSyncErr" VALUE 0x80504C52 Val_Wu16 906.000000000 DFC_Verb 0.00 906.000000000 FORMAT "%13.9" /end CHARACTERISTIC
/begin CHARACTERISTIC DFES_GrpRpr.DFC_HEGOS2B1HtrPsMax_C "common MIL debouncing / group representative for common MIL debouncing of DFC_HEGOS2B1HtrPsMax" VALUE 0x80504C54 Val_Wu16 906.000000000 DFC_Verb 0.00 906.000000000 FORMAT "%13.9" /end CHARACTERISTIC
/begin CHARACTERISTIC DFES_GrpRpr.DFC_HEGOS2B1HtrPsMin_C "common MIL debouncing / group representative for common MIL debouncing of DFC_HEGOS2B1HtrPsMin" VALUE 0x80504C56 Val_Wu16 906.000000000 DFC_Verb 0.00 906.000000000 FORMAT "%13.9" /end CHARACTERISTIC
/begin CHARACTERISTIC DFES_GrpRpr.DFC_HEGOS2B1HtrPsSig_C "common MIL debouncing / group representative for common MIL debouncing of DFC_HEGOS2B1HtrPsSig" VALUE 0x80504C58 Val_Wu16 906.000000000 DFC_Verb 0.00 906.000000000 FORMAT "%13.9" /end CHARACTERISTIC
/begin CHARACTERISTIC DFES_GrpRpr.DFC_LinCSErrACG_C "common MIL debouncing / group representative for common MIL debouncing of DFC_LinCSErrACG" VALUE 0x80504C5A Val_Wu16 906.000000000 DFC_Verb 0.00 906.000000000 FORMAT "%13.9" /end CHARACTERISTIC
/begin CHARACTERISTIC DFES_GrpRpr.DFC_LinCSErrAEV_C "common MIL debouncing / group representative for common MIL debouncing of DFC_LinCSErrAEV" VALUE 0x80504C5C Val_Wu16 906.000000000 DFC_Verb 0.00 906.000000000 FORMAT "%13.9" /end CHARACTERISTIC
/begin CHARACTERISTIC DFES_GrpRpr.DFC_LinCSErrDCDC_C "common MIL debouncing / group representative for common MIL debouncing of DFC_LinCSErrDCDC" VALUE 0x80504C5E Val_Wu16 906.000000000 DFC_Verb 0.00 906.000000000 FORMAT "%13.9" /end CHARACTERISTIC
/begin CHARACTERISTIC DFES_GrpRpr.DFC_LinCSErrEBS_C "common MIL debouncing / group representative for common MIL debouncing of DFC_LinCSErrEBS" VALUE 0x80504C60 Val_Wu16 906.000000000 DFC_Verb 0.00 906.000000000 FORMAT "%13.9" /end CHARACTERISTIC
/begin CHARACTERISTIC DFES_GrpRpr.DFC_LinHdrTimeoutErrACG_C "common MIL debouncing / group representative for common MIL debouncing of DFC_LinHdrTimeoutErrACG" VALUE 0x80504C62 Val_Wu16 906.000000000 DFC_Verb 0.00 906.000000000 FORMAT "%13.9" /end CHARACTERISTIC
/begin CHARACTERISTIC DFES_GrpRpr.DFC_LinHdrTimeoutErrAEV_C "common MIL debouncing / group representative for common MIL debouncing of DFC_LinHdrTimeoutErrAEV" VALUE 0x80504C64 Val_Wu16 906.000000000 DFC_Verb 0.00 906.000000000 FORMAT "%13.9" /end CHARACTERISTIC
/begin CHARACTERISTIC DFES_GrpRpr.DFC_LinHdrTimeoutErrDCDC_C "common MIL debouncing / group representative for common MIL debouncing of DFC_LinHdrTimeoutErrDCDC" VALUE 0x80504C66 Val_Wu16 906.000000000 DFC_Verb 0.00 906.000000000 FORMAT "%13.9" /end CHARACTERISTIC
/begin CHARACTERISTIC DFES_GrpRpr.DFC_LinHdrTimeoutErrEBS_C "common MIL debouncing / group representative for common MIL debouncing of DFC_LinHdrTimeoutErrEBS" VALUE 0x80504C68 Val_Wu16 906.000000000 DFC_Verb 0.00 906.000000000 FORMAT "%13.9" /end CHARACTERISTIC
/begin CHARACTERISTIC DFES_GrpRpr.DFC_LinMsgTimeoutErrACG_C "common MIL debouncing / group representative for common MIL debouncing of DFC_LinMsgTimeoutErrACG" VALUE 0x80504C6A Val_Wu16 906.000000000 DFC_Verb 0.00 906.000000000 FORMAT "%13.9" /end CHARACTERISTIC
/begin CHARACTERISTIC DFES_GrpRpr.DFC_LinMsgTimeoutErrAEV_C "common MIL debouncing / group representative for common MIL debouncing of DFC_LinMsgTimeoutErrAEV" VALUE 0x80504C6C Val_Wu16 906.000000000 DFC_Verb 0.00 906.000000000 FORMAT "%13.9" /end CHARACTERISTIC
/begin CHARACTERISTIC DFES_GrpRpr.DFC_LinMsgTimeoutErrDCDC_C "common MIL debouncing / group representative for common MIL debouncing of DFC_LinMsgTimeoutErrDCDC" VALUE 0x80504C6E Val_Wu16 906.000000000 DFC_Verb 0.00 906.000000000 FORMAT "%13.9" /end CHARACTERISTIC
/begin CHARACTERISTIC DFES_GrpRpr.DFC_LinMsgTimeoutErrEBS_C "common MIL debouncing / group representative for common MIL debouncing of DFC_LinMsgTimeoutErrEBS" VALUE 0x80504C70 Val_Wu16 906.000000000 DFC_Verb 0.00 906.000000000 FORMAT "%13.9" /end CHARACTERISTIC
/begin CHARACTERISTIC DFES_GrpRpr.DFC_LinNoStrtComErr_C "common MIL debouncing / group representative for common MIL debouncing of DFC_LinNoStrtComErr" VALUE 0x80504C72 Val_Wu16 906.000000000 DFC_Verb 0.00 906.000000000 FORMAT "%13.9" /end CHARACTERISTIC
/begin CHARACTERISTIC DFES_GrpRpr.DFC_LowPresOilP_C "common MIL debouncing / group representative for common MIL debouncing of DFC_LowPresOilP" VALUE 0x80504C74 Val_Wu16 906.000000000 DFC_Verb 0.00 906.000000000 FORMAT "%13.9" /end CHARACTERISTIC
/begin CHARACTERISTIC DFES_GrpRpr.DFC_MisfDetVWhlFrntLeOORHi_C "common MIL debouncing / group representative for common MIL debouncing of DFC_MisfDetVWhlFrntLeOORHi" VALUE 0x80504C76 Val_Wu16 906.000000000 DFC_Verb 0.00 906.000000000 FORMAT "%13.9" /end CHARACTERISTIC
/begin CHARACTERISTIC DFES_GrpRpr.DFC_MisfDetVWhlFrntLeRatyHi_C "common MIL debouncing / group representative for common MIL debouncing of DFC_MisfDetVWhlFrntLeRatyHi" VALUE 0x80504C78 Val_Wu16 906.000000000 DFC_Verb 0.00 906.000000000 FORMAT "%13.9" /end CHARACTERISTIC
/begin CHARACTERISTIC DFES_GrpRpr.DFC_MisfDetVWhlFrntLeRatyLo_C "common MIL debouncing / group representative for common MIL debouncing of DFC_MisfDetVWhlFrntLeRatyLo" VALUE 0x80504C7A Val_Wu16 906.000000000 DFC_Verb 0.00 906.000000000 FORMAT "%13.9" /end CHARACTERISTIC
/begin CHARACTERISTIC DFES_GrpRpr.DFC_MisfDetVWhlFrntLeStuck_C "common MIL debouncing / group representative for common MIL debouncing of DFC_MisfDetVWhlFrntLeStuck" VALUE 0x80504C7C Val_Wu16 906.000000000 DFC_Verb 0.00 906.000000000 FORMAT "%13.9" /end CHARACTERISTIC
/begin CHARACTERISTIC DFES_GrpRpr.DFC_MisfDetVWhlFrntRiOORHi_C "common MIL debouncing / group representative for common MIL debouncing of DFC_MisfDetVWhlFrntRiOORHi" VALUE 0x80504C7E Val_Wu16 906.000000000 DFC_Verb 0.00 906.000000000 FORMAT "%13.9" /end CHARACTERISTIC
/begin CHARACTERISTIC DFES_GrpRpr.DFC_MisfDetVWhlFrntRiRatyHi_C "common MIL debouncing / group representative for common MIL debouncing of DFC_MisfDetVWhlFrntRiRatyHi" VALUE 0x80504C80 Val_Wu16 906.000000000 DFC_Verb 0.00 906.000000000 FORMAT "%13.9" /end CHARACTERISTIC
/begin CHARACTERISTIC DFES_GrpRpr.DFC_MisfDetVWhlFrntRiRatyLo_C "common MIL debouncing / group representative for common MIL debouncing of DFC_MisfDetVWhlFrntRiRatyLo" VALUE 0x80504C82 Val_Wu16 906.000000000 DFC_Verb 0.00 906.000000000 FORMAT "%13.9" /end CHARACTERISTIC
/begin CHARACTERISTIC DFES_GrpRpr.DFC_MisfDetVWhlFrntRiStuck_C "common MIL debouncing / group representative for common MIL debouncing of DFC_MisfDetVWhlFrntRiStuck" VALUE 0x80504C84 Val_Wu16 906.000000000 DFC_Verb 0.00 906.000000000 FORMAT "%13.9" /end CHARACTERISTIC
/begin CHARACTERISTIC DFES_GrpRpr.DFC_MisfDetVWhlReLeOORHi_C "common MIL debouncing / group representative for common MIL debouncing of DFC_MisfDetVWhlReLeOORHi" VALUE 0x80504C86 Val_Wu16 906.000000000 DFC_Verb 0.00 906.000000000 FORMAT "%13.9" /end CHARACTERISTIC
/begin CHARACTERISTIC DFES_GrpRpr.DFC_MisfDetVWhlReLeRatyHi_C "common MIL debouncing / group representative for common MIL debouncing of DFC_MisfDetVWhlReLeRatyHi" VALUE 0x80504C88 Val_Wu16 906.000000000 DFC_Verb 0.00 906.000000000 FORMAT "%13.9" /end CHARACTERISTIC
/begin CHARACTERISTIC DFES_GrpRpr.DFC_MisfDetVWhlReLeRatyLo_C "common MIL debouncing / group representative for common MIL debouncing of DFC_MisfDetVWhlReLeRatyLo" VALUE 0x80504C8A Val_Wu16 906.000000000 DFC_Verb 0.00 906.000000000 FORMAT "%13.9" /end CHARACTERISTIC
/begin CHARACTERISTIC DFES_GrpRpr.DFC_MisfDetVWhlReLeStuck_C "common MIL debouncing / group representative for common MIL debouncing of DFC_MisfDetVWhlReLeStuck" VALUE 0x80504C8C Val_Wu16 906.000000000 DFC_Verb 0.00 906.000000000 FORMAT "%13.9" /end CHARACTERISTIC
/begin CHARACTERISTIC DFES_GrpRpr.DFC_MisfDetVWhlReRiOORHi_C "common MIL debouncing / group representative for common MIL debouncing of DFC_MisfDetVWhlReRiOORHi" VALUE 0x80504C8E Val_Wu16 906.000000000 DFC_Verb 0.00 906.000000000 FORMAT "%13.9" /end CHARACTERISTIC
/begin CHARACTERISTIC DFES_GrpRpr.DFC_MisfDetVWhlReRiRatyHi_C "common MIL debouncing / group representative for common MIL debouncing of DFC_MisfDetVWhlReRiRatyHi" VALUE 0x80504C90 Val_Wu16 906.000000000 DFC_Verb 0.00 906.000000000 FORMAT "%13.9" /end CHARACTERISTIC
/begin CHARACTERISTIC DFES_GrpRpr.DFC_MisfDetVWhlReRiRatyLo_C "common MIL debouncing / group representative for common MIL debouncing of DFC_MisfDetVWhlReRiRatyLo" VALUE 0x80504C92 Val_Wu16 906.000000000 DFC_Verb 0.00 906.000000000 FORMAT "%13.9" /end CHARACTERISTIC
/begin CHARACTERISTIC DFES_GrpRpr.DFC_MisfDetVWhlReRiStuck_C "common MIL debouncing / group representative for common MIL debouncing of DFC_MisfDetVWhlReRiStuck" VALUE 0x80504C94 Val_Wu16 906.000000000 DFC_Verb 0.00 906.000000000 FORMAT "%13.9" /end CHARACTERISTIC
/begin CHARACTERISTIC DFES_GrpRpr.DFC_MisfDetdVWhlFrntLePlaus_C "common MIL debouncing / group representative for common MIL debouncing of DFC_MisfDetdVWhlFrntLePlaus" VALUE 0x80504C96 Val_Wu16 906.000000000 DFC_Verb 0.00 906.000000000 FORMAT "%13.9" /end CHARACTERISTIC
/begin CHARACTERISTIC DFES_GrpRpr.DFC_MisfDetdVWhlFrntRiPlaus_C "common MIL debouncing / group representative for common MIL debouncing of DFC_MisfDetdVWhlFrntRiPlaus" VALUE 0x80504C98 Val_Wu16 906.000000000 DFC_Verb 0.00 906.000000000 FORMAT "%13.9" /end CHARACTERISTIC
/begin CHARACTERISTIC DFES_GrpRpr.DFC_MisfDetdVWhlReLePlaus_C "common MIL debouncing / group representative for common MIL debouncing of DFC_MisfDetdVWhlReLePlaus" VALUE 0x80504C9A Val_Wu16 906.000000000 DFC_Verb 0.00 906.000000000 FORMAT "%13.9" /end CHARACTERISTIC
/begin CHARACTERISTIC DFES_GrpRpr.DFC_MisfDetdVWhlReRiPlaus_C "common MIL debouncing / group representative for common MIL debouncing of DFC_MisfDetdVWhlReRiPlaus" VALUE 0x80504C9C Val_Wu16 906.000000000 DFC_Verb 0.00 906.000000000 FORMAT "%13.9" /end CHARACTERISTIC
/begin CHARACTERISTIC DFES_GrpRpr.DFC_PEnvSigRngMax_C "common MIL debouncing / group representative for common MIL debouncing of DFC_PEnvSigRngMax" VALUE 0x80504C9E Val_Wu16 906.000000000 DFC_Verb 0.00 906.000000000 FORMAT "%13.9" /end CHARACTERISTIC
/begin CHARACTERISTIC DFES_GrpRpr.DFC_PEnvSigRngMin_C "common MIL debouncing / group representative for common MIL debouncing of DFC_PEnvSigRngMin" VALUE 0x80504CA0 Val_Wu16 906.000000000 DFC_Verb 0.00 906.000000000 FORMAT "%13.9" /end CHARACTERISTIC
/begin CHARACTERISTIC DFES_GrpRpr.DFC_StmFault_C "common MIL debouncing / group representative for common MIL debouncing of DFC_StmFault" VALUE 0x80504CA2 Val_Wu16 906.000000000 DFC_Verb 0.00 906.000000000 FORMAT "%13.9" /end CHARACTERISTIC
/begin CHARACTERISTIC DFES_GrpRpr.DFC_StrtCtOffPth_C "common MIL debouncing / group representative for common MIL debouncing of DFC_StrtCtOffPth" VALUE 0x80504CA4 Val_Wu16 906.000000000 DFC_Verb 0.00 906.000000000 FORMAT "%13.9" /end CHARACTERISTIC
/begin CHARACTERISTIC DFES_GrpRpr.DFC_StrtCtlErr_C "common MIL debouncing / group representative for common MIL debouncing of DFC_StrtCtlErr" VALUE 0x80504CA6 Val_Wu16 906.000000000 DFC_Verb 0.00 906.000000000 FORMAT "%13.9" /end CHARACTERISTIC
/begin CHARACTERISTIC DFES_GrpRpr.DFC_StrtFault_C "common MIL debouncing / group representative for common MIL debouncing of DFC_StrtFault" VALUE 0x80504CA8 Val_Wu16 906.000000000 DFC_Verb 0.00 906.000000000 FORMAT "%13.9" /end CHARACTERISTIC
/begin CHARACTERISTIC DFES_GrpRpr.DFC_StrtLckJudg1_C "common MIL debouncing / group representative for common MIL debouncing of DFC_StrtLckJudg1" VALUE 0x80504CAA Val_Wu16 906.000000000 DFC_Verb 0.00 906.000000000 FORMAT "%13.9" /end CHARACTERISTIC
/begin CHARACTERISTIC DFES_GrpRpr.DFC_StrtLckJudg2_C "common MIL debouncing / group representative for common MIL debouncing of DFC_StrtLckJudg2" VALUE 0x80504CAC Val_Wu16 906.000000000 DFC_Verb 0.00 906.000000000 FORMAT "%13.9" /end CHARACTERISTIC
/begin CHARACTERISTIC DFES_GrpRpr.DFC_StrtOL_C "common MIL debouncing / group representative for common MIL debouncing of DFC_StrtOL" VALUE 0x80504CAE Val_Wu16 906.000000000 DFC_Verb 0.00 906.000000000 FORMAT "%13.9" /end CHARACTERISTIC
/begin CHARACTERISTIC DFES_GrpRpr.DFC_StrtOL2_C "common MIL debouncing / group representative for common MIL debouncing of DFC_StrtOL2" VALUE 0x80504CB0 Val_Wu16 906.000000000 DFC_Verb 0.00 906.000000000 FORMAT "%13.9" /end CHARACTERISTIC
/begin CHARACTERISTIC DFES_GrpRpr.DFC_StrtSCB_C "common MIL debouncing / group representative for common MIL debouncing of DFC_StrtSCB" VALUE 0x80504CB2 Val_Wu16 906.000000000 DFC_Verb 0.00 906.000000000 FORMAT "%13.9" /end CHARACTERISTIC
/begin CHARACTERISTIC DFES_GrpRpr.DFC_StrtSCB2_C "common MIL debouncing / group representative for common MIL debouncing of DFC_StrtSCB2" VALUE 0x80504CB4 Val_Wu16 906.000000000 DFC_Verb 0.00 906.000000000 FORMAT "%13.9" /end CHARACTERISTIC
/begin CHARACTERISTIC DFES_GrpRpr.DFC_StrtSCG_C "common MIL debouncing / group representative for common MIL debouncing of DFC_StrtSCG" VALUE 0x80504CB6 Val_Wu16 906.000000000 DFC_Verb 0.00 906.000000000 FORMAT "%13.9" /end CHARACTERISTIC
/begin CHARACTERISTIC DFES_GrpRpr.DFC_StrtSCG2_C "common MIL debouncing / group representative for common MIL debouncing of DFC_StrtSCG2" VALUE 0x80504CB8 Val_Wu16 906.000000000 DFC_Verb 0.00 906.000000000 FORMAT "%13.9" /end CHARACTERISTIC
/begin CHARACTERISTIC DFES_GrpRpr.DFC_StrtStkRly1_C "common MIL debouncing / group representative for common MIL debouncing of DFC_StrtStkRly1" VALUE 0x80504CBA Val_Wu16 906.000000000 DFC_Verb 0.00 906.000000000 FORMAT "%13.9" /end CHARACTERISTIC
/begin CHARACTERISTIC DFES_GrpRpr.DFC_StrtStkRly2_C "common MIL debouncing / group representative for common MIL debouncing of DFC_StrtStkRly2" VALUE 0x80504CBC Val_Wu16 906.000000000 DFC_Verb 0.00 906.000000000 FORMAT "%13.9" /end CHARACTERISTIC
/begin CHARACTERISTIC DFES_GrpRpr.DFC_TEVEmax_C "common MIL debouncing / group representative for common MIL debouncing of DFC_TEVEmax" VALUE 0x80504CBE Val_Wu16 906.000000000 DFC_Verb 0.00 906.000000000 FORMAT "%13.9" /end CHARACTERISTIC
/begin CHARACTERISTIC DFES_GrpRpr.DFC_TEVEmin_C "common MIL debouncing / group representative for common MIL debouncing of DFC_TEVEmin" VALUE 0x80504CC0 Val_Wu16 906.000000000 DFC_Verb 0.00 906.000000000 FORMAT "%13.9" /end CHARACTERISTIC
/begin CHARACTERISTIC DFES_GrpRpr.DFC_TEVEsig_C "common MIL debouncing / group representative for common MIL debouncing of DFC_TEVEsig" VALUE 0x80504CC2 Val_Wu16 906.000000000 DFC_Verb 0.00 906.000000000 FORMAT "%13.9" /end CHARACTERISTIC
/begin CHARACTERISTIC DFES_GrpRpr.DFC_UegoHeatrPrfmncLoS1B1_C "common MIL debouncing / group representative for common MIL debouncing of DFC_UegoHeatrPrfmncLoS1B1" VALUE 0x80504CC4 Val_Wu16 906.000000000 DFC_Verb 0.00 906.000000000 FORMAT "%13.9" /end CHARACTERISTIC
/begin CHARACTERISTIC DFES_GrpRpr.DFC_VehVAllPlaus_C "common MIL debouncing / group representative for common MIL debouncing of DFC_VehVAllPlaus" VALUE 0x80504CC6 Val_Wu16 906.000000000 DFC_Verb 0.00 906.000000000 FORMAT "%13.9" /end CHARACTERISTIC
/begin CHARACTERISTIC DFES_GrpRpr.DFC_VehVNCSnsrElecFailr_C "common MIL debouncing / group representative for common MIL debouncing of DFC_VehVNCSnsrElecFailr" VALUE 0x80504CC8 Val_Wu16 906.000000000 DFC_Verb 0.00 906.000000000 FORMAT "%13.9" /end CHARACTERISTIC
/begin CHARACTERISTIC DFES_GrpRpr.DFC_VehVPlausCan_C "common MIL debouncing / group representative for common MIL debouncing of DFC_VehVPlausCan" VALUE 0x80504CCA Val_Wu16 906.000000000 DFC_Verb 0.00 906.000000000 FORMAT "%13.9" /end CHARACTERISTIC
/begin CHARACTERISTIC DFES_GrpRpr.DFC_VehVPlausFco_C "common MIL debouncing / group representative for common MIL debouncing of DFC_VehVPlausFco" VALUE 0x80504CCC Val_Wu16 906.000000000 DFC_Verb 0.00 906.000000000 FORMAT "%13.9" /end CHARACTERISTIC
/begin CHARACTERISTIC DFES_GrpRpr.DFC_VehVPlausPwr_C "common MIL debouncing / group representative for common MIL debouncing of DFC_VehVPlausPwr" VALUE 0x80504CCE Val_Wu16 906.000000000 DFC_Verb 0.00 906.000000000 FORMAT "%13.9" /end CHARACTERISTIC
/begin CHARACTERISTIC DFES_GrpRpr.DFC_VehVPlausV2N_C "common MIL debouncing / group representative for common MIL debouncing of DFC_VehVPlausV2N" VALUE 0x80504CD0 Val_Wu16 906.000000000 DFC_Verb 0.00 906.000000000 FORMAT "%13.9" /end CHARACTERISTIC
/begin CHARACTERISTIC DFES_GrpRpr.DFC_VehVSpdSnsrAElecFailr_C "common MIL debouncing / group representative for common MIL debouncing of DFC_VehVSpdSnsrAElecFailr" VALUE 0x80504CD2 Val_Wu16 906.000000000 DFC_Verb 0.00 906.000000000 FORMAT "%13.9" /end CHARACTERISTIC
/begin CHARACTERISTIC DFES_GrpRpr.DFC_VehVSpdSnsrBElecFailr_C "common MIL debouncing / group representative for common MIL debouncing of DFC_VehVSpdSnsrBElecFailr" VALUE 0x80504CD4 Val_Wu16 906.000000000 DFC_Verb 0.00 906.000000000 FORMAT "%13.9" /end CHARACTERISTIC
/begin CHARACTERISTIC DFES_GrpRpr.DFC_ClthMax_C "common MIL debouncing / group representative for common MIL debouncing of DFC_ClthMax" VALUE 0x80504CD6 Val_Wu16 906.000000000 DFC_Verb 0.00 906.000000000 FORMAT "%13.9" /end CHARACTERISTIC
/begin CHARACTERISTIC DFES_GrpRpr.DFC_IgnClPs_DevComErr_C "common MIL debouncing / group representative for common MIL debouncing of DFC_IgnClPs_DevComErr" VALUE 0x80504CD8 Val_Wu16 906.000000000 DFC_Verb 0.00 906.000000000 FORMAT "%13.9" /end CHARACTERISTIC
/begin CHARACTERISTIC DFES_GrpRpr.DFC_IgnClPs_LineOl_0_C "common MIL debouncing / group representative for common MIL debouncing of DFC_IgnClPs_LineOl_0" VALUE 0x80504CDA Val_Wu16 906.000000000 DFC_Verb 0.00 906.000000000 FORMAT "%13.9" /end CHARACTERISTIC
/begin CHARACTERISTIC DFES_GrpRpr.DFC_IgnClPs_LineOl_1_C "common MIL debouncing / group representative for common MIL debouncing of DFC_IgnClPs_LineOl_1" VALUE 0x80504CDC Val_Wu16 906.000000000 DFC_Verb 0.00 906.000000000 FORMAT "%13.9" /end CHARACTERISTIC
/begin CHARACTERISTIC DFES_GrpRpr.DFC_IgnClPs_LineOl_2_C "common MIL debouncing / group representative for common MIL debouncing of DFC_IgnClPs_LineOl_2" VALUE 0x80504CDE Val_Wu16 906.000000000 DFC_Verb 0.00 906.000000000 FORMAT "%13.9" /end CHARACTERISTIC
/begin CHARACTERISTIC DFES_GrpRpr.DFC_IgnClPs_LineOl_3_C "common MIL debouncing / group representative for common MIL debouncing of DFC_IgnClPs_LineOl_3" VALUE 0x80504CE0 Val_Wu16 906.000000000 DFC_Verb 0.00 906.000000000 FORMAT "%13.9" /end CHARACTERISTIC
/begin CHARACTERISTIC DFES_GrpRpr.DFC_IgnClPs_LineScb_0_C "common MIL debouncing / group representative for common MIL debouncing of DFC_IgnClPs_LineScb_0" VALUE 0x80504CE2 Val_Wu16 906.000000000 DFC_Verb 0.00 906.000000000 FORMAT "%13.9" /end CHARACTERISTIC
/begin CHARACTERISTIC DFES_GrpRpr.DFC_IgnClPs_LineScb_1_C "common MIL debouncing / group representative for common MIL debouncing of DFC_IgnClPs_LineScb_1" VALUE 0x80504CE4 Val_Wu16 906.000000000 DFC_Verb 0.00 906.000000000 FORMAT "%13.9" /end CHARACTERISTIC
/begin CHARACTERISTIC DFES_GrpRpr.DFC_IgnClPs_LineScb_2_C "common MIL debouncing / group representative for common MIL debouncing of DFC_IgnClPs_LineScb_2" VALUE 0x80504CE6 Val_Wu16 906.000000000 DFC_Verb 0.00 906.000000000 FORMAT "%13.9" /end CHARACTERISTIC
/begin CHARACTERISTIC DFES_GrpRpr.DFC_IgnClPs_LineScb_3_C "common MIL debouncing / group representative for common MIL debouncing of DFC_IgnClPs_LineScb_3" VALUE 0x80504CE8 Val_Wu16 906.000000000 DFC_Verb 0.00 906.000000000 FORMAT "%13.9" /end CHARACTERISTIC
/begin CHARACTERISTIC DFES_GrpRpr.DFC_IgnClPs_LineScg_0_C "common MIL debouncing / group representative for common MIL debouncing of DFC_IgnClPs_LineScg_0" VALUE 0x80504CEA Val_Wu16 906.000000000 DFC_Verb 0.00 906.000000000 FORMAT "%13.9" /end CHARACTERISTIC
/begin CHARACTERISTIC DFES_GrpRpr.DFC_IgnClPs_LineScg_1_C "common MIL debouncing / group representative for common MIL debouncing of DFC_IgnClPs_LineScg_1" VALUE 0x80504CEC Val_Wu16 906.000000000 DFC_Verb 0.00 906.000000000 FORMAT "%13.9" /end CHARACTERISTIC
/begin CHARACTERISTIC DFES_GrpRpr.DFC_IgnClPs_LineScg_2_C "common MIL debouncing / group representative for common MIL debouncing of DFC_IgnClPs_LineScg_2" VALUE 0x80504CEE Val_Wu16 906.000000000 DFC_Verb 0.00 906.000000000 FORMAT "%13.9" /end CHARACTERISTIC
/begin CHARACTERISTIC DFES_GrpRpr.DFC_IgnClPs_LineScg_3_C "common MIL debouncing / group representative for common MIL debouncing of DFC_IgnClPs_LineScg_3" VALUE 0x80504CF0 Val_Wu16 906.000000000 DFC_Verb 0.00 906.000000000 FORMAT "%13.9" /end CHARACTERISTIC
/begin CHARACTERISTIC DFES_GrpRpr.DFC_KRVEKOEVAB_C "common MIL debouncing / group representative for common MIL debouncing of DFC_KRVEKOEVAB" VALUE 0x80504CF2 Val_Wu16 906.000000000 DFC_Verb 0.00 906.000000000 FORMAT "%13.9" /end CHARACTERISTIC
/begin CHARACTERISTIC DFES_GrpRpr.DFC_KRVEKOEVAB0_C "common MIL debouncing / group representative for common MIL debouncing of DFC_KRVEKOEVAB0" VALUE 0x80504CF4 Val_Wu16 906.000000000 DFC_Verb 0.00 906.000000000 FORMAT "%13.9" /end CHARACTERISTIC
/begin CHARACTERISTIC DFES_GrpRpr.DFC_KRVEKOEVAB1_C "common MIL debouncing / group representative for common MIL debouncing of DFC_KRVEKOEVAB1" VALUE 0x80504CF6 Val_Wu16 906.000000000 DFC_Verb 0.00 906.000000000 FORMAT "%13.9" /end CHARACTERISTIC
/begin CHARACTERISTIC DFES_GrpRpr.DFC_KRVEKOEVAB2_C "common MIL debouncing / group representative for common MIL debouncing of DFC_KRVEKOEVAB2" VALUE 0x80504CF8 Val_Wu16 906.000000000 DFC_Verb 0.00 906.000000000 FORMAT "%13.9" /end CHARACTERISTIC
/begin CHARACTERISTIC DFES_GrpRpr.DFC_KRVEKOEVAB3_C "common MIL debouncing / group representative for common MIL debouncing of DFC_KRVEKOEVAB3" VALUE 0x80504CFA Val_Wu16 906.000000000 DFC_Verb 0.00 906.000000000 FORMAT "%13.9" /end CHARACTERISTIC
/begin CHARACTERISTIC DFES_GrpRpr.DFC_UegoSigEcuAsicS1B1_C "common MIL debouncing / group representative for common MIL debouncing of DFC_UegoSigEcuAsicS1B1" VALUE 0x80504CFC Val_Wu16 906.000000000 DFC_Verb 0.00 906.000000000 FORMAT "%13.9" /end CHARACTERISTIC
/begin CHARACTERISTIC DFES_GrpRpr.DFC_UegoSigEcuComS1B1_C "common MIL debouncing / group representative for common MIL debouncing of DFC_UegoSigEcuComS1B1" VALUE 0x80504CFE Val_Wu16 906.000000000 DFC_Verb 0.00 906.000000000 FORMAT "%13.9" /end CHARACTERISTIC
/begin CHARACTERISTIC DFES_GrpRpr.DFC_UegoSigSnsrS1B1_C "common MIL debouncing / group representative for common MIL debouncing of DFC_UegoSigSnsrS1B1" VALUE 0x80504D00 Val_Wu16 906.000000000 DFC_Verb 0.00 906.000000000 FORMAT "%13.9" /end CHARACTERISTIC
/begin CHARACTERISTIC DFES_GrpRpr.DFC_UegoSigWireOlApesS1B1_C "common MIL debouncing / group representative for common MIL debouncing of DFC_UegoSigWireOlApesS1B1" VALUE 0x80504D02 Val_Wu16 906.000000000 DFC_Verb 0.00 906.000000000 FORMAT "%13.9" /end CHARACTERISTIC
/begin CHARACTERISTIC DFES_GrpRpr.DFC_UegoSigWireOlIpeS1B1_C "common MIL debouncing / group representative for common MIL debouncing of DFC_UegoSigWireOlIpeS1B1" VALUE 0x80504D04 Val_Wu16 906.000000000 DFC_Verb 0.00 906.000000000 FORMAT "%13.9" /end CHARACTERISTIC
/begin CHARACTERISTIC DFES_GrpRpr.DFC_UegoSigWireOlReS1B1_C "common MIL debouncing / group representative for common MIL debouncing of DFC_UegoSigWireOlReS1B1" VALUE 0x80504D06 Val_Wu16 906.000000000 DFC_Verb 0.00 906.000000000 FORMAT "%13.9" /end CHARACTERISTIC
/begin CHARACTERISTIC DFES_GrpRpr.DFC_UegoSigWireRCmpS1B1_C "common MIL debouncing / group representative for common MIL debouncing of DFC_UegoSigWireRCmpS1B1" VALUE 0x80504D08 Val_Wu16 906.000000000 DFC_Verb 0.00 906.000000000 FORMAT "%13.9" /end CHARACTERISTIC
/begin CHARACTERISTIC DFES_GrpRpr.DFC_UegoSigWireScbS1B1_C "common MIL debouncing / group representative for common MIL debouncing of DFC_UegoSigWireScbS1B1" VALUE 0x80504D0A Val_Wu16 906.000000000 DFC_Verb 0.00 906.000000000 FORMAT "%13.9" /end CHARACTERISTIC
/begin CHARACTERISTIC DFES_GrpRpr.DFC_UegoSigWireScgS1B1_C "common MIL debouncing / group representative for common MIL debouncing of DFC_UegoSigWireScgS1B1" VALUE 0x80504D0C Val_Wu16 906.000000000 DFC_Verb 0.00 906.000000000 FORMAT "%13.9" /end CHARACTERISTIC
/begin CHARACTERISTIC DFES_GrpRpr.DFC_AfsPhyRngHiB1_C "common MIL debouncing / group representative for common MIL debouncing of DFC_AfsPhyRngHiB1" VALUE 0x80504D0E Val_Wu16 906.000000000 DFC_Verb 0.00 906.000000000 FORMAT "%13.9" /end CHARACTERISTIC
/begin CHARACTERISTIC DFES_GrpRpr.DFC_AfsPhyRngLoB1_C "common MIL debouncing / group representative for common MIL debouncing of DFC_AfsPhyRngLoB1" VALUE 0x80504D10 Val_Wu16 906.000000000 DFC_Verb 0.00 906.000000000 FORMAT "%13.9" /end CHARACTERISTIC
/begin CHARACTERISTIC DFES_GrpRpr.DFC_AirCCmprOL_C "common MIL debouncing / group representative for common MIL debouncing of DFC_AirCCmprOL" VALUE 0x80504D12 Val_Wu16 906.000000000 DFC_Verb 0.00 906.000000000 FORMAT "%13.9" /end CHARACTERISTIC
/begin CHARACTERISTIC DFES_GrpRpr.DFC_AirCCmprOvrTemp_C "common MIL debouncing / group representative for common MIL debouncing of DFC_AirCCmprOvrTemp" VALUE 0x80504D14 Val_Wu16 906.000000000 DFC_Verb 0.00 906.000000000 FORMAT "%13.9" /end CHARACTERISTIC
/begin CHARACTERISTIC DFES_GrpRpr.DFC_AirCCmprSCB_C "common MIL debouncing / group representative for common MIL debouncing of DFC_AirCCmprSCB" VALUE 0x80504D16 Val_Wu16 906.000000000 DFC_Verb 0.00 906.000000000 FORMAT "%13.9" /end CHARACTERISTIC
/begin CHARACTERISTIC DFES_GrpRpr.DFC_AirCCmprSCG_C "common MIL debouncing / group representative for common MIL debouncing of DFC_AirCCmprSCG" VALUE 0x80504D18 Val_Wu16 906.000000000 DFC_Verb 0.00 906.000000000 FORMAT "%13.9" /end CHARACTERISTIC
/begin CHARACTERISTIC DFES_GrpRpr.DFC_AltErr_C "common MIL debouncing / group representative for common MIL debouncing of DFC_AltErr" VALUE 0x80504D1A Val_Wu16 906.000000000 DFC_Verb 0.00 906.000000000 FORMAT "%13.9" /end CHARACTERISTIC
/begin CHARACTERISTIC DFES_GrpRpr.DFC_BattUSRCMax_C "common MIL debouncing / group representative for common MIL debouncing of DFC_BattUSRCMax" VALUE 0x80504D1C Val_Wu16 906.000000000 DFC_Verb 0.00 906.000000000 FORMAT "%13.9" /end CHARACTERISTIC
/begin CHARACTERISTIC DFES_GrpRpr.DFC_BattUSRCMin_C "common MIL debouncing / group representative for common MIL debouncing of DFC_BattUSRCMin" VALUE 0x80504D1E Val_Wu16 906.000000000 DFC_Verb 0.00 906.000000000 FORMAT "%13.9" /end CHARACTERISTIC
/begin CHARACTERISTIC DFES_GrpRpr.DFC_ComChksTCU1_C "common MIL debouncing / group representative for common MIL debouncing of DFC_ComChksTCU1" VALUE 0x80504D20 Val_Wu16 906.000000000 DFC_Verb 0.00 906.000000000 FORMAT "%13.9" /end CHARACTERISTIC
/begin CHARACTERISTIC DFES_GrpRpr.DFC_ComChksTCU11_C "common MIL debouncing / group representative for common MIL debouncing of DFC_ComChksTCU11" VALUE 0x80504D22 Val_Wu16 906.000000000 DFC_Verb 0.00 906.000000000 FORMAT "%13.9" /end CHARACTERISTIC
/begin CHARACTERISTIC DFES_GrpRpr.DFC_ComChksTCU12_C "common MIL debouncing / group representative for common MIL debouncing of DFC_ComChksTCU12" VALUE 0x80504D24 Val_Wu16 906.000000000 DFC_Verb 0.00 906.000000000 FORMAT "%13.9" /end CHARACTERISTIC
/begin CHARACTERISTIC DFES_GrpRpr.DFC_ComChksTCU13_C "common MIL debouncing / group representative for common MIL debouncing of DFC_ComChksTCU13" VALUE 0x80504D26 Val_Wu16 906.000000000 DFC_Verb 0.00 906.000000000 FORMAT "%13.9" /end CHARACTERISTIC
/begin CHARACTERISTIC DFES_GrpRpr.DFC_ComChksTCU2_C "common MIL debouncing / group representative for common MIL debouncing of DFC_ComChksTCU2" VALUE 0x80504D28 Val_Wu16 906.000000000 DFC_Verb 0.00 906.000000000 FORMAT "%13.9" /end CHARACTERISTIC
/begin CHARACTERISTIC DFES_GrpRpr.DFC_ComChksTCU3_C "common MIL debouncing / group representative for common MIL debouncing of DFC_ComChksTCU3" VALUE 0x80504D2A Val_Wu16 906.000000000 DFC_Verb 0.00 906.000000000 FORMAT "%13.9" /end CHARACTERISTIC
/begin CHARACTERISTIC DFES_GrpRpr.DFC_ComChksTCU4_C "common MIL debouncing / group representative for common MIL debouncing of DFC_ComChksTCU4" VALUE 0x80504D2C Val_Wu16 906.000000000 DFC_Verb 0.00 906.000000000 FORMAT "%13.9" /end CHARACTERISTIC
/begin CHARACTERISTIC DFES_GrpRpr.DFC_ComCntTCU1_C "common MIL debouncing / group representative for common MIL debouncing of DFC_ComCntTCU1" VALUE 0x80504D2E Val_Wu16 906.000000000 DFC_Verb 0.00 906.000000000 FORMAT "%13.9" /end CHARACTERISTIC
/begin CHARACTERISTIC DFES_GrpRpr.DFC_ComCntTCU11_C "common MIL debouncing / group representative for common MIL debouncing of DFC_ComCntTCU11" VALUE 0x80504D30 Val_Wu16 906.000000000 DFC_Verb 0.00 906.000000000 FORMAT "%13.9" /end CHARACTERISTIC
/begin CHARACTERISTIC DFES_GrpRpr.DFC_ComCntTCU12_C "common MIL debouncing / group representative for common MIL debouncing of DFC_ComCntTCU12" VALUE 0x80504D32 Val_Wu16 906.000000000 DFC_Verb 0.00 906.000000000 FORMAT "%13.9" /end CHARACTERISTIC
/begin CHARACTERISTIC DFES_GrpRpr.DFC_ComCntTCU13_C "common MIL debouncing / group representative for common MIL debouncing of DFC_ComCntTCU13" VALUE 0x80504D34 Val_Wu16 906.000000000 DFC_Verb 0.00 906.000000000 FORMAT "%13.9" /end CHARACTERISTIC
/begin CHARACTERISTIC DFES_GrpRpr.DFC_ComCntTCU2_C "common MIL debouncing / group representative for common MIL debouncing of DFC_ComCntTCU2" VALUE 0x80504D36 Val_Wu16 906.000000000 DFC_Verb 0.00 906.000000000 FORMAT "%13.9" /end CHARACTERISTIC
/begin CHARACTERISTIC DFES_GrpRpr.DFC_ComCntTCU3_C "common MIL debouncing / group representative for common MIL debouncing of DFC_ComCntTCU3" VALUE 0x80504D38 Val_Wu16 906.000000000 DFC_Verb 0.00 906.000000000 FORMAT "%13.9" /end CHARACTERISTIC
/begin CHARACTERISTIC DFES_GrpRpr.DFC_ComCntTCU4_C "common MIL debouncing / group representative for common MIL debouncing of DFC_ComCntTCU4" VALUE 0x80504D3A Val_Wu16 906.000000000 DFC_Verb 0.00 906.000000000 FORMAT "%13.9" /end CHARACTERISTIC
/begin CHARACTERISTIC DFES_GrpRpr.DFC_ComTOutTCU01_C "common MIL debouncing / group representative for common MIL debouncing of DFC_ComTOutTCU01" VALUE 0x80504D3C Val_Wu16 906.000000000 DFC_Verb 0.00 906.000000000 FORMAT "%13.9" /end CHARACTERISTIC
/begin CHARACTERISTIC DFES_GrpRpr.DFC_ComTOutTCU02_C "common MIL debouncing / group representative for common MIL debouncing of DFC_ComTOutTCU02" VALUE 0x80504D3E Val_Wu16 906.000000000 DFC_Verb 0.00 906.000000000 FORMAT "%13.9" /end CHARACTERISTIC
/begin CHARACTERISTIC DFES_GrpRpr.DFC_ComTOutTCU1_C "common MIL debouncing / group representative for common MIL debouncing of DFC_ComTOutTCU1" VALUE 0x80504D40 Val_Wu16 906.000000000 DFC_Verb 0.00 906.000000000 FORMAT "%13.9" /end CHARACTERISTIC
/begin CHARACTERISTIC DFES_GrpRpr.DFC_ComTOutTCU11_C "common MIL debouncing / group representative for common MIL debouncing of DFC_ComTOutTCU11" VALUE 0x80504D42 Val_Wu16 906.000000000 DFC_Verb 0.00 906.000000000 FORMAT "%13.9" /end CHARACTERISTIC
/begin CHARACTERISTIC DFES_GrpRpr.DFC_ComTOutTCU12_C "common MIL debouncing / group representative for common MIL debouncing of DFC_ComTOutTCU12" VALUE 0x80504D44 Val_Wu16 906.000000000 DFC_Verb 0.00 906.000000000 FORMAT "%13.9" /end CHARACTERISTIC
/begin CHARACTERISTIC DFES_GrpRpr.DFC_ComTOutTCU13_C "common MIL debouncing / group representative for common MIL debouncing of DFC_ComTOutTCU13" VALUE 0x80504D46 Val_Wu16 906.000000000 DFC_Verb 0.00 906.000000000 FORMAT "%13.9" /end CHARACTERISTIC
/begin CHARACTERISTIC DFES_GrpRpr.DFC_ComTOutTCU14_C "common MIL debouncing / group representative for common MIL debouncing of DFC_ComTOutTCU14" VALUE 0x80504D48 Val_Wu16 906.000000000 DFC_Verb 0.00 906.000000000 FORMAT "%13.9" /end CHARACTERISTIC
/begin CHARACTERISTIC DFES_GrpRpr.DFC_ComTOutTCU2_C "common MIL debouncing / group representative for common MIL debouncing of DFC_ComTOutTCU2" VALUE 0x80504D4A Val_Wu16 906.000000000 DFC_Verb 0.00 906.000000000 FORMAT "%13.9" /end CHARACTERISTIC
/begin CHARACTERISTIC DFES_GrpRpr.DFC_ComTOutTCU3_C "common MIL debouncing / group representative for common MIL debouncing of DFC_ComTOutTCU3" VALUE 0x80504D4C Val_Wu16 906.000000000 DFC_Verb 0.00 906.000000000 FORMAT "%13.9" /end CHARACTERISTIC
/begin CHARACTERISTIC DFES_GrpRpr.DFC_ComTOutTCU4_C "common MIL debouncing / group representative for common MIL debouncing of DFC_ComTOutTCU4" VALUE 0x80504D4E Val_Wu16 906.000000000 DFC_Verb 0.00 906.000000000 FORMAT "%13.9" /end CHARACTERISTIC
/begin CHARACTERISTIC DFES_GrpRpr.DFC_DevLibBattUHi_C "common MIL debouncing / group representative for common MIL debouncing of DFC_DevLibBattUHi" VALUE 0x80504D50 Val_Wu16 906.000000000 DFC_Verb 0.00 906.000000000 FORMAT "%13.9" /end CHARACTERISTIC
/begin CHARACTERISTIC DFES_GrpRpr.DFC_DevLibBattULo_C "common MIL debouncing / group representative for common MIL debouncing of DFC_DevLibBattULo" VALUE 0x80504D52 Val_Wu16 906.000000000 DFC_Verb 0.00 906.000000000 FORMAT "%13.9" /end CHARACTERISTIC
/begin CHARACTERISTIC DFES_GrpRpr.DFC_EGRVlvFailSafeActv_C "common MIL debouncing / group representative for common MIL debouncing of DFC_EGRVlvFailSafeActv" VALUE 0x80504D54 Val_Wu16 906.000000000 DFC_Verb 0.00 906.000000000 FORMAT "%13.9" /end CHARACTERISTIC
/begin CHARACTERISTIC DFES_GrpRpr.DFC_EGRVlvGovDvtCld_C "common MIL debouncing / group representative for common MIL debouncing of DFC_EGRVlvGovDvtCld" VALUE 0x80504D56 Val_Wu16 906.000000000 DFC_Verb 0.00 906.000000000 FORMAT "%13.9" /end CHARACTERISTIC
/begin CHARACTERISTIC DFES_GrpRpr.DFC_EGRVlvPhysSRCMax_C "common MIL debouncing / group representative for common MIL debouncing of DFC_EGRVlvPhysSRCMax" VALUE 0x80504D58 Val_Wu16 906.000000000 DFC_Verb 0.00 906.000000000 FORMAT "%13.9" /end CHARACTERISTIC
/begin CHARACTERISTIC DFES_GrpRpr.DFC_EGRVlvPhysSRCMin_C "common MIL debouncing / group representative for common MIL debouncing of DFC_EGRVlvPhysSRCMin" VALUE 0x80504D5A Val_Wu16 906.000000000 DFC_Verb 0.00 906.000000000 FORMAT "%13.9" /end CHARACTERISTIC
/begin CHARACTERISTIC DFES_GrpRpr.DFC_FanDIOOL_0_C "common MIL debouncing / group representative for common MIL debouncing of DFC_FanDIOOL_0" VALUE 0x80504D5C Val_Wu16 906.000000000 DFC_Verb 0.00 906.000000000 FORMAT "%13.9" /end CHARACTERISTIC
/begin CHARACTERISTIC DFES_GrpRpr.DFC_FanDIOOL_1_C "common MIL debouncing / group representative for common MIL debouncing of DFC_FanDIOOL_1" VALUE 0x80504D5E Val_Wu16 906.000000000 DFC_Verb 0.00 906.000000000 FORMAT "%13.9" /end CHARACTERISTIC
/begin CHARACTERISTIC DFES_GrpRpr.DFC_FanDIOOvrTemp_0_C "common MIL debouncing / group representative for common MIL debouncing of DFC_FanDIOOvrTemp_0" VALUE 0x80504D60 Val_Wu16 906.000000000 DFC_Verb 0.00 906.000000000 FORMAT "%13.9" /end CHARACTERISTIC
/begin CHARACTERISTIC DFES_GrpRpr.DFC_FanDIOOvrTemp_1_C "common MIL debouncing / group representative for common MIL debouncing of DFC_FanDIOOvrTemp_1" VALUE 0x80504D62 Val_Wu16 906.000000000 DFC_Verb 0.00 906.000000000 FORMAT "%13.9" /end CHARACTERISTIC
/begin CHARACTERISTIC DFES_GrpRpr.DFC_FanDIOSCB_0_C "common MIL debouncing / group representative for common MIL debouncing of DFC_FanDIOSCB_0" VALUE 0x80504D64 Val_Wu16 906.000000000 DFC_Verb 0.00 906.000000000 FORMAT "%13.9" /end CHARACTERISTIC
/begin CHARACTERISTIC DFES_GrpRpr.DFC_FanDIOSCB_1_C "common MIL debouncing / group representative for common MIL debouncing of DFC_FanDIOSCB_1" VALUE 0x80504D66 Val_Wu16 906.000000000 DFC_Verb 0.00 906.000000000 FORMAT "%13.9" /end CHARACTERISTIC
/begin CHARACTERISTIC DFES_GrpRpr.DFC_FanDIOSCG_0_C "common MIL debouncing / group representative for common MIL debouncing of DFC_FanDIOSCG_0" VALUE 0x80504D68 Val_Wu16 906.000000000 DFC_Verb 0.00 906.000000000 FORMAT "%13.9" /end CHARACTERISTIC
/begin CHARACTERISTIC DFES_GrpRpr.DFC_FanDIOSCG_1_C "common MIL debouncing / group representative for common MIL debouncing of DFC_FanDIOSCG_1" VALUE 0x80504D6A Val_Wu16 906.000000000 DFC_Verb 0.00 906.000000000 FORMAT "%13.9" /end CHARACTERISTIC
/begin CHARACTERISTIC DFES_GrpRpr.DFC_MRlyDcOL_C "common MIL debouncing / group representative for common MIL debouncing of DFC_MRlyDcOL" VALUE 0x80504D6C Val_Wu16 906.000000000 DFC_Verb 0.00 906.000000000 FORMAT "%13.9" /end CHARACTERISTIC
/begin CHARACTERISTIC DFES_GrpRpr.DFC_MRlyDcSCB_C "common MIL debouncing / group representative for common MIL debouncing of DFC_MRlyDcSCB" VALUE 0x80504D6E Val_Wu16 906.000000000 DFC_Verb 0.00 906.000000000 FORMAT "%13.9" /end CHARACTERISTIC
/begin CHARACTERISTIC DFES_GrpRpr.DFC_MRlyDcSCG_C "common MIL debouncing / group representative for common MIL debouncing of DFC_MRlyDcSCG" VALUE 0x80504D70 Val_Wu16 906.000000000 DFC_Verb 0.00 906.000000000 FORMAT "%13.9" /end CHARACTERISTIC
/begin CHARACTERISTIC DFES_GrpRpr.DFC_PSPOL_C "common MIL debouncing / group representative for common MIL debouncing of DFC_PSPOL" VALUE 0x80504D72 Val_Wu16 906.000000000 DFC_Verb 0.00 906.000000000 FORMAT "%13.9" /end CHARACTERISTIC
/begin CHARACTERISTIC DFES_GrpRpr.DFC_PSPOvrTemp_C "common MIL debouncing / group representative for common MIL debouncing of DFC_PSPOvrTemp" VALUE 0x80504D74 Val_Wu16 906.000000000 DFC_Verb 0.00 906.000000000 FORMAT "%13.9" /end CHARACTERISTIC
/begin CHARACTERISTIC DFES_GrpRpr.DFC_PSPSCB_C "common MIL debouncing / group representative for common MIL debouncing of DFC_PSPSCB" VALUE 0x80504D76 Val_Wu16 906.000000000 DFC_Verb 0.00 906.000000000 FORMAT "%13.9" /end CHARACTERISTIC
/begin CHARACTERISTIC DFES_GrpRpr.DFC_PSPSCG_C "common MIL debouncing / group representative for common MIL debouncing of DFC_PSPSCG" VALUE 0x80504D78 Val_Wu16 906.000000000 DFC_Verb 0.00 906.000000000 FORMAT "%13.9" /end CHARACTERISTIC
/begin CHARACTERISTIC DFES_GrpRpr.DFC_T50Err_C "common MIL debouncing / group representative for common MIL debouncing of DFC_T50Err" VALUE 0x80504D7A Val_Wu16 906.000000000 DFC_Verb 0.00 906.000000000 FORMAT "%13.9" /end CHARACTERISTIC
/begin CHARACTERISTIC DFES_GrpRpr.DFC_ThrVlvLoBattB1_C "common MIL debouncing / group representative for common MIL debouncing of DFC_ThrVlvLoBattB1" VALUE 0x80504D7C Val_Wu16 906.000000000 DFC_Verb 0.00 906.000000000 FORMAT "%13.9" /end CHARACTERISTIC
/begin CHARACTERISTIC DFES_GrpRpr.DFC_UegoSigOperPlausS1B1_C "common MIL debouncing / group representative for common MIL debouncing of DFC_UegoSigOperPlausS1B1" VALUE 0x80504D7E Val_Wu16 906.000000000 DFC_Verb 0.00 906.000000000 FORMAT "%13.9" /end CHARACTERISTIC
/begin CHARACTERISTIC DFES_GrpRpr.DFC_VehVPhysRngHi_C "common MIL debouncing / group representative for common MIL debouncing of DFC_VehVPhysRngHi" VALUE 0x80504D80 Val_Wu16 906.000000000 DFC_Verb 0.00 906.000000000 FORMAT "%13.9" /end CHARACTERISTIC
/begin CHARACTERISTIC DFES_GrpRpr.DFC_VehVSclOutOL_C "common MIL debouncing / group representative for common MIL debouncing of DFC_VehVSclOutOL" VALUE 0x80504D82 Val_Wu16 906.000000000 DFC_Verb 0.00 906.000000000 FORMAT "%13.9" /end CHARACTERISTIC
/begin CHARACTERISTIC DFES_GrpRpr.DFC_VehVSclOutOT_C "common MIL debouncing / group representative for common MIL debouncing of DFC_VehVSclOutOT" VALUE 0x80504D84 Val_Wu16 906.000000000 DFC_Verb 0.00 906.000000000 FORMAT "%13.9" /end CHARACTERISTIC
/begin CHARACTERISTIC DFES_GrpRpr.DFC_VehVSclOutSCB_C "common MIL debouncing / group representative for common MIL debouncing of DFC_VehVSclOutSCB" VALUE 0x80504D86 Val_Wu16 906.000000000 DFC_Verb 0.00 906.000000000 FORMAT "%13.9" /end CHARACTERISTIC
/begin CHARACTERISTIC DFES_GrpRpr.DFC_VehVSclOutSCG_C "common MIL debouncing / group representative for common MIL debouncing of DFC_VehVSclOutSCG" VALUE 0x80504D88 Val_Wu16 906.000000000 DFC_Verb 0.00 906.000000000 FORMAT "%13.9" /end CHARACTERISTIC
/begin CHARACTERISTIC DFES_GrpRpr.DFC_VehVSigFL_C "common MIL debouncing / group representative for common MIL debouncing of DFC_VehVSigFL" VALUE 0x80504D8A Val_Wu16 906.000000000 DFC_Verb 0.00 906.000000000 FORMAT "%13.9" /end CHARACTERISTIC
/begin CHARACTERISTIC DFES_GrpRpr.DFC_VehVSigFR_C "common MIL debouncing / group representative for common MIL debouncing of DFC_VehVSigFR" VALUE 0x80504D8C Val_Wu16 906.000000000 DFC_Verb 0.00 906.000000000 FORMAT "%13.9" /end CHARACTERISTIC
/begin CHARACTERISTIC DFES_GrpRpr.DFC_VehVSigRL_C "common MIL debouncing / group representative for common MIL debouncing of DFC_VehVSigRL" VALUE 0x80504D8E Val_Wu16 906.000000000 DFC_Verb 0.00 906.000000000 FORMAT "%13.9" /end CHARACTERISTIC
/begin CHARACTERISTIC DFES_GrpRpr.DFC_VehVSigRR_C "common MIL debouncing / group representative for common MIL debouncing of DFC_VehVSigRR" VALUE 0x80504D90 Val_Wu16 906.000000000 DFC_Verb 0.00 906.000000000 FORMAT "%13.9" /end CHARACTERISTIC
/begin CHARACTERISTIC DFES_GrpRpr.DFC_VehVSnsrARngHi_C "common MIL debouncing / group representative for common MIL debouncing of DFC_VehVSnsrARngHi" VALUE 0x80504D92 Val_Wu16 906.000000000 DFC_Verb 0.00 906.000000000 FORMAT "%13.9" /end CHARACTERISTIC
/begin CHARACTERISTIC DFES_GrpRpr.DFC_VehVSnsrBRngHi_C "common MIL debouncing / group representative for common MIL debouncing of DFC_VehVSnsrBRngHi" VALUE 0x80504D94 Val_Wu16 906.000000000 DFC_Verb 0.00 906.000000000 FORMAT "%13.9" /end CHARACTERISTIC
/begin CHARACTERISTIC DFES_GrpRpr.DFC_VehVSpdRtyDiag_C "common MIL debouncing / group representative for common MIL debouncing of DFC_VehVSpdRtyDiag" VALUE 0x80504D96 Val_Wu16 906.000000000 DFC_Verb 0.00 906.000000000 FORMAT "%13.9" /end CHARACTERISTIC
/begin CHARACTERISTIC DFES_GrpRpr.DFC_DHFHD_C "common MIL debouncing / group representative for common MIL debouncing of DFC_DHFHD" VALUE 0x80504D98 Val_Wu16 906.000000000 DFC_Verb 0.00 906.000000000 FORMAT "%13.9" /end CHARACTERISTIC
/begin CHARACTERISTIC DFES_GrpRpr.DFC_InjVlv_DI_DcDc_C "common MIL debouncing / group representative for common MIL debouncing of DFC_InjVlv_DI_DcDc" VALUE 0x80504D9A Val_Wu16 906.000000000 DFC_Verb 0.00 906.000000000 FORMAT "%13.9" /end CHARACTERISTIC
/begin CHARACTERISTIC DFES_GrpRpr.DFC_InjVlv_DI_NoLd_0_C "common MIL debouncing / group representative for common MIL debouncing of DFC_InjVlv_DI_NoLd_0" VALUE 0x80504D9C Val_Wu16 906.000000000 DFC_Verb 0.00 906.000000000 FORMAT "%13.9" /end CHARACTERISTIC
/begin CHARACTERISTIC DFES_GrpRpr.DFC_InjVlv_DI_NoLd_1_C "common MIL debouncing / group representative for common MIL debouncing of DFC_InjVlv_DI_NoLd_1" VALUE 0x80504D9E Val_Wu16 906.000000000 DFC_Verb 0.00 906.000000000 FORMAT "%13.9" /end CHARACTERISTIC
/begin CHARACTERISTIC DFES_GrpRpr.DFC_InjVlv_DI_NoLd_2_C "common MIL debouncing / group representative for common MIL debouncing of DFC_InjVlv_DI_NoLd_2" VALUE 0x80504DA0 Val_Wu16 906.000000000 DFC_Verb 0.00 906.000000000 FORMAT "%13.9" /end CHARACTERISTIC
/begin CHARACTERISTIC DFES_GrpRpr.DFC_InjVlv_DI_NoLd_3_C "common MIL debouncing / group representative for common MIL debouncing of DFC_InjVlv_DI_NoLd_3" VALUE 0x80504DA2 Val_Wu16 906.000000000 DFC_Verb 0.00 906.000000000 FORMAT "%13.9" /end CHARACTERISTIC
/begin CHARACTERISTIC DFES_GrpRpr.DFC_InjVlv_DI_ScBnk_0_C "common MIL debouncing / group representative for common MIL debouncing of DFC_InjVlv_DI_ScBnk_0" VALUE 0x80504DA4 Val_Wu16 906.000000000 DFC_Verb 0.00 906.000000000 FORMAT "%13.9" /end CHARACTERISTIC
/begin CHARACTERISTIC DFES_GrpRpr.DFC_InjVlv_DI_ScBnk_1_C "common MIL debouncing / group representative for common MIL debouncing of DFC_InjVlv_DI_ScBnk_1" VALUE 0x80504DA6 Val_Wu16 906.000000000 DFC_Verb 0.00 906.000000000 FORMAT "%13.9" /end CHARACTERISTIC
/begin CHARACTERISTIC DFES_GrpRpr.DFC_InjVlv_DI_ScBnk_2_C "common MIL debouncing / group representative for common MIL debouncing of DFC_InjVlv_DI_ScBnk_2" VALUE 0x80504DA8 Val_Wu16 906.000000000 DFC_Verb 0.00 906.000000000 FORMAT "%13.9" /end CHARACTERISTIC
/begin CHARACTERISTIC DFES_GrpRpr.DFC_InjVlv_DI_ScBnk_3_C "common MIL debouncing / group representative for common MIL debouncing of DFC_InjVlv_DI_ScBnk_3" VALUE 0x80504DAA Val_Wu16 906.000000000 DFC_Verb 0.00 906.000000000 FORMAT "%13.9" /end CHARACTERISTIC
/begin CHARACTERISTIC DFES_GrpRpr.DFC_InjVlv_DI_ScCyl_0_C "common MIL debouncing / group representative for common MIL debouncing of DFC_InjVlv_DI_ScCyl_0" VALUE 0x80504DAC Val_Wu16 906.000000000 DFC_Verb 0.00 906.000000000 FORMAT "%13.9" /end CHARACTERISTIC
/begin CHARACTERISTIC DFES_GrpRpr.DFC_InjVlv_DI_ScCyl_1_C "common MIL debouncing / group representative for common MIL debouncing of DFC_InjVlv_DI_ScCyl_1" VALUE 0x80504DAE Val_Wu16 906.000000000 DFC_Verb 0.00 906.000000000 FORMAT "%13.9" /end CHARACTERISTIC
/begin CHARACTERISTIC DFES_GrpRpr.DFC_InjVlv_DI_ScCyl_2_C "common MIL debouncing / group representative for common MIL debouncing of DFC_InjVlv_DI_ScCyl_2" VALUE 0x80504DB0 Val_Wu16 906.000000000 DFC_Verb 0.00 906.000000000 FORMAT "%13.9" /end CHARACTERISTIC
/begin CHARACTERISTIC DFES_GrpRpr.DFC_InjVlv_DI_ScCyl_3_C "common MIL debouncing / group representative for common MIL debouncing of DFC_InjVlv_DI_ScCyl_3" VALUE 0x80504DB2 Val_Wu16 906.000000000 DFC_Verb 0.00 906.000000000 FORMAT "%13.9" /end CHARACTERISTIC
/begin CHARACTERISTIC DFES_GrpRpr.DFC_InjVlv_DI_ScHsLs_0_C "common MIL debouncing / group representative for common MIL debouncing of DFC_InjVlv_DI_ScHsLs_0" VALUE 0x80504DB4 Val_Wu16 906.000000000 DFC_Verb 0.00 906.000000000 FORMAT "%13.9" /end CHARACTERISTIC
/begin CHARACTERISTIC DFES_GrpRpr.DFC_InjVlv_DI_ScHsLs_1_C "common MIL debouncing / group representative for common MIL debouncing of DFC_InjVlv_DI_ScHsLs_1" VALUE 0x80504DB6 Val_Wu16 906.000000000 DFC_Verb 0.00 906.000000000 FORMAT "%13.9" /end CHARACTERISTIC
/begin CHARACTERISTIC DFES_GrpRpr.DFC_InjVlv_DI_ScHsLs_2_C "common MIL debouncing / group representative for common MIL debouncing of DFC_InjVlv_DI_ScHsLs_2" VALUE 0x80504DB8 Val_Wu16 906.000000000 DFC_Verb 0.00 906.000000000 FORMAT "%13.9" /end CHARACTERISTIC
/begin CHARACTERISTIC DFES_GrpRpr.DFC_InjVlv_DI_ScHsLs_3_C "common MIL debouncing / group representative for common MIL debouncing of DFC_InjVlv_DI_ScHsLs_3" VALUE 0x80504DBA Val_Wu16 906.000000000 DFC_Verb 0.00 906.000000000 FORMAT "%13.9" /end CHARACTERISTIC
/begin CHARACTERISTIC DFES_GrpRpr.DFC_MfPsDiaOpenLoad1_C "common MIL debouncing / group representative for common MIL debouncing of DFC_MfPsDiaOpenLoad1" VALUE 0x80504DBC Val_Wu16 906.000000000 DFC_Verb 0.00 906.000000000 FORMAT "%13.9" /end CHARACTERISTIC
/begin CHARACTERISTIC DFES_GrpRpr.DFC_MfPsDiaScHiS1_C "common MIL debouncing / group representative for common MIL debouncing of DFC_MfPsDiaScHiS1" VALUE 0x80504DBE Val_Wu16 906.000000000 DFC_Verb 0.00 906.000000000 FORMAT "%13.9" /end CHARACTERISTIC
/begin CHARACTERISTIC DFES_GrpRpr.DFC_MfPsDiaScHiSLowS1_C "common MIL debouncing / group representative for common MIL debouncing of DFC_MfPsDiaScHiSLowS1" VALUE 0x80504DC0 Val_Wu16 906.000000000 DFC_Verb 0.00 906.000000000 FORMAT "%13.9" /end CHARACTERISTIC
/begin CHARACTERISTIC DFES_GrpRpr.DFC_MfPsDiaScLowS1_C "common MIL debouncing / group representative for common MIL debouncing of DFC_MfPsDiaScLowS1" VALUE 0x80504DC2 Val_Wu16 906.000000000 DFC_Verb 0.00 906.000000000 FORMAT "%13.9" /end CHARACTERISTIC
/begin CHARACTERISTIC DFES_GrpRpr.DFC_ACEvpTPhysRngHi_C "common MIL debouncing / group representative for common MIL debouncing of DFC_ACEvpTPhysRngHi" VALUE 0x80504DC4 Val_Wu16 906.000000000 DFC_Verb 0.00 906.000000000 FORMAT "%13.9" /end CHARACTERISTIC
/begin CHARACTERISTIC DFES_GrpRpr.DFC_ACEvpTPhysRngLo_C "common MIL debouncing / group representative for common MIL debouncing of DFC_ACEvpTPhysRngLo" VALUE 0x80504DC6 Val_Wu16 906.000000000 DFC_Verb 0.00 906.000000000 FORMAT "%13.9" /end CHARACTERISTIC
/begin CHARACTERISTIC DFES_GrpRpr.DFC_ACEvpTSRCMax_C "common MIL debouncing / group representative for common MIL debouncing of DFC_ACEvpTSRCMax" VALUE 0x80504DC8 Val_Wu16 906.000000000 DFC_Verb 0.00 906.000000000 FORMAT "%13.9" /end CHARACTERISTIC
/begin CHARACTERISTIC DFES_GrpRpr.DFC_ACEvpTSRCMin_C "common MIL debouncing / group representative for common MIL debouncing of DFC_ACEvpTSRCMin" VALUE 0x80504DCA Val_Wu16 906.000000000 DFC_Verb 0.00 906.000000000 FORMAT "%13.9" /end CHARACTERISTIC
/begin CHARACTERISTIC DFES_GrpRpr.DFC_AfsRawSigRngHiB1_C "common MIL debouncing / group representative for common MIL debouncing of DFC_AfsRawSigRngHiB1" VALUE 0x80504DCC Val_Wu16 906.000000000 DFC_Verb 0.00 906.000000000 FORMAT "%13.9" /end CHARACTERISTIC
/begin CHARACTERISTIC DFES_GrpRpr.DFC_AfsRawSigRngLoB1_C "common MIL debouncing / group representative for common MIL debouncing of DFC_AfsRawSigRngLoB1" VALUE 0x80504DCE Val_Wu16 906.000000000 DFC_Verb 0.00 906.000000000 FORMAT "%13.9" /end CHARACTERISTIC
/begin CHARACTERISTIC DFES_GrpRpr.DFC_AfsSnsrErrB1_C "common MIL debouncing / group representative for common MIL debouncing of DFC_AfsSnsrErrB1" VALUE 0x80504DD0 Val_Wu16 906.000000000 DFC_Verb 0.00 906.000000000 FORMAT "%13.9" /end CHARACTERISTIC
/begin CHARACTERISTIC DFES_GrpRpr.DFC_AirCClntPAnaSRCMax_C "common MIL debouncing / group representative for common MIL debouncing of DFC_AirCClntPAnaSRCMax" VALUE 0x80504DD2 Val_Wu16 906.000000000 DFC_Verb 0.00 906.000000000 FORMAT "%13.9" /end CHARACTERISTIC
/begin CHARACTERISTIC DFES_GrpRpr.DFC_AirCClntPAnaSRCMin_C "common MIL debouncing / group representative for common MIL debouncing of DFC_AirCClntPAnaSRCMin" VALUE 0x80504DD4 Val_Wu16 906.000000000 DFC_Verb 0.00 906.000000000 FORMAT "%13.9" /end CHARACTERISTIC
/begin CHARACTERISTIC DFES_GrpRpr.DFC_AirCSwtNpl_C "common MIL debouncing / group representative for common MIL debouncing of DFC_AirCSwtNpl" VALUE 0x80504DD6 Val_Wu16 906.000000000 DFC_Verb 0.00 906.000000000 FORMAT "%13.9" /end CHARACTERISTIC
/begin CHARACTERISTIC DFES_GrpRpr.DFC_AirCSwtSig_C "common MIL debouncing / group representative for common MIL debouncing of DFC_AirCSwtSig" VALUE 0x80504DD8 Val_Wu16 906.000000000 DFC_Verb 0.00 906.000000000 FORMAT "%13.9" /end CHARACTERISTIC
/begin CHARACTERISTIC DFES_GrpRpr.DFC_Brk_C "common MIL debouncing / group representative for common MIL debouncing of DFC_Brk" VALUE 0x80504DDA Val_Wu16 906.000000000 DFC_Verb 0.00 906.000000000 FORMAT "%13.9" /end CHARACTERISTIC
/begin CHARACTERISTIC DFES_GrpRpr.DFC_BrkBstSensSCB_C "common MIL debouncing / group representative for common MIL debouncing of DFC_BrkBstSensSCB" VALUE 0x80504DDC Val_Wu16 906.000000000 DFC_Verb 0.00 906.000000000 FORMAT "%13.9" /end CHARACTERISTIC
/begin CHARACTERISTIC DFES_GrpRpr.DFC_BrkBstSensSCG_C "common MIL debouncing / group representative for common MIL debouncing of DFC_BrkBstSensSCG" VALUE 0x80504DDE Val_Wu16 906.000000000 DFC_Verb 0.00 906.000000000 FORMAT "%13.9" /end CHARACTERISTIC
/begin CHARACTERISTIC DFES_GrpRpr.DFC_BrkSig_C "common MIL debouncing / group representative for common MIL debouncing of DFC_BrkSig" VALUE 0x80504DE0 Val_Wu16 906.000000000 DFC_Verb 0.00 906.000000000 FORMAT "%13.9" /end CHARACTERISTIC
/begin CHARACTERISTIC DFES_GrpRpr.DFC_ClthSig_C "common MIL debouncing / group representative for common MIL debouncing of DFC_ClthSig" VALUE 0x80504DE2 Val_Wu16 906.000000000 DFC_Verb 0.00 906.000000000 FORMAT "%13.9" /end CHARACTERISTIC
/begin CHARACTERISTIC DFES_GrpRpr.DFC_EGRVlvCurrLim_C "common MIL debouncing / group representative for common MIL debouncing of DFC_EGRVlvCurrLim" VALUE 0x80504DE4 Val_Wu16 906.000000000 DFC_Verb 0.00 906.000000000 FORMAT "%13.9" /end CHARACTERISTIC
/begin CHARACTERISTIC DFES_GrpRpr.DFC_EGRVlvOL_C "common MIL debouncing / group representative for common MIL debouncing of DFC_EGRVlvOL" VALUE 0x80504DE6 Val_Wu16 906.000000000 DFC_Verb 0.00 906.000000000 FORMAT "%13.9" /end CHARACTERISTIC
/begin CHARACTERISTIC DFES_GrpRpr.DFC_EGRVlvOvrTemp_C "common MIL debouncing / group representative for common MIL debouncing of DFC_EGRVlvOvrTemp" VALUE 0x80504DE8 Val_Wu16 906.000000000 DFC_Verb 0.00 906.000000000 FORMAT "%13.9" /end CHARACTERISTIC
/begin CHARACTERISTIC DFES_GrpRpr.DFC_EGRVlvSCB_C "common MIL debouncing / group representative for common MIL debouncing of DFC_EGRVlvSCB" VALUE 0x80504DEA Val_Wu16 906.000000000 DFC_Verb 0.00 906.000000000 FORMAT "%13.9" /end CHARACTERISTIC
/begin CHARACTERISTIC DFES_GrpRpr.DFC_EGRVlvSCG_C "common MIL debouncing / group representative for common MIL debouncing of DFC_EGRVlvSCG" VALUE 0x80504DEC Val_Wu16 906.000000000 DFC_Verb 0.00 906.000000000 FORMAT "%13.9" /end CHARACTERISTIC
/begin CHARACTERISTIC DFES_GrpRpr.DFC_EGRVlvSRCMax_C "common MIL debouncing / group representative for common MIL debouncing of DFC_EGRVlvSRCMax" VALUE 0x80504DEE Val_Wu16 906.000000000 DFC_Verb 0.00 906.000000000 FORMAT "%13.9" /end CHARACTERISTIC
/begin CHARACTERISTIC DFES_GrpRpr.DFC_EGRVlvSRCMin_C "common MIL debouncing / group representative for common MIL debouncing of DFC_EGRVlvSRCMin" VALUE 0x80504DF0 Val_Wu16 906.000000000 DFC_Verb 0.00 906.000000000 FORMAT "%13.9" /end CHARACTERISTIC
/begin CHARACTERISTIC DFES_GrpRpr.DFC_HLSDemOvhtEngLim_C "common MIL debouncing / group representative for common MIL debouncing of DFC_HLSDemOvhtEngLim" VALUE 0x80504DF2 Val_Wu16 906.000000000 DFC_Verb 0.00 906.000000000 FORMAT "%13.9" /end CHARACTERISTIC
/begin CHARACTERISTIC DFES_GrpRpr.DFC_OilPSwmpSRCMax_C "common MIL debouncing / group representative for common MIL debouncing of DFC_OilPSwmpSRCMax" VALUE 0x80504DF4 Val_Wu16 906.000000000 DFC_Verb 0.00 906.000000000 FORMAT "%13.9" /end CHARACTERISTIC
/begin CHARACTERISTIC DFES_GrpRpr.DFC_OilPSwmpSRCMin_C "common MIL debouncing / group representative for common MIL debouncing of DFC_OilPSwmpSRCMin" VALUE 0x80504DF6 Val_Wu16 906.000000000 DFC_Verb 0.00 906.000000000 FORMAT "%13.9" /end CHARACTERISTIC
/begin CHARACTERISTIC DFES_GrpRpr.DFC_PIntkVUsLineHiB1_C "common MIL debouncing / group representative for common MIL debouncing of DFC_PIntkVUsLineHiB1" VALUE 0x80504DF8 Val_Wu16 906.000000000 DFC_Verb 0.00 906.000000000 FORMAT "%13.9" /end CHARACTERISTIC
/begin CHARACTERISTIC DFES_GrpRpr.DFC_PIntkVUsLineLoB1_C "common MIL debouncing / group representative for common MIL debouncing of DFC_PIntkVUsLineLoB1" VALUE 0x80504DFA Val_Wu16 906.000000000 DFC_Verb 0.00 906.000000000 FORMAT "%13.9" /end CHARACTERISTIC
/begin CHARACTERISTIC DFES_GrpRpr.DFC_VehVPhysRngLo_C "common MIL debouncing / group representative for common MIL debouncing of DFC_VehVPhysRngLo" VALUE 0x80504DFC Val_Wu16 906.000000000 DFC_Verb 0.00 906.000000000 FORMAT "%13.9" /end CHARACTERISTIC
/begin CHARACTERISTIC DFES_GrpRpr.DFC_VehVSigCan_C "common MIL debouncing / group representative for common MIL debouncing of DFC_VehVSigCan" VALUE 0x80504DFE Val_Wu16 906.000000000 DFC_Verb 0.00 906.000000000 FORMAT "%13.9" /end CHARACTERISTIC
/begin CHARACTERISTIC DFES_GrpRpr.DFC_VehVSigCanSafe_C "common MIL debouncing / group representative for common MIL debouncing of DFC_VehVSigCanSafe" VALUE 0x80504E00 Val_Wu16 906.000000000 DFC_Verb 0.00 906.000000000 FORMAT "%13.9" /end CHARACTERISTIC
/begin CHARACTERISTIC DFES_GrpRpr.DFC_VlvLftFbOilPSnsrIntk11SRCMax_C "common MIL debouncing / group representative for common MIL debouncing of DFC_VlvLftFbOilPSnsrIntk11SRCMax" VALUE 0x80504E02 Val_Wu16 906.000000000 DFC_Verb 0.00 906.000000000 FORMAT "%13.9" /end CHARACTERISTIC
/begin CHARACTERISTIC DFES_GrpRpr.DFC_VlvLftFbOilPSnsrIntk11SRCMin_C "common MIL debouncing / group representative for common MIL debouncing of DFC_VlvLftFbOilPSnsrIntk11SRCMin" VALUE 0x80504E04 Val_Wu16 906.000000000 DFC_Verb 0.00 906.000000000 FORMAT "%13.9" /end CHARACTERISTIC
/begin CHARACTERISTIC DFES_GrpRpr.DFC_ClthNpl_C "common MIL debouncing / group representative for common MIL debouncing of DFC_ClthNpl" VALUE 0x80504E06 Val_Wu16 906.000000000 DFC_Verb 0.00 906.000000000 FORMAT "%13.9" /end CHARACTERISTIC
/begin FUNCTION DFES "30000.73.0_2.0.0Diagnostic Fault Event Storage"
 /begin DEF_CHARACTERISTIC DFES_FaultTyp.DFC_LMmax_C DFES_FaultTyp.DFC_LZSRnpl_C DFES_FaultTyp.DFC_LamDynDiagS1B1_C DFES_FaultTyp.DFC_LeakIntkMnfldEmiInfl_C DFES_FaultTyp.DFC_LinFrameErrDCDC_C DFES_FaultTyp.DFC_LinOverrunErrDCDC_C DFES_FaultTyp.DFC_MD00max_C DFES_FaultTyp.DFC_MDBmax_C DFES_FaultTyp.DFC_MDCat_C DFES_FaultTyp.DFC_MDCatCrit_C DFES_FaultTyp.DFC_MDCatCurr_C DFES_FaultTyp.DFC_MDCyl_0_C DFES_FaultTyp.DFC_MDCyl_1_C DFES_FaultTyp.DFC_MDCyl_2_C DFES_FaultTyp.DFC_MDCyl_3_C DFES_FaultTyp.DFC_MDEmi_C DFES_FaultTyp.DFC_MDEmiStrt_C DFES_FaultTyp.DFC_MDFco_C DFES_FaultTyp.DFC_MDMpl_C DFES_FaultTyp.DFC_MDSegTiAdpn_C DFES_FaultTyp.DFC_MDmax_C DFES_FaultTyp.DFC_MFuOilMax_C DFES_FaultTyp.DFC_MOXEMM_SMU_ALM0_0_C DFES_FaultTyp.DFC_MOXEMM_SMU_ALM0_1_C DFES_FaultTyp.DFC_MOXEMM_SMU_ALM0_10_C DFES_FaultTyp.DFC_MOXEMM_SMU_ALM0_11_C DFES_FaultTyp.DFC_MOXEMM_SMU_ALM0_13_C DFES_FaultTyp.DFC_MOXEMM_SMU_ALM0_14_C DFES_FaultTyp.DFC_MOXEMM_SMU_ALM0_2_C DFES_FaultTyp.DFC_MOXEMM_SMU_ALM0_22_C DFES_FaultTyp.DFC_MOXEMM_SMU_ALM0_23_C DFES_FaultTyp.DFC_MOXEMM_SMU_ALM0_4_C DFES_FaultTyp.DFC_MOXEMM_SMU_ALM0_5_C DFES_FaultTyp.DFC_MOXEMM_SMU_ALM0_7_C DFES_FaultTyp.DFC_MOXEMM_SMU_ALM0_8_C DFES_FaultTyp.DFC_MOXEMM_SMU_ALM10_16_C DFES_FaultTyp.DFC_MOXEMM_SMU_ALM10_17_C DFES_FaultTyp.DFC_MOXEMM_SMU_ALM10_21_C DFES_FaultTyp.DFC_MOXEMM_SMU_ALM11_0_C DFES_FaultTyp.DFC_MOXEMM_SMU_ALM11_1_C DFES_FaultTyp.DFC_MOXEMM_SMU_ALM11_2_C DFES_FaultTyp.DFC_MOXEMM_SMU_ALM11_3_C DFES_FaultTyp.DFC_MOXEMM_SMU_ALM11_4_C DFES_FaultTyp.DFC_MOXEMM_SMU_ALM11_5_C DFES_FaultTyp.DFC_MOXEMM_SMU_ALM11_8_C DFES_FaultTyp.DFC_MOXEMM_SMU_ALM11_9_C DFES_FaultTyp.DFC_MOXEMM_SMU_ALM1_0_C DFES_FaultTyp.DFC_MOXEMM_SMU_ALM1_1_C DFES_FaultTyp.DFC_MOXEMM_SMU_ALM1_10_C DFES_FaultTyp.DFC_MOXEMM_SMU_ALM1_11_C DFES_FaultTyp.DFC_MOXEMM_SMU_ALM1_13_C DFES_FaultTyp.DFC_MOXEMM_SMU_ALM1_14_C DFES_FaultTyp.DFC_MOXEMM_SMU_ALM1_2_C DFES_FaultTyp.DFC_MOXEMM_SMU_ALM1_22_C DFES_FaultTyp.DFC_MOXEMM_SMU_ALM1_23_C DFES_FaultTyp.DFC_MOXEMM_SMU_ALM1_4_C DFES_FaultTyp.DFC_MOXEMM_SMU_ALM1_5_C DFES_FaultTyp.DFC_MOXEMM_SMU_ALM1_7_C DFES_FaultTyp.DFC_MOXEMM_SMU_ALM1_8_C DFES_FaultTyp.DFC_MOXEMM_SMU_ALM21_0_C DFES_FaultTyp.DFC_MOXEMM_SMU_ALM21_16_C DFES_FaultTyp.DFC_MOXEMM_SMU_ALM21_3_C DFES_FaultTyp.DFC_MOXEMM_SMU_ALM2_1_C DFES_FaultTyp.DFC_MOXEMM_SMU_ALM2_10_C DFES_FaultTyp.DFC_MOXEMM_SMU_ALM2_11_C DFES_FaultTyp.DFC_MOXEMM_SMU_ALM2_13_C DFES_FaultTyp.DFC_MOXEMM_SMU_ALM2_14_C DFES_FaultTyp.DFC_MOXEMM_SMU_ALM2_22_C DFES_FaultTyp.DFC_MOXEMM_SMU_ALM2_23_C DFES_FaultTyp.DFC_MOXEMM_SMU_ALM2_4_C DFES_FaultTyp.DFC_MOXEMM_SMU_ALM2_5_C DFES_FaultTyp.DFC_MOXEMM_SMU_ALM2_7_C DFES_FaultTyp.DFC_MOXEMM_SMU_ALM2_8_C DFES_FaultTyp.DFC_MOXEMM_SMU_ALM6_0_C DFES_FaultTyp.DFC_MOXEMM_SMU_ALM6_11_C DFES_FaultTyp.DFC_MOXEMM_SMU_ALM6_12_C DFES_FaultTyp.DFC_MOXEMM_SMU_ALM6_14_C DFES_FaultTyp.DFC_MOXEMM_SMU_ALM6_15_C DFES_FaultTyp.DFC_MOXEMM_SMU_ALM6_17_C DFES_FaultTyp.DFC_MOXEMM_SMU_ALM6_18_C DFES_FaultTyp.DFC_MOXEMM_SMU_ALM6_20_C DFES_FaultTyp.DFC_MOXEMM_SMU_ALM6_21_C DFES_FaultTyp.DFC_MOXEMM_SMU_ALM6_25_C DFES_FaultTyp.DFC_MOXEMM_SMU_ALM6_4_C DFES_FaultTyp.DFC_MOXEMM_SMU_ALM6_5_C DFES_FaultTyp.DFC_MOXEMM_SMU_ALM6_7_C DFES_FaultTyp.DFC_MOXEMM_SMU_ALM6_8_C DFES_FaultTyp.DFC_MOXEMM_SMU_ALM7_1_C DFES_FaultTyp.DFC_MOXEMM_SMU_ALM7_12_C DFES_FaultTyp.DFC_MOXEMM_SMU_ALM7_13_C DFES_FaultTyp.DFC_MOXEMM_SMU_ALM7_14_C DFES_FaultTyp.DFC_MOXEMM_SMU_ALM7_15_C DFES_FaultTyp.DFC_MOXEMM_SMU_ALM7_16_C DFES_FaultTyp.DFC_MOXEMM_SMU_ALM7_17_C DFES_FaultTyp.DFC_MOXEMM_SMU_ALM7_2_C DFES_FaultTyp.DFC_MOXEMM_SMU_ALM7_20_C DFES_FaultTyp.DFC_MOXEMM_SMU_ALM7_25_C DFES_FaultTyp.DFC_MOXEMM_SMU_ALM7_26_C DFES_FaultTyp.DFC_MOXEMM_SMU_ALM7_28_C DFES_FaultTyp.DFC_MOXEMM_SMU_ALM7_29_C DFES_FaultTyp.DFC_MOXEMM_SMU_ALM7_30_C DFES_FaultTyp.DFC_MOXEMM_SMU_ALM7_31_C DFES_FaultTyp.DFC_MOXEMM_SMU_ALM8_0_C DFES_FaultTyp.DFC_MOXEMM_SMU_ALM8_1_C DFES_FaultTyp.DFC_MOXEMM_SMU_ALM8_10_C DFES_FaultTyp.DFC_MOXEMM_SMU_ALM8_11_C DFES_FaultTyp.DFC_MOXEMM_SMU_ALM8_12_C DFES_FaultTyp.DFC_MOXEMM_SMU_ALM8_16_C DFES_FaultTyp.DFC_MOXEMM_SMU_ALM8_18_C DFES_FaultTyp.DFC_MOXEMM_SMU_ALM8_2_C DFES_FaultTyp.DFC_MOXEMM_SMU_ALM8_3_C DFES_FaultTyp.DFC_MOXEMM_SMU_ALM8_31_C DFES_FaultTyp.DFC_MOXEMM_SMU_ALM8_4_C DFES_FaultTyp.DFC_MOXEMM_SMU_ALM9_0_C DFES_FaultTyp.DFC_MOXEMM_SMU_ALM9_15_C DFES_FaultTyp.DFC_MOXEMM_SMU_ALM9_3_C DFES_FaultTyp.DFC_MoCADCNTP_C DFES_FaultTyp.DFC_MoCADCTst_C DFES_FaultTyp.DFC_MoCSOPICO_C DFES_FaultTyp.DFC_MoFAPP_C DFES_FaultTyp.DFC_MoFAirFilgPrdc_C DFES_FaultTyp.DFC_MoFAirFlCtOffGdi_C DFES_FaultTyp.DFC_MoFAirFlCylGdi_C DFES_FaultTyp.DFC_MoFAirFlFF_C DFES_FaultTyp.DFC_MoFAirFlIn_C DFES_FaultTyp.DFC_MoFAirFlMixCtlGdiChkAirFl_C DFES_FaultTyp.DFC_MoFAirFlMixCtlGdiChkCtrl_C DFES_FaultTyp.DFC_MoFAirFlMode_C DFES_FaultTyp.DFC_MoFESpd_C DFES_FaultTyp.DFC_MoFIACo_C DFES_FaultTyp.DFC_MoFICOL1_C DFES_FaultTyp.DFC_MoFICOL2_C DFES_FaultTyp.DFC_MoFStrt_C DFES_FaultTyp.DFC_MoFTrqCmp_C DFES_FaultTyp.DFC_MoFTrqCmpMax_C DFES_FaultTyp.DFC_MoFTrqCmpMin_C DFES_FaultTyp.DFC_MoFVarPostBldSel_C DFES_FaultTyp.DFC_MoXEMMHwLTMCUFW_C DFES_FaultTyp.DFC_MoXEMMHwLTMonBIST_C DFES_FaultTyp.DFC_MoXEMMHwLTRegMonTest_C DFES_FaultTyp.DFC_MoXEMMHwLTStbySMUAlvTest_C DFES_FaultTyp.DFC_MoXEMMHwLTTempSens_C DFES_FaultTyp.DFC_MoXEMMHwLTUCBCfg_C DFES_FaultTyp.DFC_NWSEmax_C DFES_FaultTyp.DFC_NWSmax_C DFES_FaultTyp.DFC_OCWDAABEActv_C DFES_FaultTyp.DFC_OCWDACom_C DFES_FaultTyp.DFC_OCWDAErrPin_C DFES_FaultTyp.DFC_OCWDAOvrVltg_C DFES_FaultTyp.DFC_ORAmax_C DFES_FaultTyp.DFC_ORAmin_C DFES_FaultTyp.DFC_OilPPlaus_C DFES_FaultTyp.DFC_PLLSUmax_C DFES_FaultTyp.DFC_PLLSUmin_C DFES_FaultTyp.DFC_PSR1max_C DFES_FaultTyp.DFC_PSRBmax_C DFES_FaultTyp.DFC_PSRBmin_C DFES_FaultTyp.DFC_PSRPmax_C DFES_FaultTyp.DFC_PSRPmin_C DFES_FaultTyp.DFC_PSRPsig_C DFES_FaultTyp.DFC_PSRmax_C DFES_FaultTyp.DFC_PUmax_C DFES_FaultTyp.DFC_P_VSE11_OL_C DFES_FaultTyp.DFC_P_VSE11_SCB_C DFES_FaultTyp.DFC_P_VSE11_SCG_C DFES_FaultTyp.DFC_PhyHighAPP1_C DFES_FaultTyp.DFC_PhyHighAPP2_C DFES_FaultTyp.DFC_PhyLowAPP1_C DFES_FaultTyp.DFC_PhyLowAPP2_C DFES_FaultTyp.DFC_SRCHighAPP1_C DFES_FaultTyp.DFC_SRCHighAPP2_C DFES_FaultTyp.DFC_SRCLowAPP1_C DFES_FaultTyp.DFC_SRCLowAPP2_C DFES_FaultTyp.DFC_SSpMon2_C DFES_FaultTyp.DFC_STHDRmax_C DFES_FaultTyp.DFC_SWReset_0_C DFES_FaultTyp.DFC_SWReset_1_C DFES_FaultTyp.DFC_SWReset_2_C DFES_FaultTyp.DFC_SyncAPP_C DFES_FaultTyp.DFC_TANKLnpl_C DFES_FaultTyp.DFC_TAmax_Dummy_C DFES_FaultTyp.DFC_TESFmax_C DFES_FaultTyp.DFC_TESGmax_C DFES_FaultTyp.DFC_TKAEmax_C DFES_FaultTyp.DFC_TKAEmin_C DFES_FaultTyp.DFC_TKARmax_C DFES_FaultTyp.DFC_TKARnpl_C DFES_FaultTyp.DFC_TMmax_Dummy_C DFES_FaultTyp.DFC_TUMmax_Dummy_C DFES_FaultTyp.DFC_TWCDPriCatB1_C DFES_FaultTyp.DFC_ThrVlvClsdPosnFirstOffsLrnImpoB1_C DFES_FaultTyp.DFC_ThrVlvClsdPosnOffsLrnImpoB1_C DFES_FaultTyp.DFC_ThrVlvClsdPosnOffsLrnMaxB1_C DFES_FaultTyp.DFC_ThrVlvClsdPosnOffsLrnMinB1_C DFES_FaultTyp.DFC_ThrVlvCtrlDeB1_C DFES_FaultTyp.DFC_ThrVlvDycB1_C DFES_FaultTyp.DFC_ThrVlvLimpAirPosnMaxAbsltDriftB1_C DFES_FaultTyp.DFC_ThrVlvLimpAirPosnMaxB1_C DFES_FaultTyp.DFC_ThrVlvLimpAirPosnMaxRelDriftB1_C DFES_FaultTyp.DFC_ThrVlvLimpAirPosnMinB1_C DFES_FaultTyp.DFC_ThrVlvOpenLoadB1_C DFES_FaultTyp.DFC_ThrVlvOpenSprgB1_C DFES_FaultTyp.DFC_ThrVlvOpenSprgSprdB1_C DFES_FaultTyp.DFC_ThrVlvOpenSprgTwnB1_C DFES_FaultTyp.DFC_ThrVlvOverTB1_C DFES_FaultTyp.DFC_ThrVlvRetSprgB1_C DFES_FaultTyp.DFC_ThrVlvRetSprgSprdB1_C DFES_FaultTyp.DFC_ThrVlvRetSprgTwnB1_C DFES_FaultTyp.DFC_ThrVlvSens1MaxB1_C DFES_FaultTyp.DFC_ThrVlvSens1NplB1_C DFES_FaultTyp.DFC_ThrVlvSens2MaxB1_C DFES_FaultTyp.DFC_ThrVlvSens2MinB1_C DFES_FaultTyp.DFC_ThrVlvSens2NplB1_C DFES_FaultTyp.DFC_ThrVlvShoCircB1_C DFES_FaultTyp.DFC_ThrVlvSpiErrB1_C DFES_FaultTyp.DFC_ThrvlvSens1MinB1_C DFES_FaultTyp.DFC_TiOffTBasdChkFast_C DFES_FaultTyp.DFC_TiOffTBasdChkSlow_C DFES_FaultTyp.DFC_UEGOSnsrMntdS1B1_C DFES_FaultTyp.DFC_VehVSig_C DFES_FaultTyp.DFC_VlvLftFbSwtIntk11SpclFail_C DFES_FaultTyp.DFC_VlvLftFbSwtIntk11StdFail_C DFES_GrpRpr.DFC_Unused_C DFES_GrpRpr.DFC_AAVEmax_C DFES_GrpRpr.DFC_AAVEmin_C DFES_GrpRpr.DFC_AAVEsig_C DFES_GrpRpr.DFC_AltIOACGFailr_C DFES_GrpRpr.DFC_AltIOACGHiVltg_C DFES_GrpRpr.DFC_AltIOACGLoVltg_C DFES_GrpRpr.DFC_AltIOACGTHi_C DFES_GrpRpr.DFC_AltIODConnACG_C DFES_GrpRpr.DFC_BGOELWAF_C DFES_GrpRpr.DFC_BattUHiFailr_C DFES_GrpRpr.DFC_BattULoFailr_C DFES_GrpRpr.DFC_BrkBstPDriftHiErr_C DFES_GrpRpr.DFC_BrkBstPDriftLoErr_C DFES_GrpRpr.DFC_BrkBstPSnsrStuck_C DFES_GrpRpr.DFC_BrkMnSwtContOn_C DFES_GrpRpr.DFC_BrkMnSwtNotStp_C DFES_GrpRpr.DFC_BrkNpl_C DFES_GrpRpr.DFC_BrkRdntSwtContOn_C DFES_GrpRpr.DFC_BrkRdntSwtNotStp_C DFES_GrpRpr.DFC_Clth3ONStuck_C DFES_GrpRpr.DFC_Clth4OFFStuck_C DFES_GrpRpr.DFC_ClthOFFStuck_C DFES_GrpRpr.DFC_ClthONStuck_C DFES_GrpRpr.DFC_ClthStkFailInfo_C DFES_GrpRpr.DFC_ComACFailInfo_C DFES_GrpRpr.DFC_ComATFTValErr_C DFES_GrpRpr.DFC_ComATMILReq_C DFES_GrpRpr.DFC_ComAYCAChksum_C DFES_GrpRpr.DFC_ComAYCARingCnt_C DFES_GrpRpr.DFC_ComAYCATOut_C DFES_GrpRpr.DFC_ComAYCDChkSum_C DFES_GrpRpr.DFC_ComAYCDTOut_C DFES_GrpRpr.DFC_ComAYCFChksum_C DFES_GrpRpr.DFC_ComAYCFRingCnt_C DFES_GrpRpr.DFC_ComAYCFTOut_C DFES_GrpRpr.DFC_ComAYCGChksum_C DFES_GrpRpr.DFC_ComAYCGRingCnt_C DFES_GrpRpr.DFC_ComAYCGTOut_C DFES_GrpRpr.DFC_ComAYCIChkSum_C DFES_GrpRpr.DFC_ComAYCIRingCnt_C DFES_GrpRpr.DFC_ComAYCITOut_C DFES_GrpRpr.DFC_ComBCM1ChkSum_C DFES_GrpRpr.DFC_ComBCM1RingCnt_C DFES_GrpRpr.DFC_ComBCM1TOut_C DFES_GrpRpr.DFC_ComCANABusOffErr_C DFES_GrpRpr.DFC_ComCANBBusOffErr_C DFES_GrpRpr.DFC_ComCANCBusOffErr_C DFES_GrpRpr.DFC_ComCGW1ChkSum_C DFES_GrpRpr.DFC_ComCGW1RingCnt_C DFES_GrpRpr.DFC_ComCGW1TOut_C DFES_GrpRpr.DFC_ComConvBoostErr_C DFES_GrpRpr.DFC_ComConvSlipErr_C DFES_GrpRpr.DFC_ComDCDCPrfmncErr_C DFES_GrpRpr.DFC_ComDCDCTempWarn_C DFES_GrpRpr.DFC_ComEAT10Chksum_C DFES_GrpRpr.DFC_ComEAT10RingCnt_C DFES_GrpRpr.DFC_ComEAT10TOut_C DFES_GrpRpr.DFC_ComEAT11ChkSum_C DFES_GrpRpr.DFC_ComEAT11RingCnt_C DFES_GrpRpr.DFC_ComEAT11TOut_C DFES_GrpRpr.DFC_ComEAT12ChkSum_C DFES_GrpRpr.DFC_ComEAT12RingCnt_C DFES_GrpRpr.DFC_ComEAT12TOut_C DFES_GrpRpr.DFC_ComEAT13ChkSum_C DFES_GrpRpr.DFC_ComEAT13RingCnt_C DFES_GrpRpr.DFC_ComEAT13TOut_C DFES_GrpRpr.DFC_ComEAT1Chksum_C DFES_GrpRpr.DFC_ComEAT1RingCnt_C DFES_GrpRpr.DFC_ComEAT1TOut_C DFES_GrpRpr.DFC_ComEAT2ChkSum_C DFES_GrpRpr.DFC_ComEAT2RingCnt_C DFES_GrpRpr.DFC_ComEAT2TOut_C DFES_GrpRpr.DFC_ComEAT4ChkSum_C DFES_GrpRpr.DFC_ComEAT4RingCnt_C DFES_GrpRpr.DFC_ComEAT4TOut_C DFES_GrpRpr.DFC_ComEAT6Chksum_C DFES_GrpRpr.DFC_ComEAT6RingCnt_C DFES_GrpRpr.DFC_ComEAT6TOut_C DFES_GrpRpr.DFC_ComEAT7Chksum_C DFES_GrpRpr.DFC_ComEAT7RingCnt_C DFES_GrpRpr.DFC_ComEAT7TOut_C DFES_GrpRpr.DFC_ComEAT8Chksum_C DFES_GrpRpr.DFC_ComEAT8RingCnt_C DFES_GrpRpr.DFC_ComEAT8TOut_C DFES_GrpRpr.DFC_ComEATAChksum_C DFES_GrpRpr.DFC_ComEATARingCnt_C DFES_GrpRpr.DFC_ComEATATOut_C DFES_GrpRpr.DFC_ComEATBChkSum_C DFES_GrpRpr.DFC_ComEATBRingCnt_C DFES_GrpRpr.DFC_ComEATBTOut_C DFES_GrpRpr.DFC_ComEATCChksum_C DFES_GrpRpr.DFC_ComEATCRingCnt_C DFES_GrpRpr.DFC_ComEATCTOut_C DFES_GrpRpr.DFC_ComEPBBChkSum_C DFES_GrpRpr.DFC_ComEPBBRingCnt_C DFES_GrpRpr.DFC_ComEPBBTOut_C DFES_GrpRpr.DFC_ComEPBChksum_C DFES_GrpRpr.DFC_ComEPBTOut_C DFES_GrpRpr.DFC_ComEPBctRing_C DFES_GrpRpr.DFC_ComEPS1Chksum_C DFES_GrpRpr.DFC_ComEPS1RingCnt_C DFES_GrpRpr.DFC_ComEPS1TOut_C DFES_GrpRpr.DFC_ComEngCanRxErr_C DFES_GrpRpr.DFC_ComGrvySnsrErr_C DFES_GrpRpr.DFC_ComGwIMG1ChkSum_C DFES_GrpRpr.DFC_ComGwIMG1RingCnt_C DFES_GrpRpr.DFC_ComGwIMG1TOut_C DFES_GrpRpr.DFC_ComGwIMG3ChkSum_C DFES_GrpRpr.DFC_ComGwIMG3RingCnt_C DFES_GrpRpr.DFC_ComGwIMG3TOut_C DFES_GrpRpr.DFC_ComGwIMG4ChkSum_C DFES_GrpRpr.DFC_ComGwIMG4RingCnt_C DFES_GrpRpr.DFC_ComGwIMG4TOut_C DFES_GrpRpr.DFC_ComGwIMG5ChkSum_C DFES_GrpRpr.DFC_ComGwIMG5RingCnt_C DFES_GrpRpr.DFC_ComGwIMG5TOut_C DFES_GrpRpr.DFC_ComGwIMG6ChkSum_C DFES_GrpRpr.DFC_ComGwIMG6RingCnt_C DFES_GrpRpr.DFC_ComGwIMG6TOut_C DFES_GrpRpr.DFC_ComIDASBChksum_C DFES_GrpRpr.DFC_ComIDASBRingCnt_C DFES_GrpRpr.DFC_ComIDASBTOut_C DFES_GrpRpr.DFC_ComIMGMILReq_C DFES_GrpRpr.DFC_ComISSPrms_C DFES_GrpRpr.DFC_ComMETAChksum_C DFES_GrpRpr.DFC_ComMETAChksumPstDrv_C DFES_GrpRpr.DFC_ComMETARingCnt_C DFES_GrpRpr.DFC_ComMETARingCntPstDrv_C DFES_GrpRpr.DFC_ComMETATOut_C DFES_GrpRpr.DFC_ComMETATOutPstDrv_C DFES_GrpRpr.DFC_ComMETCChksum_C DFES_GrpRpr.DFC_ComMETCRingCnt_C DFES_GrpRpr.DFC_ComMETCTOut_C DFES_GrpRpr.DFC_ComMETDChksum_C DFES_GrpRpr.DFC_ComMETDRingCnt_C DFES_GrpRpr.DFC_ComMETDTOut_C DFES_GrpRpr.DFC_ComMETE2Chksum_C DFES_GrpRpr.DFC_ComMETE2RingCnt_C DFES_GrpRpr.DFC_ComMETE2TOut_C DFES_GrpRpr.DFC_ComMETFChksum_C DFES_GrpRpr.DFC_ComMETFRingCnt_C DFES_GrpRpr.DFC_ComMETFTOut_C DFES_GrpRpr.DFC_ComMETGChksum_C DFES_GrpRpr.DFC_ComMETGRingCnt_C DFES_GrpRpr.DFC_ComMETGTOut_C DFES_GrpRpr.DFC_ComMETH2Chksum_C DFES_GrpRpr.DFC_ComMETH2RingCnt_C DFES_GrpRpr.DFC_ComMETH2TOut_C DFES_GrpRpr.DFC_ComMETHChksum_C DFES_GrpRpr.DFC_ComMETHRingCnt_C DFES_GrpRpr.DFC_ComMETHTOut_C DFES_GrpRpr.DFC_ComMETIChksum_C DFES_GrpRpr.DFC_ComMETIRingCnt_C DFES_GrpRpr.DFC_ComMETITOut_C DFES_GrpRpr.DFC_ComMETKChksum_C DFES_GrpRpr.DFC_ComMETKRingCnt_C DFES_GrpRpr.DFC_ComMETKTOut_C DFES_GrpRpr.DFC_ComMETLChksum_C DFES_GrpRpr.DFC_ComMETLRingCnt_C DFES_GrpRpr.DFC_ComMETLTOut_C DFES_GrpRpr.DFC_ComMETMChksum_C DFES_GrpRpr.DFC_ComMETMRingCnt_C DFES_GrpRpr.DFC_ComMETMTOut_C DFES_GrpRpr.DFC_ComMETNChksum_C DFES_GrpRpr.DFC_ComMETNRingCnt_C DFES_GrpRpr.DFC_ComMETNTOut_C DFES_GrpRpr.DFC_ComMtrCom_C DFES_GrpRpr.DFC_ComPCUChkSum_C DFES_GrpRpr.DFC_ComPCURingCnt_C DFES_GrpRpr.DFC_ComPCUTOut_C DFES_GrpRpr.DFC_ComSRSAChksum_C DFES_GrpRpr.DFC_ComSRSARingCnt_C DFES_GrpRpr.DFC_ComSRSATOut_C DFES_GrpRpr.DFC_ComSRSBChksum_C DFES_GrpRpr.DFC_ComSRSBRingCnt_C DFES_GrpRpr.DFC_ComSRSBTOut_C DFES_GrpRpr.DFC_ComSRSChksum_C DFES_GrpRpr.DFC_ComSRSErr_C DFES_GrpRpr.DFC_ComSRSRingCnt_C DFES_GrpRpr.DFC_ComSRSTOut_C DFES_GrpRpr.DFC_ComVehSpdPndFltTCU_C DFES_GrpRpr.DFC_EbsChartcCurrErr_C DFES_GrpRpr.DFC_EbsSelfDiagErr_C DFES_GrpRpr.DFC_GEVlvPhaCsersIntkB1_C DFES_GrpRpr.DFC_GEVlvPhaPsOpenLoadIntkB1_C DFES_GrpRpr.DFC_GEVlvPhaPsShoToBattIntkB1_C DFES_GrpRpr.DFC_GEVlvPhaPsShoToGndIntkB1_C DFES_GrpRpr.DFC_GbxCANDigPlausErr_C DFES_GrpRpr.DFC_GbxNPos1SRCMax_C DFES_GrpRpr.DFC_GbxNPos1SRCMin_C DFES_GrpRpr.DFC_GbxNPos2SRCMax_C DFES_GrpRpr.DFC_GbxNPos2SRCMin_C DFES_GrpRpr.DFC_GbxNPosAlvChk_C DFES_GrpRpr.DFC_GbxNPosSyncErr_C DFES_GrpRpr.DFC_HEGOS2B1HtrPsMax_C DFES_GrpRpr.DFC_HEGOS2B1HtrPsMin_C DFES_GrpRpr.DFC_HEGOS2B1HtrPsSig_C DFES_GrpRpr.DFC_LinCSErrACG_C DFES_GrpRpr.DFC_LinCSErrAEV_C DFES_GrpRpr.DFC_LinCSErrDCDC_C DFES_GrpRpr.DFC_LinCSErrEBS_C DFES_GrpRpr.DFC_LinHdrTimeoutErrACG_C DFES_GrpRpr.DFC_LinHdrTimeoutErrAEV_C DFES_GrpRpr.DFC_LinHdrTimeoutErrDCDC_C DFES_GrpRpr.DFC_LinHdrTimeoutErrEBS_C DFES_GrpRpr.DFC_LinMsgTimeoutErrACG_C DFES_GrpRpr.DFC_LinMsgTimeoutErrAEV_C DFES_GrpRpr.DFC_LinMsgTimeoutErrDCDC_C DFES_GrpRpr.DFC_LinMsgTimeoutErrEBS_C DFES_GrpRpr.DFC_LinNoStrtComErr_C DFES_GrpRpr.DFC_LowPresOilP_C DFES_GrpRpr.DFC_MisfDetVWhlFrntLeOORHi_C DFES_GrpRpr.DFC_MisfDetVWhlFrntLeRatyHi_C DFES_GrpRpr.DFC_MisfDetVWhlFrntLeRatyLo_C DFES_GrpRpr.DFC_MisfDetVWhlFrntLeStuck_C DFES_GrpRpr.DFC_MisfDetVWhlFrntRiOORHi_C DFES_GrpRpr.DFC_MisfDetVWhlFrntRiRatyHi_C DFES_GrpRpr.DFC_MisfDetVWhlFrntRiRatyLo_C DFES_GrpRpr.DFC_MisfDetVWhlFrntRiStuck_C DFES_GrpRpr.DFC_MisfDetVWhlReLeOORHi_C DFES_GrpRpr.DFC_MisfDetVWhlReLeRatyHi_C DFES_GrpRpr.DFC_MisfDetVWhlReLeRatyLo_C DFES_GrpRpr.DFC_MisfDetVWhlReLeStuck_C DFES_GrpRpr.DFC_MisfDetVWhlReRiOORHi_C DFES_GrpRpr.DFC_MisfDetVWhlReRiRatyHi_C DFES_GrpRpr.DFC_MisfDetVWhlReRiRatyLo_C DFES_GrpRpr.DFC_MisfDetVWhlReRiStuck_C DFES_GrpRpr.DFC_MisfDetdVWhlFrntLePlaus_C DFES_GrpRpr.DFC_MisfDetdVWhlFrntRiPlaus_C DFES_GrpRpr.DFC_MisfDetdVWhlReLePlaus_C DFES_GrpRpr.DFC_MisfDetdVWhlReRiPlaus_C DFES_GrpRpr.DFC_PEnvSigRngMax_C DFES_GrpRpr.DFC_PEnvSigRngMin_C DFES_GrpRpr.DFC_StmFault_C DFES_GrpRpr.DFC_StrtCtOffPth_C DFES_GrpRpr.DFC_StrtCtlErr_C DFES_GrpRpr.DFC_StrtFault_C DFES_GrpRpr.DFC_StrtLckJudg1_C DFES_GrpRpr.DFC_StrtLckJudg2_C DFES_GrpRpr.DFC_StrtOL_C DFES_GrpRpr.DFC_StrtOL2_C DFES_GrpRpr.DFC_StrtSCB_C DFES_GrpRpr.DFC_StrtSCB2_C DFES_GrpRpr.DFC_StrtSCG_C DFES_GrpRpr.DFC_StrtSCG2_C DFES_GrpRpr.DFC_StrtStkRly1_C DFES_GrpRpr.DFC_StrtStkRly2_C DFES_GrpRpr.DFC_TEVEmax_C DFES_GrpRpr.DFC_TEVEmin_C DFES_GrpRpr.DFC_TEVEsig_C DFES_GrpRpr.DFC_UegoHeatrPrfmncLoS1B1_C DFES_GrpRpr.DFC_VehVAllPlaus_C DFES_GrpRpr.DFC_VehVNCSnsrElecFailr_C DFES_GrpRpr.DFC_VehVPlausCan_C DFES_GrpRpr.DFC_VehVPlausFco_C DFES_GrpRpr.DFC_VehVPlausPwr_C DFES_GrpRpr.DFC_VehVPlausV2N_C DFES_GrpRpr.DFC_VehVSpdSnsrAElecFailr_C DFES_GrpRpr.DFC_VehVSpdSnsrBElecFailr_C DFES_GrpRpr.DFC_ClthMax_C DFES_GrpRpr.DFC_IgnClPs_DevComErr_C DFES_GrpRpr.DFC_IgnClPs_LineOl_0_C DFES_GrpRpr.DFC_IgnClPs_LineOl_1_C DFES_GrpRpr.DFC_IgnClPs_LineOl_2_C DFES_GrpRpr.DFC_IgnClPs_LineOl_3_C DFES_GrpRpr.DFC_IgnClPs_LineScb_0_C DFES_GrpRpr.DFC_IgnClPs_LineScb_1_C DFES_GrpRpr.DFC_IgnClPs_LineScb_2_C DFES_GrpRpr.DFC_IgnClPs_LineScb_3_C DFES_GrpRpr.DFC_IgnClPs_LineScg_0_C DFES_GrpRpr.DFC_IgnClPs_LineScg_1_C DFES_GrpRpr.DFC_IgnClPs_LineScg_2_C DFES_GrpRpr.DFC_IgnClPs_LineScg_3_C DFES_GrpRpr.DFC_KRVEKOEVAB_C DFES_GrpRpr.DFC_KRVEKOEVAB0_C DFES_GrpRpr.DFC_KRVEKOEVAB1_C DFES_GrpRpr.DFC_KRVEKOEVAB2_C DFES_GrpRpr.DFC_KRVEKOEVAB3_C DFES_GrpRpr.DFC_UegoSigEcuAsicS1B1_C DFES_GrpRpr.DFC_UegoSigEcuComS1B1_C DFES_GrpRpr.DFC_UegoSigSnsrS1B1_C DFES_GrpRpr.DFC_UegoSigWireOlApesS1B1_C DFES_GrpRpr.DFC_UegoSigWireOlIpeS1B1_C DFES_GrpRpr.DFC_UegoSigWireOlReS1B1_C DFES_GrpRpr.DFC_UegoSigWireRCmpS1B1_C DFES_GrpRpr.DFC_UegoSigWireScbS1B1_C DFES_GrpRpr.DFC_UegoSigWireScgS1B1_C DFES_GrpRpr.DFC_AfsPhyRngHiB1_C DFES_GrpRpr.DFC_AfsPhyRngLoB1_C DFES_GrpRpr.DFC_AirCCmprOL_C DFES_GrpRpr.DFC_AirCCmprOvrTemp_C DFES_GrpRpr.DFC_AirCCmprSCB_C DFES_GrpRpr.DFC_AirCCmprSCG_C DFES_GrpRpr.DFC_AltErr_C DFES_GrpRpr.DFC_BattUSRCMax_C DFES_GrpRpr.DFC_BattUSRCMin_C DFES_GrpRpr.DFC_ComChksTCU1_C DFES_GrpRpr.DFC_ComChksTCU11_C DFES_GrpRpr.DFC_ComChksTCU12_C DFES_GrpRpr.DFC_ComChksTCU13_C DFES_GrpRpr.DFC_ComChksTCU2_C DFES_GrpRpr.DFC_ComChksTCU3_C DFES_GrpRpr.DFC_ComChksTCU4_C DFES_GrpRpr.DFC_ComCntTCU1_C DFES_GrpRpr.DFC_ComCntTCU11_C DFES_GrpRpr.DFC_ComCntTCU12_C DFES_GrpRpr.DFC_ComCntTCU13_C DFES_GrpRpr.DFC_ComCntTCU2_C DFES_GrpRpr.DFC_ComCntTCU3_C DFES_GrpRpr.DFC_ComCntTCU4_C DFES_GrpRpr.DFC_ComTOutTCU01_C DFES_GrpRpr.DFC_ComTOutTCU02_C DFES_GrpRpr.DFC_ComTOutTCU1_C DFES_GrpRpr.DFC_ComTOutTCU11_C DFES_GrpRpr.DFC_ComTOutTCU12_C DFES_GrpRpr.DFC_ComTOutTCU13_C DFES_GrpRpr.DFC_ComTOutTCU14_C DFES_GrpRpr.DFC_ComTOutTCU2_C DFES_GrpRpr.DFC_ComTOutTCU3_C DFES_GrpRpr.DFC_ComTOutTCU4_C DFES_GrpRpr.DFC_DevLibBattUHi_C DFES_GrpRpr.DFC_DevLibBattULo_C DFES_GrpRpr.DFC_EGRVlvFailSafeActv_C DFES_GrpRpr.DFC_EGRVlvGovDvtCld_C DFES_GrpRpr.DFC_EGRVlvPhysSRCMax_C DFES_GrpRpr.DFC_EGRVlvPhysSRCMin_C DFES_GrpRpr.DFC_FanDIOOL_0_C DFES_GrpRpr.DFC_FanDIOOL_1_C DFES_GrpRpr.DFC_FanDIOOvrTemp_0_C DFES_GrpRpr.DFC_FanDIOOvrTemp_1_C DFES_GrpRpr.DFC_FanDIOSCB_0_C DFES_GrpRpr.DFC_FanDIOSCB_1_C DFES_GrpRpr.DFC_FanDIOSCG_0_C DFES_GrpRpr.DFC_FanDIOSCG_1_C DFES_GrpRpr.DFC_MRlyDcOL_C DFES_GrpRpr.DFC_MRlyDcSCB_C DFES_GrpRpr.DFC_MRlyDcSCG_C DFES_GrpRpr.DFC_PSPOL_C DFES_GrpRpr.DFC_PSPOvrTemp_C DFES_GrpRpr.DFC_PSPSCB_C DFES_GrpRpr.DFC_PSPSCG_C DFES_GrpRpr.DFC_T50Err_C DFES_GrpRpr.DFC_ThrVlvLoBattB1_C DFES_GrpRpr.DFC_UegoSigOperPlausS1B1_C DFES_GrpRpr.DFC_VehVPhysRngHi_C DFES_GrpRpr.DFC_VehVSclOutOL_C DFES_GrpRpr.DFC_VehVSclOutOT_C DFES_GrpRpr.DFC_VehVSclOutSCB_C DFES_GrpRpr.DFC_VehVSclOutSCG_C DFES_GrpRpr.DFC_VehVSigFL_C DFES_GrpRpr.DFC_VehVSigFR_C DFES_GrpRpr.DFC_VehVSigRL_C DFES_GrpRpr.DFC_VehVSigRR_C DFES_GrpRpr.DFC_VehVSnsrARngHi_C DFES_GrpRpr.DFC_VehVSnsrBRngHi_C DFES_GrpRpr.DFC_VehVSpdRtyDiag_C DFES_GrpRpr.DFC_DHFHD_C DFES_GrpRpr.DFC_InjVlv_DI_DcDc_C DFES_GrpRpr.DFC_InjVlv_DI_NoLd_0_C DFES_GrpRpr.DFC_InjVlv_DI_NoLd_1_C DFES_GrpRpr.DFC_InjVlv_DI_NoLd_2_C DFES_GrpRpr.DFC_InjVlv_DI_NoLd_3_C DFES_GrpRpr.DFC_InjVlv_DI_ScBnk_0_C DFES_GrpRpr.DFC_InjVlv_DI_ScBnk_1_C DFES_GrpRpr.DFC_InjVlv_DI_ScBnk_2_C DFES_GrpRpr.DFC_InjVlv_DI_ScBnk_3_C DFES_GrpRpr.DFC_InjVlv_DI_ScCyl_0_C DFES_GrpRpr.DFC_InjVlv_DI_ScCyl_1_C DFES_GrpRpr.DFC_InjVlv_DI_ScCyl_2_C DFES_GrpRpr.DFC_InjVlv_DI_ScCyl_3_C DFES_GrpRpr.DFC_InjVlv_DI_ScHsLs_0_C DFES_GrpRpr.DFC_InjVlv_DI_ScHsLs_1_C DFES_GrpRpr.DFC_InjVlv_DI_ScHsLs_2_C DFES_GrpRpr.DFC_InjVlv_DI_ScHsLs_3_C DFES_GrpRpr.DFC_MfPsDiaOpenLoad1_C DFES_GrpRpr.DFC_MfPsDiaScHiS1_C DFES_GrpRpr.DFC_MfPsDiaScHiSLowS1_C DFES_GrpRpr.DFC_MfPsDiaScLowS1_C DFES_GrpRpr.DFC_ACEvpTPhysRngHi_C DFES_GrpRpr.DFC_ACEvpTPhysRngLo_C DFES_GrpRpr.DFC_ACEvpTSRCMax_C DFES_GrpRpr.DFC_ACEvpTSRCMin_C DFES_GrpRpr.DFC_AfsRawSigRngHiB1_C DFES_GrpRpr.DFC_AfsRawSigRngLoB1_C DFES_GrpRpr.DFC_AfsSnsrErrB1_C DFES_GrpRpr.DFC_AirCClntPAnaSRCMax_C DFES_GrpRpr.DFC_AirCClntPAnaSRCMin_C DFES_GrpRpr.DFC_AirCSwtNpl_C DFES_GrpRpr.DFC_AirCSwtSig_C DFES_GrpRpr.DFC_Brk_C DFES_GrpRpr.DFC_BrkBstSensSCB_C DFES_GrpRpr.DFC_BrkBstSensSCG_C DFES_GrpRpr.DFC_BrkSig_C DFES_GrpRpr.DFC_ClthSig_C DFES_GrpRpr.DFC_EGRVlvCurrLim_C DFES_GrpRpr.DFC_EGRVlvOL_C DFES_GrpRpr.DFC_EGRVlvOvrTemp_C DFES_GrpRpr.DFC_EGRVlvSCB_C DFES_GrpRpr.DFC_EGRVlvSCG_C DFES_GrpRpr.DFC_EGRVlvSRCMax_C DFES_GrpRpr.DFC_EGRVlvSRCMin_C DFES_GrpRpr.DFC_HLSDemOvhtEngLim_C DFES_GrpRpr.DFC_OilPSwmpSRCMax_C DFES_GrpRpr.DFC_OilPSwmpSRCMin_C DFES_GrpRpr.DFC_PIntkVUsLineHiB1_C DFES_GrpRpr.DFC_PIntkVUsLineLoB1_C DFES_GrpRpr.DFC_VehVPhysRngLo_C DFES_GrpRpr.DFC_VehVSigCan_C DFES_GrpRpr.DFC_VehVSigCanSafe_C DFES_GrpRpr.DFC_VlvLftFbOilPSnsrIntk11SRCMax_C DFES_GrpRpr.DFC_VlvLftFbOilPSnsrIntk11SRCMin_C DFES_GrpRpr.DFC_ClthNpl_C /end DEF_CHARACTERISTIC
 FUNCTION_VERSION "30000.73.0_2.0.0" /end FUNCTION
/begin COMPU_METHOD DFC_Verb "" TAB_VERB "%6.3" "-" COMPU_TAB_REF DFC_Verb /end COMPU_METHOD
/begin COMPU_VTAB DFC_Verb "" TAB_VERB 907 0 "DFC_Unused" 1 "DFC_AAVEmax" 2 "DFC_AAVEmin" 3 "DFC_AAVEsig" 508 "DFC_AAVmin" 379 "DFC_ACEvpTPhysRngHi" 380 "DFC_ACEvpTPhysRngLo" 381 "DFC_ACEvpTSRCMax" 382 "DFC_ACEvpTSRCMin" 288 "DFC_AfsPhyRngHiB1" 289 "DFC_AfsPhyRngLoB1" 510 "DFC_AfsPlausDiagHi" 511 "DFC_AfsPlausDiagLo" 383 "DFC_AfsRawSigRngHiB1" 384 "DFC_AfsRawSigRngLoB1" 415 "DFC_AfsSigErrLineHiB1" 416 "DFC_AfsSigErrLineLoB1" 385 "DFC_AfsSnsrErrB1" 512 "DFC_AfsVrntDiagErrB1" 509 "DFC_AGRSUS" 386 "DFC_AirCClntPAnaSRCMax" 387 "DFC_AirCClntPAnaSRCMin" 290 "DFC_AirCCmprOL" 291 "DFC_AirCCmprOvrTemp" 292 "DFC_AirCCmprSCB" 293 "DFC_AirCCmprSCG" 388 "DFC_AirCSwtNpl" 389 "DFC_AirCSwtSig" 294 "DFC_AltErr" 4 "DFC_AltIOACGFailr" 5 "DFC_AltIOACGHiVltg" 6 "DFC_AltIOACGLoVltg" 7 "DFC_AltIOACGTHi" 8 "DFC_AltIODConnACG" 513 "DFC_AppAllSnsrDfct" 10 "DFC_BattUHiFailr" 11 "DFC_BattULoFailr" 295 "DFC_BattUSRCMax" 296 "DFC_BattUSRCMin" 516 "DFC_BattUStdbyDiaOL" 514 "DFC_BBKRnldg" 515 "DFC_BBKRsyne" 9 "DFC_BGOELWAF" 517 "DFC_BigLeakIntkMnfldEmiInfl" 518 "DFC_BlkdLineTank" 390 "DFC_Brk" 12 "DFC_BrkBstPDriftHiErr" 13 "DFC_BrkBstPDriftLoErr" 14 "DFC_BrkBstPSnsrStuck" 391 "DFC_BrkBstSensSCB" 392 "DFC_BrkBstSensSCG" 15 "DFC_BrkMnSwtContOn" 519 "DFC_BrkMnSwtContOnWarnLmp" 16 "DFC_BrkMnSwtNotStp" 520 "DFC_BrkMnSwtNotStpWarnLmp" 17 "DFC_BrkNpl" 18 "DFC_BrkRdntSwtContOn" 521 "DFC_BrkRdntSwtContOnWarnLmp" 19 "DFC_BrkRdntSwtNotStp" 522 "DFC_BrkRdntSwtNotStpWarnLmp" 393 "DFC_BrkSig" 496 "DFC_BSWM_E_ACTION_FAILED" 497 "DFC_BSWM_E_INTRPTQUEUE_FULL" 472 "DFC_BusDiagCANAPPLBusOff" 473 "DFC_BusDiagCANCANCBusOff" 474 "DFC_BusDiagCANVEHICLEBusOff" 490 "DFC_CAN_E_TIMEOUT" 523 "DFC_CEngDsTColdStrtMax" 524 "DFC_CEngDsTColdStrtMin" 525 "DFC_CEngDsTImps" 526 "DFC_CEngDsTPlausHSC" 527 "DFC_CEngDsTPlausLSC" 528 "DFC_CEngDsTPlausSTC" 531 "DFC_CEngDsTSig" 529 "DFC_CEngDsTSRCMax" 530 "DFC_CEngDsTSRCMin" 532 "DFC_CEngUsTColdStrtMax" 533 "DFC_CEngUsTColdStrtMin" 534 "DFC_CEngUsTLooseCnctn" 535 "DFC_CEngUsTSRCMax" 536 "DFC_CEngUsTSRCMin" 432 "DFC_Clth2ONStuck" 433 "DFC_Clth2ONStuckLdc" 20 "DFC_Clth3ONStuck" 434 "DFC_Clth3ONStuckLdc" 435 "DFC_Clth3ONStuckPostDrv" 21 "DFC_Clth4OFFStuck" 436 "DFC_Clth4ONStuck" 437 "DFC_Clth4ONStuckLdc" 260 "DFC_ClthMax" 412 "DFC_ClthNpl" 22 "DFC_ClthOFFStuck" 23 "DFC_ClthONStuck" 394 "DFC_ClthSig" 24 "DFC_ClthStkFailInfo" 25 "DFC_ComACFailInfo" 26 "DFC_ComATFTValErr" 27 "DFC_ComATMILReq" 28 "DFC_ComAYCAChksum" 29 "DFC_ComAYCARingCnt" 30 "DFC_ComAYCATOut" 31 "DFC_ComAYCDChkSum" 32 "DFC_ComAYCDTOut" 33 "DFC_ComAYCFChksum" 34 "DFC_ComAYCFRingCnt" 35 "DFC_ComAYCFTOut" 36 "DFC_ComAYCGChksum" 37 "DFC_ComAYCGRingCnt" 38 "DFC_ComAYCGTOut" 39 "DFC_ComAYCIChkSum" 40 "DFC_ComAYCIRingCnt" 41 "DFC_ComAYCITOut" 42 "DFC_ComBCM1ChkSum" 43 "DFC_ComBCM1RingCnt" 44 "DFC_ComBCM1TOut" 438 "DFC_ComBCMUnit" 45 "DFC_ComCANABusOffErr" 46 "DFC_ComCANBBusOffErr" 47 "DFC_ComCANCBusOffErr" 48 "DFC_ComCGW1ChkSum" 49 "DFC_ComCGW1RingCnt" 50 "DFC_ComCGW1TOut" 297 "DFC_ComChksTCU1" 298 "DFC_ComChksTCU11" 299 "DFC_ComChksTCU12" 300 "DFC_ComChksTCU13" 301 "DFC_ComChksTCU2" 302 "DFC_ComChksTCU3" 303 "DFC_ComChksTCU4" 304 "DFC_ComCntTCU1" 305 "DFC_ComCntTCU11" 306 "DFC_ComCntTCU12" 307 "DFC_ComCntTCU13" 308 "DFC_ComCntTCU2" 309 "DFC_ComCntTCU3" 310 "DFC_ComCntTCU4" 51 "DFC_ComConvBoostErr" 52 "DFC_ComConvSlipErr" 537 "DFC_ComDCDCACCFailr" 53 "DFC_ComDCDCPrfmncErr" 54 "DFC_ComDCDCTempWarn" 439 "DFC_ComDLCTCU01" 440 "DFC_ComDLCTCU02" 441 "DFC_ComDLCTCU1" 442 "DFC_ComDLCTCU11" 443 "DFC_ComDLCTCU12" 444 "DFC_ComDLCTCU13" 445 "DFC_ComDLCTCU14" 446 "DFC_ComDLCTCU2" 447 "DFC_ComDLCTCU3" 448 "DFC_ComDLCTCU4" 55 "DFC_ComEAT10Chksum" 56 "DFC_ComEAT10RingCnt" 57 "DFC_ComEAT10TOut" 58 "DFC_ComEAT11ChkSum" 59 "DFC_ComEAT11RingCnt" 60 "DFC_ComEAT11TOut" 61 "DFC_ComEAT12ChkSum" 62 "DFC_ComEAT12RingCnt" 63 "DFC_ComEAT12TOut" 64 "DFC_ComEAT13ChkSum" 65 "DFC_ComEAT13RingCnt" 66 "DFC_ComEAT13TOut" 67 "DFC_ComEAT1Chksum" 68 "DFC_ComEAT1RingCnt" 69 "DFC_ComEAT1TOut" 70 "DFC_ComEAT2ChkSum" 71 "DFC_ComEAT2RingCnt" 72 "DFC_ComEAT2TOut" 73 "DFC_ComEAT4ChkSum" 74 "DFC_ComEAT4RingCnt" 75 "DFC_ComEAT4TOut" 76 "DFC_ComEAT6Chksum" 77 "DFC_ComEAT6RingCnt" 78 "DFC_ComEAT6TOut" 79 "DFC_ComEAT7Chksum" 80 "DFC_ComEAT7RingCnt" 81 "DFC_ComEAT7TOut" 82 "DFC_ComEAT8Chksum" 83 "DFC_ComEAT8RingCnt" 84 "DFC_ComEAT8TOut" 85 "DFC_ComEATAChksum" 86 "DFC_ComEATARingCnt" 87 "DFC_ComEATATOut" 88 "DFC_ComEATBChkSum" 89 "DFC_ComEATBRingCnt" 90 "DFC_ComEATBTOut" 91 "DFC_ComEATCChksum" 92 "DFC_ComEATCRingCnt" 93 "DFC_ComEATCTOut" 103 "DFC_ComEngCanRxErr" 94 "DFC_ComEPBBChkSum" 95 "DFC_ComEPBBRingCnt" 96 "DFC_ComEPBBTOut" 97 "DFC_ComEPBChksum" 99 "DFC_ComEPBctRing" 98 "DFC_ComEPBTOut" 100 "DFC_ComEPS1Chksum" 101 "DFC_ComEPS1RingCnt" 102 "DFC_ComEPS1TOut" 449 "DFC_ComEPSUnit" 104 "DFC_ComGrvySnsrErr" 105 "DFC_ComGwIMG1ChkSum" 106 "DFC_ComGwIMG1RingCnt" 107 "DFC_ComGwIMG1TOut" 108 "DFC_ComGwIMG3ChkSum" 109 "DFC_ComGwIMG3RingCnt" 110 "DFC_ComGwIMG3TOut" 111 "DFC_ComGwIMG4ChkSum" 112 "DFC_ComGwIMG4RingCnt" 113 "DFC_ComGwIMG4TOut" 114 "DFC_ComGwIMG5ChkSum" 115 "DFC_ComGwIMG5RingCnt" 116 "DFC_ComGwIMG5TOut" 117 "DFC_ComGwIMG6ChkSum" 118 "DFC_ComGwIMG6RingCnt" 119 "DFC_ComGwIMG6TOut" 120 "DFC_ComIDASBChksum" 121 "DFC_ComIDASBRingCnt" 122 "DFC_ComIDASBTOut" 450 "DFC_ComIDASBUnit" 123 "DFC_ComIMGMILReq" 451 "DFC_ComIMGUnit" 124 "DFC_ComISSPrms" 125 "DFC_ComMETAChksum" 126 "DFC_ComMETAChksumPstDrv" 127 "DFC_ComMETARingCnt" 128 "DFC_ComMETARingCntPstDrv" 129 "DFC_ComMETATOut" 130 "DFC_ComMETATOutPstDrv" 131 "DFC_ComMETCChksum" 132 "DFC_ComMETCRingCnt" 133 "DFC_ComMETCTOut" 134 "DFC_ComMETDChksum" 135 "DFC_ComMETDRingCnt" 136 "DFC_ComMETDTOut" 137 "DFC_ComMETE2Chksum" 138 "DFC_ComMETE2RingCnt" 139 "DFC_ComMETE2TOut" 140 "DFC_ComMETFChksum" 141 "DFC_ComMETFRingCnt" 142 "DFC_ComMETFTOut" 143 "DFC_ComMETGChksum" 144 "DFC_ComMETGRingCnt" 145 "DFC_ComMETGTOut" 146 "DFC_ComMETH2Chksum" 147 "DFC_ComMETH2RingCnt" 148 "DFC_ComMETH2TOut" 149 "DFC_ComMETHChksum" 150 "DFC_ComMETHRingCnt" 151 "DFC_ComMETHTOut" 152 "DFC_ComMETIChksum" 153 "DFC_ComMETIRingCnt" 154 "DFC_ComMETITOut" 155 "DFC_ComMETKChksum" 156 "DFC_ComMETKRingCnt" 157 "DFC_ComMETKTOut" 158 "DFC_ComMETLChksum" 159 "DFC_ComMETLRingCnt" 160 "DFC_ComMETLTOut" 161 "DFC_ComMETMChksum" 162 "DFC_ComMETMRingCnt" 163 "DFC_ComMETMTOut" 164 "DFC_ComMETNChksum" 165 "DFC_ComMETNRingCnt" 166 "DFC_ComMETNTOut" 452 "DFC_ComMETUnit" 167 "DFC_ComMtrCom" 168 "DFC_ComPCUChkSum" 169 "DFC_ComPCURingCnt" 170 "DFC_ComPCUTOut" 171 "DFC_ComSRSAChksum" 172 "DFC_ComSRSARingCnt" 173 "DFC_ComSRSATOut" 174 "DFC_ComSRSBChksum" 175 "DFC_ComSRSBRingCnt" 176 "DFC_ComSRSBTOut" 177 "DFC_ComSRSChksum" 178 "DFC_ComSRSErr" 179 "DFC_ComSRSRingCnt" 180 "DFC_ComSRSTOut" 453 "DFC_ComSRSUnit" 311 "DFC_ComTOutTCU01" 312 "DFC_ComTOutTCU02" 313 "DFC_ComTOutTCU1" 314 "DFC_ComTOutTCU11" 315 "DFC_ComTOutTCU12" 316 "DFC_ComTOutTCU13" 317 "DFC_ComTOutTCU14" 318 "DFC_ComTOutTCU2" 319 "DFC_ComTOutTCU3" 320 "DFC_ComTOutTCU4" 181 "DFC_ComVehSpdPndFltTCU" 454 "DFC_ComVSAUnit" 538 "DFC_DCDCFltDet" 321 "DFC_DevLibBattUHi" 322 "DFC_DevLibBattULo" 357 "DFC_DHFHD" 558 "DFC_DiagCpv1DteskLoLoadStuckClsd" 559 "DFC_DiagCpv1DteskLoLoadStuckOpen" 541 "DFC_DKnpl" 539 "DFC_DKRSA" 540 "DFC_DKVSmax" 542 "DFC_DSKVRmax" 543 "DFC_DSKVRmin" 544 "DFC_DSKVRnpl" 545 "DFC_DSKVRsig" 546 "DFC_DSKVSsig" 547 "DFC_DSSmax" 548 "DFC_DSTDmax" 549 "DFC_DSTEmax" 550 "DFC_DSTEmin" 551 "DFC_DSTOFmax" 552 "DFC_DSTRmax" 553 "DFC_DSTRmin" 554 "DFC_DSTRnpl" 555 "DFC_DSTRsig" 556 "DFC_DSTTI" 557 "DFC_DSUmax" 182 "DFC_EbsChartcCurrErr" 183 "DFC_EbsSelfDiagErr" 455 "DFC_EbsSocFlt" 395 "DFC_EGRVlvCurrLim" 560 "DFC_EGRVlvDrftClsd" 561 "DFC_EGRVlvDrftOpn" 323 "DFC_EGRVlvFailSafeActv" 324 "DFC_EGRVlvGovDvtCld" 562 "DFC_EGRVlvJamVlvClsd" 563 "DFC_EGRVlvJamVlvOpn" 396 "DFC_EGRVlvOL" 397 "DFC_EGRVlvOvrTemp" 325 "DFC_EGRVlvPhysSRCMax" 326 "DFC_EGRVlvPhysSRCMin" 398 "DFC_EGRVlvSCB" 399 "DFC_EGRVlvSCG" 564 "DFC_EGRVlvSprgBrk" 400 "DFC_EGRVlvSRCMax" 401 "DFC_EGRVlvSRCMin" 565 "DFC_EGRVlvTempMdlEEPErr" 566 "DFC_EGRVlvTmpErr" 567 "DFC_EGSDUS2B1LtrDly" 568 "DFC_EGSDUS2B1LtrPT1" 569 "DFC_EGSDUS2B1RtlDly" 570 "DFC_EGSDUS2B1RtlPT1" 571 "DFC_EGSDUS2B1TarLean" 572 "DFC_EGSDUS2B1TarRich" 586 "DFC_EngICO" 587 "DFC_EngPrtOvrSpdMon" 573 "DFC_EONVmax" 588 "DFC_EpmCaSI1ErrSig" 589 "DFC_EpmCaSI1MntErr" 590 "DFC_EpmCaSI1NoSigMax" 591 "DFC_EpmCaSI1NoSigMin" 592 "DFC_EpmCaSI1OfsErr" 593 "DFC_EpmCrSDGI" 594 "DFC_EpmCrSErrSig" 595 "DFC_EpmCrSNoSig" 596 "DFC_EtaEngIdleNonCsers" 597 "DFC_EtaEngPtlNonCsers" 574 "DFC_ETAKHLmax" 575 "DFC_ETAKHTmax" 576 "DFC_ETHSEmax" 577 "DFC_ETHSEmin" 578 "DFC_ETHSFmax" 579 "DFC_ETHSFmin" 580 "DFC_ETHSFsig" 581 "DFC_ETHSNPWmax" 582 "DFC_ETHSNPWmin" 583 "DFC_ETHSNPWsig" 584 "DFC_ETHSPLnpl" 585 "DFC_ETHSTPLnpl" 327 "DFC_FanDIOOL_0" 328 "DFC_FanDIOOL_1" 329 "DFC_FanDIOOvrTemp_0" 330 "DFC_FanDIOOvrTemp_1" 331 "DFC_FanDIOSCB_0" 332 "DFC_FanDIOSCB_1" 333 "DFC_FanDIOSCG_0" 334 "DFC_FanDIOSCG_1" 598 "DFC_FRAmax" 599 "DFC_FRAmin" 600 "DFC_FSTEmax" 601 "DFC_FSTEmin" 605 "DFC_FSTmax" 602 "DFC_FSTRmax" 603 "DFC_FSTRmin" 604 "DFC_FSTRnpl" 606 "DFC_FTDLAmax" 607 "DFC_FTDLAmin" 608 "DFC_FuPHiSnsrEleclmax" 609 "DFC_FuPHiSnsrEleclmin" 610 "DFC_FuPHiSnsrEleclnpl" 611 "DFC_FuPHiSnsrURngMax" 612 "DFC_FuPHiSnsrURngMin" 613 "DFC_FuSnsrPhyRngMaxErr" 614 "DFC_FuSnsrPhyRngMinErr" 188 "DFC_GbxCANDigPlausErr" 189 "DFC_GbxNPos1SRCMax" 190 "DFC_GbxNPos1SRCMin" 191 "DFC_GbxNPos2SRCMax" 192 "DFC_GbxNPos2SRCMin" 193 "DFC_GbxNPosAlvChk" 194 "DFC_GbxNPosSyncErr" 413 "DFC_GbxPNPosnDrvCdn" 414 "DFC_GbxPNPosnPlausy" 618 "DFC_GbxRvsSwtStk" 615 "DFC_GEVlvLockPinDiagIntkB1" 184 "DFC_GEVlvPhaCsersIntkB1" 185 "DFC_GEVlvPhaPsOpenLoadIntkB1" 186 "DFC_GEVlvPhaPsShoToBattIntkB1" 187 "DFC_GEVlvPhaPsShoToGndIntkB1" 616 "DFC_GEVlvPhaSlowIntkB1" 617 "DFC_GEVlvPhaTargIntkB1" 619 "DFC_HDRKHmax" 620 "DFC_HDRKHmin" 623 "DFC_HDRmax" 624 "DFC_HDRmin" 621 "DFC_HDRPLmax" 622 "DFC_HDRPLmin" 625 "DFC_HEGOS2B1ElecMax" 626 "DFC_HEGOS2B1ElecMin" 627 "DFC_HEGOS2B1ElecSig" 628 "DFC_HEGOS2B1HtgNpl" 195 "DFC_HEGOS2B1HtrPsMax" 196 "DFC_HEGOS2B1HtrPsMin" 197 "DFC_HEGOS2B1HtrPsSig" 629 "DFC_HEV00max" 630 "DFC_HEV01max" 631 "DFC_HEV02max" 632 "DFC_HEV03max" 633 "DFC_HEVE0max" 634 "DFC_HEVE1max" 635 "DFC_HFMmax" 636 "DFC_HiPSysHiPMaxLimExcdd" 402 "DFC_HLSDemOvhtEngLim" 456 "DFC_I14229VINErr" 261 "DFC_IgnClPs_DevComErr" 262 "DFC_IgnClPs_LineOl_0" 263 "DFC_IgnClPs_LineOl_1" 264 "DFC_IgnClPs_LineOl_2" 265 "DFC_IgnClPs_LineOl_3" 266 "DFC_IgnClPs_LineScb_0" 267 "DFC_IgnClPs_LineScb_1" 268 "DFC_IgnClPs_LineScb_2" 269 "DFC_IgnClPs_LineScb_3" 270 "DFC_IgnClPs_LineScg_0" 271 "DFC_IgnClPs_LineScg_1" 272 "DFC_IgnClPs_LineScg_2" 273 "DFC_IgnClPs_LineScg_3" 457 "DFC_InjCatHeatgErr" 458 "DFC_InjSysMulInjDiagErr" 358 "DFC_InjVlv_DI_DcDc" 359 "DFC_InjVlv_DI_NoLd_0" 360 "DFC_InjVlv_DI_NoLd_1" 361 "DFC_InjVlv_DI_NoLd_2" 362 "DFC_InjVlv_DI_NoLd_3" 363 "DFC_InjVlv_DI_ScBnk_0" 364 "DFC_InjVlv_DI_ScBnk_1" 365 "DFC_InjVlv_DI_ScBnk_2" 366 "DFC_InjVlv_DI_ScBnk_3" 367 "DFC_InjVlv_DI_ScCyl_0" 368 "DFC_InjVlv_DI_ScCyl_1" 369 "DFC_InjVlv_DI_ScCyl_2" 370 "DFC_InjVlv_DI_ScCyl_3" 371 "DFC_InjVlv_DI_ScHsLs_0" 372 "DFC_InjVlv_DI_ScHsLs_1" 373 "DFC_InjVlv_DI_ScHsLs_2" 374 "DFC_InjVlv_DI_ScHsLs_3" 652 "DFC_IntkAirTAirFltDsCrssMax" 653 "DFC_IntkAirTAirFltDsCrssMin" 654 "DFC_IntkAirTAirFltDsHSCMax" 655 "DFC_IntkAirTAirFltDsImps" 656 "DFC_IntkAirTAirFltDsPRCMax" 657 "DFC_IntkAirTAirFltDsPRCMin" 658 "DFC_IntkAirTAirFltDsSRCMax" 659 "DFC_IntkAirTAirFltDsSRCMin" 660 "DFC_IntkAirTAirFltDsSTC" 661 "DFC_IntkAirTIntkMnfldCrssMax" 662 "DFC_IntkAirTIntkMnfldCrssMin" 663 "DFC_IntkAirTIntkMnfldHSCMax" 664 "DFC_IntkAirTIntkMnfldImps" 665 "DFC_IntkAirTIntkMnfldPRCMax" 666 "DFC_IntkAirTIntkMnfldPRCMin" 667 "DFC_IntkAirTIntkMnfldSRCMax" 668 "DFC_IntkAirTIntkMnfldSRCMin" 669 "DFC_IntkAirTIntkMnfldSTC" 647 "DFC_IVGdiCtl_CvoErr" 648 "DFC_IVGdiCtl_CvoSigPlaus_0" 649 "DFC_IVGdiCtl_CvoSigPlaus_1" 650 "DFC_IVGdiCtl_CvoSigPlaus_2" 651 "DFC_IVGdiCtl_CvoSigPlaus_3" 637 "DFC_IVGdiCtlCvoErrMax_0" 638 "DFC_IVGdiCtlCvoErrMax_1" 639 "DFC_IVGdiCtlCvoErrMax_2" 640 "DFC_IVGdiCtlCvoErrMax_3" 641 "DFC_IVGdiCtlCvoErrMin_0" 642 "DFC_IVGdiCtlCvoErrMin_1" 643 "DFC_IVGdiCtlCvoErrMin_2" 644 "DFC_IVGdiCtlCvoErrMin_3" 645 "DFC_IVGdiCtlCvoErrMinMax" 646 "DFC_IVGdiCtlCvoSigPlausErrSmrCdn" 428 "DFC_KnDetSens1PortAMax" 429 "DFC_KnDetSens1PortAMin" 430 "DFC_KnDetSens1PortBMax" 431 "DFC_KnDetSens1PortBMin" 670 "DFC_KRREGRLMX" 671 "DFC_KRVEKOCVLCI" 672 "DFC_KRVEKOENCHMT" 673 "DFC_KRVEKOENCHMT0" 674 "DFC_KRVEKOENCHMT1" 675 "DFC_KRVEKOENCHMT2" 676 "DFC_KRVEKOENCHMT3" 677 "DFC_KRVEKOENCHMT4" 678 "DFC_KRVEKOENCHMT5" 679 "DFC_KRVEKOENCHMT6" 680 "DFC_KRVEKOENCHMT7" 274 "DFC_KRVEKOEVAB" 275 "DFC_KRVEKOEVAB0" 276 "DFC_KRVEKOEVAB1" 277 "DFC_KRVEKOEVAB2" 278 "DFC_KRVEKOEVAB3" 681 "DFC_KRVEKORLMX" 682 "DFC_KRVEKORLMXL" 683 "DFC_KS1max" 684 "DFC_KS1min" 687 "DFC_LamDynDiagS1B1" 688 "DFC_LeakIntkMnfldEmiInfl" 491 "DFC_LIN_E_TIMEOUT" 465 "DFC_LinACGUnit" 466 "DFC_LinAEVUnit" 198 "DFC_LinCSErrACG" 199 "DFC_LinCSErrAEV" 200 "DFC_LinCSErrDCDC" 201 "DFC_LinCSErrEBS" 467 "DFC_LinEBSUnit" 689 "DFC_LinFrameErrDCDC" 202 "DFC_LinHdrTimeoutErrACG" 203 "DFC_LinHdrTimeoutErrAEV" 204 "DFC_LinHdrTimeoutErrDCDC" 205 "DFC_LinHdrTimeoutErrEBS" 206 "DFC_LinMsgTimeoutErrACG" 207 "DFC_LinMsgTimeoutErrAEV" 208 "DFC_LinMsgTimeoutErrDCDC" 209 "DFC_LinMsgTimeoutErrEBS" 210 "DFC_LinNoStrtComErr" 690 "DFC_LinOverrunErrDCDC" 459 "DFC_LLRHmax" 460 "DFC_LLRHmin" 461 "DFC_LLRHnpl" 462 "DFC_LLRKHmax" 463 "DFC_LLRKHmin" 464 "DFC_LLRKHnpl" 685 "DFC_LMmax" 211 "DFC_LowPresOilP" 686 "DFC_LZSRnpl" 691 "DFC_MD00max" 692 "DFC_MDBmax" 693 "DFC_MDCat" 694 "DFC_MDCatCrit" 695 "DFC_MDCatCurr" 696 "DFC_MDCyl_0" 697 "DFC_MDCyl_1" 698 "DFC_MDCyl_2" 699 "DFC_MDCyl_3" 700 "DFC_MDEmi" 701 "DFC_MDEmiStrt" 702 "DFC_MDFco" 705 "DFC_MDmax" 703 "DFC_MDMpl" 704 "DFC_MDSegTiAdpn" 375 "DFC_MfPsDiaOpenLoad1" 376 "DFC_MfPsDiaScHiS1" 377 "DFC_MfPsDiaScHiSLowS1" 378 "DFC_MfPsDiaScLowS1" 706 "DFC_MFuOilMax" 228 "DFC_MisfDetdVWhlFrntLePlaus" 229 "DFC_MisfDetdVWhlFrntRiPlaus" 230 "DFC_MisfDetdVWhlReLePlaus" 231 "DFC_MisfDetdVWhlReRiPlaus" 212 "DFC_MisfDetVWhlFrntLeOORHi" 213 "DFC_MisfDetVWhlFrntLeRatyHi" 214 "DFC_MisfDetVWhlFrntLeRatyLo" 215 "DFC_MisfDetVWhlFrntLeStuck" 216 "DFC_MisfDetVWhlFrntRiOORHi" 217 "DFC_MisfDetVWhlFrntRiRatyHi" 218 "DFC_MisfDetVWhlFrntRiRatyLo" 219 "DFC_MisfDetVWhlFrntRiStuck" 220 "DFC_MisfDetVWhlReLeOORHi" 221 "DFC_MisfDetVWhlReLeRatyHi" 222 "DFC_MisfDetVWhlReLeRatyLo" 223 "DFC_MisfDetVWhlReLeStuck" 224 "DFC_MisfDetVWhlReRiOORHi" 225 "DFC_MisfDetVWhlReRiRatyHi" 226 "DFC_MisfDetVWhlReRiRatyLo" 227 "DFC_MisfDetVWhlReRiStuck" 801 "DFC_MoCADCNTP" 802 "DFC_MoCADCTst" 803 "DFC_MoCSOPICO" 805 "DFC_MoFAirFilgPrdc" 806 "DFC_MoFAirFlCtOffGdi" 807 "DFC_MoFAirFlCylGdi" 808 "DFC_MoFAirFlFF" 809 "DFC_MoFAirFlIn" 810 "DFC_MoFAirFlMixCtlGdiChkAirFl" 811 "DFC_MoFAirFlMixCtlGdiChkCtrl" 812 "DFC_MoFAirFlMode" 804 "DFC_MoFAPP" 813 "DFC_MoFESpd" 814 "DFC_MoFIACo" 815 "DFC_MoFICOL1" 816 "DFC_MoFICOL2" 817 "DFC_MoFStrt" 818 "DFC_MoFTrqCmp" 819 "DFC_MoFTrqCmpMax" 820 "DFC_MoFTrqCmpMin" 821 "DFC_MoFVarPostBldSel" 707 "DFC_MOXEMM_SMU_ALM0_0" 708 "DFC_MOXEMM_SMU_ALM0_1" 709 "DFC_MOXEMM_SMU_ALM0_10" 710 "DFC_MOXEMM_SMU_ALM0_11" 711 "DFC_MOXEMM_SMU_ALM0_13" 712 "DFC_MOXEMM_SMU_ALM0_14" 713 "DFC_MOXEMM_SMU_ALM0_2" 714 "DFC_MOXEMM_SMU_ALM0_22" 715 "DFC_MOXEMM_SMU_ALM0_23" 716 "DFC_MOXEMM_SMU_ALM0_4" 717 "DFC_MOXEMM_SMU_ALM0_5" 718 "DFC_MOXEMM_SMU_ALM0_7" 719 "DFC_MOXEMM_SMU_ALM0_8" 720 "DFC_MOXEMM_SMU_ALM10_16" 721 "DFC_MOXEMM_SMU_ALM10_17" 722 "DFC_MOXEMM_SMU_ALM10_21" 723 "DFC_MOXEMM_SMU_ALM11_0" 724 "DFC_MOXEMM_SMU_ALM11_1" 725 "DFC_MOXEMM_SMU_ALM11_2" 726 "DFC_MOXEMM_SMU_ALM11_3" 727 "DFC_MOXEMM_SMU_ALM11_4" 728 "DFC_MOXEMM_SMU_ALM11_5" 729 "DFC_MOXEMM_SMU_ALM11_8" 730 "DFC_MOXEMM_SMU_ALM11_9" 731 "DFC_MOXEMM_SMU_ALM1_0" 732 "DFC_MOXEMM_SMU_ALM1_1" 733 "DFC_MOXEMM_SMU_ALM1_10" 734 "DFC_MOXEMM_SMU_ALM1_11" 735 "DFC_MOXEMM_SMU_ALM1_13" 736 "DFC_MOXEMM_SMU_ALM1_14" 737 "DFC_MOXEMM_SMU_ALM1_2" 738 "DFC_MOXEMM_SMU_ALM1_22" 739 "DFC_MOXEMM_SMU_ALM1_23" 740 "DFC_MOXEMM_SMU_ALM1_4" 741 "DFC_MOXEMM_SMU_ALM1_5" 742 "DFC_MOXEMM_SMU_ALM1_7" 743 "DFC_MOXEMM_SMU_ALM1_8" 744 "DFC_MOXEMM_SMU_ALM21_0" 745 "DFC_MOXEMM_SMU_ALM21_16" 746 "DFC_MOXEMM_SMU_ALM21_3" 747 "DFC_MOXEMM_SMU_ALM2_1" 748 "DFC_MOXEMM_SMU_ALM2_10" 749 "DFC_MOXEMM_SMU_ALM2_11" 750 "DFC_MOXEMM_SMU_ALM2_13" 751 "DFC_MOXEMM_SMU_ALM2_14" 752 "DFC_MOXEMM_SMU_ALM2_22" 753 "DFC_MOXEMM_SMU_ALM2_23" 754 "DFC_MOXEMM_SMU_ALM2_4" 755 "DFC_MOXEMM_SMU_ALM2_5" 756 "DFC_MOXEMM_SMU_ALM2_7" 757 "DFC_MOXEMM_SMU_ALM2_8" 758 "DFC_MOXEMM_SMU_ALM6_0" 759 "DFC_MOXEMM_SMU_ALM6_11" 760 "DFC_MOXEMM_SMU_ALM6_12" 761 "DFC_MOXEMM_SMU_ALM6_14" 762 "DFC_MOXEMM_SMU_ALM6_15" 763 "DFC_MOXEMM_SMU_ALM6_17" 764 "DFC_MOXEMM_SMU_ALM6_18" 765 "DFC_MOXEMM_SMU_ALM6_20" 766 "DFC_MOXEMM_SMU_ALM6_21" 767 "DFC_MOXEMM_SMU_ALM6_25" 768 "DFC_MOXEMM_SMU_ALM6_4" 769 "DFC_MOXEMM_SMU_ALM6_5" 770 "DFC_MOXEMM_SMU_ALM6_7" 771 "DFC_MOXEMM_SMU_ALM6_8" 772 "DFC_MOXEMM_SMU_ALM7_1" 773 "DFC_MOXEMM_SMU_ALM7_12" 774 "DFC_MOXEMM_SMU_ALM7_13" 775 "DFC_MOXEMM_SMU_ALM7_14" 776 "DFC_MOXEMM_SMU_ALM7_15" 777 "DFC_MOXEMM_SMU_ALM7_16" 778 "DFC_MOXEMM_SMU_ALM7_17" 779 "DFC_MOXEMM_SMU_ALM7_2" 780 "DFC_MOXEMM_SMU_ALM7_20" 781 "DFC_MOXEMM_SMU_ALM7_25" 782 "DFC_MOXEMM_SMU_ALM7_26" 783 "DFC_MOXEMM_SMU_ALM7_28" 784 "DFC_MOXEMM_SMU_ALM7_29" 785 "DFC_MOXEMM_SMU_ALM7_30" 786 "DFC_MOXEMM_SMU_ALM7_31" 787 "DFC_MOXEMM_SMU_ALM8_0" 788 "DFC_MOXEMM_SMU_ALM8_1" 789 "DFC_MOXEMM_SMU_ALM8_10" 790 "DFC_MOXEMM_SMU_ALM8_11" 791 "DFC_MOXEMM_SMU_ALM8_12" 792 "DFC_MOXEMM_SMU_ALM8_16" 793 "DFC_MOXEMM_SMU_ALM8_18" 794 "DFC_MOXEMM_SMU_ALM8_2" 795 "DFC_MOXEMM_SMU_ALM8_3" 796 "DFC_MOXEMM_SMU_ALM8_31" 797 "DFC_MOXEMM_SMU_ALM8_4" 798 "DFC_MOXEMM_SMU_ALM9_0" 799 "DFC_MOXEMM_SMU_ALM9_15" 800 "DFC_MOXEMM_SMU_ALM9_3" 822 "DFC_MoXEMMHwLTMCUFW" 823 "DFC_MoXEMMHwLTMonBIST" 824 "DFC_MoXEMMHwLTRegMonTest" 825 "DFC_MoXEMMHwLTStbySMUAlvTest" 826 "DFC_MoXEMMHwLTTempSens" 827 "DFC_MoXEMMHwLTUCBCfg" 335 "DFC_MRlyDcOL" 336 "DFC_MRlyDcSCB" 337 "DFC_MRlyDcSCG" 492 "DFC_MRlyOL" 493 "DFC_MRlySCB" 494 "DFC_MRlySCG" 828 "DFC_NWSEmax" 829 "DFC_NWSmax" 830 "DFC_OCWDAABEActv" 831 "DFC_OCWDACom" 832 "DFC_OCWDAErrPin" 833 "DFC_OCWDAOvrVltg" 836 "DFC_OilPPlaus" 403 "DFC_OilPSwmpSRCMax" 404 "DFC_OilPSwmpSRCMin" 834 "DFC_ORAmax" 835 "DFC_ORAmin" 847 "DFC_P_VSE11_OL" 848 "DFC_P_VSE11_SCB" 849 "DFC_P_VSE11_SCG" 417 "DFC_PEnvCcMax" 418 "DFC_PEnvCcMin" 419 "DFC_PEnvRngChkMax" 420 "DFC_PEnvRngChkMin" 232 "DFC_PEnvSigRngMax" 233 "DFC_PEnvSigRngMin" 421 "DFC_PEnvSnsrPlaus" 850 "DFC_PhyHighAPP1" 851 "DFC_PhyHighAPP2" 852 "DFC_PhyLowAPP1" 853 "DFC_PhyLowAPP2" 405 "DFC_PIntkVUsLineHiB1" 406 "DFC_PIntkVUsLineLoB1" 837 "DFC_PLLSUmax" 838 "DFC_PLLSUmin" 338 "DFC_PSPOL" 339 "DFC_PSPOvrTemp" 340 "DFC_PSPSCB" 341 "DFC_PSPSCG" 839 "DFC_PSR1max" 840 "DFC_PSRBmax" 841 "DFC_PSRBmin" 845 "DFC_PSRmax" 842 "DFC_PSRPmax" 843 "DFC_PSRPmin" 844 "DFC_PSRPsig" 846 "DFC_PUmax" 475 "DFC_RBA_IODIAGPWR_rba_IoExtCy329_SignalVltSply_0" 476 "DFC_RBA_IODIAGPWR_rba_IoExtCy329_SignalVltSply_0OT" 477 "DFC_RBA_IODIAGPWR_rba_IoExtCy329_SignalVltSply_0OV" 478 "DFC_RBA_IODIAGPWR_rba_IoExtCy329_SignalVltSply_0SCG" 479 "DFC_RBA_IODIAGPWR_rba_IoExtCy329_SignalVltSply_0UV" 480 "DFC_RBA_IODIAGPWR_rba_IoExtCy329_SignalVltSply_1" 481 "DFC_RBA_IODIAGPWR_rba_IoExtCy329_SignalVltSply_1OT" 482 "DFC_RBA_IODIAGPWR_rba_IoExtCy329_SignalVltSply_1OV" 483 "DFC_RBA_IODIAGPWR_rba_IoExtCy329_SignalVltSply_1SCG" 484 "DFC_RBA_IODIAGPWR_rba_IoExtCy329_SignalVltSply_1UV" 485 "DFC_RBA_IODIAGPWR_rba_IoExtCy329_SignalVltSply_2" 486 "DFC_RBA_IODIAGPWR_rba_IoExtCy329_SignalVltSply_2OT" 487 "DFC_RBA_IODIAGPWR_rba_IoExtCy329_SignalVltSply_2OV" 488 "DFC_RBA_IODIAGPWR_rba_IoExtCy329_SignalVltSply_2SCG" 489 "DFC_RBA_IODIAGPWR_rba_IoExtCy329_SignalVltSply_2UV" 498 "DFC_RBA_IOEXTLIB_KEEPALIVE_DRV" 499 "DFC_RBA_IOEXTLIB_KEEPALIVE_INI" 500 "DFC_rba_IoSigRtc_StopCounter" 502 "DFC_rba_MemDiag_MemReadErr" 503 "DFC_rba_MemDiag_MemWrErr" 501 "DFC_rba_MRly_Diag_Stk_Event" 495 "DFC_rba_MultiStackTrace_Threshold" 504 "DFC_rba_SyC_IrrSwOffTrigEngRun_Event" 505 "DFC_rba_T15_Diag_ComInVld_Event" 506 "DFC_rba_T15_Diag_ComOff_HwOn_Event" 507 "DFC_rba_T15_Diag_ComOn_HwOff_Event" 468 "DFC_RoughRoad" 469 "DFC_SiaEEPRdErr" 470 "DFC_SiaEEPWrngCod" 854 "DFC_SRCHighAPP1" 855 "DFC_SRCHighAPP2" 856 "DFC_SRCLowAPP1" 857 "DFC_SRCLowAPP2" 858 "DFC_SSpMon2" 859 "DFC_STHDRmax" 234 "DFC_StmFault" 236 "DFC_StrtCtlErr" 235 "DFC_StrtCtOffPth" 237 "DFC_StrtFault" 238 "DFC_StrtLckJudg1" 239 "DFC_StrtLckJudg2" 240 "DFC_StrtOL" 241 "DFC_StrtOL2" 242 "DFC_StrtSCB" 243 "DFC_StrtSCB2" 244 "DFC_StrtSCG" 245 "DFC_StrtSCG2" 246 "DFC_StrtStkRly1" 247 "DFC_StrtStkRly2" 860 "DFC_SWReset_0" 861 "DFC_SWReset_1" 862 "DFC_SWReset_2" 863 "DFC_SyncAPP" 342 "DFC_T50Err" 865 "DFC_TAmax_Dummy" 864 "DFC_TANKLnpl" 866 "DFC_TESFmax" 867 "DFC_TESGmax" 248 "DFC_TEVEmax" 249 "DFC_TEVEmin" 250 "DFC_TEVEsig" 875 "DFC_ThrVlvClsdPosnFirstOffsLrnImpoB1" 876 "DFC_ThrVlvClsdPosnOffsLrnImpoB1" 877 "DFC_ThrVlvClsdPosnOffsLrnMaxB1" 878 "DFC_ThrVlvClsdPosnOffsLrnMinB1" 879 "DFC_ThrVlvCtrlDeB1" 880 "DFC_ThrVlvDycB1" 881 "DFC_ThrVlvLimpAirPosnMaxAbsltDriftB1" 882 "DFC_ThrVlvLimpAirPosnMaxB1" 883 "DFC_ThrVlvLimpAirPosnMaxRelDriftB1" 884 "DFC_ThrVlvLimpAirPosnMinB1" 343 "DFC_ThrVlvLoBattB1" 885 "DFC_ThrVlvOpenLoadB1" 886 "DFC_ThrVlvOpenSprgB1" 887 "DFC_ThrVlvOpenSprgSprdB1" 888 "DFC_ThrVlvOpenSprgTwnB1" 889 "DFC_ThrVlvOverTB1" 890 "DFC_ThrVlvRetSprgB1" 891 "DFC_ThrVlvRetSprgSprdB1" 892 "DFC_ThrVlvRetSprgTwnB1" 893 "DFC_ThrVlvSens1MaxB1" 900 "DFC_ThrvlvSens1MinB1" 894 "DFC_ThrVlvSens1NplB1" 895 "DFC_ThrVlvSens2MaxB1" 896 "DFC_ThrVlvSens2MinB1" 897 "DFC_ThrVlvSens2NplB1" 898 "DFC_ThrVlvShoCircB1" 899 "DFC_ThrVlvSpiErrB1" 901 "DFC_TiOffTBasdChkFast" 902 "DFC_TiOffTBasdChkSlow" 868 "DFC_TKAEmax" 869 "DFC_TKAEmin" 870 "DFC_TKARmax" 871 "DFC_TKARnpl" 872 "DFC_TMmax_Dummy" 873 "DFC_TUMmax_Dummy" 874 "DFC_TWCDPriCatB1" 251 "DFC_UegoHeatrPrfmncLoS1B1" 422 "DFC_UEGOHeatrRlyPsOLS1B1" 423 "DFC_UEGOHeatrRlyPsSCBS1B1" 424 "DFC_UEGOHeatrRlyPsSCGS1B1" 471 "DFC_UegoHeatrStrtS1B1" 425 "DFC_UegoHeatrWireOlS1B1" 426 "DFC_UegoHeatrWireScbS1B1" 427 "DFC_UegoHeatrWireScgS1B1" 279 "DFC_UegoSigEcuAsicS1B1" 280 "DFC_UegoSigEcuComS1B1" 344 "DFC_UegoSigOperPlausS1B1" 281 "DFC_UegoSigSnsrS1B1" 282 "DFC_UegoSigWireOlApesS1B1" 283 "DFC_UegoSigWireOlIpeS1B1" 284 "DFC_UegoSigWireOlReS1B1" 285 "DFC_UegoSigWireRCmpS1B1" 286 "DFC_UegoSigWireScbS1B1" 287 "DFC_UegoSigWireScgS1B1" 903 "DFC_UEGOSnsrMntdS1B1" 252 "DFC_VehVAllPlaus" 253 "DFC_VehVNCSnsrElecFailr" 345 "DFC_VehVPhysRngHi" 407 "DFC_VehVPhysRngLo" 254 "DFC_VehVPlausCan" 255 "DFC_VehVPlausFco" 256 "DFC_VehVPlausPwr" 257 "DFC_VehVPlausV2N" 346 "DFC_VehVSclOutOL" 347 "DFC_VehVSclOutOT" 348 "DFC_VehVSclOutSCB" 349 "DFC_VehVSclOutSCG" 904 "DFC_VehVSig" 408 "DFC_VehVSigCan" 409 "DFC_VehVSigCanSafe" 350 "DFC_VehVSigFL" 351 "DFC_VehVSigFR" 352 "DFC_VehVSigRL" 353 "DFC_VehVSigRR" 354 "DFC_VehVSnsrARngHi" 355 "DFC_VehVSnsrBRngHi" 356 "DFC_VehVSpdRtyDiag" 258 "DFC_VehVSpdSnsrAElecFailr" 259 "DFC_VehVSpdSnsrBElecFailr" 410 "DFC_VlvLftFbOilPSnsrIntk11SRCMax" 411 "DFC_VlvLftFbOilPSnsrIntk11SRCMin" 905 "DFC_VlvLftFbSwtIntk11SpclFail" 906 "DFC_VlvLftFbSwtIntk11StdFail" DEFAULT_VALUE "---" /end COMPU_VTAB
/begin COMPU_METHOD DFES_OneToOne "" RAT_FUNC "%6.2" "-" COEFFS 0 1 0 0 0 1 /end COMPU_METHOD
/begin RECORD_LAYOUT Val_Wu16 FNC_VALUES 1 UWORD COLUMN_DIR DIRECT /end RECORD_LAYOUT
/begin RECORD_LAYOUT Val_Wu8 FNC_VALUES 1 UBYTE COLUMN_DIR DIRECT /end RECORD_LAYOUT
/end MODULE
/end PROJECT
